## crypto/asymmetric_keys/Kconfig
```kconfig
# SPDX-License-Identifier: GPL-2.0
menuconfig ASYMMETRIC_KEY_TYPE
	bool "Asymmetric (public-key cryptographic) key type"
	depends on KEYS
	help
	  This option provides support for a key type that holds the data for
	  the asymmetric keys used for public key cryptographic operations such
	  as encryption, decryption, signature generation and signature
	  verification.

if ASYMMETRIC_KEY_TYPE

config ASYMMETRIC_PUBLIC_KEY_SUBTYPE
	tristate "Asymmetric public-key crypto algorithm subtype"
	select MPILIB
	select CRYPTO_HASH_INFO
	select CRYPTO_AKCIPHER
	select CRYPTO_SIG
	select CRYPTO_HASH
	help
	  This option provides support for asymmetric public key type handling.
	  If signature generation and/or verification are to be used,
	  appropriate hash algorithms (such as SHA-1) must be available.
	  ENOPKG will be reported if the requisite algorithm is unavailable.

config X509_CERTIFICATE_PARSER
	tristate "X.509 certificate parser"
	depends on ASYMMETRIC_PUBLIC_KEY_SUBTYPE
	select ASN1
	select OID_REGISTRY
	help
	  This option provides support for parsing X.509 format blobs for key
	  data and provides the ability to instantiate a crypto key from a
	  public key packet found inside the certificate.

config PKCS8_PRIVATE_KEY_PARSER
	tristate "PKCS#8 private key parser"
	depends on ASYMMETRIC_PUBLIC_KEY_SUBTYPE
	select ASN1
	select OID_REGISTRY
	help
	  This option provides support for parsing PKCS#8 format blobs for
	  private key data and provides the ability to instantiate a crypto key
	  from that data.

config PKCS7_MESSAGE_PARSER
	tristate "PKCS#7 message parser"
	depends on X509_CERTIFICATE_PARSER
	select CRYPTO_HASH
	select ASN1
	select OID_REGISTRY
	help
	  This option provides support for parsing PKCS#7 format messages for
	  signature data and provides the ability to verify the signature.

config PKCS7_TEST_KEY
	tristate "PKCS#7 testing key type"
	depends on SYSTEM_DATA_VERIFICATION
	help
	  This option provides a type of key that can be loaded up from a
	  PKCS#7 message - provided the message is signed by a trusted key.  If
	  it is, the PKCS#7 wrapper is discarded and reading the key returns
	  just the payload.  If it isn't, adding the key will fail with an
	  error.

	  This is intended for testing the PKCS#7 parser.

config SIGNED_PE_FILE_VERIFICATION
	bool "Support for PE file signature verification"
	depends on PKCS7_MESSAGE_PARSER=y
	depends on SYSTEM_DATA_VERIFICATION
	select CRYPTO_HASH
	select ASN1
	select OID_REGISTRY
	help
	  This option provides support for verifying the signature(s) on a
	  signed PE binary.

config FIPS_SIGNATURE_SELFTEST
	tristate "Run FIPS selftests on the X.509+PKCS7 signature verification"
	help
	  This option causes some selftests to be run on the signature
	  verification code, using some built in data.  This is required
	  for FIPS.
	depends on KEYS
	depends on ASYMMETRIC_KEY_TYPE
	depends on PKCS7_MESSAGE_PARSER=X509_CERTIFICATE_PARSER
	depends on X509_CERTIFICATE_PARSER
	depends on CRYPTO_RSA
	depends on CRYPTO_SHA256

config FIPS_SIGNATURE_SELFTEST_RSA
	bool
	default y
	depends on FIPS_SIGNATURE_SELFTEST
	depends on CRYPTO_SHA256=y || CRYPTO_SHA256=FIPS_SIGNATURE_SELFTEST
	depends on CRYPTO_RSA=y || CRYPTO_RSA=FIPS_SIGNATURE_SELFTEST

config FIPS_SIGNATURE_SELFTEST_ECDSA
	bool
	default y
	depends on FIPS_SIGNATURE_SELFTEST
	depends on CRYPTO_SHA256=y || CRYPTO_SHA256=FIPS_SIGNATURE_SELFTEST
	depends on CRYPTO_ECDSA=y || CRYPTO_ECDSA=FIPS_SIGNATURE_SELFTEST

endif # ASYMMETRIC_KEY_TYPE
```

## crypto/async_tx/Kconfig
```kconfig
# SPDX-License-Identifier: GPL-2.0
config ASYNC_CORE
	tristate

config ASYNC_MEMCPY
	tristate
	select ASYNC_CORE

config ASYNC_XOR
	tristate
	select ASYNC_CORE
	select XOR_BLOCKS

config ASYNC_PQ
	tristate
	select ASYNC_CORE

config ASYNC_RAID6_RECOV
	tristate
	select ASYNC_CORE
	select ASYNC_PQ
	select ASYNC_XOR

config ASYNC_TX_DISABLE_PQ_VAL_DMA
	bool

config ASYNC_TX_DISABLE_XOR_VAL_DMA
	bool
```

## crypto/krb5/Kconfig
```kconfig
config CRYPTO_KRB5
	tristate "Kerberos 5 crypto"
	select CRYPTO_MANAGER
	select CRYPTO_KRB5ENC
	select CRYPTO_AUTHENC
	select CRYPTO_SKCIPHER
	select CRYPTO_HASH_INFO
	select CRYPTO_HMAC
	select CRYPTO_CMAC
	select CRYPTO_SHA1
	select CRYPTO_SHA256
	select CRYPTO_SHA512
	select CRYPTO_CBC
	select CRYPTO_CTS
	select CRYPTO_AES
	select CRYPTO_CAMELLIA
	help
	  Provide a library for provision of Kerberos-5-based crypto.  This is
	  intended for network filesystems to use.

config CRYPTO_KRB5_SELFTESTS
	bool "Kerberos 5 crypto selftests"
	depends on CRYPTO_KRB5
	help
	  Turn on some self-testing for the kerberos 5 crypto functions.  These
	  will be performed on module load or boot, if compiled in.
```

## drivers/Kconfig
```kconfig
# SPDX-License-Identifier: GPL-2.0
menu "Device Drivers"

# Keep I/O buses first

source "drivers/amba/Kconfig"
source "drivers/eisa/Kconfig"
source "drivers/pci/Kconfig"
source "drivers/cxl/Kconfig"
source "drivers/pcmcia/Kconfig"
source "drivers/rapidio/Kconfig"

config PC104
	bool "PC/104 support" if EXPERT
	help
	  Expose PC/104 form factor device drivers and options available for
	  selection and configuration. Enable this option if your target
	  machine has a PC/104 bus.

source "drivers/base/Kconfig"

source "drivers/bus/Kconfig"

source "drivers/cache/Kconfig"

source "drivers/connector/Kconfig"

source "drivers/firmware/Kconfig"

source "drivers/fwctl/Kconfig"

source "drivers/gnss/Kconfig"

source "drivers/mtd/Kconfig"

source "drivers/of/Kconfig"

source "drivers/parport/Kconfig"

source "drivers/pnp/Kconfig"

source "drivers/block/Kconfig"

source "drivers/nvme/Kconfig"

source "drivers/misc/Kconfig"

source "drivers/scsi/Kconfig"

source "drivers/ata/Kconfig"

source "drivers/md/Kconfig"

source "drivers/target/Kconfig"

source "drivers/message/fusion/Kconfig"

source "drivers/firewire/Kconfig"

source "drivers/macintosh/Kconfig"

source "drivers/net/Kconfig"

source "drivers/isdn/Kconfig"

# input before char - char/joystick depends on it. As does USB.

source "drivers/input/Kconfig"

source "drivers/char/Kconfig"

source "drivers/i2c/Kconfig"

source "drivers/i3c/Kconfig"

source "drivers/spi/Kconfig"

source "drivers/spmi/Kconfig"

source "drivers/hsi/Kconfig"

source "drivers/pps/Kconfig"

source "drivers/ptp/Kconfig"

source "drivers/pinctrl/Kconfig"

source "drivers/gpio/Kconfig"

source "drivers/w1/Kconfig"

source "drivers/power/Kconfig"

source "drivers/hwmon/Kconfig"

source "drivers/thermal/Kconfig"

source "drivers/watchdog/Kconfig"

source "drivers/ssb/Kconfig"

source "drivers/bcma/Kconfig"

source "drivers/mfd/Kconfig"

source "drivers/regulator/Kconfig"

source "drivers/media/Kconfig"

source "drivers/video/Kconfig"

source "drivers/accel/Kconfig"

source "sound/Kconfig"

source "drivers/hid/Kconfig"

source "drivers/usb/Kconfig"

source "drivers/mmc/Kconfig"

source "drivers/ufs/Kconfig"

source "drivers/memstick/Kconfig"

source "drivers/leds/Kconfig"

source "drivers/accessibility/Kconfig"

source "drivers/infiniband/Kconfig"

source "drivers/edac/Kconfig"

source "drivers/rtc/Kconfig"

source "drivers/dma/Kconfig"

source "drivers/dma-buf/Kconfig"

source "drivers/dca/Kconfig"

source "drivers/uio/Kconfig"

source "drivers/vfio/Kconfig"

source "drivers/virt/Kconfig"

source "drivers/virtio/Kconfig"

source "drivers/vdpa/Kconfig"

source "drivers/vhost/Kconfig"

source "drivers/hv/Kconfig"

source "drivers/xen/Kconfig"

source "drivers/greybus/Kconfig"

source "drivers/comedi/Kconfig"

source "drivers/staging/Kconfig"

source "drivers/platform/Kconfig"

source "drivers/clk/Kconfig"

source "drivers/hwspinlock/Kconfig"

source "drivers/clocksource/Kconfig"

source "drivers/mailbox/Kconfig"

source "drivers/iommu/Kconfig"

source "drivers/remoteproc/Kconfig"

source "drivers/rpmsg/Kconfig"

source "drivers/soundwire/Kconfig"

source "drivers/soc/Kconfig"

source "drivers/pmdomain/Kconfig"

source "drivers/devfreq/Kconfig"

source "drivers/extcon/Kconfig"

source "drivers/memory/Kconfig"

source "drivers/iio/Kconfig"

source "drivers/ntb/Kconfig"

source "drivers/pwm/Kconfig"

source "drivers/irqchip/Kconfig"

source "drivers/ipack/Kconfig"

source "drivers/reset/Kconfig"

source "drivers/phy/Kconfig"

source "drivers/powercap/Kconfig"

source "drivers/mcb/Kconfig"

source "drivers/perf/Kconfig"

source "drivers/ras/Kconfig"

source "drivers/thunderbolt/Kconfig"

source "drivers/android/Kconfig"

source "drivers/gpu/trace/Kconfig"

source "drivers/nvdimm/Kconfig"

source "drivers/dax/Kconfig"

source "drivers/nvmem/Kconfig"

source "drivers/hwtracing/Kconfig"

source "drivers/fpga/Kconfig"

source "drivers/fsi/Kconfig"

source "drivers/tee/Kconfig"

source "drivers/mux/Kconfig"

source "drivers/opp/Kconfig"

source "drivers/siox/Kconfig"

source "drivers/slimbus/Kconfig"

source "drivers/interconnect/Kconfig"

source "drivers/counter/Kconfig"

source "drivers/most/Kconfig"

source "drivers/peci/Kconfig"

source "drivers/hte/Kconfig"

source "drivers/cdx/Kconfig"

source "drivers/dpll/Kconfig"

endmenu
```

## drivers/accel/Kconfig
```kconfig
# SPDX-License-Identifier: GPL-2.0-only
#
# Compute Acceleration device configuration
#
# This framework provides support for compute acceleration devices, such
# as, but not limited to, Machine-Learning and Deep-Learning acceleration
# devices
#
if DRM

menuconfig DRM_ACCEL
	bool "Compute Acceleration Framework"
	help
	  Framework for device drivers of compute acceleration devices, such
	  as, but not limited to, Machine-Learning and Deep-Learning
	  acceleration devices.
	  If you say Y here, you need to select the module that's right for
	  your acceleration device from the list below.
	  This framework is integrated with the DRM subsystem as compute
	  accelerators and GPUs share a lot in common and can use almost the
	  same infrastructure code.
	  Having said that, acceleration devices will have a different
	  major number than GPUs, and will be exposed to user-space using
	  different device files, called accel/accel* (in /dev, sysfs
	  and debugfs).

source "drivers/accel/habanalabs/Kconfig"
source "drivers/accel/ivpu/Kconfig"

endif
```

## drivers/accel/amdxdna/Kconfig
```kconfig
# SPDX-License-Identifier: GPL-2.0-only

config DRM_ACCEL_AMDXDNA
	tristate "AMD AI Engine"
	depends on AMD_IOMMU
	depends on DRM_ACCEL
	depends on PCI && HAS_IOMEM
	depends on X86_64
	select DRM_SCHED
	select DRM_GEM_SHMEM_HELPER
	select FW_LOADER
	select HMM_MIRROR
	help
	  Choose this option to enable support for NPU integrated into AMD
	  client CPUs like AMD Ryzen AI 300 Series. AMD NPU can be used to
	  accelerate machine learning applications.

	  If "M" is selected, the driver module will be amdxdna.
```

## drivers/accel/ethosu/Kconfig
```kconfig
# SPDX-License-Identifier: GPL-2.0-only

config DRM_ACCEL_ARM_ETHOSU
	tristate "Arm Ethos-U65/U85 NPU"
	depends on HAS_IOMEM
	depends on DRM_ACCEL
	select DRM_GEM_DMA_HELPER
	select DRM_SCHED
	select GENERIC_ALLOCATOR
	help
	  Enables driver for Arm Ethos-U65/U85 NPUs
```

## drivers/accel/habanalabs/Kconfig
```kconfig
# SPDX-License-Identifier: GPL-2.0-only
#
# HabanaLabs AI accelerators driver
#

config DRM_ACCEL_HABANALABS
	tristate "HabanaLabs AI accelerators"
	depends on DRM_ACCEL
	depends on X86 && X86_64
	depends on PCI && HAS_IOMEM
	select GENERIC_ALLOCATOR
	select HWMON
	select DMA_SHARED_BUFFER
	select CRC32
	select FW_LOADER
	help
	  Enables PCIe card driver for Habana's AI Processors (AIP) that are
	  designed to accelerate Deep Learning inference and training workloads.

	  The driver manages the PCIe devices and provides IOCTL interface for
	  the user to submit workloads to the devices.

	  The user-space interface is described in
	  include/uapi/drm/habanalabs_accel.h

	  If unsure, say N.

	  To compile this driver as a module, choose M here: the
	  module will be called habanalabs.

if DRM_ACCEL_HABANALABS

config HL_HLDIO
	bool "Habanalabs NVMe Direct I/O (HLDIO)"
	depends on PCI_P2PDMA
	depends on BLOCK
	help
	  Enable NVMe peer-to-peer direct I/O support for Habanalabs AI
	  accelerators.

	  This allows direct data transfers between NVMe storage devices
	  and Habanalabs accelerators without involving system memory,
	  using PCI peer-to-peer DMA capabilities.

	  Requirements:
	  - CONFIG_PCI_P2PDMA=y
	  - NVMe device and Habanalabs accelerator under same PCI root complex
	  - IOMMU disabled or in passthrough mode
	  - Hardware supporting PCI P2P DMA

	  If unsure, say N
endif # DRM_ACCEL_HABANALABS
```

## drivers/accel/ivpu/Kconfig
```kconfig
# SPDX-License-Identifier: GPL-2.0-only

config DRM_ACCEL_IVPU
	tristate "Intel NPU (Neural Processing Unit)"
	depends on DRM_ACCEL
	depends on X86_64 && !UML
	depends on PCI && PCI_MSI
	select FW_LOADER
	select DRM_GEM_SHMEM_HELPER
	select GENERIC_ALLOCATOR
	select WANT_DEV_COREDUMP
	help
	  Choose this option if you have a system with an 14th generation
	  Intel CPU (Meteor Lake) or newer. Intel NPU (formerly called Intel VPU)
	  is a CPU-integrated inference accelerator for Computer Vision
	  and Deep Learning applications.

	  If "M" is selected, the module will be called intel_vpu.

config DRM_ACCEL_IVPU_DEBUG
	bool "Intel NPU debug mode"
	depends on DRM_ACCEL_IVPU
	help
	  Choose this option to enable additional
	  debug features for the Intel NPU driver:
	  - Always print debug messages regardless of dyndbg config,
	  - Enable unsafe module params.
```
