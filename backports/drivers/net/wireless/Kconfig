## backports/drivers/net/wireless/ath/carl9170/Kconfig
```kconfig
config BACKPORT_CARL9170
	tristate "Linux Community AR9170 802.11n USB support"
	depends on !CARL9170
	depends on USB && BACKPORT_MAC80211
	select BACKPORT_ATH_COMMON
	depends on FW_LOADER
	depends on CRC32
	help
	  This is another driver for the Atheros "otus" 802.11n USB devices.

	  This driver provides more features than the original,
	  but it needs a special firmware (carl9170-1.fw) to do that.

	  The firmware can be downloaded from our wiki here:
	  <http://wireless.kernel.org/en/users/Drivers/carl9170>

	  If you choose to build a module, it'll be called carl9170.

config BACKPORT_CARL9170_LEDS
	bool "SoftLED Support"
	depends on !CARL9170_LEDS
	depends on BACKPORT_CARL9170
	select BACKPORT_MAC80211_LEDS
	depends on LEDS_CLASS
	depends on NEW_LEDS
	default y
	help
	  This option is necessary, if you want your device' LEDs to blink

	  Say Y, unless you need the LEDs for firmware debugging.

config BACKPORT_CARL9170_DEBUGFS
	bool "DebugFS Support"
	depends on !CARL9170_DEBUGFS
	depends on CARL9170 && DEBUG_FS && BACKPORT_MAC80211_DEBUGFS
	default n
	help
	  Export several driver and device internals to user space.

	  Say N.

config BACKPORT_CARL9170_WPC
	bool
	depends on !CARL9170_WPC
	depends on BACKPORT_CARL9170 && (INPUT = y || INPUT = BACKPORT_CARL9170)
	default y

config BACKPORT_CARL9170_HWRNG
        bool "Random number generator"
	depends on !CARL9170_HWRNG
        depends on BACKPORT_CARL9170 && (HW_RANDOM = y || HW_RANDOM = BACKPORT_CARL9170)
        default n
	help
	  Provides a hardware random number generator to the kernel.

	  SECURITY WARNING: It's relatively easy to eavesdrop all
	  generated random numbers from the transport stream with
	  usbmon [software] or special usb sniffer hardware.

	  Say N, unless your setup[i.e.: embedded system] has no
	  other rng source and you can afford to take the risk.
```

## backports/drivers/net/wireless/ath/wcn36xx/Kconfig
```kconfig
config BACKPORT_WCN36XX
	tristate "Qualcomm Atheros WCN3660/3680 support"
	depends on !WCN36XX
	depends on BACKPORT_MAC80211 && HAS_DMA
	---help---
	  This module adds support for wireless adapters based on
	  Qualcomm Atheros WCN3660 and WCN3680 mobile chipsets.

	  If you choose to build a module, it'll be called wcn36xx.

config BACKPORT_WCN36XX_DEBUGFS
	bool "WCN36XX debugfs support"
	depends on !WCN36XX_DEBUGFS
	depends on BACKPORT_WCN36XX
	---help---
	  Enabled debugfs support

	  If unsure, say Y to make it easier to debug problems.
```

## backports/drivers/net/wireless/b43/Kconfig
```kconfig
config BACKPORT_B43
	tristate "Broadcom 43xx wireless support (mac80211 stack)"
	depends on !B43
	depends on (BCMA_POSSIBLE || SSB_POSSIBLE) && BACKPORT_MAC80211 && HAS_DMA
	select BCMA if BACKPORT_B43_BCMA
	select SSB if BACKPORT_B43_SSB
	select FW_LOADER
	---help---
	  b43 is a driver for the Broadcom 43xx series wireless devices.

	  Check "lspci" for something like
	  "Broadcom Corporation BCM43XX 802.11 Wireless LAN Controller"
	  to determine whether you own such a device.

	  This driver supports the new BCM43xx IEEE 802.11G devices, but not
	  the old IEEE 802.11B devices. Old devices are supported by
	  the b43legacy driver.
	  Note that this has nothing to do with the standard that your AccessPoint
	  supports (A, B, G or a combination).
	  IEEE 802.11G devices can talk to IEEE 802.11B AccessPoints.

	  It is safe to include both b43 and b43legacy as the underlying glue
	  layer will automatically load the correct version for your device.

	  This driver uses V4 firmware, which must be installed separately using
	  b43-fwcutter.

	  This driver can be built as a module (recommended) that will be called "b43".
	  If unsure, say M.

config BACKPORT_B43_BCMA
	bool
	depends on !B43_BCMA

config BACKPORT_B43_SSB
	bool
	depends on !B43_SSB

choice
	prompt "Supported bus types"
	depends on BACKPORT_B43
	default BACKPORT_B43_BUSES_BCMA_AND_SSB

config BACKPORT_B43_BUSES_BCMA_AND_SSB
	bool "BCMA and SSB"
	depends on !B43_BUSES_BCMA_AND_SSB
	depends on BCMA_POSSIBLE && BACKPORT_SSB_POSSIBLE
	select BACKPORT_B43_BCMA
	select BACKPORT_B43_SSB

config BACKPORT_B43_BUSES_BCMA
	bool "BCMA only"
	depends on !B43_BUSES_BCMA
	depends on BACKPORT_BCMA_POSSIBLE
	select BACKPORT_B43_BCMA

config BACKPORT_B43_BUSES_SSB
	bool "SSB only"
	depends on !B43_BUSES_SSB
	depends on BACKPORT_SSB_POSSIBLE
	select BACKPORT_B43_SSB

endchoice

# Auto-select BACKPORT_SSB PCI-HOST support, if possible
config BACKPORT_B43_PCI_AUTOSELECT
	bool
	depends on !B43_PCI_AUTOSELECT
	depends on BACKPORT_B43 && SSB_PCIHOST_POSSIBLE
	select BACKPORT_SSB_PCIHOST
	select SSB_B43_PCI_BRIDGE
	default y

# Auto-select BACKPORT_SSB PCICORE driver, if possible
config BACKPORT_B43_PCICORE_AUTOSELECT
	bool
	depends on !B43_PCICORE_AUTOSELECT
	depends on BACKPORT_B43 && SSB_DRIVER_PCICORE_POSSIBLE
	select BACKPORT_SSB_DRIVER_PCICORE
	default y

config BACKPORT_B43_PCMCIA
	bool "Broadcom 43xx PCMCIA device support"
	depends on !B43_PCMCIA
	depends on BACKPORT_B43 && BACKPORT_B43_SSB && SSB_PCMCIAHOST_POSSIBLE
	select BACKPORT_SSB_PCMCIAHOST
	---help---
	  Broadcom 43xx PCMCIA device support.

	  Support for 16bit PCMCIA devices.
	  Please note that most PC-CARD devices are _NOT_ 16bit PCMCIA
	  devices, but 32bit CardBUS devices. CardBUS devices are supported
	  out of the box by b43.

	  With this config option you can drive b43 cards in
	  CompactFlash formfactor in a PCMCIA adaptor.
	  CF b43 cards can sometimes be found in handheld PCs.

	  It's safe to select Y here, even if you don't have a BACKPORT_B43 PCMCIA device.

	  If unsure, say N.

config BACKPORT_B43_SDIO
	bool "Broadcom 43xx SDIO device support"
	depends on !B43_SDIO
	depends on BACKPORT_B43 && BACKPORT_B43_SSB && SSB_SDIOHOST_POSSIBLE
	select BACKPORT_SSB_SDIOHOST
	---help---
	  Broadcom 43xx device support for Soft-MAC SDIO devices.

	  With this config option you can drive Soft-MAC b43 cards with a
	  Secure Digital I/O interface.
	  This includes the BACKPORT_WLAN daughter card found on the Nintendo Wii
	  video game console.
	  Note that this does not support Broadcom 43xx Full-MAC devices.

	  It's safe to select Y here, even if you don't have a BACKPORT_B43 SDIO device.

	  If unsure, say N.

#Data transfers to the device via PIO. We want it as a fallback even
# if we can do DMA.
config BACKPORT_B43_BCMA_PIO
	bool
	depends on !B43_BCMA_PIO
	depends on BACKPORT_B43 && BACKPORT_B43_BCMA
	select BACKPORT_BCMA_BLOCKIO
	default y

config BACKPORT_B43_PIO
	bool
	depends on !B43_PIO
	depends on BACKPORT_B43 && BACKPORT_B43_SSB
	select BACKPORT_SSB_BLOCKIO
	default y

config BACKPORT_B43_PHY_G
	bool "Support for G-PHY (802.11g) devices"
	depends on !B43_PHY_G
	depends on BACKPORT_B43 && BACKPORT_B43_SSB
	default y
	---help---
	  This PHY type can be found in the following chipsets:
	  PCI: BCM4306, BCM4311, BCM4318
	  SoC: BCM4712, BCM5352E

config BACKPORT_B43_PHY_N
	bool "Support for N-PHY (the main 802.11n series) devices"
	depends on !B43_PHY_N
	depends on BACKPORT_B43
	default y
	---help---
	  This PHY type can be found in the following chipsets:
	  PCI: BCM4321, BCM4322,
	       BCM43222, BCM43224, BCM43225,
	       BCM43131, BCM43217, BCM43227, BCM43228
	  SoC: BCM4716, BCM4717, BCM4718, BCM5356, BCM5357, BCM5358

config BACKPORT_B43_PHY_LP
	bool "Support for LP-PHY (low-power 802.11g) devices"
	depends on !B43_PHY_LP
	depends on BACKPORT_B43 && BACKPORT_B43_SSB
	default y
	---help---
	  The LP-PHY is a low-power PHY built into some notebooks
	  and embedded devices. It supports 802.11a/b/g
	  (802.11a support is optional, and currently disabled).

config BACKPORT_B43_PHY_HT
	bool "Support for HT-PHY (high throughput 802.11n) devices"
	depends on !B43_PHY_HT
	depends on BACKPORT_B43 && BACKPORT_B43_BCMA
	default y
	---help---
	  This PHY type with 3x3:3 MIMO can be found in the BCM4331 PCI chipset.

config BACKPORT_B43_PHY_LCN
	bool "Support for LCN-PHY devices (BROKEN)"
	depends on !B43_PHY_LCN
	depends on BACKPORT_B43 && BROKEN
	---help---
	  Support for the LCN-PHY.

	  Say N, this is BROKEN and crashes driver.

# This config option automatically enables b43 LEDS support,
# if it's possible.
config BACKPORT_B43_LEDS
	bool
	depends on !B43_LEDS
	depends on B43 && BACKPORT_MAC80211_LEDS && (LEDS_CLASS = y || LEDS_CLASS = B43)
	default y

# This config option automatically enables b43 HW-RNG support,
# if the HW-RNG core is enabled.
config BACKPORT_B43_HWRNG
	bool
	depends on !B43_HWRNG
	depends on BACKPORT_B43 && (HW_RANDOM = y || HW_RANDOM = BACKPORT_B43)
	default y

config BACKPORT_B43_DEBUG
	bool "Broadcom 43xx debugging"
	depends on !B43_DEBUG
	depends on BACKPORT_B43
	---help---
	  Broadcom 43xx debugging.

	  This adds additional runtime sanity checks and statistics to the driver.
	  These checks and statistics might be expensive and hurt the runtime
	  performance of your system.
	  This also adds the b43 debugfs interface.

	  Do not enable this, unless you are debugging the driver.

	  Say N, if you are a distributor or user building a release kernel
	  for production use.
	  Only say Y, if you are debugging a problem in the b43 driver sourcecode.
```

## backports/drivers/net/wireless/brcm80211/Kconfig
```kconfig
config BACKPORT_BRCMUTIL
	tristate
	depends on !BRCMUTIL

config BACKPORT_BRCMSMAC
	tristate "Broadcom IEEE802.11n PCIe SoftMAC WLAN driver"
	depends on !BRCMSMAC
	depends on BACKPORT_MAC80211
	depends on BACKPORT_BCMA_POSSIBLE
	select BACKPORT_BCMA
	select NEW_LEDS if BACKPORT_BCMA_DRIVER_GPIO
	select LEDS_CLASS if BACKPORT_BCMA_DRIVER_GPIO
	select BACKPORT_BRCMUTIL
	depends on FW_LOADER
	depends on CORDIC
	---help---
	  This module adds support for PCIe wireless adapters based on Broadcom
	  IEEE802.11n SoftMAC chipsets. It also has BACKPORT_WLAN led support, which will
	  be available if you select BACKPORT_BCMA_DRIVER_GPIO. If you choose to build a
	  module, the driver will be called brcmsmac.ko.

config BACKPORT_BRCMFMAC
	tristate "Broadcom IEEE802.11n embedded FullMAC WLAN driver"
	depends on !BRCMFMAC
	depends on BACKPORT_CFG80211
	select BACKPORT_BRCMUTIL
	---help---
	  This module adds support for embedded wireless adapters based on
	  Broadcom IEEE802.11n FullMAC chipsets. It has to work with at least
	  one of the bus interface support. If you choose to build a module,
	  it'll be called brcmfmac.ko.

config BACKPORT_BRCMFMAC_PROTO_BCDC
	bool
	depends on !BRCMFMAC_PROTO_BCDC

config BACKPORT_BRCMFMAC_PROTO_MSGBUF
	bool
	depends on !BRCMFMAC_PROTO_MSGBUF

config BACKPORT_BRCMFMAC_SDIO
	bool "SDIO bus interface support for FullMAC driver"
	depends on !BRCMFMAC_SDIO
	depends on (MMC = y || MMC = BACKPORT_BRCMFMAC)
	depends on BACKPORT_BRCMFMAC
	select BACKPORT_BRCMFMAC_PROTO_BCDC
	depends on FW_LOADER
	default y
	---help---
	  This option enables the SDIO bus interface support for Broadcom
	  IEEE802.11n embedded FullMAC BACKPORT_WLAN driver. Say Y if you want to
	  use the driver for a SDIO wireless card.

config BACKPORT_BRCMFMAC_USB
	bool "USB bus interface support for FullMAC driver"
	depends on !BRCMFMAC_USB
	depends on (USB = y || USB = BACKPORT_BRCMFMAC)
	depends on BACKPORT_BRCMFMAC
	select BACKPORT_BRCMFMAC_PROTO_BCDC
	depends on FW_LOADER
	---help---
	  This option enables the USB bus interface support for Broadcom
	  IEEE802.11n embedded FullMAC BACKPORT_WLAN driver. Say Y if you want to
	  use the driver for an USB wireless card.

config BACKPORT_BRCMFMAC_PCIE
	bool "PCIE bus interface support for FullMAC driver"
	depends on !BRCMFMAC_PCIE
	depends on BACKPORT_BRCMFMAC
	depends on PCI
	depends on HAS_DMA
	select BACKPORT_BRCMFMAC_PROTO_MSGBUF
	depends on FW_LOADER
	---help---
	  This option enables the PCIE bus interface support for Broadcom
	  IEEE802.11ac embedded FullMAC BACKPORT_WLAN driver. Say Y if you want to
	  use the driver for an PCIE wireless card.

config BACKPORT_BRCM_TRACING
	bool "Broadcom device tracing"
	depends on !BRCM_TRACING
	depends on BACKPORT_BRCMSMAC || BRCMFMAC
	---help---
	  If you say Y here, the Broadcom wireless drivers will register
	  with ftrace to dump event information into the trace ringbuffer.
	  Tracing can be enabled at runtime to aid in debugging wireless
	  issues. This option adds a small amount of overhead when tracing
	  is disabled. If unsure, say Y to allow developers to better help
	  you when wireless problems occur.

config BACKPORT_BRCMDBG
	bool "Broadcom driver debug functions"
	depends on !BRCMDBG
	depends on BACKPORT_BRCMSMAC || BRCMFMAC
	---help---
	  Selecting this enables additional code for debug purposes.
```

## backports/drivers/net/wireless/cw1200/Kconfig
```kconfig
config BACKPORT_CW1200
	tristate "CW1200 WLAN support"
	depends on !CW1200
	depends on MAC80211 && BACKPORT_CFG80211
	help
	  This is a driver for the ST-E CW1100 & CW1200 BACKPORT_WLAN chipsets.
	  This option just enables the driver core, see below for
	  specific bus support.

if BACKPORT_CW1200

config BACKPORT_CW1200_WLAN_SDIO
	tristate "Support SDIO platforms"
	depends on !CW1200_WLAN_SDIO
	depends on BACKPORT_CW1200 && MMC
	help
	  Enable support for the BACKPORT_CW1200 connected via an SDIO bus.
	  By default this driver only supports the Sagrad SG901-1091/1098 EVK
	  and similar designs that utilize a hardware reset circuit. To
	  support different BACKPORT_CW1200 SDIO designs you will need to override
	  the default platform data by calling cw1200_sdio_set_platform_data()
	  in your board setup file.

config BACKPORT_CW1200_WLAN_SPI
	tristate "Support SPI platforms"
	depends on !CW1200_WLAN_SPI
	depends on BACKPORT_CW1200 && SPI
	help
	  Enables support for the BACKPORT_CW1200 connected via a SPI bus.  You will
	  need to add appropriate platform data glue in your board setup
	  file.

endif
```
