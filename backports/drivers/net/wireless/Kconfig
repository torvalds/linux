## backports/drivers/net/wireless/ti/wlcore/Kconfig
```kconfig
config BACKPORT_WLCORE
	tristate "TI wlcore support"
	depends on !WLCORE
	depends on WL_TI && BACKPORT_MAC80211
	depends on FW_LOADER
	---help---
	  This module contains the main code for TI BACKPORT_WLAN chips.  It abstracts
	  hardware-specific differences among different chipset families.
	  Each chipset family needs to implement its own lower-level module
	  that will depend on this module for the common code.

	  If you choose to build a module, it will be called wlcore. Say N if
	  unsure.

config BACKPORT_WLCORE_SPI
	tristate "TI wlcore SPI support"
	depends on !WLCORE_SPI
	depends on BACKPORT_WLCORE && SPI_MASTER
	depends on CRC7
	---help---
	  This module adds support for the SPI interface of adapters using
	  TI BACKPORT_WLAN chipsets.  Select this if your platform is using
	  the SPI bus.

	  If you choose to build a module, it'll be called wlcore_spi.
	  Say N if unsure.

config BACKPORT_WLCORE_SDIO
	tristate "TI wlcore SDIO support"
	depends on !WLCORE_SDIO
	depends on BACKPORT_WLCORE && MMC
	---help---
	  This module adds support for the SDIO interface of adapters using
	  TI BACKPORT_WLAN chipsets.  Select this if your platform is using
	  the SDIO bus.

	  If you choose to build a module, it'll be called wlcore_sdio.
	  Say N if unsure.
```

## backports/drivers/net/wireless/zd1211rw/Kconfig
```kconfig
config BACKPORT_ZD1211RW
	tristate "ZyDAS ZD1211/ZD1211B USB-wireless support"
	depends on !ZD1211RW
	depends on USB && BACKPORT_MAC80211
	depends on FW_LOADER
	---help---
	  This is a driver for the ZyDAS ZD1211/ZD1211B wireless
	  chip, present in many USB-wireless adapters.

	  Device firmware is required alongside this driver. You can download
	  the firmware distribution from http://sf.net/projects/zd1211/files/

config BACKPORT_ZD1211RW_DEBUG
	bool "ZyDAS ZD1211 debugging"
	depends on !ZD1211RW_DEBUG
	depends on BACKPORT_ZD1211RW
	---help---
	  ZD1211 debugging messages. Choosing Y will result in additional debug
	  messages being saved to your kernel logs, which may help debug any
	  problems.
```

## backports/drivers/nfc/Kconfig
```kconfig
#
# Near Field Communication (NFC) devices
#

menu "Near Field Communication (NFC) devices"
	depends on BACKPORT_NFC

config BACKPORT_NFC_PN533
	tristate "NXP PN533 USB driver"
	depends on !NFC_PN533
	depends on USB
	help
	  NXP PN533 USB driver.
	  This driver provides support for BACKPORT_NFC NXP PN533 devices.

	  Say Y here to compile support for PN533 devices into the
	  kernel or say M to compile it as module (pn533).

config BACKPORT_NFC_WILINK
	tristate "Texas Instruments NFC WiLink driver"
	depends on !NFC_WILINK
	depends on TI_ST && BACKPORT_NFC_NCI
	help
	  This enables the NFC driver for Texas Instrument's BACKPORT_BT/FM/GPS/NFC
	  combo devices. This makes use of shared transport line discipline
	  core driver to communicate with the BACKPORT_NFC core of the combo chip.

	  Say Y here to compile support for Texas Instrument's BACKPORT_NFC WiLink driver
	  into the kernel or say M to compile it as module.

config BACKPORT_NFC_TRF7970A
	tristate "Texas Instruments TRF7970a NFC driver"
	depends on !NFC_TRF7970A
	depends on SPI && BACKPORT_NFC_DIGITAL
	help
	  This option enables the BACKPORT_NFC driver for Texas Instruments' TRF7970a
	  device. Such device supports 5 different protocols: ISO14443A,
	  ISO14443B, FeLiCa, ISO15693 and ISO18000-3.

	  Say Y here to compile support for TRF7970a into the kernel or
	  say M  to compile it as a module. The module will be called
	  trf7970a.ko.

config BACKPORT_NFC_MEI_PHY
	tristate "MEI bus NFC device support"
	depends on !NFC_MEI_PHY
	depends on INTEL_MEI && BACKPORT_NFC_HCI
	help
	  This adds support to use an mei bus nfc device. Select this if you
	  will use an HCI BACKPORT_NFC driver for an BACKPORT_NFC chip connected behind an
	  Intel's Management Engine chip.

	  If unsure, say N.

config BACKPORT_NFC_SIM
	tristate "NFC hardware simulator driver"
	depends on !NFC_SIM
	help
	  This driver declares two virtual BACKPORT_NFC devices supporting BACKPORT_NFC-DEP
	  protocol. An LLCP connection can be established between them and
	  all packets sent from one device is sent back to the other, acting as
	  loopback devices.

	  If unsure, say N.

config BACKPORT_NFC_PORT100
	tristate "Sony NFC Port-100 Series USB device support"
	depends on !NFC_PORT100
	depends on USB
	depends on BACKPORT_NFC_DIGITAL
	help
	  This adds support for Sony Port-100 chip based USB devices such as the
	  RC-S380 dongle.

	  If unsure, say N.

source "$BACKPORT_DIR/drivers/nfc/pn544/Kconfig"
source "$BACKPORT_DIR/drivers/nfc/microread/Kconfig"
source "$BACKPORT_DIR/drivers/nfc/nfcmrvl/Kconfig"
source "$BACKPORT_DIR/drivers/nfc/st21nfca/Kconfig"
source "$BACKPORT_DIR/drivers/nfc/st21nfcb/Kconfig"
endmenu
```

## backports/drivers/nfc/microread/Kconfig
```kconfig
config BACKPORT_NFC_MICROREAD
	tristate "Inside Secure microread NFC driver"
	depends on !NFC_MICROREAD
	depends on BACKPORT_NFC_HCI
	depends on CRC_CCITT
	default n
	---help---
	  This module contains the main code for Inside Secure microread
	  BACKPORT_NFC chipsets. It implements the chipset HCI logic and hooks into
	  the BACKPORT_NFC kernel APIs. Physical layers will register against it.

	  To compile this driver as a module, choose m here. The module will
	  be called microread.
	  Say N if unsure.

config BACKPORT_NFC_MICROREAD_I2C
	tristate "NFC Microread i2c support"
	depends on !NFC_MICROREAD_I2C
	depends on BACKPORT_NFC_MICROREAD && I2C && BACKPORT_NFC_SHDLC
	---help---
	  This module adds support for the i2c interface of adapters using
	  Inside microread chipsets.  Select this if your platform is using
	  the i2c bus.

	  If you choose to build a module, it'll be called microread_i2c.
	  Say N if unsure.

config BACKPORT_NFC_MICROREAD_MEI
	tristate "NFC Microread MEI support"
	depends on !NFC_MICROREAD_MEI
	depends on BACKPORT_NFC_MICROREAD && BACKPORT_NFC_MEI_PHY
	---help---
	  This module adds support for the mei interface of adapters using
	  Inside microread chipsets.  Select this if your microread chipset
	  is handled by Intel's Management Engine Interface on your platform.

	  If you choose to build a module, it'll be called microread_mei.
	  Say N if unsure.
```

## backports/drivers/nfc/nfcmrvl/Kconfig
```kconfig
config BACKPORT_NFC_MRVL
	tristate "Marvell NFC driver support"
	depends on !NFC_MRVL
	depends on BACKPORT_NFC_NCI
	help
	  The core driver to support Marvell BACKPORT_NFC devices.

	  This driver is required if you want to support
	  Marvell BACKPORT_NFC device 8897.

	  Say Y here to compile Marvell BACKPORT_NFC driver into the kernel or
	  say M to compile it as module.

config BACKPORT_NFC_MRVL_USB
	tristate "Marvell NFC-over-USB driver"
	depends on !NFC_MRVL_USB
	depends on BACKPORT_NFC_MRVL && USB
	help
	  Marvell BACKPORT_NFC-over-USB driver.

	  This driver provides support for Marvell BACKPORT_NFC-over-USB devices:
          8897.

	  Say Y here to compile support for Marvell BACKPORT_NFC-over-USB driver
	  into the kernel or say M to compile it as module.
```

## backports/drivers/nfc/pn544/Kconfig
```kconfig
config BACKPORT_NFC_PN544
	tristate "NXP PN544 NFC driver"
	depends on !NFC_PN544
	depends on BACKPORT_NFC_HCI
	depends on CRC_CCITT
	default n
	---help---
	  NXP PN544 core driver.
	  This is a driver based on the HCI BACKPORT_NFC kernel layers and
	  will thus not work with NXP libnfc library.

	  To compile this driver as a module, choose m here. The module will
	  be called pn544.
	  Say N if unsure.

config BACKPORT_NFC_PN544_I2C
	tristate "NFC PN544 i2c support"
	depends on !NFC_PN544_I2C
	depends on BACKPORT_NFC_PN544 && I2C && BACKPORT_NFC_SHDLC
	---help---
	  This module adds support for the NXP pn544 i2c interface.
	  Select this if your platform is using the i2c bus.

	  If you choose to build a module, it'll be called pn544_i2c.
	  Say N if unsure.

config BACKPORT_NFC_PN544_MEI
	tristate "NFC PN544 MEI support"
	depends on !NFC_PN544_MEI
	depends on BACKPORT_NFC_PN544 && BACKPORT_NFC_MEI_PHY
	---help---
	  This module adds support for the mei interface of adapters using
	  NXP pn544 chipsets.  Select this if your pn544 chipset
	  is handled by Intel's Management Engine Interface on your platform.

	  If you choose to build a module, it'll be called pn544_mei.
	  Say N if unsure.
```
