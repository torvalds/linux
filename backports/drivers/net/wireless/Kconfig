## backports/drivers/net/wireless/ipw2x00/Kconfig
```kconfig
#
# Intel Centrino wireless drivers
#

config BACKPORT_IPW2100
	tristate "Intel PRO/Wireless 2100 Network Connection"
	depends on !IPW2100
	depends on PCI && BACKPORT_CFG80211
	depends on WIRELESS_EXT
	depends on WEXT_SPY
	depends on WEXT_PRIV
	depends on FW_LOADER
	select BACKPORT_LIB80211
	select BACKPORT_LIBIPW
	---help---
          A driver for the Intel PRO/Wireless 2100 Network 
	  Connection 802.11b wireless network adapter.

          See <file:Documentation/networking/README.ipw2100> for information on
          the capabilities currently enabled in this driver and for tips
          for debugging issues and problems.

	  In order to use this driver, you will need a firmware image for it.
          You can obtain the firmware from
	  <http://ipw2100.sf.net/>.  Once you have the firmware image, you 
	  will need to place it in /lib/firmware.

          You will also very likely need the Wireless Tools in order to
          configure your card:

          <http://www.hpl.hp.com/personal/Jean_Tourrilhes/Linux/Tools.html>.

          It is recommended that you compile this driver as a module (M)
          rather than built-in (Y). This driver requires firmware at device
          initialization time, and when built-in this typically happens
          before the filesystem is accessible (hence firmware will be
          unavailable and initialization will fail). If you do choose to build
          this driver into your kernel image, you can avoid this problem by
          including the firmware and a firmware loader in an initramfs.
 
config BACKPORT_IPW2100_MONITOR
        bool "Enable promiscuous mode"
	depends on !IPW2100_MONITOR
        depends on BACKPORT_IPW2100
        ---help---
	  Enables promiscuous/monitor mode support for the ipw2100 driver.
	  With this feature compiled into the driver, you can switch to 
	  promiscuous mode via the Wireless Tool's Monitor mode.  While in this
	  mode, no packets can be sent.

config BACKPORT_IPW2100_DEBUG
	bool "Enable full debugging output in IPW2100 module."
	depends on !IPW2100_DEBUG
	depends on BACKPORT_IPW2100
	---help---
	  This option will enable debug tracing output for the BACKPORT_IPW2100.  

	  This will result in the kernel module being ~60k larger.  You can 
	  control which debug output is sent to the kernel log by setting the 
	  value in 

	  /sys/bus/pci/drivers/ipw2100/debug_level

	  This entry will only exist if this option is enabled.

	  If you are not trying to debug or develop the BACKPORT_IPW2100 driver, you 
	  most likely want to say N here.

config BACKPORT_IPW2200
	tristate "Intel PRO/Wireless 2200BG and 2915ABG Network Connection"
	depends on !IPW2200
	depends on PCI && BACKPORT_CFG80211
	select BACKPORT_CFG80211_WEXT
	depends on WIRELESS_EXT
	depends on WEXT_SPY
	depends on WEXT_PRIV
	depends on FW_LOADER
	select BACKPORT_LIB80211
	select BACKPORT_LIBIPW
	---help---
          A driver for the Intel PRO/Wireless 2200BG and 2915ABG Network
	  Connection adapters. 

          See <file:Documentation/networking/README.ipw2200> for 
	  information on the capabilities currently enabled in this 
	  driver and for tips for debugging issues and problems.

	  In order to use this driver, you will need a firmware image for it.
          You can obtain the firmware from
	  <http://ipw2200.sf.net/>.  See the above referenced README.ipw2200 
	  for information on where to install the firmware images.

          You will also very likely need the Wireless Tools in order to
          configure your card:

          <http://www.hpl.hp.com/personal/Jean_Tourrilhes/Linux/Tools.html>.

          It is recommended that you compile this driver as a module (M)
          rather than built-in (Y). This driver requires firmware at device
          initialization time, and when built-in this typically happens
          before the filesystem is accessible (hence firmware will be
          unavailable and initialization will fail). If you do choose to build
          this driver into your kernel image, you can avoid this problem by
          including the firmware and a firmware loader in an initramfs.

config BACKPORT_IPW2200_MONITOR
        bool "Enable promiscuous mode"
	depends on !IPW2200_MONITOR
        depends on BACKPORT_IPW2200
        ---help---
	  Enables promiscuous/monitor mode support for the ipw2200 driver.
	  With this feature compiled into the driver, you can switch to 
	  promiscuous mode via the Wireless Tool's Monitor mode.  While in this
	  mode, no packets can be sent.

config BACKPORT_IPW2200_RADIOTAP
	bool "Enable radiotap format 802.11 raw packet support"
	depends on !IPW2200_RADIOTAP
	depends on BACKPORT_IPW2200_MONITOR

config BACKPORT_IPW2200_PROMISCUOUS
	bool "Enable creation of a RF radiotap promiscuous interface"
	depends on !IPW2200_PROMISCUOUS
	depends on BACKPORT_IPW2200_MONITOR
	select BACKPORT_IPW2200_RADIOTAP
	---help---
          Enables the creation of a second interface prefixed 'rtap'. 
          This second interface will provide every received in radiotap
	  format.

          This is useful for performing wireless network analysis while
          maintaining an active association.

          Example usage:

            % modprobe ipw2200 rtap_iface=1
            % ifconfig rtap0 up
            % tethereal -i rtap0

          If you do not specify 'rtap_iface=1' as a module parameter then 
          the rtap interface will not be created and you will need to turn 
          it on via sysfs:
	
            % echo 1 > /sys/bus/pci/drivers/ipw2200/*/rtap_iface

config BACKPORT_IPW2200_QOS
        bool "Enable QoS support"
	depends on !IPW2200_QOS
        depends on BACKPORT_IPW2200

config BACKPORT_IPW2200_DEBUG
	bool "Enable full debugging output in IPW2200 module."
	depends on !IPW2200_DEBUG
	depends on BACKPORT_IPW2200
	---help---
	  This option will enable low level debug tracing output for BACKPORT_IPW2200.

	  Note, normal debug code is already compiled in. This low level
	  debug option enables debug on hot paths (e.g Tx, Rx, ISR) and
	  will result in the kernel module being ~70 larger.  Most users
	  will typically not need this high verbosity debug information.

	  If you are not sure, say N here.

config BACKPORT_LIBIPW
	tristate
	depends on !LIBIPW
	depends on PCI && BACKPORT_CFG80211
	depends on WIRELESS_EXT
	depends on WEXT_SPY
	depends on CRYPTO
	depends on CRYPTO_ARC4
	depends on CRYPTO_ECB
	depends on CRYPTO_AES
	depends on CRYPTO_MICHAEL_MIC
	depends on CRYPTO_ECB
	depends on CRC32
	select BACKPORT_LIB80211
	select BACKPORT_LIB80211_CRYPT_WEP
	select BACKPORT_LIB80211_CRYPT_TKIP
	select BACKPORT_LIB80211_CRYPT_CCMP
	---help---
	This option enables the hardware independent IEEE 802.11
	networking stack.  This component is deprecated in favor of the
	mac80211 component.

config BACKPORT_LIBIPW_DEBUG
	bool "Full debugging output for the LIBIPW component"
	depends on !LIBIPW_DEBUG
	depends on BACKPORT_LIBIPW
	---help---
	  This option will enable debug tracing output for the
	  libipw component.

	  This will result in the kernel module being ~70k larger.  You
	  can control which debug output is sent to the kernel log by
	  setting the value in

	  /proc/net/ieee80211/debug_level

	  For example:

	  % echo 0x00000FFO > /proc/net/ieee80211/debug_level

	  For a list of values you can assign to debug_level, you
	  can look at the bit mask values in ieee80211.h

	  If you are not trying to debug or develop the libipw
	  component, you most likely want to say N here.
```

## backports/drivers/net/wireless/iwlegacy/Kconfig
```kconfig
config BACKPORT_IWLEGACY
	tristate
	depends on !IWLEGACY
	depends on FW_LOADER
	depends on NEW_LEDS
	depends on LEDS_CLASS
	depends on LEDS_TRIGGERS
	select BACKPORT_MAC80211_LEDS

config BACKPORT_IWL4965
	tristate "Intel Wireless WiFi 4965AGN (iwl4965)"
	depends on !IWL4965
	depends on PCI && BACKPORT_MAC80211
	select BACKPORT_IWLEGACY
	---help---
	  This option enables support for

	  Select to build the driver supporting the:

	  Intel Wireless WiFi Link 4965AGN

	  This driver uses the kernel's mac80211 subsystem.

	  In order to use this driver, you will need a microcode (uCode)
	  image for it. You can obtain the microcode from:

	          <http://intellinuxwireless.org/>.

	  The microcode is typically installed in /lib/firmware. You can
	  look in the hotplug script /etc/hotplug/firmware.agent to
	  determine which directory FIRMWARE_DIR is set to when the script
	  runs.

	  If you want to compile the driver as a module ( = code which can be
	  inserted in and removed from the running kernel whenever you want),
	  say M here and read <file:Documentation/kbuild/modules.txt>.  The
	  module will be called iwl4965.

config BACKPORT_IWL3945
	tristate "Intel PRO/Wireless 3945ABG/BG Network Connection (iwl3945)"
	depends on !IWL3945
	depends on PCI && BACKPORT_MAC80211
	select BACKPORT_IWLEGACY
	---help---
	  Select to build the driver supporting the:

	  Intel PRO/Wireless 3945ABG/BG Network Connection

	  This driver uses the kernel's mac80211 subsystem.

	  In order to use this driver, you will need a microcode (uCode)
	  image for it. You can obtain the microcode from:

	          <http://intellinuxwireless.org/>.

	  The microcode is typically installed in /lib/firmware. You can
	  look in the hotplug script /etc/hotplug/firmware.agent to
	  determine which directory FIRMWARE_DIR is set to when the script
	  runs.

	  If you want to compile the driver as a module ( = code which can be
	  inserted in and removed from the running kernel whenever you want),
	  say M here and read <file:Documentation/kbuild/modules.txt>.  The
	  module will be called iwl3945.

menu "iwl3945 / iwl4965 Debugging Options"
	depends on BACKPORT_IWLEGACY

config BACKPORT_IWLEGACY_DEBUG
	bool "Enable full debugging output in iwlegacy (iwl 3945/4965) drivers"
	depends on !IWLEGACY_DEBUG
	depends on BACKPORT_IWLEGACY
	---help---
	  This option will enable debug tracing output for the iwlegacy
	  drivers.

	  This will result in the kernel module being ~100k larger.  You can
	  control which debug output is sent to the kernel log by setting the
	  value in

		/sys/class/net/wlan0/device/debug_level

	  This entry will only exist if this option is enabled.

	  To set a value, simply echo an 8-byte hex value to the same file:

		  % echo 0x43fff > /sys/class/net/wlan0/device/debug_level

	  You can find the list of debug mask values in:
		  drivers/net/wireless/iwlegacy/common.h

	  If this is your first time using this driver, you should say Y here
	  as the debug information can assist others in helping you resolve
	  any problems you may encounter.

config BACKPORT_IWLEGACY_DEBUGFS
        bool "iwlegacy (iwl 3945/4965) debugfs support"
	depends on !IWLEGACY_DEBUGFS
        depends on IWLEGACY && BACKPORT_MAC80211_DEBUGFS
        ---help---
	  Enable creation of debugfs files for the iwlegacy drivers. This
	  is a low-impact option that allows getting insight into the
	  driver's state at runtime.

endmenu
```

## backports/drivers/net/wireless/libertas/Kconfig
```kconfig
config BACKPORT_LIBERTAS
	tristate "Marvell 8xxx Libertas WLAN driver support"
	depends on !LIBERTAS
	depends on BACKPORT_CFG80211
	depends on WIRELESS_EXT
	depends on WEXT_SPY
	select BACKPORT_LIB80211
	depends on FW_LOADER
	---help---
	  A library for Marvell Libertas 8xxx devices.

config BACKPORT_LIBERTAS_USB
	tristate "Marvell Libertas 8388 USB 802.11b/g cards"
	depends on !LIBERTAS_USB
	depends on BACKPORT_LIBERTAS && USB
	---help---
	  A driver for Marvell Libertas 8388 USB devices.

config BACKPORT_LIBERTAS_CS
	tristate "Marvell Libertas 8385 CompactFlash 802.11b/g cards"
	depends on !LIBERTAS_CS
	depends on BACKPORT_LIBERTAS && PCMCIA && HAS_IOPORT_MAP
	---help---
	  A driver for Marvell Libertas 8385 CompactFlash devices.

config BACKPORT_LIBERTAS_SDIO
	tristate "Marvell Libertas 8385/8686/8688 SDIO 802.11b/g cards"
	depends on !LIBERTAS_SDIO
	depends on BACKPORT_LIBERTAS && MMC
	---help---
	  A driver for Marvell Libertas 8385/8686/8688 SDIO devices.

config BACKPORT_LIBERTAS_SPI
	tristate "Marvell Libertas 8686 SPI 802.11b/g cards"
	depends on !LIBERTAS_SPI
	depends on BACKPORT_LIBERTAS && SPI
	---help---
	  A driver for Marvell Libertas 8686 SPI devices.

config BACKPORT_LIBERTAS_DEBUG
	bool "Enable full debugging output in the Libertas module."
	depends on !LIBERTAS_DEBUG
	depends on BACKPORT_LIBERTAS
	---help---
	  Debugging support.

config BACKPORT_LIBERTAS_MESH
	bool "Enable mesh support"
	depends on !LIBERTAS_MESH
	depends on BACKPORT_LIBERTAS
	help
	  This enables Libertas' MESH support, used by e.g. the OLPC people.
```

## backports/drivers/net/wireless/mwifiex/Kconfig
```kconfig
config BACKPORT_MWIFIEX
	tristate "Marvell WiFi-Ex Driver"
	depends on !MWIFIEX
	depends on BACKPORT_CFG80211
	---help---
	  This adds support for wireless adapters based on Marvell
	  802.11n/ac chipsets.

	  If you choose to build it as a module, it will be called
	  mwifiex.

config BACKPORT_MWIFIEX_SDIO
	tristate "Marvell WiFi-Ex Driver for SD8786/SD8787/SD8797/SD8887/SD8897"
	depends on !MWIFIEX_SDIO
	depends on BACKPORT_MWIFIEX && MMC
	depends on FW_LOADER
	---help---
	  This adds support for wireless adapters based on Marvell
	  8786/8787/8797/8887/8897 chipsets with SDIO interface.

	  If you choose to build it as a module, it will be called
	  mwifiex_sdio.

config BACKPORT_MWIFIEX_PCIE
	tristate "Marvell WiFi-Ex Driver for PCIE 8766/8897"
	depends on !MWIFIEX_PCIE
	depends on BACKPORT_MWIFIEX && PCI
	depends on FW_LOADER
	---help---
	  This adds support for wireless adapters based on Marvell
	  8766/8897 chipsets with PCIe interface.

	  If you choose to build it as a module, it will be called
	  mwifiex_pcie.

config BACKPORT_MWIFIEX_USB
	tristate "Marvell WiFi-Ex Driver for USB8766/8797/8897"
	depends on !MWIFIEX_USB
	depends on BACKPORT_MWIFIEX && USB
	depends on FW_LOADER
	---help---
	  This adds support for wireless adapters based on Marvell
	  8797/8897 chipset with USB interface.

	  If you choose to build it as a module, it will be called
	  mwifiex_usb.
```
