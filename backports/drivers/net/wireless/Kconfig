## backports/drivers/net/wireless/Kconfig
```kconfig
#
# Wireless LAN device configuration
#

menuconfig BACKPORT_WLAN
	bool "Wireless LAN"
	depends on !WLAN
	depends on !S390
	depends on NET
	depends on WIRELESS
	default y
	---help---
	  This section contains all the pre 802.11 and 802.11 wireless
	  device drivers. For a complete list of drivers and documentation
	  on them refer to the wireless wiki:

	  http://wireless.kernel.org/en/users/Drivers

if BACKPORT_WLAN

config BACKPORT_PCMCIA_RAYCS
	depends on n
	tristate "Aviator/Raytheon 2.4GHz wireless support"
	depends on !PCMCIA_RAYCS
	depends on PCMCIA
	depends on WIRELESS_EXT
	depends on WEXT_SPY
	depends on WEXT_PRIV
	---help---
	  Say Y here if you intend to attach an Aviator/Raytheon PCMCIA
	  (PC-card) wireless Ethernet networking card to your computer.
	  Please read the file <file:Documentation/networking/ray_cs.txt> for
	  details.

	  To compile this driver as a module, choose M here: the module will be
	  called ray_cs.  If unsure, say N.

config BACKPORT_LIBERTAS_THINFIRM
	tristate "Marvell 8xxx Libertas WLAN driver support with thin firmware"
	depends on !LIBERTAS_THINFIRM
	depends on BACKPORT_MAC80211
	depends on FW_LOADER
	---help---
	  A library for Marvell Libertas 8xxx devices using thinfirm.

config BACKPORT_LIBERTAS_THINFIRM_DEBUG
	bool "Enable full debugging output in the Libertas thin firmware module."
	depends on !LIBERTAS_THINFIRM_DEBUG
	depends on BACKPORT_LIBERTAS_THINFIRM
	---help---
	  Debugging support.

config BACKPORT_LIBERTAS_THINFIRM_USB
	tristate "Marvell Libertas 8388 USB 802.11b/g cards with thin firmware"
	depends on !LIBERTAS_THINFIRM_USB
	depends on BACKPORT_LIBERTAS_THINFIRM && USB
	---help---
	  A driver for Marvell Libertas 8388 USB devices using thinfirm.

config BACKPORT_AIRO
	depends on n
	tristate "Cisco/Aironet 34X/35X/4500/4800 ISA and PCI cards"
	depends on !AIRO
	depends on BACKPORT_CFG80211 && ISA_DMA_API && (PCI || BROKEN)
	depends on WIRELESS_EXT
	depends on CRYPTO
	depends on WEXT_SPY
	depends on WEXT_PRIV
	---help---
	  This is the standard Linux driver to support Cisco/Aironet ISA and
	  PCI 802.11 wireless cards.
	  It supports the new 802.11b cards from Cisco (Cisco 34X, Cisco 35X
	  - with or without encryption) as well as card before the Cisco
	  acquisition (Aironet 4500, Aironet 4800, Aironet 4800B).

	  This driver support both the standard Linux Wireless Extensions
	  and Cisco proprietary API, so both the Linux Wireless Tools and the
	  Cisco Linux utilities can be used to configure the card.

	  The driver can be compiled as a module and will be named "airo".

config BACKPORT_ATMEL
	depends on n
      tristate "Atmel at76c50x chipset  802.11b support"
	depends on !ATMEL
      depends on BACKPORT_CFG80211 && (PCI || PCMCIA)
      depends on WIRELESS_EXT
      depends on WEXT_PRIV
      depends on FW_LOADER
      depends on CRC32
       ---help---
        A driver 802.11b wireless cards based on the Atmel fast-vnet
        chips. This driver supports standard Linux wireless extensions.

        Many  cards based on this chipset do not have flash memory
        and need their firmware loaded at start-up. If yours is
        one of these, you will need to provide a firmware image
        to be loaded into the card by the driver. The Atmel
        firmware package can be downloaded from
        <http://www.thekelleys.org.uk/atmel>

config BACKPORT_PCI_ATMEL
	depends on n
      tristate "Atmel at76c506 PCI cards"
	depends on !PCI_ATMEL
      depends on BACKPORT_ATMEL && PCI
       ---help---
        Enable support for PCI and mini-PCI cards containing the
        Atmel at76c506 chip.

config BACKPORT_PCMCIA_ATMEL
	depends on n
	tristate "Atmel at76c502/at76c504 PCMCIA cards"
	depends on !PCMCIA_ATMEL
	depends on BACKPORT_ATMEL && PCMCIA
	depends on WIRELESS_EXT
	depends on FW_LOADER
	depends on CRC32
	---help---
	  Enable support for PCMCIA cards containing the
	  Atmel at76c502 and at76c504 chips.

config BACKPORT_AT76C50X_USB
        tristate "Atmel at76c503/at76c505/at76c505a USB cards"
	depends on !AT76C50X_USB
        depends on BACKPORT_MAC80211 && USB
        depends on FW_LOADER
        ---help---
          Enable support for USB Wireless devices using Atmel at76c503,
          at76c505 or at76c505a chips.

config BACKPORT_AIRO_CS
	depends on n
	tristate "Cisco/Aironet 34X/35X/4500/4800 PCMCIA cards"
	depends on !AIRO_CS
	depends on BACKPORT_CFG80211 && PCMCIA && (BROKEN || !M32R)
	depends on WIRELESS_EXT
	depends on WEXT_SPY
	depends on WEXT_PRIV
	depends on CRYPTO
	depends on CRYPTO_AES
	---help---
	  This is the standard Linux driver to support Cisco/Aironet PCMCIA
	  802.11 wireless cards.  This driver is the same as the Aironet
	  driver part of the Linux Pcmcia package.
	  It supports the new 802.11b cards from Cisco (Cisco 34X, Cisco 35X
	  - with or without encryption) as well as card before the Cisco
	  acquisition (Aironet 4500, Aironet 4800, Aironet 4800B). It also
	  supports OEM of Cisco such as the DELL TrueMobile 4800 and Xircom
	  802.11b cards.

	  This driver support both the standard Linux Wireless Extensions
	  and Cisco proprietary API, so both the Linux Wireless Tools and the
	  Cisco Linux utilities can be used to configure the card.

config BACKPORT_PCMCIA_WL3501
	depends on n
	tristate "Planet WL3501 PCMCIA cards"
	depends on !PCMCIA_WL3501
	depends on BACKPORT_CFG80211 && PCMCIA
	depends on WIRELESS_EXT
	depends on WEXT_SPY
	help
	  A driver for WL3501 PCMCIA 802.11 wireless cards made by Planet.
	  It has basic support for Linux wireless extensions and initial
	  micro support for ethtool.

config BACKPORT_PRISM54
	depends on n
	tristate 'Intersil Prism GT/Duette/Indigo PCI/Cardbus (DEPRECATED)'
	depends on !PRISM54
	depends on PCI
	depends on WIRELESS_EXT
	depends on WEXT_SPY
	depends on WEXT_PRIV
	depends on FW_LOADER
	---help---
	  This enables support for FullMAC PCI/Cardbus prism54 devices. This
	  driver is now deprecated in favor for the SoftMAC driver, p54pci.
	  p54pci supports FullMAC PCI/Cardbus devices as well.

	  For more information refer to the p54 wiki:

	  http://wireless.kernel.org/en/users/Drivers/p54

	  Note: You need a motherboard with DMA support to use any of these cards

	  When built as module you get the module prism54

config BACKPORT_USB_ZD1201
	depends on n
	tristate "USB ZD1201 based Wireless device support"
	depends on !USB_ZD1201
	depends on BACKPORT_CFG80211 && USB
	depends on WIRELESS_EXT
	depends on WEXT_PRIV
	depends on FW_LOADER
	---help---
	  Say Y if you want to use wireless LAN adapters based on the ZyDAS
	  ZD1201 chip.

	  This driver makes the adapter appear as a normal Ethernet interface,
	  typically on wlan0.

	  The zd1201 device requires external firmware to be loaded.
	  This can be found at http://linux-lc100020.sourceforge.net/

	  To compile this driver as a module, choose M here: the
	  module will be called zd1201.

config BACKPORT_USB_NET_RNDIS_WLAN
	tristate "Wireless RNDIS USB support"
	depends on !USB_NET_RNDIS_WLAN
	depends on USB
	depends on BACKPORT_CFG80211
	select BACKPORT_USB_NET_DRIVERS
	select BACKPORT_USB_USBNET
	select BACKPORT_USB_NET_CDCETHER
	select BACKPORT_USB_NET_RNDIS_HOST
	---help---
	  This is a driver for wireless RNDIS devices.
	  These are USB based adapters found in devices such as:

	  Buffalo WLI-U2-KG125S
	  U.S. Robotics USR5421
	  Belkin F5D7051
	  Linksys WUSB54GSv2
	  Linksys WUSB54GSC
	  Asus WL169gE
	  Eminent EM4045
	  BACKPORT_BT Voyager 1055
	  Linksys WUSB54GSv1
	  U.S. Robotics USR5420
	  BUFFALO WLI-USB-G54

	  All of these devices are based on Broadcom 4320 chip which is the
	  only wireless RNDIS chip known to date.

	  If you choose to build a module, it'll be called rndis_wlan.

source "$BACKPORT_DIR/drivers/net/wireless/rtl818x/Kconfig"

config BACKPORT_ADM8211
	tristate "ADMtek ADM8211 support"
	depends on !ADM8211
	depends on BACKPORT_MAC80211 && PCI
	depends on CRC32
	depends on EEPROM_93CX6
	---help---
	  This driver is for BACKPORT_ADM8211A, BACKPORT_ADM8211B, and BACKPORT_ADM8211C based cards.
	  These are PCI/mini-PCI/Cardbus 802.11b chips found in cards such as:

	  Xterasys Cardbus XN-2411b
	  Blitz NetWave Point PC
	  TrendNet 221pc
	  Belkin F5D6001
	  SMC 2635W
	  Linksys WPC11 v1
	  Fiberline FL-WL-200X
	  3com Office Connect (3CRSHPW796)
	  Corega WLPCIB-11
	  SMC 2602W V2 EU
	  D-Link DWL-520 Revision C

	  However, some of these cards have been replaced with other chips
	  like the BACKPORT_RTL8180L (Xterasys Cardbus XN-2411b, Belkin F5D6001) or
	  the Ralink RT2400 (SMC2635W) without a model number change.

	  Thanks to Infineon-ADMtek for their support of this driver.

config BACKPORT_MAC80211_HWSIM
	tristate "Simulated radio testing tool for mac80211"
	depends on !MAC80211_HWSIM
	depends on BACKPORT_MAC80211
	---help---
	  This driver is a developer testing tool that can be used to test
	  IEEE 802.11 networking stack (mac80211) functionality. This is not
	  needed for normal wireless LAN usage and is only for testing. See
	  Documentation/networking/mac80211_hwsim for more information on how
	  to use this tool.

	  To compile this driver as a module, choose M here: the module will be
	  called mac80211_hwsim.  If unsure, say N.

config BACKPORT_MWL8K
	tristate "Marvell 88W8xxx PCI/PCIe Wireless support"
	depends on !MWL8K
	depends on BACKPORT_MAC80211 && PCI
	---help---
	  This driver supports Marvell TOPDOG 802.11 wireless cards.

	  To compile this driver as a module, choose M here: the module
	  will be called mwl8k.  If unsure, say N.

source "$BACKPORT_DIR/drivers/net/wireless/ath/Kconfig"
source "$BACKPORT_DIR/drivers/net/wireless/b43/Kconfig"
source "$BACKPORT_DIR/drivers/net/wireless/b43legacy/Kconfig"
source "$BACKPORT_DIR/drivers/net/wireless/brcm80211/Kconfig"
#source "drivers/net/wireless/hostap/Kconfig"
source "$BACKPORT_DIR/drivers/net/wireless/ipw2x00/Kconfig"
source "$BACKPORT_DIR/drivers/net/wireless/iwlwifi/Kconfig"
source "$BACKPORT_DIR/drivers/net/wireless/iwlegacy/Kconfig"
source "$BACKPORT_DIR/drivers/net/wireless/libertas/Kconfig"
source "$BACKPORT_DIR/drivers/net/wireless/orinoco/Kconfig"
source "$BACKPORT_DIR/drivers/net/wireless/p54/Kconfig"
source "$BACKPORT_DIR/drivers/net/wireless/rt2x00/Kconfig"
source "$BACKPORT_DIR/drivers/net/wireless/rtlwifi/Kconfig"
source "$BACKPORT_DIR/drivers/net/wireless/ti/Kconfig"
source "$BACKPORT_DIR/drivers/net/wireless/zd1211rw/Kconfig"
source "$BACKPORT_DIR/drivers/net/wireless/mwifiex/Kconfig"
source "$BACKPORT_DIR/drivers/net/wireless/cw1200/Kconfig"
source "$BACKPORT_DIR/drivers/net/wireless/rsi/Kconfig"

endif # BACKPORT_WLAN
```

## backports/drivers/net/wireless/ath/Kconfig
```kconfig
config BACKPORT_ATH_COMMON
	tristate
	depends on !ATH_COMMON

menuconfig BACKPORT_ATH_CARDS
	tristate "Atheros Wireless Cards"
	depends on !ATH_CARDS
	depends on BACKPORT_CFG80211 && (!UML || BROKEN)
	---help---
	  This will enable the support for the Atheros wireless drivers.
	  ath5k, ath9k, ath9k_htc and ar9170 drivers share some common code, this option
	  enables the common ath.ko module which shares common helpers.

	  For more information and documentation on this module you can visit:

	  http://wireless.kernel.org/en/users/Drivers/ath

	  For information on all Atheros wireless drivers visit:

	  http://wireless.kernel.org/en/users/Drivers/Atheros

if BACKPORT_ATH_CARDS

config BACKPORT_ATH_DEBUG
	bool "Atheros wireless debugging"
	depends on !ATH_DEBUG
	---help---
	  Say Y, if you want to debug atheros wireless drivers.
	  Right now only ath9k makes use of this.

config BACKPORT_ATH_TRACEPOINTS
       bool "Atheros wireless tracing"
	depends on !ATH_TRACEPOINTS
       depends on BACKPORT_ATH_DEBUG
       depends on EVENT_TRACING
       ---help---
         This option enables tracepoints for atheros wireless drivers.
	 Currently, ath9k makes use of this facility.

config BACKPORT_ATH_REG_DYNAMIC_USER_REG_HINTS
	bool "Atheros dynamic user regulatory hints"
	depends on !ATH_REG_DYNAMIC_USER_REG_HINTS
	depends on BACKPORT_CFG80211_CERTIFICATION_ONUS
	default n
	---help---
	  Say N. This should only be enabled in countries where
	  this feature is explicitly allowed and only on cards that
	  specifically have been tested for this.

config BACKPORT_ATH_REG_DYNAMIC_USER_CERT_TESTING
	bool "Atheros dynamic user regulatory testing"
	depends on !ATH_REG_DYNAMIC_USER_CERT_TESTING
	depends on ATH_REG_DYNAMIC_USER_REG_HINTS && BACKPORT_CFG80211_CERTIFICATION_ONUS
	default n
	---help---
	  Say N. This should only be enabled on systems
	  undergoing certification testing.

source "$BACKPORT_DIR/drivers/net/wireless/ath/ath5k/Kconfig"
source "$BACKPORT_DIR/drivers/net/wireless/ath/ath9k/Kconfig"
source "$BACKPORT_DIR/drivers/net/wireless/ath/carl9170/Kconfig"
source "$BACKPORT_DIR/drivers/net/wireless/ath/ath6kl/Kconfig"
source "$BACKPORT_DIR/drivers/net/wireless/ath/ar5523/Kconfig"
source "$BACKPORT_DIR/drivers/net/wireless/ath/wil6210/Kconfig"
source "$BACKPORT_DIR/drivers/net/wireless/ath/ath10k/Kconfig"
source "$BACKPORT_DIR/drivers/net/wireless/ath/wcn36xx/Kconfig"

endif
```

## backports/drivers/net/wireless/ath/ar5523/Kconfig
```kconfig
config BACKPORT_AR5523
       tristate "Atheros AR5523 wireless driver support"
	depends on !AR5523
       depends on BACKPORT_MAC80211 && USB
       select BACKPORT_ATH_COMMON
       depends on FW_LOADER
       ---help---
         This module add support for BACKPORT_AR5523 based USB dongles such as D-Link
         DWL-G132, Netgear WPN111 and many more.
```

## backports/drivers/net/wireless/ath/ath10k/Kconfig
```kconfig
config BACKPORT_ATH10K
        tristate "Atheros 802.11ac wireless cards support"
	depends on !ATH10K
        depends on BACKPORT_MAC80211 && HAS_DMA
	select BACKPORT_ATH_COMMON
        ---help---
          This module adds support for wireless adapters based on
          Atheros IEEE 802.11ac family of chipsets.

          If you choose to build a module, it'll be called ath10k.

config BACKPORT_ATH10K_PCI
	tristate "Atheros ath10k PCI support"
	depends on !ATH10K_PCI
	depends on BACKPORT_ATH10K && PCI
	---help---
	  This module adds support for PCIE bus

config BACKPORT_ATH10K_DEBUG
	bool "Atheros ath10k debugging"
	depends on !ATH10K_DEBUG
	depends on BACKPORT_ATH10K
	---help---
	  Enables debug support

	  If unsure, say Y to make it easier to debug problems.

config BACKPORT_ATH10K_DEBUGFS
	bool "Atheros ath10k debugfs support"
	depends on !ATH10K_DEBUGFS
	depends on BACKPORT_ATH10K && DEBUG_FS
	depends on RELAY
	---help---
	  Enabled debugfs support

	  If unsure, say Y to make it easier to debug problems.

config BACKPORT_ATH10K_TRACING
	bool "Atheros ath10k tracing support"
	depends on !ATH10K_TRACING
	depends on BACKPORT_ATH10K
	depends on EVENT_TRACING
	---help---
	  Select this to ath10k use tracing infrastructure.

config BACKPORT_ATH10K_DFS_CERTIFIED
	bool "Atheros DFS support for certified platforms"
	depends on !ATH10K_DFS_CERTIFIED
	depends on ATH10K && BACKPORT_CFG80211_CERTIFICATION_ONUS
	default n
	---help---
	This option enables DFS support for initiating radiation on
	ath10k.
```
