## backports/drivers/net/wireless/rt2x00/Kconfig
```kconfig
menuconfig BACKPORT_RT2X00
	tristate "Ralink driver support"
	depends on !RT2X00
	depends on BACKPORT_MAC80211 && HAS_DMA
	---help---
	  This will enable the support for the Ralink drivers,
	  developed in the rt2x00 project <http://rt2x00.serialmonkey.com>.

	  These drivers make use of the mac80211 stack.

	  When building one of the individual drivers, the rt2x00 library
	  will also be created. That library (when the driver is built as
	  a module) will be called rt2x00lib.

	  Additionally PCI and USB libraries will also be build depending
	  on the types of drivers being selected, these libraries will be
	  called rt2x00pci and rt2x00usb.

if BACKPORT_RT2X00

config BACKPORT_RT2400PCI
	tristate "Ralink rt2400 (PCI/PCMCIA) support"
	depends on !RT2400PCI
	depends on PCI
	select BACKPORT_RT2X00_LIB_MMIO
	select BACKPORT_RT2X00_LIB_PCI
	depends on EEPROM_93CX6
	---help---
	  This adds support for rt2400 wireless chipset family.
	  Supported chips: RT2460.

	  When compiled as a module, this driver will be called rt2400pci.

config BACKPORT_RT2500PCI
	tristate "Ralink rt2500 (PCI/PCMCIA) support"
	depends on !RT2500PCI
	depends on PCI
	select BACKPORT_RT2X00_LIB_MMIO
	select BACKPORT_RT2X00_LIB_PCI
	depends on EEPROM_93CX6
	---help---
	  This adds support for rt2500 wireless chipset family.
	  Supported chips: RT2560.

	  When compiled as a module, this driver will be called rt2500pci.

config BACKPORT_RT61PCI
	tristate "Ralink rt2501/rt61 (PCI/PCMCIA) support"
	depends on !RT61PCI
	depends on PCI
	select BACKPORT_RT2X00_LIB_PCI
	select BACKPORT_RT2X00_LIB_MMIO
	select BACKPORT_RT2X00_LIB_FIRMWARE
	select BACKPORT_RT2X00_LIB_CRYPTO
	depends on CRC_ITU_T
	depends on EEPROM_93CX6
	---help---
	  This adds support for rt2501 wireless chipset family.
	  Supported chips: RT2561, RT2561S & RT2661.

	  When compiled as a module, this driver will be called rt61pci.

config BACKPORT_RT2800PCI
	tristate "Ralink rt27xx/rt28xx/rt30xx (PCI/PCIe/PCMCIA) support"
	depends on !RT2800PCI
	depends on PCI
	select BACKPORT_RT2800_LIB
	select BACKPORT_RT2800_LIB_MMIO
	select BACKPORT_RT2X00_LIB_MMIO
	select BACKPORT_RT2X00_LIB_PCI
	select BACKPORT_RT2X00_LIB_FIRMWARE
	select BACKPORT_RT2X00_LIB_CRYPTO
	depends on CRC_CCITT
	depends on EEPROM_93CX6
	---help---
	  This adds support for rt27xx/rt28xx/rt30xx wireless chipset family.
	  Supported chips: RT2760, RT2790, RT2860, RT2880, RT2890, RT3052,
			   RT3090, RT3091 & RT3092

	  When compiled as a module, this driver will be called "rt2800pci.ko".

if BACKPORT_RT2800PCI

config BACKPORT_RT2800PCI_RT33XX
	bool "rt2800pci - Include support for rt33xx devices"
	depends on !RT2800PCI_RT33XX
	default y
	---help---
	  This adds support for rt33xx wireless chipset family to the
	  rt2800pci driver.
	  Supported chips: RT3390

config BACKPORT_RT2800PCI_RT35XX
	bool "rt2800pci - Include support for rt35xx devices (EXPERIMENTAL)"
	depends on !RT2800PCI_RT35XX
	default y
	---help---
	  This adds support for rt35xx wireless chipset family to the
	  rt2800pci driver.
	  Supported chips: RT3060, RT3062, RT3562, RT3592


config BACKPORT_RT2800PCI_RT53XX
       bool "rt2800pci - Include support for rt53xx devices (EXPERIMENTAL)"
	depends on !RT2800PCI_RT53XX
       default y
       ---help---
         This adds support for rt53xx wireless chipset family to the
         rt2800pci driver.
         Supported chips: RT5390

config BACKPORT_RT2800PCI_RT3290
       bool "rt2800pci - Include support for rt3290 devices (EXPERIMENTAL)"
	depends on !RT2800PCI_RT3290
       default y
       ---help---
         This adds support for rt3290 wireless chipset family to the
         rt2800pci driver.
         Supported chips: RT3290
endif

config BACKPORT_RT2500USB
	tristate "Ralink rt2500 (USB) support"
	depends on !RT2500USB
	depends on USB
	select BACKPORT_RT2X00_LIB_USB
	select BACKPORT_RT2X00_LIB_CRYPTO
	---help---
	  This adds support for rt2500 wireless chipset family.
	  Supported chips: RT2571 & RT2572.

	  When compiled as a module, this driver will be called rt2500usb.

config BACKPORT_RT73USB
	tristate "Ralink rt2501/rt73 (USB) support"
	depends on !RT73USB
	depends on USB
	select BACKPORT_RT2X00_LIB_USB
	select BACKPORT_RT2X00_LIB_FIRMWARE
	select BACKPORT_RT2X00_LIB_CRYPTO
	depends on CRC_ITU_T
	---help---
	  This adds support for rt2501 wireless chipset family.
	  Supported chips: RT2571W, RT2573 & RT2671.

	  When compiled as a module, this driver will be called rt73usb.

config BACKPORT_RT2800USB
	tristate "Ralink rt27xx/rt28xx/rt30xx (USB) support"
	depends on !RT2800USB
	depends on USB
	select BACKPORT_RT2800_LIB
	select BACKPORT_RT2X00_LIB_USB
	select BACKPORT_RT2X00_LIB_FIRMWARE
	select BACKPORT_RT2X00_LIB_CRYPTO
	depends on CRC_CCITT
	---help---
	  This adds support for rt27xx/rt28xx/rt30xx wireless chipset family.
	  Supported chips: RT2770, RT2870 & RT3070, RT3071 & RT3072

	  When compiled as a module, this driver will be called "rt2800usb.ko".

if BACKPORT_RT2800USB

config BACKPORT_RT2800USB_RT33XX
	bool "rt2800usb - Include support for rt33xx devices"
	depends on !RT2800USB_RT33XX
	default y
	---help---
	  This adds support for rt33xx wireless chipset family to the
	  rt2800usb driver.
	  Supported chips: RT3370

config BACKPORT_RT2800USB_RT35XX
	bool "rt2800usb - Include support for rt35xx devices (EXPERIMENTAL)"
	depends on !RT2800USB_RT35XX
	default y
	---help---
	  This adds support for rt35xx wireless chipset family to the
	  rt2800usb driver.
	  Supported chips: RT3572

config BACKPORT_RT2800USB_RT3573
	bool "rt2800usb - Include support for rt3573 devices (EXPERIMENTAL)"
	depends on !RT2800USB_RT3573
	---help---
	  This enables support for RT3573 chipset based wireless USB devices
	  in the rt2800usb driver.

config BACKPORT_RT2800USB_RT53XX
       bool "rt2800usb - Include support for rt53xx devices (EXPERIMENTAL)"
	depends on !RT2800USB_RT53XX
       ---help---
         This adds support for rt53xx wireless chipset family to the
         rt2800usb driver.
         Supported chips: RT5370

config BACKPORT_RT2800USB_RT55XX
       bool "rt2800usb - Include support for rt55xx devices (EXPERIMENTAL)"
	depends on !RT2800USB_RT55XX
       ---help---
         This adds support for rt55xx wireless chipset family to the
         rt2800usb driver.
         Supported chips: RT5572

config BACKPORT_RT2800USB_UNKNOWN
	bool "rt2800usb - Include support for unknown (USB) devices"
	depends on !RT2800USB_UNKNOWN
	default n
	---help---
	  This adds support for rt2800usb devices that are known to
	  have a rt28xx family compatible chipset, but for which the exact
	  chipset is unknown.

	  Support status for these devices is unknown, and enabling these
	  devices may or may not work.

endif

config BACKPORT_RT2800SOC
	tristate "Ralink WiSoC support"
	depends on !RT2800SOC
	depends on SOC_RT288X || SOC_RT305X
	select BACKPORT_RT2X00_LIB_SOC
	select BACKPORT_RT2X00_LIB_MMIO
	select BACKPORT_RT2X00_LIB_CRYPTO
	select BACKPORT_RT2X00_LIB_FIRMWARE
	select BACKPORT_RT2800_LIB
	select BACKPORT_RT2800_LIB_MMIO
	---help---
	  This adds support for Ralink WiSoC devices.
	  Supported chips: RT2880, RT3050, RT3052, RT3350, RT3352.

	  When compiled as a module, this driver will be called rt2800soc.


config BACKPORT_RT2800_LIB
	tristate
	depends on !RT2800_LIB

config BACKPORT_RT2800_LIB_MMIO
	tristate
	depends on !RT2800_LIB_MMIO
	select BACKPORT_RT2X00_LIB_MMIO
	select BACKPORT_RT2800_LIB

config BACKPORT_RT2X00_LIB_MMIO
	tristate
	depends on !RT2X00_LIB_MMIO

config BACKPORT_RT2X00_LIB_PCI
	tristate
	depends on !RT2X00_LIB_PCI
	select BACKPORT_RT2X00_LIB

config BACKPORT_RT2X00_LIB_SOC
	tristate
	depends on !RT2X00_LIB_SOC
	select BACKPORT_RT2X00_LIB

config BACKPORT_RT2X00_LIB_USB
	tristate
	depends on !RT2X00_LIB_USB
	select BACKPORT_RT2X00_LIB

config BACKPORT_RT2X00_LIB
	tristate
	depends on !RT2X00_LIB
	depends on AVERAGE

config BACKPORT_RT2X00_LIB_FIRMWARE
	bool
	depends on !RT2X00_LIB_FIRMWARE
	depends on FW_LOADER

config BACKPORT_RT2X00_LIB_CRYPTO
	bool
	depends on !RT2X00_LIB_CRYPTO

config BACKPORT_RT2X00_LIB_LEDS
	bool
	depends on !RT2X00_LIB_LEDS
	default y if (RT2X00_LIB=y && LEDS_CLASS=y) || (RT2X00_LIB=m && LEDS_CLASS!=n)

config BACKPORT_RT2X00_LIB_DEBUGFS
	bool "Ralink debugfs support"
	depends on !RT2X00_LIB_DEBUGFS
	depends on RT2X00_LIB && BACKPORT_MAC80211_DEBUGFS
	---help---
	  Enable creation of debugfs files for the rt2x00 drivers.
	  These debugfs files support both reading and writing of the
	  most important register types of the rt2x00 hardware.

config BACKPORT_RT2X00_DEBUG
	bool "Ralink debug output"
	depends on !RT2X00_DEBUG
	depends on BACKPORT_RT2X00_LIB
	---help---
	  Enable debugging output for all rt2x00 modules

endif
```

## backports/drivers/net/wireless/rtlwifi/Kconfig
```kconfig
menuconfig BACKPORT_RTL_CARDS
	tristate "Realtek rtlwifi family of devices"
	depends on !RTL_CARDS
	depends on BACKPORT_MAC80211 && (PCI || USB)
	default y
	---help---
	  This option will enable support for the Realtek mac80211-based
	  wireless drivers. Drivers rtl8192ce, rtl8192cu, rtl8192se, rtl8192de,
	  rtl8723ae, rtl8723be, rtl8188ee, rtl8192ee, and rtl8821ae share
	  some common code.

if BACKPORT_RTL_CARDS

config BACKPORT_RTL8192CE
	tristate "Realtek RTL8192CE/RTL8188CE Wireless Network Adapter"
	depends on !RTL8192CE
	depends on PCI
	select BACKPORT_RTL8192C_COMMON
	select BACKPORT_RTLWIFI
	select BACKPORT_RTLWIFI_PCI
	---help---
	This is the driver for Realtek BACKPORT_RTL8192CE/RTL8188CE 802.11n PCIe
	wireless network adapters.

	If you choose to build it as a module, it will be called rtl8192ce

config BACKPORT_RTL8192SE
	tristate "Realtek RTL8192SE/RTL8191SE PCIe Wireless Network Adapter"
	depends on !RTL8192SE
	depends on PCI
	select BACKPORT_RTLWIFI
	select BACKPORT_RTLWIFI_PCI
	---help---
	This is the driver for Realtek BACKPORT_RTL8192SE/RTL8191SE 802.11n PCIe
	wireless network adapters.

	If you choose to build it as a module, it will be called rtl8192se

config BACKPORT_RTL8192DE
	tristate "Realtek RTL8192DE/RTL8188DE PCIe Wireless Network Adapter"
	depends on !RTL8192DE
	depends on PCI
	select BACKPORT_RTLWIFI
	select BACKPORT_RTLWIFI_PCI
	---help---
	This is the driver for Realtek BACKPORT_RTL8192DE/RTL8188DE 802.11n PCIe
	wireless network adapters.

	If you choose to build it as a module, it will be called rtl8192de

config BACKPORT_RTL8723AE
	tristate "Realtek RTL8723AE PCIe Wireless Network Adapter"
	depends on !RTL8723AE
	depends on PCI
	select BACKPORT_RTLWIFI
	select BACKPORT_RTLWIFI_PCI
	select BACKPORT_RTL8723_COMMON
	depends on RTLBTCOEXIST
	---help---
	This is the driver for Realtek BACKPORT_RTL8723AE 802.11n PCIe
	wireless network adapters.

	If you choose to build it as a module, it will be called rtl8723ae

config BACKPORT_RTL8723BE
	tristate "Realtek RTL8723BE PCIe Wireless Network Adapter"
	depends on !RTL8723BE
	depends on PCI
	select BACKPORT_RTLWIFI
	select BACKPORT_RTLWIFI_PCI
	select BACKPORT_RTL8723_COMMON
	depends on RTLBTCOEXIST
	---help---
	This is the driver for Realtek BACKPORT_RTL8723BE 802.11n PCIe
	wireless network adapters.

	If you choose to build it as a module, it will be called rtl8723be

config BACKPORT_RTL8188EE
	tristate "Realtek RTL8188EE Wireless Network Adapter"
	depends on !RTL8188EE
	depends on PCI
	select BACKPORT_RTLWIFI
	select BACKPORT_RTLWIFI_PCI
	---help---
	This is the driver for Realtek BACKPORT_RTL8188EE 802.11n PCIe
	wireless network adapters.

	If you choose to build it as a module, it will be called rtl8188ee

config BACKPORT_RTL8192EE
	tristate "Realtek RTL8192EE Wireless Network Adapter"
	depends on !RTL8192EE
	depends on PCI
	select BACKPORT_RTLWIFI
	select BACKPORT_RTLWIFI_PCI
	depends on RTLBTCOEXIST
	---help---
	This is the driver for Realtek BACKPORT_RTL8192EE 802.11n PCIe
	wireless network adapters.

	If you choose to build it as a module, it will be called rtl8192ee

config BACKPORT_RTL8821AE
	tristate "Realtek RTL8821AE/RTL8812AE Wireless Network Adapter"
	depends on !RTL8821AE
	depends on PCI
	select BACKPORT_RTLWIFI
	select BACKPORT_RTLWIFI_PCI
	depends on RTLBTCOEXIST
	---help---
	This is the driver for Realtek RTL8i821AE/RTL8812AE 802.11av PCIe
	wireless network adapters.

	If you choose to build it as a module, it will be called rtl8821ae

config BACKPORT_RTL8192CU
	tristate "Realtek RTL8192CU/RTL8188CU USB Wireless Network Adapter"
	depends on !RTL8192CU
	depends on USB
	select BACKPORT_RTLWIFI
	select BACKPORT_RTLWIFI_USB
	select BACKPORT_RTL8192C_COMMON
	---help---
	This is the driver for Realtek BACKPORT_RTL8192CU/RTL8188CU 802.11n USB
	wireless network adapters.

	If you choose to build it as a module, it will be called rtl8192cu

config BACKPORT_RTLWIFI
	tristate
	depends on !RTLWIFI
	depends on FW_LOADER

config BACKPORT_RTLWIFI_PCI
	tristate
	depends on !RTLWIFI_PCI

config BACKPORT_RTLWIFI_USB
	tristate
	depends on !RTLWIFI_USB

config BACKPORT_RTLWIFI_DEBUG
	bool "Debugging output for rtlwifi driver family"
	depends on !RTLWIFI_DEBUG
	depends on BACKPORT_RTLWIFI
	default y
	---help---
	To use the module option that sets the dynamic-debugging level for,
	the front-end driver, this parameter must be "Y". For memory-limited
	systems, choose "N". If in doubt, choose "Y".

config BACKPORT_RTL8192C_COMMON
	tristate
	depends on !RTL8192C_COMMON
	depends on BACKPORT_RTL8192CE || RTL8192CU
	default y

config BACKPORT_RTL8723_COMMON
	tristate
	depends on !RTL8723_COMMON
	depends on BACKPORT_RTL8723AE || RTL8723BE
	default y

config BACKPORT_RTLBTCOEXIST
	tristate
	depends on !RTLBTCOEXIST
	depends on BACKPORT_RTL8723AE || RTL8723BE || RTL8821AE || RTL8192EE
	default y

endif
```

## backports/drivers/net/wireless/ti/Kconfig
```kconfig
menuconfig BACKPORT_WL_TI
	bool "TI Wireless LAN support"
	depends on !WL_TI
	---help---
	  This section contains support for all the wireless drivers
	  for Texas Instruments BACKPORT_WLAN chips, such as wl1251 and the wl12xx
	  family.

if BACKPORT_WL_TI
source "$BACKPORT_DIR/drivers/net/wireless/ti/wl1251/Kconfig"
source "$BACKPORT_DIR/drivers/net/wireless/ti/wl12xx/Kconfig"
source "$BACKPORT_DIR/drivers/net/wireless/ti/wl18xx/Kconfig"

# keep last for automatic dependencies
source "$BACKPORT_DIR/drivers/net/wireless/ti/wlcore/Kconfig"

config BACKPORT_WILINK_PLATFORM_DATA
	bool "TI WiLink platform data"
	depends on !WILINK_PLATFORM_DATA
	depends on WLCORE_SDIO || BACKPORT_WL1251_SDIO
	default y
	---help---
	Small platform data bit needed to pass data to the sdio modules.


endif # BACKPORT_WL_TI
```

## backports/drivers/net/wireless/ti/wl18xx/Kconfig
```kconfig
config BACKPORT_WL18XX
	tristate "TI wl18xx support"
	depends on !WL18XX
	depends on BACKPORT_MAC80211
	select BACKPORT_WLCORE
	---help---
	  This module adds support for wireless adapters based on TI
	  WiLink 8 chipsets.
```
