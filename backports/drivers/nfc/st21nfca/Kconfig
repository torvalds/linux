## backports/drivers/nfc/st21nfca/Kconfig
```kconfig
config BACKPORT_NFC_ST21NFCA
	tristate "STMicroelectronics ST21NFCA NFC driver"
	depends on !NFC_ST21NFCA
	depends on BACKPORT_NFC_HCI
	depends on CRC_CCITT
	default n
	---help---
	  STMicroelectronics ST21NFCA core driver. It implements the chipset
	  HCI logic and hooks into the BACKPORT_NFC kernel APIs. Physical layers will
	  register against it.

	  To compile this driver as a module, choose m here. The module will
	  be called st21nfca.
	  Say N if unsure.

config BACKPORT_NFC_ST21NFCA_I2C
	tristate "NFC ST21NFCA i2c support"
	depends on !NFC_ST21NFCA_I2C
	depends on BACKPORT_NFC_ST21NFCA && I2C && BACKPORT_NFC_SHDLC
	---help---
	  This module adds support for the STMicroelectronics st21nfca i2c interface.
	  Select this if your platform is using the i2c bus.

	  If you choose to build a module, it'll be called st21nfca_i2c.
	  Say N if unsure.
```

## backports/drivers/realtek/8188eu/rtl8xxx_EU_MP/Kconfig
```kconfig
config RTL8188EU_MP
	tristate "Realtek 8188E USB WiFi"
	depends on USB
	---help---
	  Help message of RTL8188EU
```

## backports/drivers/realtek/8192cu/Kconfig
```kconfig
config RTL8192CU
	tristate "Realtek 8192C USB WiFi"
	depends on USB
	---help---
	  Enable wireless network adapters based on Realtek RTL8192C chipset family, such as EDUP nano series
```

## backports/drivers/realtek/8192du/Kconfig
```kconfig
config RTL8192DU
	tristate "Realtek 8192D USB WiFi"
	depends on USB
	---help---
	  Help message of RTL8192DU
```

## backports/drivers/realtek/8192eu/Kconfig
```kconfig
config RTL8192EU
	tristate "Realtek 8192E USB WiFi"
	depends on USB
	---help---
	  Help message of RTL8192EU
```

## backports/drivers/realtek/8723au/rtl8723AU/Kconfig
```kconfig
config RTL8723AU
	tristate "Realtek 8723A USB WiFi"
	---help---
	  Help message of RTL8723AS-VAU
```

## backports/drivers/realtek/Kconfig
```kconfig
source "$BACKPORT_DIR/drivers/realtek/8192cu/Kconfig"

config RTL8188EU
        tristate "Realtek 8188E USB WiFi"
        depends on USB
        ---help---
          Help message of RTL8188EU



config RTL8192DU
        tristate "Realtek 8192DU USB WiFi"
        depends on USB
        ---help---
          Help message of RTL8192DU
```

## backports/drivers/realtek/rtl8188eu/hostapd-0.8/hostapd/defconfig
```kconfig
# Example hostapd build time configuration
#
# This file lists the configuration options that are used when building the
# hostapd binary. All lines starting with # are ignored. Configuration option
# lines must be commented out complete, if they are not to be included, i.e.,
# just setting VARIABLE=n is not disabling that variable.
#
# This file is included in Makefile, so variables like CFLAGS and LIBS can also
# be modified from here. In most cass, these lines should use += in order not
# to override previous values of the variables.

# Driver interface for Host AP driver
#CONFIG_DRIVER_HOSTAP=y
CONFIG_DRIVER_RTW=y

# Driver interface for wired authenticator
#CONFIG_DRIVER_WIRED=y

# Driver interface for madwifi driver
#CONFIG_DRIVER_MADWIFI=y
#CFLAGS += -I../../madwifi # change to the madwifi source directory

# Driver interface for drivers using the nl80211 kernel interface
#CONFIG_DRIVER_NL80211=y

# Driver interface for FreeBSD net80211 layer (e.g., Atheros driver)
#CONFIG_DRIVER_BSD=y
#CFLAGS += -I/usr/local/include
#LIBS += -L/usr/local/lib
#LIBS_p += -L/usr/local/lib
#LIBS_c += -L/usr/local/lib

# Driver interface for no driver (e.g., RADIUS server only)
#CONFIG_DRIVER_NONE=y

# IEEE 802.11F/IAPP
#CONFIG_IAPP=y

# WPA2/IEEE 802.11i RSN pre-authentication
#CONFIG_RSN_PREAUTH=y

# PeerKey handshake for Station to Station Link (IEEE 802.11e DLS)
#CONFIG_PEERKEY=y

# IEEE 802.11w (management frame protection)
# This version is an experimental implementation based on IEEE 802.11w/D1.0
# draft and is subject to change since the standard has not yet been finalized.
# Driver support is also needed for IEEE 802.11w.
#CONFIG_IEEE80211W=y

# Integrated EAP server
CONFIG_EAP=y

# EAP-MD5 for the integrated EAP server
#CONFIG_EAP_MD5=y

# EAP-TLS for the integrated EAP server
#CONFIG_EAP_TLS=y

# EAP-MSCHAPv2 for the integrated EAP server
#CONFIG_EAP_MSCHAPV2=y

# EAP-PEAP for the integrated EAP server
#CONFIG_EAP_PEAP=y

# EAP-GTC for the integrated EAP server
#CONFIG_EAP_GTC=y

# EAP-TTLS for the integrated EAP server
#CONFIG_EAP_TTLS=y

# EAP-SIM for the integrated EAP server
#CONFIG_EAP_SIM=y

# EAP-AKA for the integrated EAP server
#CONFIG_EAP_AKA=y

# EAP-AKA' for the integrated EAP server
# This requires CONFIG_EAP_AKA to be enabled, too.
#CONFIG_EAP_AKA_PRIME=y

# EAP-PAX for the integrated EAP server
#CONFIG_EAP_PAX=y

# EAP-PSK for the integrated EAP server (this is _not_ needed for WPA-PSK)
#CONFIG_EAP_PSK=y

# EAP-SAKE for the integrated EAP server
#CONFIG_EAP_SAKE=y

# EAP-GPSK for the integrated EAP server
#CONFIG_EAP_GPSK=y
# Include support for optional SHA256 cipher suite in EAP-GPSK
#CONFIG_EAP_GPSK_SHA256=y

# EAP-FAST for the integrated EAP server
# Note: Default OpenSSL package does not include support for all the
# functionality needed for EAP-FAST. If EAP-FAST is enabled with OpenSSL,
# the OpenSSL library must be patched (openssl-0.9.9-session-ticket.patch)
# to add the needed functions.
#CONFIG_EAP_FAST=y

# Wi-Fi Protected Setup (WPS)
CONFIG_WPS=y
# Enable WSC 2.0 support
CONFIG_WPS2=y
# Enable UPnP support for external WPS Registrars
#CONFIG_WPS_UPNP=y

CONFIG_TLS=internal
CONFIG_INTERNAL_LIBTOMMATH=y

# EAP-IKEv2
#CONFIG_EAP_IKEV2=y

# Trusted Network Connect (EAP-TNC)
#CONFIG_EAP_TNC=y

# PKCS#12 (PFX) support (used to read private key and certificate file from
# a file that usually has extension .p12 or .pfx)
#CONFIG_PKCS12=y

# RADIUS authentication server. This provides access to the integrated EAP
# server from external hosts using RADIUS.
#CONFIG_RADIUS_SERVER=y

# Build IPv6 support for RADIUS operations
#CONFIG_IPV6=y

# IEEE Std 802.11r-2008 (Fast BSS Transition)
#CONFIG_IEEE80211R=y

# Use the hostapd's IEEE 802.11 authentication (ACL), but without
# the IEEE 802.11 Management capability (e.g., madwifi or FreeBSD/net80211)
#CONFIG_DRIVER_RADIUS_ACL=y

# IEEE 802.11n (High Throughput) support
CONFIG_IEEE80211N=y

# Remove debugging code that is printing out debug messages to stdout.
# This can be used to reduce the size of the hostapd considerably if debugging
# code is not needed.
#CONFIG_NO_STDOUT_DEBUG=y

# Add support for writing debug log to a file: -f /tmp/hostapd.log
# Disabled by default.
#CONFIG_DEBUG_FILE=y

# Remove support for RADIUS accounting
#CONFIG_NO_ACCOUNTING=y

# Remove support for RADIUS
#CONFIG_NO_RADIUS=y

# Remove support for VLANs
#CONFIG_NO_VLAN=y

# Enable support for fully dynamic VLANs. This enables hostapd to
# automatically create bridge and VLAN interfaces if necessary.
#CONFIG_FULL_DYNAMIC_VLAN=y

# Remove support for dumping state into a file on SIGUSR1 signal
# This can be used to reduce binary size at the cost of disabling a debugging
# option.
#CONFIG_NO_DUMP_STATE=y

# Enable tracing code for developer debugging
# This tracks use of memory allocations and other registrations and reports
# incorrect use with a backtrace of call (or allocation) location.
#CONFIG_WPA_TRACE=y
# For BSD, comment out these.
#LIBS += -lexecinfo
#LIBS_p += -lexecinfo
#LIBS_c += -lexecinfo

# Use libbfd to get more details for developer debugging
# This enables use of libbfd to get more detailed symbols for the backtraces
# generated by CONFIG_WPA_TRACE=y.
#CONFIG_WPA_TRACE_BFD=y
# For BSD, comment out these.
#LIBS += -lbfd -liberty -lz
#LIBS_p += -lbfd -liberty -lz
#LIBS_c += -lbfd -liberty -lz

# hostapd depends on strong random number generation being available from the
# operating system. os_get_random() function is used to fetch random data when
# needed, e.g., for key generation. On Linux and BSD systems, this works by
# reading /dev/urandom. It should be noted that the OS entropy pool needs to be
# properly initialized before hostapd is started. This is important especially
# on embedded devices that do not have a hardware random number generator and
# may by default start up with minimal entropy available for random number
# generation.
#
# As a safety net, hostapd is by default trying to internally collect
# additional entropy for generating random data to mix in with the data
# fetched from the OS. This by itself is not considered to be very strong, but
# it may help in cases where the system pool is not initialized properly.
# However, it is very strongly recommended that the system pool is initialized
# with enough entropy either by using hardware assisted random number
# generatior or by storing state over device reboots.
#
# If the os_get_random() is known to provide strong ramdom data (e.g., on
# Linux/BSD, the board in question is known to have reliable source of random
# data from /dev/urandom), the internal hostapd random pool can be disabled.
# This will save some in binary size and CPU use. However, this should only be
# considered for builds that are known to be used on devices that meet the
# requirements described above.
#CONFIG_NO_RANDOM_POOL=y
```

## backports/drivers/realtek/rtl8812au/Kconfig
```kconfig
config RTL8821AU
	tristate "Realtek 8821 USB WiFi"
	depends on USB
	---help---
	  Help message of RTL8821AU
```

## backports/drivers/ssb/Kconfig
```kconfig
config BACKPORT_SSB_POSSIBLE
	bool
	depends on !SSB_POSSIBLE
	depends on HAS_IOMEM && HAS_DMA
	default y

menu "Sonics Silicon Backplane"
	depends on BACKPORT_SSB_POSSIBLE

config BACKPORT_SSB
	tristate "Sonics Silicon Backplane support"
	depends on !SSB
	depends on BACKPORT_SSB_POSSIBLE
	help
	  Support for the Sonics Silicon Backplane bus.
	  You only need to enable this option, if you are
	  configuring a kernel for an embedded system with
	  this bus.
	  It will be auto-selected if needed in other
	  environments.

	  The module will be called ssb.

	  If unsure, say N.

# Common SPROM support routines
config BACKPORT_SSB_SPROM
	bool
	depends on !SSB_SPROM

# Support for Block-I/O. SELECT this from the driver that needs it.
config BACKPORT_SSB_BLOCKIO
	bool
	depends on !SSB_BLOCKIO
	depends on BACKPORT_SSB

config BACKPORT_SSB_PCIHOST_POSSIBLE
	bool
	depends on !SSB_PCIHOST_POSSIBLE
	depends on BACKPORT_SSB && (PCI = y || PCI = BACKPORT_SSB)
	default y

config BACKPORT_SSB_PCIHOST
	bool "Support for SSB on PCI-bus host"
	depends on !SSB_PCIHOST
	depends on BACKPORT_SSB_PCIHOST_POSSIBLE
	select BACKPORT_SSB_SPROM
	default y
	help
	  Support for a Sonics Silicon Backplane on top
	  of a PCI device.

	  If unsure, say Y

config BACKPORT_SSB_B43_PCI_BRIDGE
	bool
	depends on !SSB_B43_PCI_BRIDGE
	depends on BACKPORT_SSB_PCIHOST
	default n

config BACKPORT_SSB_PCMCIAHOST_POSSIBLE
	bool
	depends on !SSB_PCMCIAHOST_POSSIBLE
	depends on BACKPORT_SSB && (PCMCIA = y || PCMCIA = BACKPORT_SSB)
	default y

config BACKPORT_SSB_PCMCIAHOST
	bool "Support for SSB on PCMCIA-bus host"
	depends on !SSB_PCMCIAHOST
	depends on BACKPORT_SSB_PCMCIAHOST_POSSIBLE
	select BACKPORT_SSB_SPROM
	help
	  Support for a Sonics Silicon Backplane on top
	  of a PCMCIA device.

	  If unsure, say N

config BACKPORT_SSB_SDIOHOST_POSSIBLE
	bool
	depends on !SSB_SDIOHOST_POSSIBLE
	depends on BACKPORT_SSB && (MMC = y || MMC = BACKPORT_SSB)
	default y

config BACKPORT_SSB_SDIOHOST
	bool "Support for SSB on SDIO-bus host"
	depends on !SSB_SDIOHOST
	depends on BACKPORT_SSB_SDIOHOST_POSSIBLE
	help
	  Support for a Sonics Silicon Backplane on top
	  of a SDIO device.

	  If unsure, say N

config BACKPORT_SSB_SILENT
	bool "No SSB kernel messages"
	depends on !SSB_SILENT
	depends on BACKPORT_SSB && EXPERT
	help
	  This option turns off all Sonics Silicon Backplane printks.
	  Note that you won't be able to identify problems, once
	  messages are turned off.
	  This might only be desired for production kernels on
	  embedded devices to reduce the kernel size.

	  Say N

config BACKPORT_SSB_DEBUG
	bool "SSB debugging"
	depends on !SSB_DEBUG
	depends on BACKPORT_SSB && !SSB_SILENT
	help
	  This turns on additional runtime checks and debugging
	  messages. Turn this on for BACKPORT_SSB troubleshooting.

	  If unsure, say N

config BACKPORT_SSB_SERIAL
	bool
	depends on !SSB_SERIAL
	depends on BACKPORT_SSB
	# ChipCommon and ExtIf serial support routines.

config BACKPORT_SSB_DRIVER_PCICORE_POSSIBLE
	bool
	depends on !SSB_DRIVER_PCICORE_POSSIBLE
	depends on BACKPORT_SSB_PCIHOST
	default y

config BACKPORT_SSB_DRIVER_PCICORE
	bool "SSB PCI core driver"
	depends on !SSB_DRIVER_PCICORE
	depends on BACKPORT_SSB_DRIVER_PCICORE_POSSIBLE
	help
	  Driver for the Sonics Silicon Backplane attached
	  Broadcom PCI core.

	  If unsure, say Y

config BACKPORT_SSB_PCICORE_HOSTMODE
	bool "Hostmode support for SSB PCI core"
	depends on !SSB_PCICORE_HOSTMODE
	depends on BACKPORT_SSB_DRIVER_PCICORE && BACKPORT_SSB_DRIVER_MIPS
	help
	  PCIcore hostmode operation (external PCI bus).

config BACKPORT_SSB_DRIVER_MIPS
	bool "SSB Broadcom MIPS core driver"
	depends on !SSB_DRIVER_MIPS
	depends on BACKPORT_SSB && MIPS
	select BACKPORT_SSB_SERIAL
	help
	  Driver for the Sonics Silicon Backplane attached
	  Broadcom MIPS core.

	  If unsure, say N

config BACKPORT_SSB_SFLASH
	bool "SSB serial flash support"
	depends on !SSB_SFLASH
	depends on BACKPORT_SSB_DRIVER_MIPS
	default y

# Assumption: We are on embedded, if we compile the MIPS core.
config BACKPORT_SSB_EMBEDDED
	bool
	depends on !SSB_EMBEDDED
	depends on BACKPORT_SSB_DRIVER_MIPS && BACKPORT_SSB_PCICORE_HOSTMODE
	default y

config BACKPORT_SSB_DRIVER_EXTIF
	bool "SSB Broadcom EXTIF core driver"
	depends on !SSB_DRIVER_EXTIF
	depends on BACKPORT_SSB_DRIVER_MIPS
	help
	  Driver for the Sonics Silicon Backplane attached
	  Broadcom EXTIF core.

	  If unsure, say N

config BACKPORT_SSB_DRIVER_GIGE
	bool "SSB Broadcom Gigabit Ethernet driver"
	depends on !SSB_DRIVER_GIGE
	depends on BACKPORT_SSB_PCIHOST_POSSIBLE && BACKPORT_SSB_EMBEDDED && MIPS
	help
	  Driver for the Sonics Silicon Backplane attached
	  Broadcom Gigabit Ethernet.

	  If unsure, say N

config BACKPORT_SSB_DRIVER_GPIO
	bool "SSB GPIO driver"
	depends on !SSB_DRIVER_GPIO
	depends on BACKPORT_SSB && GPIOLIB
	select IRQ_DOMAIN if BACKPORT_SSB_EMBEDDED
	help
	  Driver to provide access to the GPIO pins on the bus.

	  If unsure, say N

endmenu
```
