## backports/drivers/usb/class/Kconfig
```kconfig
#
# USB Class driver configuration
#
comment "USB Device Class drivers"

config BACKPORT_USB_ACM
	depends on n
	tristate "USB Modem (CDC ACM) support"
	depends on !USB_ACM
	depends on TTY
	---help---
	  This driver supports USB modems and ISDN adapters which support the
	  Communication Device Class Abstract Control Model interface.
	  Please read <file:Documentation/usb/acm.txt> for details.

	  If your modem only reports "Cls=ff(vend.)" in the descriptors in
	  /proc/bus/usb/devices, then your modem will not work with this
	  driver.

	  To compile this driver as a module, choose M here: the
	  module will be called cdc-acm.

config BACKPORT_USB_PRINTER
	depends on n
	tristate "USB Printer support"
	depends on !USB_PRINTER
	help
	  Say Y here if you want to connect a USB printer to your computer's
	  USB port.

	  To compile this driver as a module, choose M here: the
	  module will be called usblp.

config BACKPORT_USB_WDM
	tristate "USB Wireless Device Management support"
	depends on !USB_WDM
	---help---
	  This driver supports the WMC Device Management functionality
	  of cell phones compliant to the CDC WMC specification. You can use
	  AT commands over this device.

	  To compile this driver as a module, choose M here: the
	  module will be called cdc-wdm.

config BACKPORT_USB_TMC
	depends on n
	tristate "USB Test and Measurement Class support"
	depends on !USB_TMC
	help
	  Say Y here if you want to connect a USB device that follows
	  the USB.org specification for USB Test and Measurement devices
	  to your computer's USB port.

	  To compile this driver as a module, choose M here: the
	  module will be called usbtmc.
```

## backports/net/6lowpan/Kconfig
```kconfig
config BACKPORT_6LOWPAN
	tristate "6LoWPAN Support"
	depends on !6LOWPAN
	depends on IPV6
	---help---
	  This enables IPv6 over Low power Wireless Personal Area Network -
	  "6LoWPAN" which is supported by IEEE 802.15.4 or Bluetooth stacks.
```

## backports/net/bluetooth/Kconfig
```kconfig
#
# Bluetooth subsystem configuration
#

menuconfig BACKPORT_BT
	tristate "Bluetooth subsystem support"
	depends on !BT
	depends on NET && !S390
	depends on RFKILL || !RFKILL
	select CRC16
	select CRYPTO
	select CRYPTO_BLKCIPHER
	select CRYPTO_AES
	select CRYPTO_CMAC
	select CRYPTO_ECB
	select CRYPTO_SHA256
	help
	  Bluetooth is low-cost, low-power, short-range wireless technology.
	  It was designed as a replacement for cables and other short-range
	  technologies like IrDA.  Bluetooth operates in personal area range
	  that typically extends up to 10 meters.  More information about
	  Bluetooth can be found at <http://www.bluetooth.com/>.

	  Linux Bluetooth subsystem consist of several layers:
	     Bluetooth Core
		HCI device and connection manager, scheduler
		SCO audio links
		L2CAP (Logical Link Control and Adaptation Protocol)
		SMP (Security Manager Protocol) on LE (Low Energy) links
	     HCI Device drivers (Interface to the hardware)
	     RFCOMM Module (RFCOMM Protocol)  
	     BNEP Module (Bluetooth Network Encapsulation Protocol)
	     CMTP Module (CAPI Message Transport Protocol)
	     HIDP Module (Human Interface Device Protocol)

	  Say Y here to compile Bluetooth support into the kernel or say M to
	  compile it as module (bluetooth).

	  To use Linux Bluetooth subsystem, you will need several user-space
	  utilities like hciconfig and bluetoothd.  These utilities and updates
	  to Bluetooth kernel modules are provided in the BlueZ packages.  For
	  more information, see <http://www.bluez.org/>.

config BACKPORT_BT_BREDR
	bool "Bluetooth Classic (BR/EDR) features"
	depends on !BT_BREDR
	depends on BACKPORT_BT
	default y

source "$BACKPORT_DIR/net/bluetooth/rfcomm/Kconfig"

source "$BACKPORT_DIR/net/bluetooth/bnep/Kconfig"

source "$BACKPORT_DIR/net/bluetooth/cmtp/Kconfig"

source "$BACKPORT_DIR/net/bluetooth/hidp/Kconfig"

config BACKPORT_BT_LE
	bool "Bluetooth Low Energy (LE) features"
	depends on !BT_LE
	depends on BACKPORT_BT
	default y

config BACKPORT_BT_6LOWPAN
	tristate "Bluetooth 6LoWPAN support"
	depends on !BT_6LOWPAN
	depends on BACKPORT_BT_LE && 6LOWPAN
	help
	  IPv6 compression over Bluetooth Low Energy.

config BACKPORT_BT_SELFTEST
	bool "Bluetooth self testing support"
	depends on !BT_SELFTEST
	depends on BACKPORT_BT && DEBUG_KERNEL
	help
	  Run self tests when initializing the Bluetooth subsystem.  This
	  is a developer option and can cause significant delay when booting
	  the system.

	  When the Bluetooth subsystem is built as module, then the test
	  cases are run first thing at module load time.  When the Bluetooth
	  subsystem is compiled into the kernel image, then the test cases
	  are run late in the initcall hierarchy.

config BACKPORT_BT_SELFTEST_ECDH
	bool "ECDH test cases"
	depends on !BT_SELFTEST_ECDH
	depends on BACKPORT_BT_LE && BACKPORT_BT_SELFTEST
	help
	  Run test cases for ECDH cryptographic functionality used by the
	  Bluetooth Low Energy Secure Connections feature.

config BACKPORT_BT_SELFTEST_SMP
	bool "SMP test cases"
	depends on !BT_SELFTEST_SMP
	depends on BACKPORT_BT_LE && BACKPORT_BT_SELFTEST
	help
	  Run test cases for SMP cryptographic functionality, including both
	  legacy SMP as well as the Secure Connections features.

source "$BACKPORT_DIR/drivers/bluetooth/Kconfig"
```

## backports/net/bluetooth/bnep/Kconfig
```kconfig
config BACKPORT_BT_BNEP
	tristate "BNEP protocol support"
	depends on !BT_BNEP
	depends on BACKPORT_BT_BREDR
	depends on CRC32
	help
	  BNEP (Bluetooth Network Encapsulation Protocol) is Ethernet
	  emulation layer on top of Bluetooth.  BNEP is required for
	  Bluetooth PAN (Personal Area Network).

	  Say Y here to compile BNEP support into the kernel or say M to
	  compile it as module (bnep).

config BACKPORT_BT_BNEP_MC_FILTER
	bool "Multicast filter support"
	depends on !BT_BNEP_MC_FILTER
	depends on BACKPORT_BT_BNEP
	help
	  This option enables the multicast filter support for BNEP.

config BACKPORT_BT_BNEP_PROTO_FILTER
	bool "Protocol filter support"
	depends on !BT_BNEP_PROTO_FILTER
	depends on BACKPORT_BT_BNEP
	help
	  This option enables the protocol filter support for BNEP.
```

## backports/net/bluetooth/hidp/Kconfig
```kconfig
config BACKPORT_BT_HIDP
	tristate "HIDP protocol support"
	depends on !BT_HIDP
	depends on BACKPORT_BT_BREDR && INPUT
	depends on HID
	help
	  HIDP (Human Interface Device Protocol) is a transport layer
	  for HID reports.  HIDP is required for the Bluetooth Human
	  Interface Device Profile.

	  Say Y here to compile HIDP support into the kernel or say M to
	  compile it as module (hidp).
```

## backports/net/bluetooth/rfcomm/Kconfig
```kconfig
config BACKPORT_BT_RFCOMM
	tristate "RFCOMM protocol support"
	depends on !BT_RFCOMM
	depends on BACKPORT_BT_BREDR
	help
	  RFCOMM provides connection oriented stream transport.  RFCOMM
	  support is required for Dialup Networking, OBEX and other Bluetooth
	  applications.

	  Say Y here to compile RFCOMM support into the kernel or say M to
	  compile it as module (rfcomm).

config BACKPORT_BT_RFCOMM_TTY
	bool "RFCOMM TTY support"
	depends on !BT_RFCOMM_TTY
	depends on BACKPORT_BT_RFCOMM
	depends on TTY
	help
	  This option enables TTY emulation support for RFCOMM channels.
```

## backports/net/ieee802154/6lowpan/Kconfig
```kconfig
config BACKPORT_IEEE802154_6LOWPAN
	tristate "6lowpan support over IEEE 802.15.4"
	depends on !IEEE802154_6LOWPAN
	depends on BACKPORT_6LOWPAN
	---help---
	  IPv6 compression over IEEE 802.15.4.
```

## backports/net/ieee802154/Kconfig
```kconfig
menuconfig BACKPORT_IEEE802154
	tristate "IEEE Std 802.15.4 Low-Rate Wireless Personal Area Networks support"
	depends on !IEEE802154
	---help---
	  IEEE Std 802.15.4 defines a low data rate, low power and low
	  complexity short range wireless personal area networks. It was
	  designed to organise networks of sensors, switches, etc automation
	  devices. Maximum allowed data rate is 250 kb/s and typical personal
	  operating space around 10m.

	  Say Y here to compile LR-WPAN support into the kernel or say M to
	  compile it as modules.

if BACKPORT_IEEE802154

config BACKPORT_IEEE802154_SOCKET
	tristate "IEEE 802.15.4 socket interface"
	depends on !IEEE802154_SOCKET
	default y
	---help---
	  Socket interface for IEEE 802.15.4. Contains DGRAM sockets interface
	  for 802.15.4 dataframes. Also RAW socket interface to build MAC
	  header from userspace.

source "$BACKPORT_DIR/net/ieee802154/6lowpan/Kconfig"

endif
```

## backports/net/mac802154/Kconfig
```kconfig
config BACKPORT_MAC802154
	tristate "Generic IEEE 802.15.4 Soft Networking Stack (mac802154)"
	depends on !MAC802154
	depends on BACKPORT_IEEE802154
	depends on CRC_CCITT
	depends on CRYPTO_AUTHENC
	depends on CRYPTO_CCM
	depends on CRYPTO_CTR
	depends on CRYPTO_AES
	---help---
	  This option enables the hardware independent IEEE 802.15.4
	  networking stack for SoftMAC devices (the ones implementing
	  only PHY level of IEEE 802.15.4 standard).

	  Note: this implementation is neither certified, nor feature
	  complete! Compatibility with other implementations hasn't
	  been tested yet!

	  If you plan to use HardMAC IEEE 802.15.4 devices, you can
	  say N here. Alternatively you can say M to compile it as
	  module.
```

## backports/net/nfc/Kconfig
```kconfig
#
# BACKPORT_NFC sybsystem configuration
#

menuconfig BACKPORT_NFC
	depends on NET
	depends on !NFC
	depends on RFKILL || !RFKILL
	tristate "NFC subsystem support"
	default n
	help
	  Say Y here if you want to build support for BACKPORT_NFC (Near field
	  communication) devices.

	  To compile this support as a module, choose M here: the module will
	  be called nfc.

config BACKPORT_NFC_DIGITAL
	depends on NFC
	depends on !NFC_DIGITAL
	depends on CRC_CCITT
	depends on CRC_ITU_T
	tristate "NFC Digital Protocol stack support"
	default n
	help
	  Say Y if you want to build BACKPORT_NFC digital protocol stack support.
	  This is needed by BACKPORT_NFC chipsets whose firmware only implement
	  the BACKPORT_NFC analog layer.

	  To compile this support as a module, choose M here: the module will
	  be called nfc_digital.

source "$BACKPORT_DIR/net/nfc/nci/Kconfig"
source "$BACKPORT_DIR/net/nfc/hci/Kconfig"

source "$BACKPORT_DIR/drivers/nfc/Kconfig"
```

## backports/net/nfc/hci/Kconfig
```kconfig
config BACKPORT_NFC_HCI
       depends on NFC
	depends on !NFC_HCI
       tristate "NFC HCI implementation"
       default n
       help
	 Say Y here if you want to build support for a kernel BACKPORT_NFC HCI
	 implementation. This is mostly needed for devices that only process
	 HCI frames, like for example the NXP pn544.

config BACKPORT_NFC_SHDLC
	depends on NFC_HCI
	depends on !NFC_SHDLC
	depends on CRC_CCITT
	bool "SHDLC link layer for HCI based BACKPORT_NFC drivers"
	default n
	---help---
	  Say yes if you use an BACKPORT_NFC HCI driver that requires SHDLC link layer.
	  If unsure, say N here.
```

## backports/net/nfc/nci/Kconfig
```kconfig
config BACKPORT_NFC_NCI
	depends on NFC
	depends on !NFC_NCI
	tristate "NCI protocol support"
	default n
	help
	  NCI (NFC Controller Interface) is a communication protocol between
	  an BACKPORT_NFC Controller (NFCC) and a Device Host (DH).

	  Say Y here to compile NCI support into the kernel or say M to
	  compile it as module (nci).

config BACKPORT_NFC_NCI_SPI
	depends on NFC_NCI && SPI
	depends on !NFC_NCI_SPI
	depends on CRC_CCITT
	bool "NCI over SPI protocol support"
	default n
	help
	  NCI (NFC Controller Interface) is a communication protocol between
	  an BACKPORT_NFC Controller (NFCC) and a Device Host (DH).

	  Say yes if you use an NCI driver that requires SPI link layer.
```
