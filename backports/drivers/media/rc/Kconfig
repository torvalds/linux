## backports/drivers/media/usb/Kconfig
```kconfig
if USB && BACKPORT_MEDIA_SUPPORT

menuconfig BACKPORT_MEDIA_USB_SUPPORT
	bool "Media USB Adapters"
	depends on !MEDIA_USB_SUPPORT
	help
	  Enable media drivers for USB bus.
	  If you have such devices, say Y.

if BACKPORT_MEDIA_USB_SUPPORT

if BACKPORT_MEDIA_CAMERA_SUPPORT
	comment "Webcam devices"
source "$BACKPORT_DIR/drivers/media/usb/uvc/Kconfig"
source "$BACKPORT_DIR/drivers/media/usb/gspca/Kconfig"
source "$BACKPORT_DIR/drivers/media/usb/pwc/Kconfig"
source "$BACKPORT_DIR/drivers/media/usb/cpia2/Kconfig"
source "$BACKPORT_DIR/drivers/media/usb/zr364xx/Kconfig"
source "$BACKPORT_DIR/drivers/media/usb/stkwebcam/Kconfig"
source "$BACKPORT_DIR/drivers/media/usb/s2255/Kconfig"
source "$BACKPORT_DIR/drivers/media/usb/usbtv/Kconfig"
endif

if BACKPORT_MEDIA_ANALOG_TV_SUPPORT
	comment "Analog TV USB devices"
source "$BACKPORT_DIR/drivers/media/usb/pvrusb2/Kconfig"
source "$BACKPORT_DIR/drivers/media/usb/hdpvr/Kconfig"
source "$BACKPORT_DIR/drivers/media/usb/usbvision/Kconfig"
source "$BACKPORT_DIR/drivers/media/usb/stk1160/Kconfig"
source "$BACKPORT_DIR/drivers/media/usb/go7007/Kconfig"
endif

if (MEDIA_ANALOG_TV_SUPPORT || MEDIA_DIGITAL_TV_SUPPORT)
	comment "Analog/digital TV USB devices"
source "$BACKPORT_DIR/drivers/media/usb/au0828/Kconfig"
source "$BACKPORT_DIR/drivers/media/usb/cx231xx/Kconfig"
source "$BACKPORT_DIR/drivers/media/usb/tm6000/Kconfig"
endif


if I2C && BACKPORT_MEDIA_DIGITAL_TV_SUPPORT
	comment "Digital TV USB devices"
source "$BACKPORT_DIR/drivers/media/usb/dvb-usb/Kconfig"
source "$BACKPORT_DIR/drivers/media/usb/dvb-usb-v2/Kconfig"
source "$BACKPORT_DIR/drivers/media/usb/ttusb-budget/Kconfig"
source "$BACKPORT_DIR/drivers/media/usb/ttusb-dec/Kconfig"
source "$BACKPORT_DIR/drivers/media/usb/siano/Kconfig"
source "$BACKPORT_DIR/drivers/media/usb/b2c2/Kconfig"
source "$BACKPORT_DIR/drivers/media/usb/as102/Kconfig"
endif

if (MEDIA_CAMERA_SUPPORT || MEDIA_ANALOG_TV_SUPPORT || MEDIA_DIGITAL_TV_SUPPORT)
	comment "Webcam, TV (analog/digital) USB devices"
source "$BACKPORT_DIR/drivers/media/usb/em28xx/Kconfig"
endif

if BACKPORT_MEDIA_SDR_SUPPORT
	comment "Software defined radio USB devices"
source "$BACKPORT_DIR/drivers/media/usb/airspy/Kconfig"
source "$BACKPORT_DIR/drivers/media/usb/hackrf/Kconfig"
source "$BACKPORT_DIR/drivers/media/usb/msi2500/Kconfig"
endif

endif #MEDIA_USB_SUPPORT
endif #USB
```

## backports/drivers/media/usb/airspy/Kconfig
```kconfig
config BACKPORT_USB_AIRSPY
	tristate "AirSpy"
	depends on !USB_AIRSPY
	depends on BACKPORT_VIDEO_V4L2
	select BACKPORT_VIDEOBUF2_VMALLOC
	---help---
	  This is a video4linux2 driver for AirSpy SDR device.

	  To compile this driver as a module, choose M here: the
	  module will be called airspy
```

## backports/drivers/media/usb/as102/Kconfig
```kconfig
config BACKPORT_DVB_AS102
	tristate "Abilis AS102 DVB receiver"
	depends on !DVB_AS102
	depends on BACKPORT_DVB_CORE && USB && I2C && INPUT
	depends on FW_LOADER
	help
	  Choose Y or M here if you have a device containing an AS102

	  To compile this driver as a module, choose M here
```

## backports/drivers/media/usb/au0828/Kconfig
```kconfig
config BACKPORT_VIDEO_AU0828
	tristate "Auvitek AU0828 support"
	depends on !VIDEO_AU0828
	depends on I2C && INPUT && BACKPORT_DVB_CORE && USB
	depends on I2C_ALGOBIT
	select BACKPORT_VIDEO_TVEEPROM
	select BACKPORT_VIDEOBUF_VMALLOC
	select DVB_AU8522_DTV if BACKPORT_MEDIA_SUBDRV_AUTOSELECT
	select MEDIA_TUNER_XC5000 if BACKPORT_MEDIA_SUBDRV_AUTOSELECT
	select MEDIA_TUNER_MXL5007T if BACKPORT_MEDIA_SUBDRV_AUTOSELECT
	select MEDIA_TUNER_TDA18271 if BACKPORT_MEDIA_SUBDRV_AUTOSELECT
	---help---
	  This is a hybrid analog/digital tv capture driver for
	  Auvitek's AU0828 USB device.

	  To compile this driver as a module, choose M here: the
	  module will be called au0828

config BACKPORT_VIDEO_AU0828_V4L2
	bool "Auvitek AU0828 v4l2 analog video support"
	depends on !VIDEO_AU0828_V4L2
	depends on VIDEO_AU0828 && BACKPORT_VIDEO_V4L2
	select DVB_AU8522_V4L if BACKPORT_MEDIA_SUBDRV_AUTOSELECT
	select BACKPORT_VIDEO_TUNER
	default y
	---help---
	  This is a video4linux driver for Auvitek's USB device.

	  Choose Y here to include support for v4l2 analog video
	  capture within the au0828 driver.

config BACKPORT_VIDEO_AU0828_RC
	bool "AU0828 Remote Controller support"
	depends on !VIDEO_AU0828_RC
	depends on BACKPORT_RC_CORE
	depends on BACKPORT_VIDEO_AU0828
	---help---
	   Enables Remote Controller support on au0828 driver.
```

## backports/drivers/media/usb/cx231xx/Kconfig
```kconfig
config BACKPORT_VIDEO_CX231XX
	tristate "Conexant cx231xx USB video capture support"
	depends on !VIDEO_CX231XX
	depends on BACKPORT_VIDEO_DEV && I2C
	select BACKPORT_VIDEO_TUNER
	select BACKPORT_VIDEO_TVEEPROM
	depends on BACKPORT_RC_CORE
	select BACKPORT_VIDEOBUF_VMALLOC
	select BACKPORT_VIDEO_CX25840
	select BACKPORT_VIDEO_CX2341X
	depends on I2C_MUX

	---help---
	  This is a video4linux driver for Conexant 231xx USB based TV cards.

	  To compile this driver as a module, choose M here: the
	  module will be called cx231xx

config BACKPORT_VIDEO_CX231XX_RC
	bool "Conexant cx231xx Remote Controller additional support"
	depends on !VIDEO_CX231XX_RC
	depends on BACKPORT_RC_CORE
	depends on BACKPORT_VIDEO_CX231XX
	default y
	---help---
	  cx231xx hardware has a builtin RX/TX support. However, a few
	  designs opted to not use it, but, instead, some other hardware.
	  This module enables the usage of those other hardware, like the
	  ones used with ISDB-T boards.

	  On most cases, all you need for IR is mceusb module.

config BACKPORT_VIDEO_CX231XX_ALSA
	tristate "Conexant Cx231xx ALSA audio module"
	depends on !VIDEO_CX231XX_ALSA
	depends on BACKPORT_VIDEO_CX231XX && SND
	depends on SND_PCM

	---help---
	  This is an ALSA driver for Cx231xx USB based TV cards.

	  To compile this driver as a module, choose M here: the
	  module will be called cx231xx-alsa

config BACKPORT_VIDEO_CX231XX_DVB
	tristate "DVB/ATSC Support for Cx231xx based TV cards"
	depends on !VIDEO_CX231XX_DVB
	depends on VIDEO_CX231XX && BACKPORT_DVB_CORE
	select BACKPORT_VIDEOBUF_DVB
	select MEDIA_TUNER_XC5000 if BACKPORT_MEDIA_SUBDRV_AUTOSELECT
	select MEDIA_TUNER_TDA18271 if BACKPORT_MEDIA_SUBDRV_AUTOSELECT
	select DVB_MB86A20S if BACKPORT_MEDIA_SUBDRV_AUTOSELECT
	select DVB_LGDT3305 if BACKPORT_MEDIA_SUBDRV_AUTOSELECT
	select DVB_TDA18271C2DD if BACKPORT_MEDIA_SUBDRV_AUTOSELECT
	select DVB_SI2165 if BACKPORT_MEDIA_SUBDRV_AUTOSELECT
	select MEDIA_TUNER_SI2157 if BACKPORT_MEDIA_SUBDRV_AUTOSELECT

	---help---
	  This adds support for DVB cards based on the
	  Conexant cx231xx chips.
```

## backports/drivers/media/usb/dvb-usb-v2/Kconfig
```kconfig
config BACKPORT_DVB_USB_V2
	tristate "Support for various USB DVB devices v2"
	depends on !DVB_USB_V2
	depends on BACKPORT_DVB_CORE && USB && I2C && (RC_CORE || RC_CORE=n)
	help
	  By enabling this you will be able to choose the various supported
	  USB1.1 and USB2.0 DVB devices.

	  Almost every USB device needs a firmware, please look into
	  <file:Documentation/dvb/README.dvb-usb>.

	  For a complete list of supported USB devices see the LinuxTV DVB Wiki:
	  <http://www.linuxtv.org/wiki/index.php/DVB_USB>

	  Say Y if you own a USB DVB device.

config BACKPORT_DVB_USB_AF9015
	tristate "Afatech AF9015 DVB-T USB2.0 support"
	depends on !DVB_USB_AF9015
	depends on BACKPORT_DVB_USB_V2
	select BACKPORT_DVB_AF9013
	select DVB_PLL              if BACKPORT_MEDIA_SUBDRV_AUTOSELECT
	select MEDIA_TUNER_MT2060   if BACKPORT_MEDIA_SUBDRV_AUTOSELECT
	select MEDIA_TUNER_QT1010   if BACKPORT_MEDIA_SUBDRV_AUTOSELECT
	select MEDIA_TUNER_TDA18271 if BACKPORT_MEDIA_SUBDRV_AUTOSELECT
	select MEDIA_TUNER_MXL5005S if BACKPORT_MEDIA_SUBDRV_AUTOSELECT
	select MEDIA_TUNER_MC44S803 if BACKPORT_MEDIA_SUBDRV_AUTOSELECT
	select MEDIA_TUNER_TDA18218 if BACKPORT_MEDIA_SUBDRV_AUTOSELECT
	select MEDIA_TUNER_MXL5007T if BACKPORT_MEDIA_SUBDRV_AUTOSELECT
	help
	  Say Y here to support the Afatech AF9015 based DVB-T USB2.0 receiver

config BACKPORT_DVB_USB_AF9035
	tristate "Afatech AF9035 DVB-T USB2.0 support"
	depends on !DVB_USB_AF9035
	depends on BACKPORT_DVB_USB_V2
	select BACKPORT_DVB_AF9033
	select MEDIA_TUNER_TUA9001 if BACKPORT_MEDIA_SUBDRV_AUTOSELECT
	select MEDIA_TUNER_FC0011 if BACKPORT_MEDIA_SUBDRV_AUTOSELECT
	select MEDIA_TUNER_MXL5007T if BACKPORT_MEDIA_SUBDRV_AUTOSELECT
	select MEDIA_TUNER_TDA18218 if BACKPORT_MEDIA_SUBDRV_AUTOSELECT
	select MEDIA_TUNER_FC2580 if BACKPORT_MEDIA_SUBDRV_AUTOSELECT
	select MEDIA_TUNER_IT913X if BACKPORT_MEDIA_SUBDRV_AUTOSELECT
	help
	  Say Y here to support the Afatech AF9035 based DVB USB receiver.

config BACKPORT_DVB_USB_ANYSEE
	tristate "Anysee DVB-T/C USB2.0 support"
	depends on !DVB_USB_ANYSEE
	depends on BACKPORT_DVB_USB_V2
	select DVB_PLL if BACKPORT_MEDIA_SUBDRV_AUTOSELECT
	select DVB_MT352 if BACKPORT_MEDIA_SUBDRV_AUTOSELECT
	select DVB_ZL10353 if BACKPORT_MEDIA_SUBDRV_AUTOSELECT
	select DVB_TDA10023 if BACKPORT_MEDIA_SUBDRV_AUTOSELECT
	select MEDIA_TUNER_TDA18212 if BACKPORT_MEDIA_SUBDRV_AUTOSELECT
	select DVB_CX24116 if BACKPORT_MEDIA_SUBDRV_AUTOSELECT
	select DVB_STV0900 if BACKPORT_MEDIA_SUBDRV_AUTOSELECT
	select DVB_STV6110 if BACKPORT_MEDIA_SUBDRV_AUTOSELECT
	select DVB_ISL6423 if BACKPORT_MEDIA_SUBDRV_AUTOSELECT
	select DVB_CXD2820R if BACKPORT_MEDIA_SUBDRV_AUTOSELECT
	help
	  Say Y here to support the Anysee E30, Anysee E30 Plus or
	  Anysee E30 C Plus DVB USB2.0 receiver.

config BACKPORT_DVB_USB_AU6610
	tristate "Alcor Micro AU6610 USB2.0 support"
	depends on !DVB_USB_AU6610
	depends on BACKPORT_DVB_USB_V2
	select DVB_ZL10353 if BACKPORT_MEDIA_SUBDRV_AUTOSELECT
	select MEDIA_TUNER_QT1010 if BACKPORT_MEDIA_SUBDRV_AUTOSELECT
	help
	  Say Y here to support the Sigmatek DVB-110 DVB-T USB2.0 receiver.

config BACKPORT_DVB_USB_AZ6007
	tristate "AzureWave 6007 and clones DVB-T/C USB2.0 support"
	depends on !DVB_USB_AZ6007
	depends on BACKPORT_DVB_USB_V2
	select BACKPORT_CYPRESS_FIRMWARE
	select DVB_DRXK if BACKPORT_MEDIA_SUBDRV_AUTOSELECT
	select MEDIA_TUNER_MT2063 if BACKPORT_MEDIA_SUBDRV_AUTOSELECT
	help
	  Say Y here to support the AZ6007 receivers like Terratec H7.

config BACKPORT_DVB_USB_CE6230
	tristate "Intel CE6230 DVB-T USB2.0 support"
	depends on !DVB_USB_CE6230
	depends on BACKPORT_DVB_USB_V2
	select BACKPORT_DVB_ZL10353
	select MEDIA_TUNER_MXL5005S if BACKPORT_MEDIA_SUBDRV_AUTOSELECT
	help
	  Say Y here to support the Intel CE6230 DVB-T USB2.0 receiver

config BACKPORT_DVB_USB_EC168
	tristate "E3C EC168 DVB-T USB2.0 support"
	depends on !DVB_USB_EC168
	depends on BACKPORT_DVB_USB_V2
	select BACKPORT_DVB_EC100
	select MEDIA_TUNER_MXL5005S if BACKPORT_MEDIA_SUBDRV_AUTOSELECT
	help
	  Say Y here to support the E3C EC168 DVB-T USB2.0 receiver.

config BACKPORT_DVB_USB_GL861
	tristate "Genesys Logic GL861 USB2.0 support"
	depends on !DVB_USB_GL861
	depends on BACKPORT_DVB_USB_V2
	select DVB_ZL10353 if BACKPORT_MEDIA_SUBDRV_AUTOSELECT
	select MEDIA_TUNER_QT1010 if BACKPORT_MEDIA_SUBDRV_AUTOSELECT
	help
	  Say Y here to support the MSI Megasky 580 (55801) DVB-T USB2.0
	  receiver with USB ID 0db0:5581.

config BACKPORT_DVB_USB_LME2510
	tristate "LME DM04/QQBOX DVB-S USB2.0 support"
	depends on !DVB_USB_LME2510
	depends on BACKPORT_DVB_USB_V2
	depends on BACKPORT_RC_CORE
	select DVB_TDA10086 if BACKPORT_MEDIA_SUBDRV_AUTOSELECT
	select DVB_TDA826X if BACKPORT_MEDIA_SUBDRV_AUTOSELECT
	select DVB_STV0288 if BACKPORT_MEDIA_SUBDRV_AUTOSELECT
	select DVB_IX2505V if BACKPORT_MEDIA_SUBDRV_AUTOSELECT
	select DVB_STV0299 if BACKPORT_MEDIA_SUBDRV_AUTOSELECT
	select DVB_PLL if BACKPORT_MEDIA_SUBDRV_AUTOSELECT
	select DVB_M88RS2000 if BACKPORT_MEDIA_SUBDRV_AUTOSELECT
	select DVB_TS2020 if BACKPORT_MEDIA_SUBDRV_AUTOSELECT
	help
	  Say Y here to support the LME DM04/QQBOX DVB-S USB2.0

config BACKPORT_DVB_USB_MXL111SF
	tristate "MxL111SF DTV USB2.0 support"
	depends on !DVB_USB_MXL111SF
	depends on BACKPORT_DVB_USB_V2
	select DVB_LGDT3305 if BACKPORT_MEDIA_SUBDRV_AUTOSELECT
	select DVB_LG2160 if BACKPORT_MEDIA_SUBDRV_AUTOSELECT
	select BACKPORT_VIDEO_TVEEPROM
	help
	  Say Y here to support the MxL111SF USB2.0 DTV receiver.

config BACKPORT_DVB_USB_RTL28XXU
	tristate "Realtek RTL28xxU DVB USB support"
	depends on !DVB_USB_RTL28XXU
	depends on BACKPORT_DVB_USB_V2 && I2C_MUX
	select BACKPORT_DVB_RTL2830
	select BACKPORT_DVB_RTL2832
	select DVB_RTL2832_SDR if (MEDIA_SUBDRV_AUTOSELECT && BACKPORT_MEDIA_SDR_SUPPORT)
	select MEDIA_TUNER_QT1010 if BACKPORT_MEDIA_SUBDRV_AUTOSELECT
	select MEDIA_TUNER_MT2060 if BACKPORT_MEDIA_SUBDRV_AUTOSELECT
	select MEDIA_TUNER_MXL5005S if BACKPORT_MEDIA_SUBDRV_AUTOSELECT
	select MEDIA_TUNER_FC0012 if BACKPORT_MEDIA_SUBDRV_AUTOSELECT
	select MEDIA_TUNER_FC0013 if BACKPORT_MEDIA_SUBDRV_AUTOSELECT
	select MEDIA_TUNER_E4000 if BACKPORT_MEDIA_SUBDRV_AUTOSELECT
	select MEDIA_TUNER_FC2580 if BACKPORT_MEDIA_SUBDRV_AUTOSELECT
	select MEDIA_TUNER_R820T if BACKPORT_MEDIA_SUBDRV_AUTOSELECT
	help
	  Say Y here to support the Realtek RTL28xxU DVB USB receiver.

config BACKPORT_DVB_USB_DVBSKY
	tristate "DVBSky USB support"
	depends on !DVB_USB_DVBSKY
	depends on BACKPORT_DVB_USB_V2
	select DVB_M88DS3103 if BACKPORT_MEDIA_SUBDRV_AUTOSELECT
	select DVB_SI2168 if BACKPORT_MEDIA_SUBDRV_AUTOSELECT
	select MEDIA_TUNER_M88TS2022 if BACKPORT_MEDIA_SUBDRV_AUTOSELECT
	select MEDIA_TUNER_SI2157 if BACKPORT_MEDIA_SUBDRV_AUTOSELECT
	select DVB_SP2 if BACKPORT_MEDIA_SUBDRV_AUTOSELECT
	help
	  Say Y here to support the USB receivers from DVBSky.
```
