## backports/drivers/media/usb/gspca/gl860/Kconfig
```kconfig
config BACKPORT_USB_GL860
	tristate "GL860 USB Camera Driver"
	depends on !USB_GL860
	depends on BACKPORT_VIDEO_V4L2 && USB_GSPCA
	help
	  Say Y here if you want support for cameras based on the GL860 chip.

	  To compile this driver as a module, choose M here: the
	  module will be called gspca_gl860.
```

## backports/drivers/media/usb/hackrf/Kconfig
```kconfig
config BACKPORT_USB_HACKRF
	tristate "HackRF"
	depends on !USB_HACKRF
	depends on BACKPORT_VIDEO_V4L2
	select BACKPORT_VIDEOBUF2_VMALLOC
	---help---
	  This is a video4linux2 driver for HackRF SDR device.

	  To compile this driver as a module, choose M here: the
	  module will be called hackrf
```

## backports/drivers/media/usb/msi2500/Kconfig
```kconfig
config BACKPORT_USB_MSI2500
	tristate "Mirics MSi2500"
	depends on !USB_MSI2500
	depends on BACKPORT_VIDEO_V4L2 && SPI
	select BACKPORT_VIDEOBUF2_VMALLOC
	select BACKPORT_MEDIA_TUNER_MSI001
```

## backports/drivers/media/usb/pvrusb2/Kconfig
```kconfig
config BACKPORT_VIDEO_PVRUSB2
	tristate "Hauppauge WinTV-PVR USB2 support"
	depends on !VIDEO_PVRUSB2
	depends on BACKPORT_VIDEO_V4L2 && I2C
	select BACKPORT_VIDEO_TUNER
	select BACKPORT_VIDEO_TVEEPROM
	select BACKPORT_VIDEO_CX2341X
	select BACKPORT_VIDEO_SAA711X
	select BACKPORT_VIDEO_CX25840
	select BACKPORT_VIDEO_MSP3400
	select BACKPORT_VIDEO_WM8775
	select BACKPORT_VIDEO_CS53L32A
	---help---
	  This is a video4linux driver for Conexant 23416 based
	  usb2 personal video recorder devices.

	  To compile this driver as a module, choose M here: the
	  module will be called pvrusb2

config BACKPORT_VIDEO_PVRUSB2_SYSFS
	bool "pvrusb2 sysfs support"
	depends on !VIDEO_PVRUSB2_SYSFS
	default y
	depends on BACKPORT_VIDEO_PVRUSB2 && SYSFS
	---help---
	  This option enables the operation of a sysfs based
	  interface for query and control of the pvrusb2 driver.

	  This is not generally needed for v4l applications,
	  although certain applications are optimized to take
	  advantage of this feature.

	  If you are in doubt, say Y.

	  Note: This feature is experimental and subject to change.

config BACKPORT_VIDEO_PVRUSB2_DVB
	bool "pvrusb2 ATSC/DVB support"
	depends on !VIDEO_PVRUSB2_DVB
	default y
	depends on VIDEO_PVRUSB2 && BACKPORT_DVB_CORE
	select DVB_LGDT330X if BACKPORT_MEDIA_SUBDRV_AUTOSELECT
	select DVB_S5H1409 if BACKPORT_MEDIA_SUBDRV_AUTOSELECT
	select DVB_S5H1411 if BACKPORT_MEDIA_SUBDRV_AUTOSELECT
	select DVB_TDA10048 if BACKPORT_MEDIA_SUBDRV_AUTOSELECT
	select MEDIA_TUNER_TDA18271 if BACKPORT_MEDIA_SUBDRV_AUTOSELECT
	select MEDIA_TUNER_SIMPLE if BACKPORT_MEDIA_SUBDRV_AUTOSELECT
	select MEDIA_TUNER_TDA8290 if BACKPORT_MEDIA_SUBDRV_AUTOSELECT
	---help---

	  This option enables a DVB interface for the pvrusb2 driver.
	  If your device does not support digital television, this
	  feature will have no affect on the driver's operation.

	  If you are in doubt, say Y.

config BACKPORT_VIDEO_PVRUSB2_DEBUGIFC
	bool "pvrusb2 debug interface"
	depends on !VIDEO_PVRUSB2_DEBUGIFC
	depends on BACKPORT_VIDEO_PVRUSB2_SYSFS
	---help---
	  This option enables the inclusion of a debug interface
	  in the pvrusb2 driver, hosted through sysfs.

	  You do not need to select this option unless you plan
	  on debugging the driver or performing a manual firmware
	  extraction.

	  If you are in doubt, say N.
```

## backports/drivers/media/usb/s2255/Kconfig
```kconfig
config BACKPORT_USB_S2255
	tristate "USB Sensoray 2255 video capture device"
	depends on !USB_S2255
	depends on BACKPORT_VIDEO_V4L2
	select BACKPORT_VIDEOBUF2_VMALLOC
	default n
	help
	  Say Y here if you want support for the Sensoray 2255 USB device.
	  This driver can be compiled as a module, called s2255drv.
```

## backports/drivers/media/usb/siano/Kconfig
```kconfig
#
# Siano Mobile Silicon Digital TV device configuration
#

config BACKPORT_SMS_USB_DRV
	tristate "Siano SMS1xxx based MDTV receiver"
	depends on !SMS_USB_DRV
	depends on BACKPORT_DVB_CORE && HAS_DMA
	select BACKPORT_MEDIA_COMMON_OPTIONS
	---help---
	  Choose if you would like to have Siano's support for USB interface
```

## backports/drivers/media/usb/stk1160/Kconfig
```kconfig
config BACKPORT_VIDEO_STK1160_COMMON
	tristate "STK1160 USB video capture support"
	depends on !VIDEO_STK1160_COMMON
	depends on BACKPORT_VIDEO_DEV && I2C

	---help---
	  This is a video4linux driver for STK1160 based video capture devices.

	  To compile this driver as a module, choose M here: the
	  module will be called stk1160

config BACKPORT_VIDEO_STK1160_AC97
	bool "STK1160 AC97 codec support"
	depends on !VIDEO_STK1160_AC97
	depends on BACKPORT_VIDEO_STK1160_COMMON && SND

	---help---
	  Enables AC97 codec support for stk1160 driver.

config BACKPORT_VIDEO_STK1160
	tristate
	depends on !VIDEO_STK1160
	depends on (!VIDEO_STK1160_AC97 || (SND='n') || SND) && BACKPORT_VIDEO_STK1160_COMMON
	default y
	select BACKPORT_VIDEOBUF2_VMALLOC
	select BACKPORT_VIDEO_SAA711X
	select SND_AC97_CODEC if SND
```

## backports/drivers/media/usb/tm6000/Kconfig
```kconfig
config BACKPORT_VIDEO_TM6000
	tristate "TV Master TM5600/6000/6010 driver"
	depends on !VIDEO_TM6000
	depends on BACKPORT_VIDEO_DEV && I2C && INPUT && RC_CORE && USB
	select BACKPORT_VIDEO_TUNER
	select BACKPORT_MEDIA_TUNER_XC2028
	select BACKPORT_MEDIA_TUNER_XC5000
	select BACKPORT_VIDEOBUF_VMALLOC
	help
	  Support for TM5600/TM6000/TM6010 USB Device

	  Since these cards have no MPEG decoder onboard, they transmit
	  only compressed MPEG data over the usb bus, so you need
	  an external software decoder to watch TV on your computer.

	  Say Y if you own such a device and want to use it.

config BACKPORT_VIDEO_TM6000_ALSA
	tristate "TV Master TM5600/6000/6010 audio support"
	depends on !VIDEO_TM6000_ALSA
	depends on BACKPORT_VIDEO_TM6000 && SND
	depends on SND_PCM
	---help---
	  This is a video4linux driver for direct (DMA) audio for
	  TM5600/TM6000/TM6010 USB Devices.

	  To compile this driver as a module, choose M here: the
	  module will be called tm6000-alsa.

config BACKPORT_VIDEO_TM6000_DVB
	tristate "DVB Support for tm6000 based TV cards"
	depends on !VIDEO_TM6000_DVB
	depends on VIDEO_TM6000 && BACKPORT_DVB_CORE && USB
	select BACKPORT_DVB_ZL10353
	---help---
	  This adds support for DVB cards based on the tm5600/tm6000 chip.
```

## backports/drivers/media/usb/usbvision/Kconfig
```kconfig
config BACKPORT_VIDEO_USBVISION
	tristate "USB video devices based on Nogatech NT1003/1004/1005"
	depends on !VIDEO_USBVISION
	depends on I2C && BACKPORT_VIDEO_V4L2
	select BACKPORT_VIDEO_TUNER
	select VIDEO_SAA711X if BACKPORT_MEDIA_SUBDRV_AUTOSELECT
	---help---
	  There are more than 50 different USB video devices based on
	  NT1003/1004/1005 USB Bridges. This driver enables using those
	  devices.

	  To compile this driver as a module, choose M here: the
	  module will be called usbvision.
```

## backports/drivers/media/usb/zr364xx/Kconfig
```kconfig
config BACKPORT_USB_ZR364XX
	tristate "USB ZR364XX Camera support"
	depends on !USB_ZR364XX
	depends on BACKPORT_VIDEO_V4L2
	select BACKPORT_VIDEOBUF_GEN
	select BACKPORT_VIDEOBUF_VMALLOC
	---help---
	  Say Y here if you want to connect this type of camera to your
	  computer's USB port.
	  See <file:Documentation/video4linux/zr364xx.txt> for more info
	  and list of supported cameras.

	  To compile this driver as a module, choose M here: the
	  module will be called zr364xx.
```

## backports/drivers/media/v4l2-core/Kconfig
```kconfig
#
# Generic video config states
#

# Enable the V4L2 core and API
config BACKPORT_VIDEO_V4L2
	tristate
	depends on !VIDEO_V4L2
	depends on (I2C || I2C=n) && BACKPORT_VIDEO_DEV
	default (I2C || I2C=n) && BACKPORT_VIDEO_DEV

config BACKPORT_VIDEO_ADV_DEBUG
	bool "Enable advanced debug functionality on V4L2 drivers"
	depends on !VIDEO_ADV_DEBUG
	default n
	---help---
	  Say Y here to enable advanced debugging functionality on some
	  V4L devices.
	  In doubt, say N.

config BACKPORT_VIDEO_FIXED_MINOR_RANGES
	bool "Enable old-style fixed minor ranges on drivers/video devices"
	depends on !VIDEO_FIXED_MINOR_RANGES
	default n
	---help---
	  Say Y here to enable the old-style fixed-range minor assignments.
	  Only useful if you rely on the old behavior and use mknod instead of udev.

	  When in doubt, say N.

config BACKPORT_VIDEO_PCI_SKELETON
	tristate "Skeleton PCI V4L2 driver"
	depends on !VIDEO_PCI_SKELETON
	depends on PCI && BUILD_DOCSRC
	depends on BACKPORT_VIDEO_V4L2 && VIDEOBUF2_CORE
	depends on BACKPORT_VIDEOBUF2_MEMOPS && VIDEOBUF2_DMA_CONTIG
	---help---
	  Enable build of the skeleton PCI driver, used as a reference
	  when developing new drivers.

# Used by drivers that need tuner.ko
config BACKPORT_VIDEO_TUNER
	tristate
	depends on !VIDEO_TUNER
	depends on BACKPORT_MEDIA_TUNER

# Used by drivers that need v4l2-mem2mem.ko
config BACKPORT_V4L2_MEM2MEM_DEV
        tristate
	depends on !V4L2_MEM2MEM_DEV
        depends on BACKPORT_VIDEOBUF2_CORE

# Used by drivers that need Videobuf modules
config BACKPORT_VIDEOBUF_GEN
	tristate
	depends on !VIDEOBUF_GEN

config BACKPORT_VIDEOBUF_DMA_SG
	tristate
	depends on !VIDEOBUF_DMA_SG
	depends on HAS_DMA
	select BACKPORT_VIDEOBUF_GEN

config BACKPORT_VIDEOBUF_VMALLOC
	tristate
	depends on !VIDEOBUF_VMALLOC
	select BACKPORT_VIDEOBUF_GEN

config BACKPORT_VIDEOBUF_DMA_CONTIG
	tristate
	depends on !VIDEOBUF_DMA_CONTIG
	depends on HAS_DMA
	select BACKPORT_VIDEOBUF_GEN

config BACKPORT_VIDEOBUF_DVB
	tristate
	depends on !VIDEOBUF_DVB
	select BACKPORT_VIDEOBUF_GEN

# Used by drivers that need Videobuf2 modules
config BACKPORT_VIDEOBUF2_CORE
	select DMA_SHARED_BUFFER if !KERNEL_3_5
	depends on !VIDEOBUF2_CORE
	tristate

config BACKPORT_VIDEOBUF2_MEMOPS
	tristate
	depends on !VIDEOBUF2_MEMOPS

config BACKPORT_VIDEOBUF2_DMA_CONTIG
	tristate
	depends on !VIDEOBUF2_DMA_CONTIG
	depends on HAS_DMA
	select BACKPORT_VIDEOBUF2_CORE
	select BACKPORT_VIDEOBUF2_MEMOPS
	select DMA_SHARED_BUFFER if !KERNEL_3_5

config BACKPORT_VIDEOBUF2_VMALLOC
	tristate
	depends on !VIDEOBUF2_VMALLOC
	select BACKPORT_VIDEOBUF2_CORE
	select BACKPORT_VIDEOBUF2_MEMOPS
	select DMA_SHARED_BUFFER if !KERNEL_3_5

config BACKPORT_VIDEOBUF2_DMA_SG
	tristate
	depends on !VIDEOBUF2_DMA_SG
	#depends on HAS_DMA
	select BACKPORT_VIDEOBUF2_CORE
	select BACKPORT_VIDEOBUF2_MEMOPS

config BACKPORT_VIDEOBUF2_DVB
	tristate
	depends on !VIDEOBUF2_DVB
	select BACKPORT_VIDEOBUF2_CORE
```
