## backports/drivers/net/ethernet/Kconfig
```kconfig
#
# Ethernet LAN device configuration
#

menuconfig BACKPORT_ETHERNET
	bool "Ethernet driver support"
	depends on !ETHERNET
	depends on NET
	default y
	---help---
	  This section contains all the Ethernet device drivers.

if BACKPORT_ETHERNET

config BACKPORT_MDIO
	tristate
	depends on !MDIO

config BACKPORT_SUNGEM_PHY
	tristate
	depends on !SUNGEM_PHY

#source "drivers/net/ethernet/3com/Kconfig"
#source "drivers/net/ethernet/adaptec/Kconfig"
#source "drivers/net/ethernet/aeroflex/Kconfig"
#source "drivers/net/ethernet/agere/Kconfig"
#source "drivers/net/ethernet/allwinner/Kconfig"
#source "drivers/net/ethernet/alteon/Kconfig"
#source "drivers/net/ethernet/altera/Kconfig"
#source "drivers/net/ethernet/amd/Kconfig"
#source "drivers/net/ethernet/apm/Kconfig"
#source "drivers/net/ethernet/apple/Kconfig"
#source "drivers/net/ethernet/arc/Kconfig"
source "$BACKPORT_DIR/drivers/net/ethernet/atheros/Kconfig"
#source "drivers/net/ethernet/cadence/Kconfig"
#source "drivers/net/ethernet/adi/Kconfig"
source "$BACKPORT_DIR/drivers/net/ethernet/broadcom/Kconfig"
#source "drivers/net/ethernet/brocade/Kconfig"
#source "drivers/net/ethernet/calxeda/Kconfig"
#source "drivers/net/ethernet/chelsio/Kconfig"
#source "drivers/net/ethernet/cirrus/Kconfig"
#source "drivers/net/ethernet/cisco/Kconfig"

config BACKPORT_CX_ECAT
	depends on n
	tristate "Beckhoff CX5020 EtherCAT master support"
	depends on !CX_ECAT
	depends on PCI
	depends on X86 || COMPILE_TEST
	---help---
	  Driver for EtherCAT master module located on CCAT FPGA
	  that can be found on Beckhoff CX5020, and possibly other of CX
	  Beckhoff CX series industrial PCs.

	  To compile this driver as a module, choose M here. The module
	  will be called ec_bhf.

#source "drivers/net/ethernet/davicom/Kconfig"

config BACKPORT_DNET
	depends on n
	tristate "Dave ethernet support (DNET)"
	depends on !DNET
	depends on HAS_IOMEM
	depends on PHYLIB
	---help---
	  The Dave ethernet interface (DNET) is found on Qong Board FPGA.
	  Say Y to include support for the BACKPORT_DNET chip.

	  To compile this driver as a module, choose M here: the module
	  will be called dnet.

#source "drivers/net/ethernet/dec/Kconfig"
#source "drivers/net/ethernet/dlink/Kconfig"
#source "drivers/net/ethernet/emulex/Kconfig"
#source "drivers/net/ethernet/neterion/Kconfig"
#source "drivers/net/ethernet/faraday/Kconfig"
#source "drivers/net/ethernet/freescale/Kconfig"
#source "drivers/net/ethernet/fujitsu/Kconfig"
#source "drivers/net/ethernet/hisilicon/Kconfig"
#source "drivers/net/ethernet/hp/Kconfig"
#source "drivers/net/ethernet/ibm/Kconfig"
source "$BACKPORT_DIR/drivers/net/ethernet/intel/Kconfig"
#source "drivers/net/ethernet/i825xx/Kconfig"
#source "drivers/net/ethernet/xscale/Kconfig"
#source "drivers/net/ethernet/icplus/Kconfig"

config BACKPORT_JME
	depends on n
	tristate "JMicron(R) PCI-Express Gigabit Ethernet support"
	depends on !JME
	depends on PCI
	depends on CRC32
	depends on MII
	---help---
	  This driver supports the PCI-Express gigabit ethernet adapters
	  based on JMicron JMC250 chipset.

	  To compile this driver as a module, choose M here. The module
	  will be called jme.

config BACKPORT_KORINA
	depends on n
	tristate "Korina (IDT RC32434) Ethernet support"
	depends on !KORINA
	depends on MIKROTIK_RB532
	---help---
	  If you have a Mikrotik RouterBoard 500 or IDT RC32434
	  based system say Y. Otherwise say N.

config BACKPORT_LANTIQ_ETOP
	depends on n
	tristate "Lantiq SoC ETOP driver"
	depends on !LANTIQ_ETOP
	depends on SOC_TYPE_XWAY
	---help---
	  Support for the MII0 inside the Lantiq SoC

#source "drivers/net/ethernet/marvell/Kconfig"
#source "drivers/net/ethernet/mellanox/Kconfig"
#source "drivers/net/ethernet/micrel/Kconfig"
#source "drivers/net/ethernet/microchip/Kconfig"
#source "drivers/net/ethernet/moxa/Kconfig"
#source "drivers/net/ethernet/myricom/Kconfig"

config BACKPORT_FEALNX
	depends on n
	tristate "Myson MTD-8xx PCI Ethernet support"
	depends on !FEALNX
	depends on PCI
	depends on CRC32
	depends on MII
	---help---
	  Say Y here to support the Myson MTD-800 family of PCI-based Ethernet
	  cards. <http://www.myson.com.tw/>

#source "drivers/net/ethernet/natsemi/Kconfig"
#source "drivers/net/ethernet/8390/Kconfig"

config BACKPORT_NET_NETX
	depends on n
	tristate "NetX Ethernet support"
	depends on !NET_NETX
	depends on MII
	depends on ARCH_NETX
	---help---
	  This is support for the Hilscher netX builtin Ethernet ports

	  To compile this driver as a module, choose M here. The module
	  will be called netx-eth.

#source "drivers/net/ethernet/nuvoton/Kconfig"
#source "drivers/net/ethernet/nvidia/Kconfig"
#source "drivers/net/ethernet/nxp/Kconfig"
#source "drivers/net/ethernet/octeon/Kconfig"
#source "drivers/net/ethernet/oki-semi/Kconfig"

config BACKPORT_ETHOC
	depends on n
	tristate "OpenCores 10/100 Mbps Ethernet MAC support"
	depends on !ETHOC
	depends on HAS_IOMEM && HAS_DMA
	depends on MII
	depends on PHYLIB
	depends on CRC32
	depends on BITREVERSE
	---help---
	  Say Y here if you want to use the OpenCores 10/100 Mbps Ethernet MAC.

#source "drivers/net/ethernet/packetengines/Kconfig"
#source "drivers/net/ethernet/pasemi/Kconfig"
#source "drivers/net/ethernet/qlogic/Kconfig"
#source "drivers/net/ethernet/qualcomm/Kconfig"
#source "drivers/net/ethernet/realtek/Kconfig"
#source "drivers/net/ethernet/renesas/Kconfig"
#source "drivers/net/ethernet/rdc/Kconfig"
#source "drivers/net/ethernet/rocker/Kconfig"
#source "drivers/net/ethernet/samsung/Kconfig"
#source "drivers/net/ethernet/seeq/Kconfig"
#source "drivers/net/ethernet/silan/Kconfig"
#source "drivers/net/ethernet/sis/Kconfig"
#source "drivers/net/ethernet/sfc/Kconfig"
#source "drivers/net/ethernet/sgi/Kconfig"
#source "drivers/net/ethernet/smsc/Kconfig"
#source "drivers/net/ethernet/stmicro/Kconfig"
#source "drivers/net/ethernet/sun/Kconfig"
#source "drivers/net/ethernet/tehuti/Kconfig"
#source "drivers/net/ethernet/ti/Kconfig"
#source "drivers/net/ethernet/tile/Kconfig"
#source "drivers/net/ethernet/toshiba/Kconfig"
#source "drivers/net/ethernet/tundra/Kconfig"
#source "drivers/net/ethernet/via/Kconfig"
#source "drivers/net/ethernet/wiznet/Kconfig"
#source "drivers/net/ethernet/xilinx/Kconfig"
#source "drivers/net/ethernet/xircom/Kconfig"

endif # BACKPORT_ETHERNET
```

## backports/drivers/net/ethernet/broadcom/Kconfig
```kconfig
#
# Broadcom device configuration
#

config BACKPORT_NET_VENDOR_BROADCOM
	bool "Broadcom devices"
	depends on !NET_VENDOR_BROADCOM
	default y
	depends on (SSB_POSSIBLE && HAS_DMA) || PCI || BCM63XX || \
		   SIBYTE_SB1xxx_SOC
	---help---
	  If you have a network (Ethernet) chipset belonging to this class,
	  say Y.

	  Note that the answer to this question does not directly affect
	  the kernel: saying N will just case the configurator to skip all
	  the questions regarding AMD chipsets. If you say Y, you will be asked
	  for your specific chipset/driver in the following questions.

if BACKPORT_NET_VENDOR_BROADCOM

config BACKPORT_B44
	tristate "Broadcom 440x/47xx ethernet support"
	depends on !B44
	depends on BACKPORT_SSB_POSSIBLE && HAS_DMA
	select BACKPORT_SSB
	depends on MII
	depends on PHYLIB
	---help---
	  If you have a network (Ethernet) controller of this type, say Y
	  or M and read the Ethernet-HOWTO, available from
	  <http://www.tldp.org/docs.html#howto>.

	  To compile this driver as a module, choose M here. The module
	  will be called b44.

# Auto-select BACKPORT_SSB PCI-HOST support, if possible
config BACKPORT_B44_PCI_AUTOSELECT
	bool
	depends on !B44_PCI_AUTOSELECT
	depends on BACKPORT_B44 && SSB_PCIHOST_POSSIBLE
	select BACKPORT_SSB_PCIHOST
	default y

# Auto-select BACKPORT_SSB PCICORE driver, if possible
config BACKPORT_B44_PCICORE_AUTOSELECT
	bool
	depends on !B44_PCICORE_AUTOSELECT
	depends on BACKPORT_B44 && SSB_DRIVER_PCICORE_POSSIBLE
	select BACKPORT_SSB_DRIVER_PCICORE
	default y

config BACKPORT_B44_PCI
	bool
	depends on !B44_PCI
	depends on BACKPORT_B44_PCI_AUTOSELECT && BACKPORT_B44_PCICORE_AUTOSELECT
	default y

config BACKPORT_BCM63XX_ENET
	depends on n
	tristate "Broadcom 63xx internal mac support"
	depends on !BCM63XX_ENET
	depends on BCM63XX
	depends on MII
	depends on PHYLIB
	help
	  This driver supports the ethernet MACs in the Broadcom 63xx
	  MIPS chipset family (BCM63XX).

config BACKPORT_BCMGENET
	depends on n
	tristate "Broadcom GENET internal MAC support"
	depends on !BCMGENET
	depends on MII
	depends on PHYLIB
	depends on FIXED_PHY
	depends on BCM7XXX_PHY
	help
	  This driver supports the built-in Ethernet MACs found in the
	  Broadcom BCM7xxx Set Top Box family chipset.

config BACKPORT_BNX2
	depends on n
	tristate "QLogic NetXtremeII support"
	depends on !BNX2
	depends on PCI
	depends on CRC32
	depends on FW_LOADER
	---help---
	  This driver supports QLogic NetXtremeII gigabit Ethernet cards.

	  To compile this driver as a module, choose M here: the module
	  will be called bnx2.  This is recommended.

config BACKPORT_CNIC
	depends on n
	tristate "QLogic CNIC support"
	depends on !CNIC
	depends on PCI && (IPV6 || IPV6=n)
	select BACKPORT_BNX2
	depends on UIO
	---help---
	  This driver supports offload features of QLogic NetXtremeII
	  gigabit Ethernet cards.

	  To compile this driver as a module, choose M here: the module
	  will be called cnic.  This is recommended.

config BACKPORT_SB1250_MAC
	depends on n
	tristate "SB1250 Gigabit Ethernet support"
	depends on !SB1250_MAC
	depends on SIBYTE_SB1xxx_SOC
	depends on PHYLIB
	---help---
	  This driver supports Gigabit Ethernet interfaces based on the
	  Broadcom SiByte family of System-On-a-Chip parts.  They include
	  the BCM1120, BCM1125, BCM1125H, BCM1250, BCM1255, BCM1280, BCM1455
	  and BCM1480 chips.

	  To compile this driver as a module, choose M here: the module
	  will be called sb1250-mac.

config BACKPORT_TIGON3
	depends on n
	tristate "Broadcom Tigon3 support"
	depends on !TIGON3
	depends on PCI
	depends on PHYLIB
	depends on HWMON
	depends on PTP_1588_CLOCK
	---help---
	  This driver supports Broadcom Tigon3 based gigabit Ethernet cards.

	  To compile this driver as a module, choose M here: the module
	  will be called tg3.  This is recommended.

config BACKPORT_BNX2X
	depends on n
	tristate "Broadcom NetXtremeII 10Gb support"
	depends on !BNX2X
	depends on PCI
	depends on PTP_1588_CLOCK
	depends on FW_LOADER
	depends on ZLIB_INFLATE
	depends on LIBCRC32C
	select BACKPORT_MDIO
	---help---
	  This driver supports Broadcom NetXtremeII 10 gigabit Ethernet cards.
	  To compile this driver as a module, choose M here: the module
	  will be called bnx2x.  This is recommended.

config BACKPORT_BNX2X_SRIOV
	bool "Broadcom 578xx and 57712 SR-IOV support"
	depends on !BNX2X_SRIOV
	depends on BACKPORT_BNX2X && PCI_IOV
	default y
	---help---
	  This configuration parameter enables Single Root Input Output
	  Virtualization support in the 578xx and 57712 products. This
	  allows for virtual function acceleration in virtual environments.

config BACKPORT_BGMAC
	depends on n
	tristate "BCMA bus GBit core support"
	depends on !BGMAC
	depends on BACKPORT_BCMA_HOST_SOC && HAS_DMA && BCM47XX
	depends on PHYLIB
	---help---
	  This driver supports GBit MAC and BCM4706 GBit MAC cores on BACKPORT_BCMA bus.
	  They can be found on BCM47xx SoCs and provide gigabit ethernet.
	  In case of using this driver on BCM4706 it's also requires to enable
	  BACKPORT_BCMA_DRIVER_GMAC_CMN to make it work.

config BACKPORT_SYSTEMPORT
	depends on n
	tristate "Broadcom SYSTEMPORT internal MAC support"
	depends on !SYSTEMPORT
	depends on OF
	depends on MII
	depends on PHYLIB
	depends on FIXED_PHY
	help
	  This driver supports the built-in Ethernet MACs found in the
	  Broadcom BCM7xxx Set Top Box family chipset using an internal
	  Ethernet switch.

endif # BACKPORT_NET_VENDOR_BROADCOM
```
