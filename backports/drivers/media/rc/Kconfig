## backports/drivers/media/rc/Kconfig
```kconfig
config BACKPORT_RC_CORE
	tristate
	depends on !RC_CORE
	depends on BACKPORT_MEDIA_RC_SUPPORT
	depends on INPUT
	default y

source "$BACKPORT_DIR/drivers/media/rc/keymaps/Kconfig"

menuconfig BACKPORT_RC_DECODERS
        bool "Remote controller decoders"
	depends on !RC_DECODERS
	depends on BACKPORT_RC_CORE
	default y

if BACKPORT_RC_DECODERS
config BACKPORT_LIRC
	tristate "LIRC interface driver"
	depends on !LIRC
	depends on BACKPORT_RC_CORE

	---help---
	   Enable this option to build the Linux Infrared Remote
	   Control (LIRC) core device interface driver. The BACKPORT_LIRC
	   interface passes raw IR to and from userspace, where the
	   BACKPORT_LIRC daemon handles protocol decoding for IR reception and
	   encoding for IR transmitting (aka "blasting").

config BACKPORT_IR_LIRC_CODEC
	tristate "Enable IR to LIRC bridge"
	depends on !IR_LIRC_CODEC
	depends on BACKPORT_RC_CORE
	depends on BACKPORT_LIRC
	default y

	---help---
	   Enable this option to pass raw IR to and from userspace via
	   the BACKPORT_LIRC interface.


config BACKPORT_IR_NEC_DECODER
	tristate "Enable IR raw decoder for the NEC protocol"
	depends on !IR_NEC_DECODER
	depends on BACKPORT_RC_CORE
	depends on BITREVERSE
	default y

	---help---
	   Enable this option if you have IR with NEC protocol, and
	   if the IR is decoded in software

config BACKPORT_IR_RC5_DECODER
	tristate "Enable IR raw decoder for the RC-5 protocol"
	depends on !IR_RC5_DECODER
	depends on BACKPORT_RC_CORE
	depends on BITREVERSE
	default y

	---help---
	   Enable this option if you have IR with RC-5 protocol, and
	   if the IR is decoded in software

config BACKPORT_IR_RC6_DECODER
	tristate "Enable IR raw decoder for the RC6 protocol"
	depends on !IR_RC6_DECODER
	depends on BACKPORT_RC_CORE
	depends on BITREVERSE
	default y

	---help---
	   Enable this option if you have an infrared remote control which
	   uses the RC6 protocol, and you need software decoding support.

config BACKPORT_IR_JVC_DECODER
	tristate "Enable IR raw decoder for the JVC protocol"
	depends on !IR_JVC_DECODER
	depends on BACKPORT_RC_CORE
	depends on BITREVERSE
	default y

	---help---
	   Enable this option if you have an infrared remote control which
	   uses the JVC protocol, and you need software decoding support.

config BACKPORT_IR_SONY_DECODER
	tristate "Enable IR raw decoder for the Sony protocol"
	depends on !IR_SONY_DECODER
	depends on BACKPORT_RC_CORE
	depends on BITREVERSE
	default y

	---help---
	   Enable this option if you have an infrared remote control which
	   uses the Sony protocol, and you need software decoding support.

config BACKPORT_IR_SANYO_DECODER
	tristate "Enable IR raw decoder for the Sanyo protocol"
	depends on !IR_SANYO_DECODER
	depends on BACKPORT_RC_CORE
	default y

	---help---
	   Enable this option if you have an infrared remote control which
	   uses the Sanyo protocol (Sanyo, Aiwa, Chinon remotes),
	   and you need software decoding support.

config BACKPORT_IR_SHARP_DECODER
	tristate "Enable IR raw decoder for the Sharp protocol"
	depends on !IR_SHARP_DECODER
	depends on BACKPORT_RC_CORE
	default y

	---help---
	   Enable this option if you have an infrared remote control which
	   uses the Sharp protocol, and you need software decoding support.

config BACKPORT_IR_MCE_KBD_DECODER
	tristate "Enable IR raw decoder for the MCE keyboard/mouse protocol"
	depends on !IR_MCE_KBD_DECODER
	depends on BACKPORT_RC_CORE
	depends on BITREVERSE
	default y

	---help---
	   Enable this option if you have a Microsoft Remote Keyboard for
	   Windows Media Center Edition, which you would like to use with
	   a raw IR receiver in your system.

config BACKPORT_IR_XMP_DECODER
	tristate "Enable IR raw decoder for the XMP protocol"
	depends on !IR_XMP_DECODER
	depends on BACKPORT_RC_CORE
	depends on BITREVERSE
	default y

	---help---
	   Enable this option if you have IR with XMP protocol, and
	   if the IR is decoded in software
endif #RC_DECODERS

menuconfig BACKPORT_RC_DEVICES
	bool "Remote Controller devices"
	depends on !RC_DEVICES
	depends on BACKPORT_RC_CORE

if BACKPORT_RC_DEVICES

config BACKPORT_RC_ATI_REMOTE
	tristate "ATI / X10 based USB RF remote controls"
	depends on !RC_ATI_REMOTE
	depends on USB_ARCH_HAS_HCD
	depends on BACKPORT_RC_CORE
	depends on USB
	help
	   Say Y here if you want to use an X10 based USB remote control.
	   These are RF remotes with USB receivers.

	   Such devices include the ATI remote that comes with many of ATI's
	   All-In-Wonder video cards, the X10 "Lola" remote, NVIDIA RF remote,
	   Medion RF remote, and SnapStream FireFly remote.

	   This driver provides mouse pointer, left and right mouse buttons,
	   and maps all the other remote buttons to keypress events.

	   To compile this driver as a module, choose M here: the module will be
	   called ati_remote.

config BACKPORT_IR_ENE
	tristate "ENE eHome Receiver/Transceiver (pnp id: ENE0100/ENE02xxx)"
	depends on !IR_ENE
	depends on PNP
	depends on BACKPORT_RC_CORE
	---help---
	   Say Y here to enable support for integrated infrared receiver
	   /transceiver made by ENE.

	   You can see if you have it by looking at lspnp output.
	   Output should include ENE0100 ENE0200 or something similar.

	   To compile this driver as a module, choose M here: the
	   module will be called ene_ir.

config BACKPORT_IR_HIX5HD2
	tristate "Hisilicon hix5hd2 IR remote control"
	depends on !IR_HIX5HD2
	depends on BACKPORT_RC_CORE
	help
	 Say Y here if you want to use hisilicon hix5hd2 remote control.
	 To compile this driver as a module, choose M here: the module will be
	 called ir-hix5hd2.

	 If you're not sure, select N here

config BACKPORT_IR_IMON
	tristate "SoundGraph iMON Receiver and Display"
	depends on !IR_IMON
	depends on USB_ARCH_HAS_HCD
	depends on BACKPORT_RC_CORE
	depends on USB
	---help---
	   Say Y here if you want to use a SoundGraph iMON (aka Antec Veris)
	   IR Receiver and/or LCD/VFD/VGA display.

	   To compile this driver as a module, choose M here: the
	   module will be called imon.

config BACKPORT_IR_MCEUSB
	tristate "Windows Media Center Ed. eHome Infrared Transceiver"
	depends on !IR_MCEUSB
	depends on USB_ARCH_HAS_HCD
	depends on BACKPORT_RC_CORE
	depends on USB
	---help---
	   Say Y here if you want to use a Windows Media Center Edition
	   eHome Infrared Transceiver.

	   To compile this driver as a module, choose M here: the
	   module will be called mceusb.

config BACKPORT_IR_ITE_CIR
	tristate "ITE Tech Inc. IT8712/IT8512 Consumer Infrared Transceiver"
	depends on !IR_ITE_CIR
	depends on PNP
	depends on BACKPORT_RC_CORE
	---help---
	   Say Y here to enable support for integrated infrared receivers
	   /transceivers made by ITE Tech Inc. These are found in
	   several ASUS devices, like the ASUS Digimatrix or the ASUS
	   EEEBox 1501U.

	   To compile this driver as a module, choose M here: the
	   module will be called ite-cir.

config BACKPORT_IR_FINTEK
	tristate "Fintek Consumer Infrared Transceiver"
	depends on !IR_FINTEK
	depends on PNP
	depends on BACKPORT_RC_CORE
	---help---
	   Say Y here to enable support for integrated infrared receiver
	   /transciever made by Fintek. This chip is found on assorted
	   Jetway motherboards (and of course, possibly others).

	   To compile this driver as a module, choose M here: the
	   module will be called fintek-cir.

config BACKPORT_IR_MESON
	tristate "Amlogic Meson IR remote receiver"
	depends on !IR_MESON
	depends on BACKPORT_RC_CORE
	depends on ARCH_MESON || COMPILE_TEST
	---help---
	   Say Y if you want to use the IR remote receiver available
	   on Amlogic Meson SoCs.

	   To compile this driver as a module, choose M here: the
	   module will be called meson-ir.

config BACKPORT_IR_NUVOTON
	tristate "Nuvoton w836x7hg Consumer Infrared Transceiver"
	depends on !IR_NUVOTON
	depends on PNP
	depends on BACKPORT_RC_CORE
	---help---
	   Say Y here to enable support for integrated infrared receiver
	   /transciever made by Nuvoton (formerly Winbond). This chip is
	   found in the ASRock ION 330HT, as well as assorted Intel
	   DP55-series motherboards (and of course, possibly others).

	   To compile this driver as a module, choose M here: the
	   module will be called nuvoton-cir.

config BACKPORT_IR_REDRAT3
	tristate "RedRat3 IR Transceiver"
	depends on !IR_REDRAT3
	depends on USB_ARCH_HAS_HCD
	depends on BACKPORT_RC_CORE
	depends on NEW_LEDS
	depends on LEDS_CLASS
	depends on USB
	---help---
	   Say Y here if you want to use a RedRat3 Infrared Transceiver.

	   To compile this driver as a module, choose M here: the
	   module will be called redrat3.

config BACKPORT_IR_STREAMZAP
	tristate "Streamzap PC Remote IR Receiver"
	depends on !IR_STREAMZAP
	depends on USB_ARCH_HAS_HCD
	depends on BACKPORT_RC_CORE
	depends on USB
	---help---
	   Say Y here if you want to use a Streamzap PC Remote
	   Infrared Receiver.

	   To compile this driver as a module, choose M here: the
	   module will be called streamzap.

config BACKPORT_IR_WINBOND_CIR
	tristate "Winbond IR remote control"
	depends on !IR_WINBOND_CIR
	depends on X86 && PNP
	depends on BACKPORT_RC_CORE
	depends on NEW_LEDS
	depends on LEDS_CLASS
	depends on BITREVERSE
	---help---
	   Say Y here if you want to use the IR remote functionality found
	   in some Winbond SuperI/O chips. Currently only the WPCD376I
	   chip is supported (included in some Intel Media series
	   motherboards).

	   To compile this driver as a module, choose M here: the module will
	   be called winbond_cir.

config BACKPORT_IR_IGORPLUGUSB
	tristate "IgorPlug-USB IR Receiver"
	depends on !IR_IGORPLUGUSB
	depends on USB_ARCH_HAS_HCD
	depends on BACKPORT_RC_CORE
	depends on USB
	---help---
	   Say Y here if you want to use the IgorPlug-USB IR Receiver by
	   Igor Cesko. This device is included on the Fit-PC2.

	   Note that this device can only record bursts of 36 IR pulses and
	   spaces, which is not enough for the NEC, Sanyo and RC-6 protocol.

	   To compile this driver as a module, choose M here: the module will
	   be called igorplugusb.

config BACKPORT_IR_IGUANA
	tristate "IguanaWorks USB IR Transceiver"
	depends on !IR_IGUANA
	depends on USB_ARCH_HAS_HCD
	depends on BACKPORT_RC_CORE
	depends on USB
	---help---
	   Say Y here if you want to use the IguanaWorks USB IR Transceiver.
	   Both infrared receive and send are supported. If you want to
	   change the ID or the pin config, use the user space driver from
	   IguanaWorks.

	   Only firmware 0x0205 and later is supported.

	   To compile this driver as a module, choose M here: the module will
	   be called iguanair.

config BACKPORT_IR_TTUSBIR
	tristate "TechnoTrend USB IR Receiver"
	depends on !IR_TTUSBIR
	depends on USB_ARCH_HAS_HCD
	depends on BACKPORT_RC_CORE
	depends on USB
	depends on NEW_LEDS
	depends on LEDS_CLASS
	---help---
	   Say Y here if you want to use the TechnoTrend USB IR Receiver. The
	   driver can control the led.

	   To compile this driver as a module, choose M here: the module will
	   be called ttusbir.

config BACKPORT_IR_RX51
	tristate "Nokia N900 IR transmitter diode"
	depends on !IR_RX51
	depends on OMAP_DM_TIMER && ARCH_OMAP2PLUS && BACKPORT_LIRC && !ARCH_MULTIPLATFORM
	---help---
	   Say Y or M here if you want to enable support for the IR
	   transmitter diode built in the Nokia N900 (RX51) device.

	   The driver uses omap DM timers for generating the carrier
	   wave and pulses.

source "$BACKPORT_DIR/drivers/media/rc/img-ir/Kconfig"

config BACKPORT_RC_LOOPBACK
	tristate "Remote Control Loopback Driver"
	depends on !RC_LOOPBACK
	depends on BACKPORT_RC_CORE
	---help---
	   Say Y here if you want support for the remote control loopback
	   driver which allows TX data to be sent back as RX data.
	   This is mostly useful for debugging purposes.

	   If you're not sure, select N here.

	   To compile this driver as a module, choose M here: the module will
	   be called rc_loopback.

config BACKPORT_IR_GPIO_CIR
	tristate "GPIO IR remote control"
	depends on !IR_GPIO_CIR
	depends on BACKPORT_RC_CORE
	---help---
	   Say Y if you want to use GPIO based IR Receiver.

	   To compile this driver as a module, choose M here: the module will
	   be called gpio-ir-recv.

config BACKPORT_RC_ST
	tristate "ST remote control receiver"
	depends on !RC_ST
	depends on BACKPORT_RC_CORE
	depends on ARCH_STI || COMPILE_TEST
	help
	 Say Y here if you want support for ST remote control driver
	 which allows both IR and UHF RX.
	 The driver passes raw pulse and space information to the BACKPORT_LIRC decoder.

	 If you're not sure, select N here.

config BACKPORT_IR_SUNXI
    tristate "SUNXI IR remote control"
	depends on !IR_SUNXI
    depends on BACKPORT_RC_CORE
    depends on ARCH_SUNXI || COMPILE_TEST
    ---help---
      Say Y if you want to use sunXi internal IR Controller

      To compile this driver as a module, choose M here: the module will
      be called sunxi-ir.

endif #RC_DEVICES
```

## backports/drivers/media/rc/img-ir/Kconfig
```kconfig
config BACKPORT_IR_IMG
	tristate "ImgTec IR Decoder"
	depends on !IR_IMG
	depends on BACKPORT_RC_CORE
	depends on METAG || MIPS || COMPILE_TEST
	select BACKPORT_IR_IMG_HW if !IR_IMG_RAW
	help
	   Say Y or M here if you want to use the ImgTec infrared decoder
	   functionality found in SoCs such as TZ1090.

config BACKPORT_IR_IMG_RAW
	bool "Raw decoder"
	depends on !IR_IMG_RAW
	depends on BACKPORT_IR_IMG
	help
	   Say Y here to enable the raw mode driver which passes raw IR signal
	   changes to the IR raw decoders for software decoding. This is much
	   less reliable (due to lack of timestamps) and consumes more
	   processing power than using hardware decode, but can be useful for
	   testing, debug, and to make more protocols available.

config BACKPORT_IR_IMG_HW
	bool "Hardware decoder"
	depends on !IR_IMG_HW
	depends on BACKPORT_IR_IMG
	help
	   Say Y here to enable the hardware decode driver which decodes the IR
	   signals in hardware. This is more reliable, consumes less processing
	   power since only a single interrupt is received for each scancode,
	   and allows an IR scancode to be used as a wake event.

config BACKPORT_IR_IMG_NEC
	bool "NEC protocol support"
	depends on !IR_IMG_NEC
	depends on BACKPORT_IR_IMG_HW
	help
	   Say Y here to enable support for the NEC, extended NEC, and 32-bit
	   NEC protocols in the ImgTec infrared decoder block.

config BACKPORT_IR_IMG_JVC
	bool "JVC protocol support"
	depends on !IR_IMG_JVC
	depends on BACKPORT_IR_IMG_HW
	help
	   Say Y here to enable support for the JVC protocol in the ImgTec
	   infrared decoder block.

config BACKPORT_IR_IMG_SONY
	bool "Sony protocol support"
	depends on !IR_IMG_SONY
	depends on BACKPORT_IR_IMG_HW
	help
	   Say Y here to enable support for the Sony protocol in the ImgTec
	   infrared decoder block.

config BACKPORT_IR_IMG_SHARP
	bool "Sharp protocol support"
	depends on !IR_IMG_SHARP
	depends on BACKPORT_IR_IMG_HW
	help
	   Say Y here to enable support for the Sharp protocol in the ImgTec
	   infrared decoder block.

config BACKPORT_IR_IMG_SANYO
	bool "Sanyo protocol support"
	depends on !IR_IMG_SANYO
	depends on BACKPORT_IR_IMG_HW
	help
	   Say Y here to enable support for the Sanyo protocol (used by Sanyo,
	   Aiwa, Chinon remotes) in the ImgTec infrared decoder block.
```
