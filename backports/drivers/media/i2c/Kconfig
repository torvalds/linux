## backports/drivers/media/platform/soc_camera/Kconfig
```kconfig
config BACKPORT_SOC_CAMERA
	tristate "SoC camera support"
	depends on !SOC_CAMERA
	depends on BACKPORT_VIDEO_V4L2 && HAS_DMA && I2C
	select BACKPORT_VIDEOBUF_GEN
	select BACKPORT_VIDEOBUF2_CORE
	help
	  SoC Camera is a common API to several cameras, not connecting
	  over a bus like PCI or USB. For example some i2c camera connected
	  directly to the data bus of an SoC.

config BACKPORT_SOC_CAMERA_SCALE_CROP
	tristate
	depends on !SOC_CAMERA_SCALE_CROP

config BACKPORT_SOC_CAMERA_PLATFORM
	tristate "platform camera support"
	depends on !SOC_CAMERA_PLATFORM
	depends on BACKPORT_SOC_CAMERA
	help
	  This is a generic SoC camera platform driver, useful for testing

config BACKPORT_VIDEO_MX3
	tristate "i.MX3x Camera Sensor Interface driver"
	depends on !VIDEO_MX3
	depends on BACKPORT_VIDEO_DEV && MX3_IPU && SOC_CAMERA
	depends on MX3_IPU || COMPILE_TEST
	depends on HAS_DMA
	select BACKPORT_VIDEOBUF2_DMA_CONTIG
	---help---
	  This is a v4l2 driver for the i.MX3x Camera Sensor Interface

config BACKPORT_VIDEO_PXA27x
	tristate "PXA27x Quick Capture Interface driver"
	depends on !VIDEO_PXA27x
	depends on BACKPORT_VIDEO_DEV && PXA27x && SOC_CAMERA
	select BACKPORT_VIDEOBUF_DMA_SG
	---help---
	  This is a v4l2 driver for the PXA27x Quick Capture Interface

config BACKPORT_VIDEO_RCAR_VIN
	tristate "R-Car Video Input (VIN) support"
	depends on !VIDEO_RCAR_VIN
	depends on BACKPORT_VIDEO_DEV && SOC_CAMERA
	depends on ARCH_SHMOBILE || COMPILE_TEST
	depends on HAS_DMA
	select BACKPORT_VIDEOBUF2_DMA_CONTIG
	select BACKPORT_SOC_CAMERA_SCALE_CROP
	---help---
	  This is a v4l2 driver for the R-Car VIN Interface

config BACKPORT_VIDEO_SH_MOBILE_CSI2
	tristate "SuperH Mobile MIPI CSI-2 Interface driver"
	depends on !VIDEO_SH_MOBILE_CSI2
	depends on BACKPORT_VIDEO_DEV && SOC_CAMERA && HAVE_CLK
	depends on ARCH_SHMOBILE || SUPERH || COMPILE_TEST
	---help---
	  This is a v4l2 driver for the SuperH MIPI CSI-2 Interface

config BACKPORT_VIDEO_SH_MOBILE_CEU
	tristate "SuperH Mobile CEU Interface driver"
	depends on !VIDEO_SH_MOBILE_CEU
	depends on BACKPORT_VIDEO_DEV && SOC_CAMERA && HAS_DMA && HAVE_CLK
	depends on ARCH_SHMOBILE || SUPERH || COMPILE_TEST
	depends on HAS_DMA
	select BACKPORT_VIDEOBUF2_DMA_CONTIG
	select BACKPORT_SOC_CAMERA_SCALE_CROP
	---help---
	  This is a v4l2 driver for the SuperH Mobile CEU Interface

config BACKPORT_VIDEO_OMAP1
	tristate "OMAP1 Camera Interface driver"
	depends on !VIDEO_OMAP1
	depends on BACKPORT_VIDEO_DEV && SOC_CAMERA
	depends on ARCH_OMAP1
	depends on HAS_DMA
	select BACKPORT_VIDEOBUF_DMA_CONTIG
	select BACKPORT_VIDEOBUF_DMA_SG
	---help---
	  This is a v4l2 driver for the TI OMAP1 camera interface

config BACKPORT_VIDEO_MX2
	tristate "i.MX27 Camera Sensor Interface driver"
	depends on !VIDEO_MX2
	depends on BACKPORT_VIDEO_DEV && SOC_CAMERA
	depends on SOC_IMX27 || COMPILE_TEST
	depends on HAS_DMA
	select BACKPORT_VIDEOBUF2_DMA_CONTIG
	---help---
	  This is a v4l2 driver for the i.MX27 Camera Sensor Interface

config BACKPORT_VIDEO_ATMEL_ISI
	tristate "ATMEL Image Sensor Interface (ISI) support"
	depends on !VIDEO_ATMEL_ISI
	depends on BACKPORT_VIDEO_DEV && SOC_CAMERA
	depends on ARCH_AT91 || COMPILE_TEST
	depends on HAS_DMA
	select BACKPORT_VIDEOBUF2_DMA_CONTIG
	---help---
	  This module makes the BACKPORT_ATMEL Image Sensor Interface available
	  as a v4l2 device.
```

## backports/drivers/media/platform/vivid/Kconfig
```kconfig
config BACKPORT_VIDEO_VIVID
	tristate "Virtual Video Test Driver"
	depends on !VIDEO_VIVID
	depends on BACKPORT_VIDEO_DEV && VIDEO_V4L2 && !SPARC32 && !SPARC64 && FB
	depends on FONT_SUPPORT
	depends on FONT_8x16
	depends on FB_CFB_FILLRECT
	depends on FB_CFB_COPYAREA
	depends on FB_CFB_IMAGEBLIT
	select BACKPORT_VIDEOBUF2_VMALLOC
	default n
	---help---
	  Enables a virtual video driver. This driver emulates a webcam,
	  TV, S-Video and HDMI capture hardware, including VBI support for
	  the SDTV inputs. Also video output, VBI output, radio receivers,
	  transmitters and software defined radio capture is emulated.

	  It is highly configurable and is ideal for testing applications.
	  Error injection is supported to test rare errors that are hard
	  to reproduce in real hardware.

	  Say Y here if you want to test video apps or debug V4L devices.
	  When in doubt, say N.
```
