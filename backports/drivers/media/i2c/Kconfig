## backports/drivers/media/pci/mantis/Kconfig
```kconfig
config BACKPORT_MANTIS_CORE
	tristate "Mantis/Hopper PCI bridge based devices"
	depends on !MANTIS_CORE
	depends on PCI && I2C && INPUT && BACKPORT_RC_CORE

	help
	  Support for PCI cards based on the Mantis and Hopper PCi bridge.

	  Say Y if you own such a device and want to use it.

config BACKPORT_DVB_MANTIS
	tristate "MANTIS based cards"
	depends on !DVB_MANTIS
	depends on MANTIS_CORE && BACKPORT_DVB_CORE && PCI && I2C
	select DVB_MB86A16 if BACKPORT_MEDIA_SUBDRV_AUTOSELECT
	select DVB_ZL10353 if BACKPORT_MEDIA_SUBDRV_AUTOSELECT
	select DVB_STV0299 if BACKPORT_MEDIA_SUBDRV_AUTOSELECT
	select DVB_LNBP21 if BACKPORT_MEDIA_SUBDRV_AUTOSELECT
	select DVB_STB0899 if BACKPORT_MEDIA_SUBDRV_AUTOSELECT
	select DVB_STB6100 if BACKPORT_MEDIA_SUBDRV_AUTOSELECT
	select DVB_TDA665x if BACKPORT_MEDIA_SUBDRV_AUTOSELECT
	select DVB_TDA10021 if BACKPORT_MEDIA_SUBDRV_AUTOSELECT
	select DVB_TDA10023 if BACKPORT_MEDIA_SUBDRV_AUTOSELECT
	select BACKPORT_DVB_PLL
	help
	  Support for PCI cards based on the Mantis PCI bridge.
	  Say Y when you have a Mantis based DVB card and want to use it.

	  If unsure say N.

config BACKPORT_DVB_HOPPER
	tristate "HOPPER based cards"
	depends on !DVB_HOPPER
	depends on MANTIS_CORE && BACKPORT_DVB_CORE && PCI && I2C
	select DVB_ZL10353 if BACKPORT_MEDIA_SUBDRV_AUTOSELECT
	select BACKPORT_DVB_PLL
	help
	  Support for PCI cards based on the Hopper  PCI bridge.
	  Say Y when you have a Hopper based DVB card and want to use it.

	  If unsure say N
```

## backports/drivers/media/pci/ngene/Kconfig
```kconfig
config BACKPORT_DVB_NGENE
	tristate "Micronas nGene support"
	depends on !DVB_NGENE
	depends on BACKPORT_DVB_CORE && PCI && I2C
	select DVB_LNBP21 if BACKPORT_MEDIA_SUBDRV_AUTOSELECT
	select DVB_STV6110x if BACKPORT_MEDIA_SUBDRV_AUTOSELECT
	select DVB_STV090x if BACKPORT_MEDIA_SUBDRV_AUTOSELECT
	select DVB_LGDT330X if BACKPORT_MEDIA_SUBDRV_AUTOSELECT
	select DVB_DRXK if BACKPORT_MEDIA_SUBDRV_AUTOSELECT
	select DVB_TDA18271C2DD if BACKPORT_MEDIA_SUBDRV_AUTOSELECT
	select MEDIA_TUNER_MT2131 if BACKPORT_MEDIA_SUBDRV_AUTOSELECT
	---help---
	  Support for Micronas PCI express cards with nGene bridge.
```

## backports/drivers/media/pci/pt3/Kconfig
```kconfig
config BACKPORT_DVB_PT3
	tristate "Earthsoft PT3 cards"
	depends on !DVB_PT3
	depends on BACKPORT_DVB_CORE && PCI && I2C
	select DVB_TC90522 if BACKPORT_MEDIA_SUBDRV_AUTOSELECT
	select MEDIA_TUNER_QM1D1C0042 if BACKPORT_MEDIA_SUBDRV_AUTOSELECT
	select MEDIA_TUNER_MXL301RF if BACKPORT_MEDIA_SUBDRV_AUTOSELECT
	help
	  Support for Earthsoft PT3 PCIe cards.

	  Say Y or M if you own such a device and want to use it.
```

## backports/drivers/media/pci/saa7134/Kconfig
```kconfig
config BACKPORT_VIDEO_SAA7134
	tristate "Philips SAA7134 support"
	depends on !VIDEO_SAA7134
	depends on BACKPORT_VIDEO_DEV && PCI && I2C
	select BACKPORT_VIDEOBUF2_DMA_SG
	select BACKPORT_VIDEO_TUNER
	select BACKPORT_VIDEO_TVEEPROM
	depends on CRC32
	select VIDEO_SAA6588 if BACKPORT_MEDIA_SUBDRV_AUTOSELECT
	select VIDEO_SAA6752HS if BACKPORT_MEDIA_SUBDRV_AUTOSELECT
	---help---
	  This is a video4linux driver for Philips SAA713x based
	  TV cards.

	  To compile this driver as a module, choose M here: the
	  module will be called saa7134.

config BACKPORT_VIDEO_SAA7134_ALSA
	tristate "Philips SAA7134 DMA audio support"
	depends on !VIDEO_SAA7134_ALSA
	depends on BACKPORT_VIDEO_SAA7134 && SND
	depends on SND_PCM
	---help---
	  This is a video4linux driver for direct (DMA) audio in
	  Philips SAA713x based TV cards using ALSA

	  To compile this driver as a module, choose M here: the
	  module will be called saa7134-alsa.

config BACKPORT_VIDEO_SAA7134_RC
	bool "Philips SAA7134 Remote Controller support"
	depends on !VIDEO_SAA7134_RC
	depends on BACKPORT_RC_CORE
	depends on BACKPORT_VIDEO_SAA7134
	depends on !(RC_CORE=m && VIDEO_SAA7134=y)
	default y
	---help---
	  Enables Remote Controller support on saa7134 driver.

config BACKPORT_VIDEO_SAA7134_DVB
	tristate "DVB/ATSC Support for saa7134 based TV cards"
	depends on !VIDEO_SAA7134_DVB
	depends on VIDEO_SAA7134 && BACKPORT_DVB_CORE
	select BACKPORT_VIDEOBUF2_DVB
	select DVB_PLL if BACKPORT_MEDIA_SUBDRV_AUTOSELECT
	select DVB_MT352 if BACKPORT_MEDIA_SUBDRV_AUTOSELECT
	select DVB_TDA1004X if BACKPORT_MEDIA_SUBDRV_AUTOSELECT
	select DVB_NXT200X if BACKPORT_MEDIA_SUBDRV_AUTOSELECT
	select DVB_TDA10086 if BACKPORT_MEDIA_SUBDRV_AUTOSELECT
	select DVB_TDA826X if BACKPORT_MEDIA_SUBDRV_AUTOSELECT
	select DVB_ISL6421 if BACKPORT_MEDIA_SUBDRV_AUTOSELECT
	select DVB_ISL6405 if BACKPORT_MEDIA_SUBDRV_AUTOSELECT
	select MEDIA_TUNER_TDA827X if BACKPORT_MEDIA_SUBDRV_AUTOSELECT
	select MEDIA_TUNER_SIMPLE if BACKPORT_MEDIA_SUBDRV_AUTOSELECT
	select DVB_ZL10036 if BACKPORT_MEDIA_SUBDRV_AUTOSELECT
	select DVB_MT312 if BACKPORT_MEDIA_SUBDRV_AUTOSELECT
	select DVB_LNBP21 if BACKPORT_MEDIA_SUBDRV_AUTOSELECT
	select DVB_ZL10353 if BACKPORT_MEDIA_SUBDRV_AUTOSELECT
	select DVB_LGDT3305 if BACKPORT_MEDIA_SUBDRV_AUTOSELECT
	select DVB_TDA10048 if BACKPORT_MEDIA_SUBDRV_AUTOSELECT
	select MEDIA_TUNER_TDA18271 if BACKPORT_MEDIA_SUBDRV_AUTOSELECT
	select MEDIA_TUNER_TDA8290 if BACKPORT_MEDIA_SUBDRV_AUTOSELECT
	select DVB_ZL10039 if BACKPORT_MEDIA_SUBDRV_AUTOSELECT
	---help---
	  This adds support for DVB cards based on the
	  Philips saa7134 chip.

	  To compile this driver as a module, choose M here: the
	  module will be called saa7134-dvb.

config BACKPORT_VIDEO_SAA7134_GO7007
	tristate "go7007 support for saa7134 based TV cards"
	depends on !VIDEO_SAA7134_GO7007
	depends on BACKPORT_VIDEO_SAA7134
	depends on BACKPORT_VIDEO_GO7007
	---help---
	  Enables saa7134 driver support for boards with go7007
	  MPEG encoder (WIS Voyager or compatible).
```

## backports/drivers/media/pci/saa7146/Kconfig
```kconfig
config BACKPORT_VIDEO_HEXIUM_GEMINI
	tristate "Hexium Gemini frame grabber"
	depends on !VIDEO_HEXIUM_GEMINI
	depends on PCI && BACKPORT_VIDEO_V4L2 && I2C
	select BACKPORT_VIDEO_SAA7146_VV
	---help---
	  This is a video4linux driver for the Hexium Gemini frame
	  grabber card by Hexium. Please note that the Gemini Dual
	  card is *not* fully supported.

	  To compile this driver as a module, choose M here: the
	  module will be called hexium_gemini.

config BACKPORT_VIDEO_HEXIUM_ORION
	tristate "Hexium HV-PCI6 and Orion frame grabber"
	depends on !VIDEO_HEXIUM_ORION
	depends on PCI && BACKPORT_VIDEO_V4L2 && I2C
	select BACKPORT_VIDEO_SAA7146_VV
	---help---
	  This is a video4linux driver for the Hexium HV-PCI6 and
	  Orion frame grabber cards by Hexium.

	  To compile this driver as a module, choose M here: the
	  module will be called hexium_orion.

config BACKPORT_VIDEO_MXB
	tristate "Siemens-Nixdorf 'Multimedia eXtension Board'"
	depends on !VIDEO_MXB
	depends on PCI && BACKPORT_VIDEO_V4L2 && I2C
	select BACKPORT_VIDEO_SAA7146_VV
	select BACKPORT_VIDEO_TUNER
	select VIDEO_SAA711X if BACKPORT_MEDIA_SUBDRV_AUTOSELECT
	select VIDEO_TDA9840 if BACKPORT_MEDIA_SUBDRV_AUTOSELECT
	select VIDEO_TEA6415C if BACKPORT_MEDIA_SUBDRV_AUTOSELECT
	select VIDEO_TEA6420 if BACKPORT_MEDIA_SUBDRV_AUTOSELECT
	---help---
	  This is a video4linux driver for the 'Multimedia eXtension Board'
	  TV card by Siemens-Nixdorf.

	  To compile this driver as a module, choose M here: the
	  module will be called mxb.
```

## backports/drivers/media/pci/saa7164/Kconfig
```kconfig
config BACKPORT_VIDEO_SAA7164
	tristate "NXP SAA7164 support"
	depends on !VIDEO_SAA7164
	depends on DVB_CORE && BACKPORT_VIDEO_DEV && PCI && I2C
	depends on I2C_ALGOBIT
	depends on FW_LOADER
	select BACKPORT_VIDEO_TUNER
	select BACKPORT_VIDEO_TVEEPROM
	select BACKPORT_VIDEOBUF_DVB
	select DVB_TDA10048 if BACKPORT_MEDIA_SUBDRV_AUTOSELECT
	select DVB_S5H1411 if BACKPORT_MEDIA_SUBDRV_AUTOSELECT
	select MEDIA_TUNER_TDA18271 if BACKPORT_MEDIA_SUBDRV_AUTOSELECT
	---help---
	  This is a video4linux driver for NXP SAA7164 based
	  TV cards.

	  To compile this driver as a module, choose M here: the
	  module will be called saa7164
```

## backports/drivers/media/pci/solo6x10/Kconfig
```kconfig
config BACKPORT_VIDEO_SOLO6X10
	tristate "Bluecherry / Softlogic 6x10 capture cards (MPEG-4/H.264)"
	depends on !VIDEO_SOLO6X10
	depends on PCI && BACKPORT_VIDEO_DEV && SND && I2C
	depends on HAS_DMA
	depends on BITREVERSE
	depends on FONT_SUPPORT
	depends on FONT_8x16
	select BACKPORT_VIDEOBUF2_DMA_SG
	select BACKPORT_VIDEOBUF2_DMA_CONTIG
	depends on SND_PCM
	depends on FONT_8x16
	---help---
	  This driver supports the Bluecherry H.264 and MPEG-4 hardware
	  compression capture cards and other Softlogic-based ones.

	  Following cards have been tested:
	  * Bluecherry BC-H16480A (PCIe, 16 port, H.264)
	  * Bluecherry BC-H04120A (PCIe, 4 port, H.264)
	  * Bluecherry BC-H04120A-MPCI (Mini-PCI, 4 port, H.264)
	  * Bluecherry BC-04120A (PCIe, 4 port, MPEG-4)
```

## backports/drivers/media/pci/tw68/Kconfig
```kconfig
config BACKPORT_VIDEO_TW68
	tristate "Techwell tw68x Video For Linux"
	depends on !VIDEO_TW68
	depends on BACKPORT_VIDEO_DEV && PCI && VIDEO_V4L2
	select BACKPORT_VIDEOBUF2_DMA_SG
	---help---
	  Support for Techwell tw68xx based frame grabber boards.

	  To compile this driver as a module, choose M here: the
	  module will be called tw68.
```

## backports/drivers/media/platform/blackfin/Kconfig
```kconfig
config BACKPORT_VIDEO_BLACKFIN_CAPTURE
	tristate "Blackfin Video Capture Driver"
	depends on !VIDEO_BLACKFIN_CAPTURE
	depends on BACKPORT_VIDEO_V4L2 && BLACKFIN && I2C
	depends on HAS_DMA
	select BACKPORT_VIDEOBUF2_DMA_CONTIG
	help
	  V4L2 bridge driver for Blackfin video capture device.
	  Choose PPI or EPPI as its interface.

	  To compile this driver as a module, choose M here: the
	  module will be called bfin_capture.

config BACKPORT_VIDEO_BLACKFIN_PPI
	tristate
	depends on !VIDEO_BLACKFIN_PPI
	depends on BACKPORT_VIDEO_BLACKFIN_CAPTURE
	default BACKPORT_VIDEO_BLACKFIN_CAPTURE
```

## backports/drivers/media/platform/exynos4-is/Kconfig
```kconfig
config BACKPORT_VIDEO_SAMSUNG_EXYNOS4_IS
	bool "Samsung S5P/EXYNOS4 SoC series Camera Subsystem driver"
	depends on !VIDEO_SAMSUNG_EXYNOS4_IS
	depends on VIDEO_V4L2 && BACKPORT_VIDEO_V4L2_SUBDEV_API
	depends on ARCH_S5PV210 || ARCH_EXYNOS || COMPILE_TEST
	depends on OF && COMMON_CLK
	help
	  Say Y here to enable camera host interface devices for
	  Samsung S5P and EXYNOS SoC series.

if BACKPORT_VIDEO_SAMSUNG_EXYNOS4_IS

config BACKPORT_VIDEO_EXYNOS4_IS_COMMON
       tristate
	depends on !VIDEO_EXYNOS4_IS_COMMON

config BACKPORT_VIDEO_S5P_FIMC
	tristate "S5P/EXYNOS4 FIMC/CAMIF camera interface driver"
	depends on !VIDEO_S5P_FIMC
	depends on I2C
	depends on HAS_DMA
	select BACKPORT_VIDEOBUF2_DMA_CONTIG
	select BACKPORT_V4L2_MEM2MEM_DEV
	depends on MFD_SYSCON
	select BACKPORT_VIDEO_EXYNOS4_IS_COMMON
	help
	  This is a V4L2 driver for Samsung S5P and EXYNOS4 SoC camera host
	  interface and video postprocessor (FIMC) devices.

	  To compile this driver as a module, choose M here: the
	  module will be called s5p-fimc.

config BACKPORT_VIDEO_S5P_MIPI_CSIS
	tristate "S5P/EXYNOS MIPI-CSI2 receiver (MIPI-CSIS) driver"
	depends on !VIDEO_S5P_MIPI_CSIS
	depends on REGULATOR
	depends on GENERIC_PHY
	help
	  This is a V4L2 driver for Samsung S5P and EXYNOS4 SoC MIPI-CSI2
	  receiver (MIPI-CSIS) devices.

	  To compile this driver as a module, choose M here: the
	  module will be called s5p-csis.

if SOC_EXYNOS4212 || SOC_EXYNOS4412 || SOC_EXYNOS5250

config BACKPORT_VIDEO_EXYNOS_FIMC_LITE
	tristate "EXYNOS FIMC-LITE camera interface driver"
	depends on !VIDEO_EXYNOS_FIMC_LITE
	depends on I2C
	depends on HAS_DMA
	select BACKPORT_VIDEOBUF2_DMA_CONTIG
	select BACKPORT_VIDEO_EXYNOS4_IS_COMMON
	help
	  This is a V4L2 driver for Samsung EXYNOS4/5 SoC FIMC-LITE camera
	  host interface.

	  To compile this driver as a module, choose M here: the
	  module will be called exynos-fimc-lite.
endif

config BACKPORT_VIDEO_EXYNOS4_FIMC_IS
	tristate "EXYNOS4x12 FIMC-IS (Imaging Subsystem) driver"
	depends on !VIDEO_EXYNOS4_FIMC_IS
	depends on HAS_DMA
	select BACKPORT_VIDEOBUF2_DMA_CONTIG
	depends on OF
	depends on FW_LOADER
	help
	  This is a V4L2 driver for Samsung EXYNOS4x12 SoC series
	  FIMC-IS (Imaging Subsystem).

	  To compile this driver as a module, choose M here: the
	  module will be called exynos4-fimc-is.

config BACKPORT_VIDEO_EXYNOS4_ISP_DMA_CAPTURE
	bool "EXYNOS4x12 FIMC-IS ISP Direct DMA capture support"
	depends on !VIDEO_EXYNOS4_ISP_DMA_CAPTURE
	depends on BACKPORT_VIDEO_EXYNOS4_FIMC_IS
	select BACKPORT_VIDEO_EXYNOS4_IS_COMMON
	default y
	  help
	  This option enables an additional video device node exposing a V4L2
	  video capture interface for the FIMC-IS ISP raw (Bayer) capture DMA.

endif # BACKPORT_VIDEO_SAMSUNG_EXYNOS4_IS
```

## backports/drivers/media/platform/marvell-ccic/Kconfig
```kconfig
config BACKPORT_VIDEO_CAFE_CCIC
	tristate "Marvell 88ALP01 (Cafe) CMOS Camera Controller support"
	depends on !VIDEO_CAFE_CCIC
	depends on PCI && I2C && BACKPORT_VIDEO_V4L2
	depends on HAS_DMA
	select BACKPORT_VIDEO_OV7670
	select BACKPORT_VIDEOBUF2_VMALLOC
	select BACKPORT_VIDEOBUF2_DMA_CONTIG
	---help---
	  This is a video4linux2 driver for the Marvell 88ALP01 integrated
	  CMOS camera controller.  This is the controller found on first-
	  generation OLPC systems.

config BACKPORT_VIDEO_MMP_CAMERA
	tristate "Marvell Armada 610 integrated camera controller support"
	depends on !VIDEO_MMP_CAMERA
	depends on ARCH_MMP && I2C && BACKPORT_VIDEO_V4L2
	depends on HAS_DMA
	select BACKPORT_VIDEO_OV7670
	depends on I2C_GPIO
	select BACKPORT_VIDEOBUF2_DMA_SG
	---help---
	  This is a Video4Linux2 driver for the integrated camera
	  controller found on Marvell Armada 610 application
	  processors (and likely beyond).  This is the controller found
	  in OLPC XO 1.75 systems.
```
