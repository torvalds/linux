## backports/drivers/media/i2c/m5mols/Kconfig
```kconfig
config BACKPORT_VIDEO_M5MOLS
	tristate "Fujitsu M-5MOLS 8MP sensor support"
	depends on !VIDEO_M5MOLS
	depends on I2C && VIDEO_V4L2 && BACKPORT_VIDEO_V4L2_SUBDEV_API
	depends on BACKPORT_MEDIA_CAMERA_SUPPORT
	---help---
	  This driver supports Fujitsu M-5MOLS camera sensor with ISP
```

## backports/drivers/media/i2c/smiapp/Kconfig
```kconfig
config BACKPORT_VIDEO_SMIAPP
	tristate "SMIA++/SMIA sensor support"
	depends on !VIDEO_SMIAPP
	depends on I2C && VIDEO_V4L2 && BACKPORT_VIDEO_V4L2_SUBDEV_API && HAVE_CLK
	depends on BACKPORT_MEDIA_CAMERA_SUPPORT
	select BACKPORT_VIDEO_SMIAPP_PLL
	---help---
	  This is a generic driver for SMIA++/SMIA camera modules.
```

## backports/drivers/media/mmc/Kconfig
```kconfig
comment "Supported MMC/SDIO adapters"
source "$BACKPORT_DIR/drivers/media/mmc/siano/Kconfig"
```

## backports/drivers/media/mmc/siano/Kconfig
```kconfig
#
# Siano Mobile Silicon Digital TV device configuration
#

config BACKPORT_SMS_SDIO_DRV
	tristate "Siano SMS1xxx based MDTV via SDIO interface"
	depends on !SMS_SDIO_DRV
	depends on BACKPORT_DVB_CORE && HAS_DMA
	depends on MMC
	select BACKPORT_MEDIA_COMMON_OPTIONS
	---help---
	  Choose if you would like to have Siano's support for SDIO interface
```

## backports/drivers/media/pci/Kconfig
```kconfig
if PCI && BACKPORT_MEDIA_SUPPORT

menuconfig BACKPORT_MEDIA_PCI_SUPPORT
	bool "Media PCI Adapters"
	depends on !MEDIA_PCI_SUPPORT
	help
	  Enable media drivers for PCI/PCIe bus.
	  If you have such devices, say Y.

if BACKPORT_MEDIA_PCI_SUPPORT

if BACKPORT_MEDIA_CAMERA_SUPPORT
	comment "Media capture support"
source "$BACKPORT_DIR/drivers/media/pci/meye/Kconfig"
source "$BACKPORT_DIR/drivers/media/pci/sta2x11/Kconfig"
endif

if BACKPORT_MEDIA_ANALOG_TV_SUPPORT
	comment "Media capture/analog TV support"
source "$BACKPORT_DIR/drivers/media/pci/ivtv/Kconfig"
source "$BACKPORT_DIR/drivers/media/pci/zoran/Kconfig"
source "$BACKPORT_DIR/drivers/media/pci/saa7146/Kconfig"
source "$BACKPORT_DIR/drivers/media/pci/solo6x10/Kconfig"
source "$BACKPORT_DIR/drivers/media/pci/tw68/Kconfig"
endif

if BACKPORT_MEDIA_ANALOG_TV_SUPPORT || MEDIA_DIGITAL_TV_SUPPORT
	comment "Media capture/analog/hybrid TV support"
source "$BACKPORT_DIR/drivers/media/pci/cx18/Kconfig"
source "$BACKPORT_DIR/drivers/media/pci/cx23885/Kconfig"
source "$BACKPORT_DIR/drivers/media/pci/cx25821/Kconfig"
source "$BACKPORT_DIR/drivers/media/pci/cx88/Kconfig"
source "$BACKPORT_DIR/drivers/media/pci/bt8xx/Kconfig"
source "$BACKPORT_DIR/drivers/media/pci/saa7134/Kconfig"
source "$BACKPORT_DIR/drivers/media/pci/saa7164/Kconfig"

endif

if BACKPORT_MEDIA_DIGITAL_TV_SUPPORT
	comment "Media digital TV PCI Adapters"
source "$BACKPORT_DIR/drivers/media/pci/ttpci/Kconfig"
source "$BACKPORT_DIR/drivers/media/pci/b2c2/Kconfig"
source "$BACKPORT_DIR/drivers/media/pci/pluto2/Kconfig"
source "$BACKPORT_DIR/drivers/media/pci/dm1105/Kconfig"
source "$BACKPORT_DIR/drivers/media/pci/pt1/Kconfig"
source "$BACKPORT_DIR/drivers/media/pci/pt3/Kconfig"
source "$BACKPORT_DIR/drivers/media/pci/mantis/Kconfig"
source "$BACKPORT_DIR/drivers/media/pci/ngene/Kconfig"
source "$BACKPORT_DIR/drivers/media/pci/ddbridge/Kconfig"
source "$BACKPORT_DIR/drivers/media/pci/smipcie/Kconfig"
endif

endif #MEDIA_PCI_SUPPORT
endif #PCI
```

## backports/drivers/media/pci/cx18/Kconfig
```kconfig
config BACKPORT_VIDEO_CX18
	tristate "Conexant cx23418 MPEG encoder support"
	depends on !VIDEO_CX18
	depends on VIDEO_V4L2 && BACKPORT_DVB_CORE && PCI && I2C
	depends on I2C_ALGOBIT
	select BACKPORT_VIDEOBUF_VMALLOC
	depends on BACKPORT_RC_CORE
	select BACKPORT_VIDEO_TUNER
	select BACKPORT_VIDEO_TVEEPROM
	select BACKPORT_VIDEO_CX2341X
	select BACKPORT_VIDEO_CS5345
	select DVB_S5H1409 if BACKPORT_MEDIA_SUBDRV_AUTOSELECT
	select MEDIA_TUNER_MXL5005S if BACKPORT_MEDIA_SUBDRV_AUTOSELECT
	select DVB_S5H1411 if BACKPORT_MEDIA_SUBDRV_AUTOSELECT
	select MEDIA_TUNER_TDA18271 if BACKPORT_MEDIA_SUBDRV_AUTOSELECT
	select MEDIA_TUNER_TDA8290 if BACKPORT_MEDIA_SUBDRV_AUTOSELECT
	---help---
	  This is a video4linux driver for Conexant cx23418 based
	  PCI combo video recorder devices.

	  This is used in devices such as the Hauppauge HVR-1600
	  cards.

	  To compile this driver as a module, choose M here: the
	  module will be called cx18.

config BACKPORT_VIDEO_CX18_ALSA
	tristate "Conexant 23418 DMA audio support"
	depends on !VIDEO_CX18_ALSA
	depends on BACKPORT_VIDEO_CX18 && SND
	depends on SND_PCM
	---help---
	  This is a video4linux driver for direct (DMA) audio on
	  Conexant 23418 based TV cards using ALSA.

	  To compile this driver as a module, choose M here: the
	  module will be called cx18-alsa.
```

## backports/drivers/media/pci/cx23885/Kconfig
```kconfig
config BACKPORT_VIDEO_CX23885
	tristate "Conexant cx23885 (2388x successor) support"
	depends on !VIDEO_CX23885
	depends on DVB_CORE && BACKPORT_VIDEO_DEV && PCI && I2C && INPUT && SND
	select SND_PCM
	select I2C_ALGOBIT
	select BACKPORT_VIDEO_TUNER
	select BACKPORT_VIDEO_TVEEPROM
	depends on BACKPORT_RC_CORE
	select BACKPORT_VIDEOBUF2_DVB
	select BACKPORT_VIDEOBUF2_DMA_SG
	select BACKPORT_VIDEO_CX25840
	select BACKPORT_VIDEO_CX2341X
	select DVB_DIB7000P if BACKPORT_MEDIA_SUBDRV_AUTOSELECT
	select DVB_DRXK if BACKPORT_MEDIA_SUBDRV_AUTOSELECT
	select DVB_S5H1409 if BACKPORT_MEDIA_SUBDRV_AUTOSELECT
	select DVB_S5H1411 if BACKPORT_MEDIA_SUBDRV_AUTOSELECT
	select DVB_LGDT330X if BACKPORT_MEDIA_SUBDRV_AUTOSELECT
	select DVB_ZL10353 if BACKPORT_MEDIA_SUBDRV_AUTOSELECT
	select DVB_TDA10048 if BACKPORT_MEDIA_SUBDRV_AUTOSELECT
	select DVB_LNBP21 if BACKPORT_MEDIA_SUBDRV_AUTOSELECT
	select DVB_STV090x if BACKPORT_MEDIA_SUBDRV_AUTOSELECT
	select DVB_STB6100 if BACKPORT_MEDIA_SUBDRV_AUTOSELECT
	select DVB_STV6110 if BACKPORT_MEDIA_SUBDRV_AUTOSELECT
	select DVB_CX24116 if BACKPORT_MEDIA_SUBDRV_AUTOSELECT
	select DVB_CX24117 if BACKPORT_MEDIA_SUBDRV_AUTOSELECT
	select DVB_STV0900 if BACKPORT_MEDIA_SUBDRV_AUTOSELECT
	select DVB_DS3000 if BACKPORT_MEDIA_SUBDRV_AUTOSELECT
	select DVB_TS2020 if BACKPORT_MEDIA_SUBDRV_AUTOSELECT
	select DVB_STV0367 if BACKPORT_MEDIA_SUBDRV_AUTOSELECT
	select DVB_TDA10071 if BACKPORT_MEDIA_SUBDRV_AUTOSELECT
	select DVB_A8293 if BACKPORT_MEDIA_SUBDRV_AUTOSELECT
	select DVB_MB86A20S if BACKPORT_MEDIA_SUBDRV_AUTOSELECT
	select DVB_SI2165 if BACKPORT_MEDIA_SUBDRV_AUTOSELECT
	select DVB_SI2168 if BACKPORT_MEDIA_SUBDRV_AUTOSELECT
	select DVB_M88DS3103 if BACKPORT_MEDIA_SUBDRV_AUTOSELECT
	select MEDIA_TUNER_MT2063 if BACKPORT_MEDIA_SUBDRV_AUTOSELECT
	select MEDIA_TUNER_MT2131 if BACKPORT_MEDIA_SUBDRV_AUTOSELECT
	select MEDIA_TUNER_XC2028 if BACKPORT_MEDIA_SUBDRV_AUTOSELECT
	select MEDIA_TUNER_TDA8290 if BACKPORT_MEDIA_SUBDRV_AUTOSELECT
	select MEDIA_TUNER_TDA18271 if BACKPORT_MEDIA_SUBDRV_AUTOSELECT
	select MEDIA_TUNER_XC5000 if BACKPORT_MEDIA_SUBDRV_AUTOSELECT
	select MEDIA_TUNER_SI2157 if BACKPORT_MEDIA_SUBDRV_AUTOSELECT
	select MEDIA_TUNER_M88TS2022 if BACKPORT_MEDIA_SUBDRV_AUTOSELECT
	select DVB_TUNER_DIB0070 if BACKPORT_MEDIA_SUBDRV_AUTOSELECT
	---help---
	  This is a video4linux driver for Conexant 23885 based
	  TV cards.

	  To compile this driver as a module, choose M here: the
	  module will be called cx23885

config BACKPORT_MEDIA_ALTERA_CI
	tristate "Altera FPGA based CI module"
	depends on !MEDIA_ALTERA_CI
	depends on VIDEO_CX23885 && BACKPORT_DVB_CORE
	select ALTERA_STAPL
	---help---
	  An Altera FPGA CI module for NetUP Dual DVB-T/C RF CI card.

	  To compile this driver as a module, choose M here: the
	  module will be called altera-ci
```

## backports/drivers/media/pci/cx88/Kconfig
```kconfig
config BACKPORT_VIDEO_CX88
	tristate "Conexant 2388x (bt878 successor) support"
	depends on !VIDEO_CX88
	depends on BACKPORT_VIDEO_DEV && PCI && I2C && RC_CORE
	depends on I2C_ALGOBIT
	select BACKPORT_VIDEOBUF2_DMA_SG
	select BACKPORT_VIDEO_TUNER
	select BACKPORT_VIDEO_TVEEPROM
	select VIDEO_WM8775 if BACKPORT_MEDIA_SUBDRV_AUTOSELECT
	---help---
	  This is a video4linux driver for Conexant 2388x based
	  TV cards.

	  To compile this driver as a module, choose M here: the
	  module will be called cx8800

config BACKPORT_VIDEO_CX88_ALSA
	tristate "Conexant 2388x DMA audio support"
	depends on !VIDEO_CX88_ALSA
	depends on BACKPORT_VIDEO_CX88 && SND
	depends on SND_PCM
	---help---
	  This is a video4linux driver for direct (DMA) audio on
	  Conexant 2388x based TV cards using ALSA.

	  It only works with boards with function 01 enabled.
	  To check if your board supports, use lspci -n.
	  If supported, you should see 14f1:8801 or 14f1:8811
	  PCI device.

	  To compile this driver as a module, choose M here: the
	  module will be called cx88-alsa.

config BACKPORT_VIDEO_CX88_BLACKBIRD
	tristate "Blackbird MPEG encoder support (cx2388x + cx23416)"
	depends on !VIDEO_CX88_BLACKBIRD
	depends on BACKPORT_VIDEO_CX88
	select BACKPORT_VIDEO_CX2341X
	---help---
	  This adds support for MPEG encoder cards based on the
	  Blackbird reference design, using the Conexant 2388x
	  and 23416 chips.

	  To compile this driver as a module, choose M here: the
	  module will be called cx88-blackbird.

config BACKPORT_VIDEO_CX88_DVB
	tristate "DVB/ATSC Support for cx2388x based TV cards"
	depends on !VIDEO_CX88_DVB
	depends on VIDEO_CX88 && BACKPORT_DVB_CORE
	select BACKPORT_VIDEOBUF2_DVB
	select DVB_PLL if BACKPORT_MEDIA_SUBDRV_AUTOSELECT
	select DVB_MT352 if BACKPORT_MEDIA_SUBDRV_AUTOSELECT
	select DVB_ZL10353 if BACKPORT_MEDIA_SUBDRV_AUTOSELECT
	select DVB_OR51132 if BACKPORT_MEDIA_SUBDRV_AUTOSELECT
	select DVB_CX22702 if BACKPORT_MEDIA_SUBDRV_AUTOSELECT
	select DVB_LGDT330X if BACKPORT_MEDIA_SUBDRV_AUTOSELECT
	select DVB_NXT200X if BACKPORT_MEDIA_SUBDRV_AUTOSELECT
	select DVB_CX24123 if BACKPORT_MEDIA_SUBDRV_AUTOSELECT
	select DVB_ISL6421 if BACKPORT_MEDIA_SUBDRV_AUTOSELECT
	select DVB_S5H1411 if BACKPORT_MEDIA_SUBDRV_AUTOSELECT
	select DVB_CX24116 if BACKPORT_MEDIA_SUBDRV_AUTOSELECT
	select DVB_STV0299 if BACKPORT_MEDIA_SUBDRV_AUTOSELECT
	select DVB_STV0288 if BACKPORT_MEDIA_SUBDRV_AUTOSELECT
	select DVB_STB6000 if BACKPORT_MEDIA_SUBDRV_AUTOSELECT
	select DVB_STV0900 if BACKPORT_MEDIA_SUBDRV_AUTOSELECT
	select DVB_STB6100 if BACKPORT_MEDIA_SUBDRV_AUTOSELECT
	select DVB_DS3000 if BACKPORT_MEDIA_SUBDRV_AUTOSELECT
	select DVB_TS2020 if BACKPORT_MEDIA_SUBDRV_AUTOSELECT
	select MEDIA_TUNER_SIMPLE if BACKPORT_MEDIA_SUBDRV_AUTOSELECT
	---help---
	  This adds support for DVB/ATSC cards based on the
	  Conexant 2388x chip.

	  To compile this driver as a module, choose M here: the
	  module will be called cx88-dvb.

config BACKPORT_VIDEO_CX88_ENABLE_VP3054
	bool "VP-3054 Secondary I2C Bus Support"
	depends on !VIDEO_CX88_ENABLE_VP3054
	default y
	depends on BACKPORT_VIDEO_CX88_DVB && DVB_MT352
	---help---
	  This adds DVB-T support for cards based on the
	  Conexant 2388x chip and the MT352 demodulator,
	  which also require support for the VP-3054
	  Secondary I2C bus, such at DNTV Live! DVB-T Pro.

config BACKPORT_VIDEO_CX88_VP3054
	tristate
	depends on !VIDEO_CX88_VP3054
	depends on BACKPORT_VIDEO_CX88_DVB && BACKPORT_VIDEO_CX88_ENABLE_VP3054
	default y

config BACKPORT_VIDEO_CX88_MPEG
	tristate
	depends on !VIDEO_CX88_MPEG
	depends on BACKPORT_VIDEO_CX88_DVB || BACKPORT_VIDEO_CX88_BLACKBIRD
	default y
```

## backports/drivers/media/pci/ddbridge/Kconfig
```kconfig
config BACKPORT_DVB_DDBRIDGE
	tristate "Digital Devices bridge support"
	depends on !DVB_DDBRIDGE
	depends on BACKPORT_DVB_CORE && PCI && I2C
	select DVB_LNBP21 if BACKPORT_MEDIA_SUBDRV_AUTOSELECT
	select DVB_STV6110x if BACKPORT_MEDIA_SUBDRV_AUTOSELECT
	select DVB_STV090x if BACKPORT_MEDIA_SUBDRV_AUTOSELECT
	select DVB_DRXK if BACKPORT_MEDIA_SUBDRV_AUTOSELECT
	select DVB_TDA18271C2DD if BACKPORT_MEDIA_SUBDRV_AUTOSELECT
	---help---
	  Support for cards with the Digital Devices PCI express bridge:
	  - Octopus PCIe Bridge
	  - Octopus mini PCIe Bridge
	  - Octopus LE
	  - DuoFlex S2 Octopus
	  - DuoFlex CT Octopus
	  - cineS2(v6)

	  Say Y if you own such a card and want to use it.
```

## backports/drivers/media/pci/dm1105/Kconfig
```kconfig
config BACKPORT_DVB_DM1105
	tristate "SDMC DM1105 based PCI cards"
	depends on !DVB_DM1105
	depends on BACKPORT_DVB_CORE && PCI && I2C
	select DVB_PLL if BACKPORT_MEDIA_SUBDRV_AUTOSELECT
	select DVB_STV0299 if BACKPORT_MEDIA_SUBDRV_AUTOSELECT
	select DVB_STV0288 if BACKPORT_MEDIA_SUBDRV_AUTOSELECT
	select DVB_STB6000 if BACKPORT_MEDIA_SUBDRV_AUTOSELECT
	select DVB_CX24116 if BACKPORT_MEDIA_SUBDRV_AUTOSELECT
	select DVB_SI21XX if BACKPORT_MEDIA_SUBDRV_AUTOSELECT
	select DVB_DS3000 if BACKPORT_MEDIA_SUBDRV_AUTOSELECT
	select DVB_TS2020 if BACKPORT_MEDIA_SUBDRV_AUTOSELECT
	depends on BACKPORT_RC_CORE
	help
	  Support for cards based on the SDMC DM1105 PCI chip like
	  DvbWorld 2002

	  Since these cards have no MPEG decoder onboard, they transmit
	  only compressed MPEG data over the PCI bus, so you need
	  an external software decoder to watch TV on your computer.

	  Say Y or M if you own such a device and want to use it.
```

## backports/drivers/media/pci/ivtv/Kconfig
```kconfig
config BACKPORT_VIDEO_IVTV
	tristate "Conexant cx23416/cx23415 MPEG encoder/decoder support"
	depends on !VIDEO_IVTV
	depends on BACKPORT_VIDEO_V4L2 && PCI && I2C
	depends on I2C_ALGOBIT
	depends on BACKPORT_RC_CORE
	select BACKPORT_VIDEO_TUNER
	select BACKPORT_VIDEO_TVEEPROM
	select BACKPORT_VIDEO_CX2341X
	select BACKPORT_VIDEO_CX25840
	select BACKPORT_VIDEO_MSP3400
	select BACKPORT_VIDEO_SAA711X
	select BACKPORT_VIDEO_SAA717X
	select BACKPORT_VIDEO_SAA7127
	select BACKPORT_VIDEO_CS53L32A
	select BACKPORT_VIDEO_M52790
	select BACKPORT_VIDEO_WM8775
	select BACKPORT_VIDEO_WM8739
	select BACKPORT_VIDEO_VP27SMPX
	select BACKPORT_VIDEO_UPD64031A
	select BACKPORT_VIDEO_UPD64083
	---help---
	  This is a video4linux driver for Conexant cx23416 or cx23415 based
	  PCI personal video recorder devices.

	  This is used in devices such as the Hauppauge PVR-150/250/350/500
	  cards. There is a driver homepage at <http://www.ivtvdriver.org>.

	  To compile this driver as a module, choose M here: the
	  module will be called ivtv.

config BACKPORT_VIDEO_IVTV_ALSA
	tristate "Conexant cx23415/cx23416 ALSA interface for PCM audio capture"
	depends on !VIDEO_IVTV_ALSA
	depends on BACKPORT_VIDEO_IVTV && SND
	depends on SND_PCM
	---help---
	  This driver provides an ALSA interface as another method for user
	  applications to obtain PCM audio data from Conexant cx23415/cx23416
	  based PCI TV cards supported by the ivtv driver.

	  The ALSA interface has much wider use in user applications performing
	  PCM audio capture, than the V4L2 "/dev/video24" PCM audio interface
	  provided by the main ivtv driver.

	  To compile this driver as a module, choose M here: the
	  module will be called ivtv-alsa.

config BACKPORT_VIDEO_FB_IVTV
	tristate "Conexant cx23415 framebuffer support"
	depends on !VIDEO_FB_IVTV
	depends on BACKPORT_VIDEO_IVTV && FB
	depends on FB_CFB_FILLRECT
	depends on FB_CFB_COPYAREA
	depends on FB_CFB_IMAGEBLIT
	---help---
	  This is a framebuffer driver for the Conexant cx23415 MPEG
	  encoder/decoder.

	  This is used in the Hauppauge PVR-350 card. There is a driver
	  homepage at <http://www.ivtvdriver.org>.

	  To compile this driver as a module, choose M here: the
	  module will be called ivtvfb.
```
