## drivers/gpu/drm/ast/Kconfig
```kconfig
# SPDX-License-Identifier: GPL-2.0-only
config DRM_AST
	tristate "AST server chips"
	depends on DRM && PCI
	select DRM_CLIENT_SELECTION
	select DRM_GEM_SHMEM_HELPER
	select DRM_KMS_HELPER
	select I2C
	select I2C_ALGOBIT
	help
	 Say yes for experimental AST GPU driver. Do not enable
	 this driver without having a working -modesetting,
	 and a version of AST that knows to fail if KMS
	 is bound to the driver. These GPUs are commonly found
	 in server chipsets.

config DRM_AST_DISABLE_WRITECOMBINE
	bool "Disable Write Combine mapping of VRAM"
	depends on DRM_AST && (PREEMPT_RT || COMPILE_TEST)
	help
	  The VRAM of AST GPUs is mapped with Write-Combine to improve
	  performances. This can interfere with real-time tasks; even if they
	  are running on other CPU cores than the graphics output.
	  Enable this option only if you run real-time tasks on a server with
	  Aspeed graphics.
```
