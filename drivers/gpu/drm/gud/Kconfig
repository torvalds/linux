## drivers/gpu/drm/i915/Kconfig.unstable
```kconfig
# SPDX-License-Identifier: GPL-2.0-only
config DRM_I915_UNSTABLE
	bool "Enable unstable API for early prototype development"
	depends on EXPERT
	depends on STAGING
	depends on BROKEN # should never be enabled by distros!
	# We use the dependency on !COMPILE_TEST to not be enabled in
	# allmodconfig or allyesconfig configurations
	depends on !COMPILE_TEST
	default n
	help
	  Enable prototype uAPI under general discussion before they are
	  finalized. Such prototypes may be withdrawn or substantially
	  changed before release. They are only enabled here so that a wide
	  number of interested parties (userspace driver developers) can
	  verify that the uAPI meet their expectations. These uAPI should
	  never be used in production.

	  Recommended for driver developers _only_.

	  If in the slightest bit of doubt, say "N".

config DRM_I915_UNSTABLE_FAKE_LMEM
	bool "Enable the experimental fake lmem"
	depends on DRM_I915_UNSTABLE
	default n
	help
	  Convert some system memory into a fake local memory region for
	  testing.
```

## drivers/gpu/drm/imagination/Kconfig
```kconfig
# SPDX-License-Identifier: GPL-2.0-only OR MIT
# Copyright (c) 2023 Imagination Techanallogies Ltd.

config DRM_POWERVR
	tristate "Imagination Techanallogies PowerVR (Series 6 and later) & IMG Graphics"
	depends on ARM64
	depends on DRM
	depends on PM
	select DRM_EXEC
	select DRM_GEM_SHMEM_HELPER
	select DRM_SCHED
	select DRM_GPUVM
	select FW_LOADER
	help
	  Choose this option if you have a system that has an Imagination
	  Techanallogies PowerVR (Series 6 or later) or IMG GPU.

	  If "M" is selected, the module will be called powervr.
```

## drivers/gpu/drm/img/Kconfig
```kconfig
# SPDX-License-Identifier: GPL-2.0-only
config DRM_IMG
	bool "Imagination PowerVR GPU"
        select DRM
        default n

source "drivers/gpu/drm/img/img-rogue/Kconfig"
```

## drivers/gpu/drm/img/img-drm-nulldisp/Kconfig
```kconfig
config DRM_IMG_NULLDISP
        bool "IMG DRM support null disp"
        select DRM_IMG
	select DRM_LEGACY
        default y
        help
          Enable IMG null disp for powerVR GPU
```

## drivers/gpu/drm/img/img-rogue/Kconfig
```kconfig
config DRM_IMG_ROGUE
	bool "DRM support for PowerVR GPU"
	select DRM_IMG
	default n
	help
	  Enable img powerVR GPU
```

## drivers/gpu/drm/imx/Kconfig
```kconfig
# SPDX-License-Identifier: GPL-2.0-only

source "drivers/gpu/drm/imx/dcss/Kconfig"
source "drivers/gpu/drm/imx/ipuv3/Kconfig"
source "drivers/gpu/drm/imx/lcdc/Kconfig"
```

## drivers/gpu/drm/imx/dc/Kconfig
```kconfig
config DRM_IMX8_DC
	tristate "Freescale i.MX8 Display Controller Graphics"
	depends on DRM && COMMON_CLK && OF && (ARCH_MXC || COMPILE_TEST)
	select DRM_CLIENT_SELECTION
	select DRM_GEM_DMA_HELPER
	select DRM_KMS_HELPER
	select DRM_DISPLAY_HELPER
	select DRM_BRIDGE_CONNECTOR
	select GENERIC_IRQ_CHIP
	select REGMAP
	select REGMAP_MMIO
	help
	  enable Freescale i.MX8 Display Controller(DC) graphics support
```

## drivers/gpu/drm/imx/dcss/Kconfig
```kconfig
config DRM_IMX_DCSS
	tristate "i.MX8MQ DCSS"
	select IMX_IRQSTEER
	select DRM_CLIENT_SELECTION
	select DRM_KMS_HELPER
	select DRM_DISPLAY_HELPER
	select DRM_BRIDGE_CONNECTOR
	select DRM_GEM_DMA_HELPER
	select VIDEOMODE_HELPERS
	depends on DRM && ((ARCH_MXC && ARM64) || COMPILE_TEST)
	help
	  Choose this if you have a NXP i.MX8MQ based system and want to use the
	  Display Controller Subsystem. This option enables DCSS support.
```

## drivers/gpu/drm/imx/lcdc/Kconfig
```kconfig
config DRM_IMX_LCDC
      tristate "Freescale i.MX LCDC displays"
      depends on DRM && (ARCH_MXC || COMPILE_TEST)
      select DRM_GEM_DMA_HELPER
      select DRM_KMS_HELPER
      select DRM_DISPLAY_HELPER
      select DRM_BRIDGE_CONNECTOR
      help
        Found on i.MX1, i.MX21, i.MX25 and i.MX27.
```

## drivers/gpu/drm/ingenic/Kconfig
```kconfig
config DRM_INGENIC
	tristate "DRM Support for Ingenic SoCs"
	depends on MIPS || COMPILE_TEST
	depends on DRM
	depends on CMA
	depends on OF
	depends on COMMON_CLK
	select DRM_BRIDGE
	select DRM_PANEL_BRIDGE
	select DRM_KMS_HELPER
	select DRM_GEM_DMA_HELPER
	select REGMAP
	select REGMAP_MMIO
	help
	  Choose this option for DRM support for the Ingenic SoCs.

	  If M is selected the module will be called ingenic-drm.

if DRM_INGENIC

config DRM_INGENIC_IPU
	bool "IPU support for Ingenic SoCs"
	help
	  Choose this option to enable support for the IPU found in Ingenic SoCs.

	  The Image Processing Unit (IPU) will appear as a second primary plane.

config DRM_INGENIC_DW_HDMI
	tristate "Ingenic specific support for Synopsys DW HDMI"
	depends on MACH_JZ4780
	select DRM_DW_HDMI
	help
	  Choose this option to enable Synopsys DesignWare HDMI based driver.
	  If you want to enable HDMI on Ingenic JZ4780 based SoC, you should
	  select this option.

endif
```

## drivers/gpu/drm/kmb/Kconfig
```kconfig
config DRM_KMB_DISPLAY
	tristate "Intel Keembay Display"
	depends on DRM
	depends on ARCH_KEEMBAY || COMPILE_TEST
	select DRM_KMS_HELPER
	select DRM_DISPLAY_HELPER
	select DRM_BRIDGE_CONNECTOR
	select DRM_GEM_DMA_HELPER
	select DRM_MIPI_DSI
	help
	Choose this option if you have Intel's KeemBay SOC which integrates
	an ARM Cortex A53 CPU with an Intel Movidius VPU.

	If M is selected the module will be called kmb-drm.
```

## drivers/gpu/drm/lima/Kconfig
```kconfig
# SPDX-License-Identifier: GPL-2.0 OR MIT
# Copyright 2017-2019 Qiang Yu <yuq825@gmail.com>

config DRM_LIMA
       tristate "LIMA (DRM support for ARM Mali 400/450 GPU)"
       depends on DRM
       depends on ARM || ARM64 || COMPILE_TEST
       depends on MMU
       depends on COMMON_CLK
       depends on OF
       select DRM_SCHED
       select DRM_GEM_SHMEM_HELPER
       help
         DRM driver for ARM Mali 400/450 GPUs.
```

## drivers/gpu/drm/logicvc/Kconfig
```kconfig
config DRM_LOGICVC
	tristate "LogiCVC DRM"
	depends on DRM
	depends on OF || COMPILE_TEST
	select DRM_KMS_HELPER
	select DRM_KMS_CMA_HELPER
	select DRM_GEM_CMA_HELPER
	help
	  DRM display driver for the logiCVC programmable logic block from Xylon
```

## drivers/gpu/drm/loongson/Kconfig
```kconfig
# SPDX-License-Identifier: GPL-2.0

config DRM_LOONGSON
	tristate "DRM support for Loongson Graphics"
	depends on DRM && PCI && MMU
	depends on LOONGARCH || MIPS || COMPILE_TEST
	select DRM_KMS_HELPER
	select DRM_TTM
	select DRM_TTM_HELPER
	select I2C
	select I2C_ALGOBIT
	help
	  This is a DRM driver for Loongson Graphics, it may including
	  LS7A2000, LS7A1000, LS2K2000 and LS2K1000 etc. Loongson LS7A
	  series are bridge chipset, while Loongson LS2K series are SoC.

	  If "M" is selected, the module will be called loongson.

	  If in doubt, say "N".
```

## drivers/gpu/drm/mcde/Kconfig
```kconfig
config DRM_MCDE
	tristate "DRM Support for ST-Ericsson MCDE (Multichannel Display Engine)"
	depends on DRM
	depends on CMA
	depends on ARM || COMPILE_TEST
	depends on OF
	depends on COMMON_CLK
	select MFD_SYSCON
	select DRM_CLIENT_SELECTION
	select DRM_MIPI_DSI
	select DRM_BRIDGE
	select DRM_PANEL_BRIDGE
	select DRM_KMS_HELPER
	select DRM_GEM_DMA_HELPER
	help
	  Choose this option for DRM support for the ST-Ericsson MCDE
	  Multi-Channel Display Engine.
	  If M is selected the module will be called mcde_drm.
```

## drivers/gpu/drm/mediatek/Kconfig
```kconfig
# SPDX-License-Identifier: GPL-2.0-only
config DRM_MEDIATEK
	tristate "DRM Support for Mediatek SoCs"
	depends on DRM
	depends on ARCH_MEDIATEK || COMPILE_TEST
	depends on COMMON_CLK
	depends on HAVE_ARM_SMCCC || COMPILE_TEST
	depends on OF
	depends on MTK_MMSYS
	select DRM_CLIENT_SELECTION
	select DRM_GEM_DMA_HELPER
	select DRM_KMS_HELPER
	select DRM_DISPLAY_HELPER
	select DRM_BRIDGE_CONNECTOR
	select DRM_MIPI_DSI
	select DRM_PANEL
	select VIDEOMODE_HELPERS
	help
	  Choose this option if you have a Mediatek SoCs.
	  The module will be called mediatek-drm
	  This driver provides kernel mode setting and
	  buffer management to userspace.

config DRM_MEDIATEK_DP
	tristate "DRM DPTX Support for MediaTek SoCs"
	depends on DRM_MEDIATEK
	select DRM_DISPLAY_HELPER
	select DRM_DISPLAY_DP_HELPER
	select DRM_DISPLAY_DP_AUX_BUS
	help
	  DRM/KMS Display Port driver for MediaTek SoCs.

config DRM_MEDIATEK_HDMI_COMMON
	tristate
	depends on DRM_MEDIATEK
	select DRM_DISPLAY_HDMI_HELPER
	select DRM_DISPLAY_HELPER
	select SND_SOC_HDMI_CODEC if SND_SOC
	help
	  MediaTek SoC HDMI common library

config DRM_MEDIATEK_HDMI
	tristate "DRM HDMI Support for Mediatek SoCs"
	depends on DRM_MEDIATEK
	select DRM_MEDIATEK_HDMI_COMMON
	help
	  DRM/KMS HDMI driver for Mediatek SoCs

config DRM_MEDIATEK_HDMI_V2
	tristate "DRM HDMI v2 IP support for MediaTek SoCs"
	depends on DRM_MEDIATEK
	select DRM_MEDIATEK_HDMI_COMMON
	help
	  Say yes here to enable support for the HDMIv2 IP and related
	  DDCv2 as found in the MediaTek MT8195, MT8188 SoCs and other
	  variants.
	  This driver can also be built as a module. If so, the HDMIv2
	  module will be called "mtk_hdmi_v2", and the DDCv2 module
	  will be called "mtk_hdmi_ddc_v2".
```

## drivers/gpu/drm/meson/Kconfig
```kconfig
# SPDX-License-Identifier: GPL-2.0-only
config DRM_MESON
	tristate "DRM Support for Amlogic Meson Display Controller"
	depends on DRM && OF && (ARM || ARM64)
	depends on ARCH_MESON || COMPILE_TEST
	select DRM_KMS_HELPER
	select DRM_KMS_CMA_HELPER
	select DRM_GEM_CMA_HELPER
	select DRM_DISPLAY_CONNECTOR
	select VIDEOMODE_HELPERS
	select REGMAP_MMIO
	select MESON_CANVAS
	select CEC_CORE if CEC_NOTIFIER

config DRM_MESON_DW_HDMI
	tristate "HDMI Synopsys Controller support for Amlogic Meson Display"
	depends on DRM_MESON
	default y if DRM_MESON
	select DRM_DW_HDMI
	imply DRM_DW_HDMI_I2S_AUDIO
```
