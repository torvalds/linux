## drivers/gpu/drm/gud/Kconfig
```kconfig
# SPDX-License-Identifier: GPL-2.0

config DRM_GUD
	tristate "GUD USB Display"
	depends on DRM && USB
	select LZ4_COMPRESS
	select DRM_KMS_HELPER
	select DRM_GEM_SHMEM_HELPER
	select BACKLIGHT_CLASS_DEVICE
	help
	  This is a DRM display driver for GUD USB Displays or display
	  adapters.

	  If M is selected the module will be called gud.
```

## drivers/gpu/drm/hisilicon/Kconfig
```kconfig
# SPDX-License-Identifier: GPL-2.0-only
#
# hisilicon drm device configuration.
# Please keep this list sorted alphabetically

source "drivers/gpu/drm/hisilicon/hibmc/Kconfig"
source "drivers/gpu/drm/hisilicon/kirin/Kconfig"
```

## drivers/gpu/drm/hisilicon/hibmc/Kconfig
```kconfig
# SPDX-License-Identifier: GPL-2.0-only
config DRM_HISI_HIBMC
	tristate "DRM Support for Hisilicon Hibmc"
	depends on DRM && PCI
	select DRM_CLIENT_SELECTION
	select DRM_DISPLAY_HELPER
	select DRM_DISPLAY_DP_HELPER
	select DRM_GEM_SHMEM_HELPER
	select DRM_KMS_HELPER
	select I2C
	select I2C_ALGOBIT
	help
	  Choose this option if you have a Hisilicon Hibmc soc chipset.
	  If M is selected the module will be called hibmc-drm.
```

## drivers/gpu/drm/hisilicon/kirin/Kconfig
```kconfig
# SPDX-License-Identifier: GPL-2.0-only
config DRM_HISI_KIRIN
	tristate "DRM Support for Hisilicon Kirin series SoCs Platform"
	depends on DRM && OF && ARM64
	select DRM_KMS_HELPER
	select DRM_GEM_DMA_HELPER
	select DRM_MIPI_DSI
	help
	  Choose this option if you have a hisilicon Kirin chipsets(hi6220).
	  If M is selected the module will be called kirin-drm.
```

## drivers/gpu/drm/hyperv/Kconfig
```kconfig
# SPDX-License-Identifier: GPL-2.0-only
config DRM_HYPERV
	tristate "DRM Support for Hyper-V synthetic video device"
	depends on DRM && PCI && HYPERV_VMBUS
	select DRM_CLIENT_SELECTION
	select DRM_KMS_HELPER
	select DRM_GEM_SHMEM_HELPER
	help
	 This is a KMS driver for Hyper-V synthetic video device. Choose this
	 option if you would like to enable drm driver for Hyper-V virtual
	 machine. Unselect Hyper-V framebuffer driver (CONFIG_FB_HYPERV) so
	 that DRM driver is used by default.

	 If M is selected the module will be called hyperv_drm.
```

## drivers/gpu/drm/i2c/Kconfig
```kconfig
# SPDX-License-Identifier: GPL-2.0-only
menu "I2C encoder or helper chips"
     depends on DRM && DRM_KMS_HELPER && I2C

config DRM_I2C_NXP_TDA998X
	tristate "NXP Semiconductors TDA998X HDMI encoder"
	default m if DRM_TILCDC
	select CEC_CORE if CEC_NOTIFIER
	select SND_SOC_HDMI_CODEC if SND_SOC
	help
	  Support for NXP Semiconductors TDA998X HDMI encoders.

config DRM_I2C_NXP_TDA9950
	tristate "NXP Semiconductors TDA9950/TDA998X HDMI CEC"
	select CEC_NOTIFIER
	select CEC_CORE

endmenu
```

## drivers/gpu/drm/i915/Kconfig
```kconfig
# SPDX-License-Identifier: GPL-2.0-only
config DRM_I915
	tristate "Intel 8xx/9xx/G3x/G4x/HD Graphics"
	depends on DRM
	depends on X86 && PCI
	select INTEL_GTT
	select INTERVAL_TREE
	# we need shmfs for the swappable backing store, and in particular
	# the shmem_readpage() which depends upon tmpfs
	select SHMEM
	select TMPFS
	select DRM_KMS_HELPER
	select DRM_PANEL
	select DRM_MIPI_DSI
	select RELAY
	select IRQ_WORK
	# i915 depends on ACPI_VIDEO when ACPI is enabled
	# but for select to work, need to select ACPI_VIDEO's dependencies, ick
	select BACKLIGHT_CLASS_DEVICE if ACPI
	select INPUT if ACPI
	select ACPI_VIDEO if ACPI
	select ACPI_BUTTON if ACPI
	select SYNC_FILE
	select IOSF_MBI
	select CRC32
	select SND_HDA_I915 if SND_HDA_CORE
	select CEC_CORE if CEC_NOTIFIER
	select VMAP_PFN
	select DRM_TTM
	help
	  Choose this option if you have a system that has "Intel Graphics
	  Media Accelerator" or "HD Graphics" integrated graphics,
	  including 830M, 845G, 852GM, 855GM, 865G, 915G, 945G, 965G,
	  G35, G41, G43, G45 chipsets and Celeron, Pentium, Core i3,
	  Core i5, Core i7 as well as Atom CPUs with integrated graphics.

	  This driver is used by the Intel driver in X.org 6.8 and
	  XFree86 4.4 and above. It replaces the older i830 module that
	  supported a subset of the hardware in older X.org releases.

	  Note that the older i810/i815 chipsets require the use of the
	  i810 driver instead, and the Atom z5xx series has an entirely
	  different implementation.

	  If "M" is selected, the module will be called i915.

config DRM_I915_FORCE_PROBE
	string "Force probe driver for selected new Intel hardware"
	depends on DRM_I915
	help
	  This is the default value for the i915.force_probe module
	  parameter. Using the module parameter overrides this option.

	  Force probe the driver for new Intel graphics devices that are
	  recognized but not properly supported by this kernel version. It is
	  recommended to upgrade to a kernel version with proper support as soon
	  as it is available.

	  Use "" to disable force probe. If in doubt, use this.

	  Use "<pci-id>[,<pci-id>,...]" to force probe the driver for listed
	  devices. For example, "4500" or "4500,4571".

	  Use "*" to force probe the driver for all known devices.

config DRM_I915_CAPTURE_ERROR
	bool "Enable capturing GPU state following a hang"
	depends on DRM_I915
	default y
	help
	  This option enables capturing the GPU state when a hang is detected.
	  This information is vital for triaging hangs and assists in debugging.
	  Please report any hang for triaging according to:
	    https://gitlab.freedesktop.org/drm/intel/-/wikis/How-to-file-i915-bugs

	  If in doubt, say "Y".

config DRM_I915_COMPRESS_ERROR
	bool "Compress GPU error state"
	depends on DRM_I915_CAPTURE_ERROR
	select ZLIB_DEFLATE
	default y
	help
	  This option selects ZLIB_DEFLATE if it isn't already
	  selected and causes any error state captured upon a GPU hang
	  to be compressed using zlib.

	  If in doubt, say "Y".

config DRM_I915_USERPTR
	bool "Always enable userptr support"
	depends on DRM_I915
	select MMU_NOTIFIER
	default y
	help
	  This option selects CONFIG_MMU_NOTIFIER if it isn't already
	  selected to enabled full userptr support.

	  If in doubt, say "Y".

config DRM_I915_GVT
	bool "Enable Intel GVT-g graphics virtualization host support"
	depends on DRM_I915
	depends on X86
	depends on 64BIT
	default n
	help
	  Choose this option if you want to enable Intel GVT-g graphics
	  virtualization technology host support with integrated graphics.
	  With GVT-g, it's possible to have one integrated graphics
	  device shared by multiple VMs under different hypervisors.

	  Note that at least one hypervisor like Xen or KVM is required for
	  this driver to work, and it only supports newer device from
	  Broadwell+. For further information and setup guide, you can
	  visit: http://01.org/igvt-g.

	  Now it's just a stub to support the modifications of i915 for
	  GVT device model. It requires at least one MPT modules for Xen/KVM
	  and other components of GVT device model to work. Use it under
	  you own risk.

	  If in doubt, say "N".

config DRM_I915_GVT_KVMGT
	tristate "Enable KVM/VFIO support for Intel GVT-g"
	depends on DRM_I915_GVT
	depends on KVM
	depends on VFIO_MDEV
	default n
	help
	  Choose this option if you want to enable KVMGT support for
	  Intel GVT-g.

menu "drm/i915 Debugging"
depends on DRM_I915
depends on EXPERT
source "drivers/gpu/drm/i915/Kconfig.debug"
endmenu

menu "drm/i915 Profile Guided Optimisation"
	visible if EXPERT
	depends on DRM_I915
	source "drivers/gpu/drm/i915/Kconfig.profile"
endmenu

menu "drm/i915 Unstable Evolution"
	visible if EXPERT && STAGING && BROKEN
	depends on DRM_I915
	source "drivers/gpu/drm/i915/Kconfig.unstable"
endmenu
```

## drivers/gpu/drm/i915/Kconfig.debug
```kconfig
# SPDX-License-Identifier: GPL-2.0-only
config DRM_I915_WERROR
	bool "Force GCC to throw an error instead of a warning when compiling"
	# As this may inadvertently break the build, only allow the user
	# to shoot oneself in the foot iff they aim really hard
	depends on EXPERT
	# We use the dependency on !COMPILE_TEST to not be enabled in
	# allmodconfig or allyesconfig configurations
	depends on !COMPILE_TEST
	default n
	help
	  Add -Werror to the build flags for (and only for) i915.ko.
	  Do not enable this unless you are writing code for the i915.ko module.

	  Recommended for driver developers only.

	  If in doubt, say "N".

config DRM_I915_REPLAY_GPU_HANGS_API
	bool "Enable GPU hang replay userspace API"
	depends on DRM_I915
	depends on EXPERT
	default n
	help
	  Choose this option if you want to enable special and unstable
	  userspace API used for replaying GPU hangs on a running system.

	  This API is intended to be used by userspace graphics stack developers
	  and provides no stability guarantees.

	  The API needs to be activated at boot time using the
	  enable_debug_only_api module parameter.

	  If in doubt, say "N".

config DRM_I915_DEBUG
	bool "Enable additional driver debugging"
	depends on DRM_I915
	depends on EXPERT # only for developers
	depends on !COMPILE_TEST # never built by robots
	select DEBUG_FS
	select PREEMPT_COUNT
	select I2C_CHARDEV
	select REF_TRACKER
	select STACKDEPOT
	select STACKTRACE
	select DRM_DISPLAY_DP_AUX_CHARDEV
	select DRM_DISPLAY_DP_TUNNEL_STATE_DEBUG if DRM_I915_DP_TUNNEL
	select X86_MSR # used by igt/pm_rpm
	select DRM_VGEM # used by igt/prime_vgem (dmabuf interop checks)
	select DRM_DEBUG_MM if DRM=y
	select DRM_EXPORT_FOR_TESTS if m
	select DRM_DEBUG_SELFTEST
	select DMABUF_SELFTESTS
	select SW_SYNC # signaling validation framework (igt/syncobj*)
	select DRM_I915_WERROR
	select DRM_I915_DEBUG_GEM
	select DRM_I915_DEBUG_GEM_ONCE
	select DRM_I915_DEBUG_MMIO
	select DRM_I915_DEBUG_RUNTIME_PM
	select DRM_I915_DEBUG_WAKEREF
	select DRM_I915_SW_FENCE_DEBUG_OBJECTS
	select DRM_I915_SELFTEST
	default n
	help
	  Choose this option to turn on extra driver debugging that may affect
	  performance but will catch some internal issues.

	  Recommended for driver developers only.

	  If in doubt, say "N".

config DRM_I915_DEBUG_MMIO
	bool "Always insert extra checks around mmio access by default"
	default n
	help
	  By default, always enables the extra sanity checks (extra register
	  reads) around every mmio (register) access that will slow the system
	  down. This sets the default value of i915.mmio_debug to -1 and can
	  be overridden at module load.

	  Recommended for driver developers only.

	  If in doubt, say "N".

config DRM_I915_DEBUG_GEM
	bool "Insert extra checks into the GEM internals"
	default n
	depends on DRM_I915_WERROR
	help
	  Enable extra sanity checks (including BUGs) along the GEM driver
	  paths that may slow the system down and if hit hang the machine.

	  Recommended for driver developers only.

	  If in doubt, say "N".

config DRM_I915_DEBUG_GEM_ONCE
	bool "Make a GEM debug failure fatal"
	default n
	depends on DRM_I915_DEBUG_GEM
	help
	  During development, we often only want the very first failure
	  as that would otherwise be lost in the deluge of subsequent
	  failures. However, more casual testers may not want to trigger
	  a hard BUG_ON and hope that the system remains sufficiently usable
	  to capture a bug report in situ.

	  Recommended for driver developers only.

	  If in doubt, say "N".

config DRM_I915_ERRLOG_GEM
	bool "Insert extra logging (very verbose) for common GEM errors"
	default n
	depends on DRM_I915_DEBUG_GEM
	help
	  Enable additional logging that may help track down the cause of
	  principally userspace errors.

	  Recommended for driver developers only.

	  If in doubt, say "N".

config DRM_I915_TRACE_GEM
	bool "Insert extra ftrace output from the GEM internals"
	depends on DRM_I915_DEBUG_GEM
	select TRACING
	default n
	help
	  Enable additional and verbose debugging output that will spam
	  ordinary tests, but may be vital for post-mortem debugging when
	  used with /proc/sys/kernel/ftrace_dump_on_oops

	  Recommended for driver developers only.

	  If in doubt, say "N".

config DRM_I915_TRACE_GTT
	bool "Insert extra ftrace output from the GTT internals"
	depends on DRM_I915_DEBUG_GEM
	select TRACING
	default n
	help
	  Enable additional and verbose debugging output that will spam
	  ordinary tests, but may be vital for post-mortem debugging when
	  used with /proc/sys/kernel/ftrace_dump_on_oops

	  Recommended for driver developers only.

	  If in doubt, say "N".

config DRM_I915_SW_FENCE_DEBUG_OBJECTS
	bool "Enable additional driver debugging for fence objects"
	depends on DRM_I915
	select DEBUG_OBJECTS
	default n
	help
	  Choose this option to turn on extra driver debugging that may affect
	  performance but will catch some internal issues.

	  Recommended for driver developers only.

	  If in doubt, say "N".

config DRM_I915_SW_FENCE_CHECK_DAG
	bool "Enable additional driver debugging for detecting dependency cycles"
	depends on DRM_I915
	default n
	help
	  Choose this option to turn on extra driver debugging that may affect
	  performance but will catch some internal issues.

	  Recommended for driver developers only.

	  If in doubt, say "N".

config DRM_I915_DEBUG_GUC
	bool "Enable additional driver debugging for GuC"
	depends on DRM_I915
	select STACKDEPOT
	default n
	help
	  Choose this option to turn on extra driver debugging that may affect
	  performance but will help resolve GuC related issues.

	  Recommended for driver developers only.

	  If in doubt, say "N".

config DRM_I915_SELFTEST
	bool "Enable selftests upon driver load"
	depends on DRM_I915
	default n
	select DRM_EXPORT_FOR_TESTS if m
	select FAULT_INJECTION
	select PRIME_NUMBERS
	select CRC32
	help
	  Choose this option to allow the driver to perform selftests upon
	  loading; also requires the i915.selftest=1 module parameter. To
	  exit the module after running the selftests (i.e. to prevent normal
	  module initialisation afterwards) use i915.selftest=-1.

	  Recommended for driver developers only.

	  If in doubt, say "N".

config DRM_I915_SELFTEST_BROKEN
	bool "Enable broken and dangerous selftests"
	depends on DRM_I915_SELFTEST
	depends on BROKEN
	default n
	help
	  This option enables the execution of selftests that are "dangerous"
	  and may trigger unintended HW side-effects as they break strict
	  rules given in the HW specification. For science.

	  Recommended for masochistic driver developers only.

	  If in doubt, say "N".

config DRM_I915_LOW_LEVEL_TRACEPOINTS
	bool "Enable low level request tracing events"
	depends on DRM_I915
	default n
	help
	  Choose this option to turn on low level request tracing events.
	  This provides the ability to precisely monitor engine utilisation
	  and also analyze the request dependency resolving timeline.

	  Recommended for driver developers only.

	  If in doubt, say "N".

config DRM_I915_DEBUG_VBLANK_EVADE
	bool "Enable extra debug warnings for vblank evasion"
	depends on DRM_I915
	default n
	help
	  Choose this option to turn on extra debug warnings for the
	  vblank evade mechanism. This gives a warning every time the
	  the deadline allotted for the vblank evade critical section
	  is exceeded, even if there isn't an actual risk of missing
	  the vblank.

	  Recommended for driver developers only.

	  If in doubt, say "N".

config DRM_I915_DEBUG_RUNTIME_PM
	bool "Enable extra state checking for runtime PM"
	depends on DRM_I915
	default n
	select REF_TRACKER
	select STACKDEPOT
	select STACKTRACE
	help
	  Choose this option to turn on extra state checking for the
	  runtime PM functionality. This may introduce overhead during
	  driver loading, suspend and resume operations.

	  Recommended for driver developers only.

	  If in doubt, say "N"

config DRM_I915_DEBUG_WAKEREF
	bool "Enable extra tracking for wakerefs"
	depends on DRM_I915
	select REF_TRACKER
	select STACKDEPOT
	select STACKTRACE
	help
	  Choose this option to turn on extra state checking and usage
	  tracking for the wakerefPM functionality. This may introduce
	  overhead during driver runtime.

	  If in doubt, say "N"
```
