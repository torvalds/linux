## drivers/gpu/drm/tiny/Kconfig
```kconfig
# SPDX-License-Identifier: GPL-2.0-only

config DRM_ARCPGU
	tristate "ARC PGU"
	depends on DRM && OF
	select DRM_KMS_CMA_HELPER
	select DRM_KMS_HELPER
	help
	  Choose this option if you have an ARC PGU controller.

	  If M is selected the module will be called arcpgu.

config DRM_CIRRUS_QEMU
	tristate "Cirrus driver for QEMU emulated device"
	depends on DRM && PCI && MMU
	select DRM_KMS_HELPER
	select DRM_GEM_SHMEM_HELPER
	help
	 This is a KMS driver for emulated cirrus device in qemu.
	 It is *NOT* intended for real cirrus devices. This requires
	 the modesetting userspace X.org driver.

	 Cirrus is obsolete, the hardware was designed in the 90ies
	 and can't keep up with todays needs.  More background:
	 https://www.kraxel.org/blog/2014/10/qemu-using-cirrus-considered-harmful/

	 Better alternatives are:
	   - stdvga (DRM_BOCHS, qemu -vga std, default in qemu 2.2+)
	   - qxl (DRM_QXL, qemu -vga qxl, works best with spice)
	   - virtio (DRM_VIRTIO_GPU), qemu -vga virtio)

config DRM_GM12U320
	tristate "GM12U320 driver for USB projectors"
	depends on DRM && USB
	select DRM_KMS_HELPER
	select DRM_GEM_SHMEM_HELPER
	help
	 This is a KMS driver for projectors which use the GM12U320 chipset
	 for video transfer over USB2/3, such as the Acer C120 mini projector.

config DRM_SIMPLEDRM
	tristate "Simple framebuffer driver"
	depends on DRM
	select DRM_GEM_SHMEM_HELPER
	select DRM_KMS_HELPER
	help
	  DRM driver for simple platform-provided framebuffers.

	  This driver assumes that the display hardware has been initialized
	  by the firmware or bootloader before the kernel boots. Scanout
	  buffer, size, and display format must be provided via device tree,
	  UEFI, VESA, etc.

	  On x86 and compatible, you should also select CONFIG_X86_SYSFB to
	  use UEFI and VESA framebuffers.

config TINYDRM_HX8357D
	tristate "DRM support for HX8357D display panels"
	depends on DRM && SPI
	select DRM_KMS_HELPER
	select DRM_KMS_CMA_HELPER
	select DRM_MIPI_DBI
	select BACKLIGHT_CLASS_DEVICE
	help
	  DRM driver for the following HX8357D panels:
	  * YX350HV15-T 3.5" 340x350 TFT (Adafruit 3.5")

	  If M is selected the module will be called hx8357d.

config TINYDRM_ILI9225
	tristate "DRM support for ILI9225 display panels"
	depends on DRM && SPI
	select DRM_KMS_HELPER
	select DRM_KMS_CMA_HELPER
	select DRM_MIPI_DBI
	help
	  DRM driver for the following Ilitek ILI9225 panels:
	  * No-name 2.2" color screen module

	  If M is selected the module will be called ili9225.

config TINYDRM_ILI9341
	tristate "DRM support for ILI9341 display panels"
	depends on DRM && SPI
	select DRM_KMS_HELPER
	select DRM_KMS_CMA_HELPER
	select DRM_MIPI_DBI
	select BACKLIGHT_CLASS_DEVICE
	help
	  DRM driver for the following Ilitek ILI9341 panels:
	  * YX240QV29-T 2.4" 240x320 TFT (Adafruit 2.4")

	  If M is selected the module will be called ili9341.

config TINYDRM_ILI9486
	tristate "DRM support for ILI9486 display panels"
	depends on DRM && SPI
	select DRM_KMS_HELPER
	select DRM_KMS_CMA_HELPER
	select DRM_MIPI_DBI
	select BACKLIGHT_CLASS_DEVICE
	help
	  DRM driver for the following Ilitek ILI9486 panels:
	  * PISCREEN 3.5" 320x480 TFT (Ozzmaker 3.5")
	  * RPILCD 3.5" 320x480 TFT (Waveshare 3.5")

	  If M is selected the module will be called ili9486.

config TINYDRM_MI0283QT
	tristate "DRM support for MI0283QT"
	depends on DRM && SPI
	select DRM_KMS_HELPER
	select DRM_KMS_CMA_HELPER
	select DRM_MIPI_DBI
	select BACKLIGHT_CLASS_DEVICE
	help
	  DRM driver for the Multi-Inno MI0283QT display panel
	  If M is selected the module will be called mi0283qt.

config TINYDRM_REPAPER
	tristate "DRM support for Pervasive Displays RePaper panels (V231)"
	depends on DRM && SPI
	select DRM_KMS_HELPER
	select DRM_KMS_CMA_HELPER
	help
	  DRM driver for the following Pervasive Displays panels:
	  1.44" TFT EPD Panel (E1144CS021)
	  1.90" TFT EPD Panel (E1190CS021)
	  2.00" TFT EPD Panel (E2200CS021)
	  2.71" TFT EPD Panel (E2271CS021)

	  If M is selected the module will be called repaper.

config TINYDRM_ST7586
	tristate "DRM support for Sitronix ST7586 display panels"
	depends on DRM && SPI
	select DRM_KMS_HELPER
	select DRM_KMS_CMA_HELPER
	select DRM_MIPI_DBI
	help
	  DRM driver for the following Sitronix ST7586 panels:
	  * LEGO MINDSTORMS EV3

	  If M is selected the module will be called st7586.

config TINYDRM_ST7735R
	tristate "DRM support for Sitronix ST7715R/ST7735R display panels"
	depends on DRM && SPI
	select DRM_KMS_HELPER
	select DRM_KMS_CMA_HELPER
	select DRM_MIPI_DBI
	select BACKLIGHT_CLASS_DEVICE
	help
	  DRM driver for Sitronix ST7715R/ST7735R with one of the following
	  LCDs:
	  * Jianda JD-T18003-T01 1.8" 128x160 TFT
	  * Okaya RH128128T 1.44" 128x128 TFT

	  If M is selected the module will be called st7735r.
```

## drivers/gpu/drm/tinydrm/Kconfig
```kconfig
# SPDX-License-Identifier: GPL-2.0-only
menuconfig DRM_TINYDRM
	tristate "Support for simple displays"
	depends on DRM
	select DRM_KMS_HELPER
	select DRM_KMS_CMA_HELPER
	help
	  Choose this option if you have a tinydrm supported display.
	  If M is selected the module will be called tinydrm.

config TINYDRM_HX8357D
	tristate "DRM support for HX8357D display panels"
	depends on DRM_TINYDRM && SPI
	select DRM_MIPI_DBI
	select BACKLIGHT_CLASS_DEVICE
	help
	  DRM driver for the following HX8357D panels:
	  * YX350HV15-T 3.5" 340x350 TFT (Adafruit 3.5")

	  If M is selected the module will be called hx8357d.

config TINYDRM_ILI9225
	tristate "DRM support for ILI9225 display panels"
	depends on DRM_TINYDRM && SPI
	select DRM_MIPI_DBI
	help
	  DRM driver for the following Ilitek ILI9225 panels:
	  * No-name 2.2" color screen module

	  If M is selected the module will be called ili9225.

config TINYDRM_ILI9341
	tristate "DRM support for ILI9341 display panels"
	depends on DRM_TINYDRM && SPI
	select DRM_MIPI_DBI
	select BACKLIGHT_CLASS_DEVICE
	help
	  DRM driver for the following Ilitek ILI9341 panels:
	  * YX240QV29-T 2.4" 240x320 TFT (Adafruit 2.4")

	  If M is selected the module will be called ili9341.

config TINYDRM_MI0283QT
	tristate "DRM support for MI0283QT"
	depends on DRM_TINYDRM && SPI
	select DRM_MIPI_DBI
	select BACKLIGHT_CLASS_DEVICE
	help
	  DRM driver for the Multi-Inno MI0283QT display panel
	  If M is selected the module will be called mi0283qt.

config TINYDRM_REPAPER
	tristate "DRM support for Pervasive Displays RePaper panels (V231)"
	depends on DRM_TINYDRM && SPI
	depends on THERMAL || !THERMAL
	help
	  DRM driver for the following Pervasive Displays panels:
	  1.44" TFT EPD Panel (E1144CS021)
	  1.90" TFT EPD Panel (E1190CS021)
	  2.00" TFT EPD Panel (E2200CS021)
	  2.71" TFT EPD Panel (E2271CS021)

	  If M is selected the module will be called repaper.

config TINYDRM_ST7586
	tristate "DRM support for Sitronix ST7586 display panels"
	depends on DRM_TINYDRM && SPI
	select DRM_MIPI_DBI
	help
	  DRM driver for the following Sitronix ST7586 panels:
	  * LEGO MINDSTORMS EV3

	  If M is selected the module will be called st7586.

config TINYDRM_ST7735R
	tristate "DRM support for Sitronix ST7735R display panels"
	depends on DRM_TINYDRM && SPI
	select DRM_MIPI_DBI
	select BACKLIGHT_CLASS_DEVICE
	help
	  DRM driver Sitronix ST7735R with one of the following LCDs:
	  * JD-T18003-T01 1.8" 128x160 TFT

	  If M is selected the module will be called st7735r.
```

## drivers/gpu/drm/tve200/Kconfig
```kconfig
# SPDX-License-Identifier: GPL-2.0-only
config DRM_TVE200
	tristate "DRM Support for Faraday TV Encoder TVE200"
	depends on DRM
	depends on CMA
	depends on ARM || COMPILE_TEST
	depends on OF
	select DRM_BRIDGE
	select DRM_PANEL_BRIDGE
	select DRM_KMS_HELPER
	select DRM_KMS_CMA_HELPER
	select DRM_GEM_CMA_HELPER
	select VT_HW_CONSOLE_BINDING if FRAMEBUFFER_CONSOLE
	help
	  Choose this option for DRM support for the Faraday TV Encoder
	  TVE200 Controller.
	  If M is selected the module will be called tve200_drm.
```

## drivers/gpu/drm/tyr/Kconfig
```kconfig
# SPDX-License-Identifier: GPL-2.0 or MIT

config DRM_TYR
	tristate "Tyr (Rust DRM support for ARM Mali CSF-based GPUs)"
	depends on DRM=y
	depends on RUST
	depends on ARM || ARM64 || COMPILE_TEST
	depends on !GENERIC_ATOMIC64  # for IOMMU_IO_PGTABLE_LPAE
	default n
	help
	  Rust DRM driver for ARM Mali CSF-based GPUs.

	  This driver is for Mali (or Immortalis) Valhall Gxxx GPUs.

	  Note that the Mali-G68 and Mali-G78, while Valhall architecture, will
	  be supported with the panfrost driver as they are not CSF GPUs.

	  if M is selected, the module will be called tyr. This driver is work
	  in progress and may not be functional.
```

## drivers/gpu/drm/udl/Kconfig
```kconfig
config DRM_UDL
	tristate "DisplayLink"
	depends on DRM
	depends on USB_SUPPORT
	depends on USB_ARCH_HAS_HCD
	select USB
	select DRM_KMS_HELPER
	help
	  This is a KMS driver for the USB displaylink video adapters.
          Say M/Y to add support for these devices via drm/kms interfaces.
```

## drivers/gpu/drm/v3d/Kconfig
```kconfig
# SPDX-License-Identifier: GPL-2.0-only
config DRM_V3D
	tristate "Broadcom V3D 3.x and newer"
	depends on ARCH_BCM || ARCH_BRCMSTB || COMPILE_TEST
	depends on DRM
	depends on COMMON_CLK
	depends on MMU
	select DRM_SCHED
	select DRM_GEM_SHMEM_HELPER
	help
	  Choose this option if you have a system that has a Broadcom
	  V3D 3.x or newer GPU, such as BCM7268.
```

## drivers/gpu/drm/vboxvideo/Kconfig
```kconfig
config DRM_VBOXVIDEO
	tristate "Virtual Box Graphics Card"
	depends on DRM && X86 && PCI
	select DRM_KMS_HELPER
	select DRM_TTM
	select GENERIC_ALLOCATOR
	help
	  This is a KMS driver for the virtual Graphics Card used in
	  Virtual Box virtual machines.

	  Although it is possible to build this driver built-in to the
	  kernel, it is advised to build it as a module, so that it can
	  be updated independently of the kernel. Select M to build this
	  driver as a module and add support for these devices via drm/kms
	  interfaces.
```

## drivers/gpu/drm/vc4/Kconfig
```kconfig
# SPDX-License-Identifier: GPL-2.0-only
config DRM_VC4
	tristate "Broadcom VC4 Graphics"
	depends on ARCH_BCM || ARCH_BCM2835 || COMPILE_TEST
	# Make sure not 'y' when RASPBERRYPI_FIRMWARE is 'm'. This can only
	# happen when COMPILE_TEST=y, hence the added !RASPBERRYPI_FIRMWARE.
	depends on RASPBERRYPI_FIRMWARE || (COMPILE_TEST && !RASPBERRYPI_FIRMWARE)
	depends on DRM
	depends on SND && SND_SOC
	depends on COMMON_CLK
	depends on PM
	select DRM_DISPLAY_HDMI_HELPER
	select DRM_DISPLAY_HELPER
	select DRM_KMS_HELPER
	select DRM_GEM_DMA_HELPER
	select DRM_PANEL_BRIDGE
	select SND_PCM
	select SND_PCM_ELD
	select SND_SOC_GENERIC_DMAENGINE_PCM
	select SND_SOC_HDMI_CODEC
	select DRM_MIPI_DSI
	help
	  Choose this option if you have a system that has a Broadcom
	  VC4 GPU, such as the Raspberry Pi or other BCM2708/BCM2835.

	  This driver requires that "avoid_warnings=2" be present in
	  the config.txt for the firmware, to keep it from smashing
	  our display setup.

config DRM_VC4_HDMI_CEC
	bool "Broadcom VC4 HDMI CEC Support"
	depends on DRM_VC4
	select CEC_CORE
	help
	  Choose this option if you have a Broadcom VC4 GPU
	  and want to use CEC.

config DRM_VC4_KUNIT_TEST
	tristate "KUnit tests for VC4" if !KUNIT_ALL_TESTS
	depends on DRM_VC4 && KUNIT
	select DRM_KUNIT_TEST_HELPERS
	default KUNIT_ALL_TESTS
	help
	  This builds unit tests for the VC4 DRM/KMS driver. This option is
	  not useful for distributions or general kernels, but only for kernel
	  developers working on the VC4 driver.

	  For more information on KUnit and unit tests in general,
	  please refer to the KUnit documentation in
	  Documentation/dev-tools/kunit/.

	  If in doubt, say "N".
```

## drivers/gpu/drm/verisilicon/Kconfig
```kconfig
# SPDX-License-Identifier: GPL-2.0-only
config DRM_VERISILICON_DC
	tristate "DRM Support for Verisilicon DC-series display controllers"
	depends on DRM && COMMON_CLK
	depends on RISCV || COMPILE_TEST
	select DRM_BRIDGE_CONNECTOR
	select DRM_CLIENT_SELECTION
	select DRM_DISPLAY_HELPER
	select DRM_GEM_DMA_HELPER
	select DRM_KMS_HELPER
	select REGMAP_MMIO
	select VIDEOMODE_HELPERS
	help
	  Choose this option if you have a SoC with Verisilicon DC-series
	  display controllers. If M is selected, the module will be called
	  verisilicon-dc.
```

## drivers/gpu/drm/vgem/Kconfig
```kconfig
# SPDX-License-Identifier: GPL-2.0-only
config DRM_VGEM
	tristate "Virtual GEM provider"
	depends on DRM && MMU
	select DRM_GEM_SHMEM_HELPER
	help
	  Choose this option to get a virtual graphics memory manager,
	  as used by Mesa's software renderer for enhanced performance.
	  If M is selected the module will be called vgem.
```

## drivers/gpu/drm/virtio/Kconfig
```kconfig
# SPDX-License-Identifier: GPL-2.0-only
config DRM_VIRTIO_GPU
	tristate "Virtio GPU driver"
	depends on DRM && VIRTIO_MENU && MMU
	select VIRTIO
	select DRM_KMS_HELPER
	select DRM_GEM_SHMEM_HELPER
	select VIRTIO_DMA_SHARED_BUFFER
	help
	   This is the virtual GPU driver for virtio.  It can be used with
	   QEMU based VMMs (like KVM or Xen).

	   If unsure say M.

config DRM_VIRTIO_GPU_KMS
	bool "Virtio GPU driver modesetting support"
	depends on DRM_VIRTIO_GPU
	default y
	help
	   Enable modesetting support for virtio GPU driver.  This can be
	   disabled in cases where only "headless" usage of the GPU is
	   required.

	   If unsure, say Y.
```
