## drivers/gpu/drm/rockchip/rk618/Kconfig
```kconfig
# SPDX-License-Identifier: GPL-2.0

config DRM_ROCKCHIP_RK618
	tristate "Rockchip rk618 display bridge driver"
	depends on DRM_ROCKCHIP
	depends on MFD_RK618
	select DRM_PANEL
	select DRM_MIPI_DSI
	help
	  Rockchip rk618 display bridge chips driver.
```

## drivers/gpu/drm/rockchip/rk628/Kconfig
```kconfig
# SPDX-License-Identifier: GPL-2.0

config DRM_ROCKCHIP_RK628
	tristate "Rockchip RK628 display bridge driver"
	depends on DRM_ROCKCHIP
	depends on MFD_RK628
	---help---
	  Rockchip RK628 display bridge chips driver.
```

## drivers/gpu/drm/rockchip/screen/Kconfig
```kconfig
choice
	prompt  "LCD Panel Select"

config LCD_GENERAL
	bool "General lcd panel"
	help 
	  select if the panel do not need initialization
config LCD_LD089WU1_MIPI
	bool "mipi dsi lcd LD089WU1 1920X1200"
config LCD_B080XAN02_MIPI
	bool "mipi dsi lcd B080XAN02 1024X768"	
endchoice
```

## drivers/gpu/drm/shmobile/Kconfig
```kconfig
# SPDX-License-Identifier: GPL-2.0
config DRM_SHMOBILE
	tristate "DRM Support for SH Mobile"
	depends on DRM && ARM
	depends on ARCH_SHMOBILE || COMPILE_TEST
	select BACKLIGHT_CLASS_DEVICE
	select DRM_KMS_HELPER
	select DRM_GEM_CMA_HELPER
	help
	  Choose this option if you have an SH Mobile chipset.
	  If M is selected the module will be called shmob-drm.
```

## drivers/gpu/drm/sitronix/Kconfig
```kconfig
config DRM_ST7571
	tristate "DRM support for Sitronix ST7567/ST7571 display panels"
	depends on DRM && MMU
	select DRM_CLIENT_SELECTION
	select DRM_GEM_SHMEM_HELPER
	select DRM_KMS_HELPER
	select VIDEOMODE_HELPERS
	help
	  Sitronix ST7571 is a driver and controller for 4-level gray
	  scale and monochrome dot matrix LCD panels.

	  DRM driver for Sitronix ST7567/ST7571 panels.
	  This is only the core driver, a driver for the appropriate bus
	  transport in your chip also must be selected.

	  if M is selected the module will be called st7571.

config DRM_ST7571_I2C
	tristate "DRM support for Sitronix ST7567/ST7571 display panels (I2C)"
	depends on DRM_ST7571 && I2C
	select REGMAP
	help
	  Sitronix ST7571 is a driver and controller for 4-level gray
	  scale and monochrome dot matrix LCD panels.

	  DRM driver for Sitronix ST7565/ST7571 panels connected via I2C bus.

	  if M is selected the module will be called st7571-i2c.

config DRM_ST7571_SPI
	tristate "DRM support for Sitronix ST7567/ST7571 display panels (SPI)"
	depends on DRM_ST7571 && SPI
	select REGMAP_SPI
	help
	  Sitronix ST7571 is a driver and controller for 4-level gray
	  scale and monochrome dot matrix LCD panels.

	  DRM driver for Sitronix ST7565/ST7571 panels connected via SPI bus.

	  if M is selected the module will be called st7571-spi.

config DRM_ST7586
	tristate "DRM support for Sitronix ST7586 display panels"
	depends on DRM && SPI
	select DRM_CLIENT_SELECTION
	select DRM_KMS_HELPER
	select DRM_GEM_DMA_HELPER
	select DRM_MIPI_DBI
	help
	  DRM driver for the following Sitronix ST7586 panels:
	  * LEGO MINDSTORMS EV3

	  If M is selected the module will be called st7586.

config DRM_ST7735R
	tristate "DRM support for Sitronix ST7715R/ST7735R display panels"
	depends on DRM && SPI
	select DRM_CLIENT_SELECTION
	select DRM_KMS_HELPER
	select DRM_GEM_DMA_HELPER
	select DRM_MIPI_DBI
	select BACKLIGHT_CLASS_DEVICE
	help
	  DRM driver for Sitronix ST7715R/ST7735R with one of the following
	  LCDs:
	  * Jianda JD-T18003-T01 1.8" 128x160 TFT
	  * Okaya RH128128T 1.44" 128x128 TFT

	  If M is selected the module will be called st7735r.

config DRM_ST7920
	tristate "DRM support for Sitronix ST7920 LCD displays"
	depends on DRM && SPI && MMU
	select DRM_GEM_SHMEM_HELPER
	select DRM_KMS_HELPER
	select REGMAP_SPI
	help
	  DRM driver for the ST7920 Sitronix LCD controllers.

	  If M is selected the module will be called st7920.
```

## drivers/gpu/drm/solomon/Kconfig
```kconfig
config DRM_SSD130X
	tristate "DRM support for Solomon SSD13xx OLED displays"
	depends on DRM && MMU
	select BACKLIGHT_CLASS_DEVICE
	select DRM_GEM_SHMEM_HELPER
	select DRM_KMS_HELPER
	help
	  DRM driver for the SSD13xx Solomon and SINO WEALTH SH110x OLED
	  controllers. This is only for the core driver, a driver for the
	  appropriate bus transport in your chip also must be selected.

	  If M is selected the module will be called ssd130x.

config DRM_SSD130X_I2C
	tristate "DRM support for Solomon SSD13xx OLED displays (I2C bus)"
	depends on DRM_SSD130X && I2C
	select REGMAP_I2C
	help
	  Say Y here if the SSD13xx or SH110x OLED display is connected via
	  I2C bus.

	  If M is selected the module will be called ssd130x-i2c.

config DRM_SSD130X_SPI
	tristate "DRM support for Solomon SSD13xx OLED displays (SPI bus)"
	depends on DRM_SSD130X && SPI
	select REGMAP
	help
	  Say Y here if the SSD13xx OLED display is connected via SPI bus.

	  If M is selected the module will be called ssd130x-spi.
```

## drivers/gpu/drm/sprd/Kconfig
```kconfig
config DRM_SPRD
	tristate "DRM Support for Unisoc SoCs Platform"
	depends on ARCH_SPRD || COMPILE_TEST
	depends on DRM && OF
	select DRM_GEM_CMA_HELPER
	select DRM_KMS_HELPER
	select DRM_MIPI_DSI
	select VIDEOMODE_HELPERS
	help
	  Choose this option if you have a Unisoc chipset.
	  If M is selected the module will be called sprd_drm.
```

## drivers/gpu/drm/sti/Kconfig
```kconfig
# SPDX-License-Identifier: GPL-2.0-only
config DRM_STI
	tristate "DRM Support for STMicroelectronics SoC stiH4xx Series"
	depends on OF && DRM && (ARCH_STI || COMPILE_TEST)
	select RESET_CONTROLLER
	select DRM_KMS_HELPER
	select DRM_GEM_DMA_HELPER
	select DRM_PANEL
	select FW_LOADER
	select SND_SOC_HDMI_CODEC if SND_SOC
	help
	  Choose this option to enable DRM on STM stiH4xx chipset
```

## drivers/gpu/drm/stm/Kconfig
```kconfig
# SPDX-License-Identifier: GPL-2.0-only
config DRM_STM
	tristate "DRM Support for STMicroelectronics SoC Series"
	depends on DRM && (ARCH_STM32 || COMPILE_TEST)
	depends on COMMON_CLK
	select DRM_CLIENT_SELECTION
	select DRM_KMS_HELPER
	select DRM_GEM_DMA_HELPER
	select DRM_PANEL_BRIDGE
	select VIDEOMODE_HELPERS
	select FB_PROVIDE_GET_FB_UNMAPPED_AREA if FB

	help
	  Enable support for the on-chip display controller on
	  STMicroelectronics STM32 MCUs.
	  To compile this driver as a module, choose M here: the module
	  will be called stm-drm.

config DRM_STM_DSI
	tristate "STMicroelectronics specific extensions for Synopsys MIPI DSI"
	depends on DRM_STM
	select DRM_DW_MIPI_DSI
	help
	  Choose this option for MIPI DSI support on STMicroelectronics SoC.

config DRM_STM_LVDS
	tristate "STMicroelectronics LVDS Display Interface Transmitter DRM driver"
	depends on DRM_STM
	help
	  Enable support for LVDS encoders on STMicroelectronics SoC.
	  The STM LVDS is a bridge which serialize pixel stream onto
	  a LVDS protocol.

	  To compile this driver as a module, choose M here: the module will be
	  called lvds.
```

## drivers/gpu/drm/sun4i/Kconfig
```kconfig
# SPDX-License-Identifier: GPL-2.0-only
config DRM_SUN4I
	tristate "DRM Support for Allwinner A10 Display Engine"
	depends on DRM && (ARM || ARM64) && COMMON_CLK
	depends on ARCH_SUNXI || COMPILE_TEST
	select DRM_GEM_CMA_HELPER
	select DRM_KMS_HELPER
	select DRM_KMS_CMA_HELPER
	select DRM_PANEL
	select REGMAP_MMIO
	select VIDEOMODE_HELPERS
	help
	  Choose this option if you have an Allwinner SoC with a
	  Display Engine. If M is selected the module will be called
	  sun4i-drm.

if DRM_SUN4I

config DRM_SUN4I_HDMI
       tristate "Allwinner A10 HDMI Controller Support"
       default DRM_SUN4I
       help
	  Choose this option if you have an Allwinner SoC with an HDMI
	  controller.

config DRM_SUN4I_HDMI_CEC
       bool "Allwinner A10 HDMI CEC Support"
       depends on DRM_SUN4I_HDMI
       select CEC_CORE
       select CEC_PIN
       help
	  Choose this option if you have an Allwinner SoC with an HDMI
	  controller and want to use CEC.

config DRM_SUN4I_BACKEND
	tristate "Support for Allwinner A10 Display Engine Backend"
	default DRM_SUN4I
	help
	  Choose this option if you have an Allwinner SoC with the
	  original Allwinner Display Engine, which has a backend to
	  do some alpha blending and feed graphics to TCON. If M is
	  selected the module will be called sun4i-backend.

config DRM_SUN6I_DSI
	tristate "Allwinner A31 MIPI-DSI Controller Support"
	default MACH_SUN8I
	select CRC_CCITT
	select DRM_MIPI_DSI
	select PHY_SUN6I_MIPI_DPHY
	help
	  Choose this option if you want have an Allwinner SoC with
	  MIPI-DSI support. If M is selected the module will be called
	  sun6i_mipi_dsi.

config DRM_SUN8I_DW_HDMI
	tristate "Support for Allwinner version of DesignWare HDMI"
	depends on DRM_SUN4I
	select DRM_DW_HDMI
	help
	  Choose this option if you have an Allwinner SoC with the
	  DesignWare HDMI controller with custom HDMI PHY. If M is
	  selected the module will be called sun8i_dw_hdmi.

config DRM_SUN8I_MIXER
	tristate "Support for Allwinner Display Engine 2.0 Mixer"
	default MACH_SUN8I
	help
	  Choose this option if you have an Allwinner SoC with the
	  Allwinner Display Engine 2.0, which has a mixer to do some
	  graphics mixture and feed graphics to TCON, If M is
	  selected the module will be called sun8i-mixer.

config DRM_SUN8I_TCON_TOP
	tristate
	default DRM_SUN4I if DRM_SUN8I_MIXER!=n
	help
	  TCON TOP is responsible for configuring display pipeline for
	  HTMI, TVE and LCD.

endif
```

## drivers/gpu/drm/sysfb/Kconfig
```kconfig
# SPDX-License-Identifier: GPL-2.0-only

menu "Drivers for system framebuffers"
	depends on DRM

config DRM_SYSFB_HELPER
	tristate
	depends on DRM

config DRM_EFIDRM
	tristate "EFI framebuffer driver"
	depends on DRM && MMU && EFI && (!SYSFB_SIMPLEFB || COMPILE_TEST)
	select APERTURE_HELPERS
	select DRM_CLIENT_SELECTION
	select DRM_GEM_SHMEM_HELPER
	select DRM_KMS_HELPER
	select DRM_SYSFB_HELPER
	select SYSFB
	help
	  DRM driver for EFI framebuffers.

	  This driver assumes that the display hardware has been initialized
	  by the firmware or bootloader before the kernel boots. Scanout
	  buffer, size, and display format must be provided via EFI interfaces.

config DRM_OFDRM
	tristate "Open Firmware display driver"
	depends on DRM && MMU && OF && (PPC || COMPILE_TEST)
	select APERTURE_HELPERS
	select DRM_CLIENT_SELECTION
	select DRM_GEM_SHMEM_HELPER
	select DRM_KMS_HELPER
	select DRM_SYSFB_HELPER
	help
	  DRM driver for Open Firmware framebuffers.

	  This driver assumes that the display hardware has been initialized
	  by the Open Firmware before the kernel boots. Scanout buffer, size,
	  and display format must be provided via device tree.

config DRM_SIMPLEDRM
	tristate "Simple framebuffer driver"
	depends on DRM && MMU
	select APERTURE_HELPERS
	select DRM_CLIENT_SELECTION
	select DRM_GEM_SHMEM_HELPER
	select DRM_KMS_HELPER
	select DRM_SYSFB_HELPER
	help
	  DRM driver for simple platform-provided framebuffers.

	  This driver assumes that the display hardware has been initialized
	  by the firmware or bootloader before the kernel boots. Scanout
	  buffer, size, and display format must be provided via device tree,
	  UEFI, VESA, etc.

	  On x86 BIOS or UEFI systems, you should also select SYSFB_SIMPLEFB
	  to use UEFI and VESA framebuffers.

config DRM_VESADRM
	tristate "VESA framebuffer driver"
	depends on DRM && MMU && X86 && (!SYSFB_SIMPLEFB || COMPILE_TEST)
	select APERTURE_HELPERS
	select DRM_CLIENT_SELECTION
	select DRM_GEM_SHMEM_HELPER
	select DRM_KMS_HELPER
	select DRM_SYSFB_HELPER
	select SYSFB
	help
	  DRM driver for VESA framebuffers.

	  This driver assumes that the display hardware has been initialized
	  by the firmware or bootloader before the kernel boots. Scanout
	  buffer, size, and display format must be provided via VBE interfaces.

endmenu
```

## drivers/gpu/drm/tegra/Kconfig
```kconfig
# SPDX-License-Identifier: GPL-2.0-only
config DRM_TEGRA
	tristate "NVIDIA Tegra DRM"
	depends on ARCH_TEGRA || (ARM && COMPILE_TEST)
	depends on COMMON_CLK
	depends on DRM
	depends on OF
	select DRM_DP_AUX_BUS
	select DRM_KMS_HELPER
	select DRM_MIPI_DSI
	select DRM_PANEL
	select TEGRA_HOST1X
	select INTERCONNECT
	select IOMMU_IOVA
	select CEC_CORE if CEC_NOTIFIER
	select SND_SIMPLE_CARD if SND_SOC_TEGRA20_SPDIF
	select SND_SOC_HDMI_CODEC if SND_SOC_TEGRA20_SPDIF
	select SND_AUDIO_GRAPH_CARD if SND_SOC_TEGRA20_SPDIF
	help
	  Choose this option if you have an NVIDIA Tegra SoC.

	  To compile this driver as a module, choose M here: the module
	  will be called tegra-drm.

if DRM_TEGRA

config DRM_TEGRA_DEBUG
	bool "NVIDIA Tegra DRM debug support"
	help
	  Say yes here to enable debugging support.

config DRM_TEGRA_STAGING
	bool "Enable HOST1X interface"
	depends on STAGING
	help
	  Say yes if HOST1X should be available for userspace DRM users.

	  If unsure, choose N.

endif
```

## drivers/gpu/drm/tidss/Kconfig
```kconfig
config DRM_TIDSS
	tristate "DRM Support for TI Keystone"
	depends on DRM && OF
	depends on ARM || ARM64 || COMPILE_TEST
	select DRM_KMS_HELPER
	select DRM_DISPLAY_HELPER
	select DRM_BRIDGE_CONNECTOR
	select DRM_GEM_DMA_HELPER
	help
	  The TI Keystone family SoCs introduced a new generation of
	  Display SubSystem. There is currently three Keystone family
	  SoCs released with DSS. Each with somewhat different version
	  of it. The SoCs are 66AK2Gx, AM65x, and J721E. Set this to Y
	  or M to add display support for TI Keystone family
	  platforms.
```

## drivers/gpu/drm/tilcdc/Kconfig
```kconfig
# SPDX-License-Identifier: GPL-2.0-only
config DRM_TILCDC
	tristate "DRM Support for TI LCDC Display Controller"
	depends on DRM && OF && ARM
	select DRM_CLIENT_SELECTION
	select DRM_KMS_HELPER
	select DRM_GEM_DMA_HELPER
	select DRM_BRIDGE
	select DRM_DISPLAY_HELPER
	select DRM_BRIDGE_CONNECTOR
	select DRM_PANEL_BRIDGE
	select VIDEOMODE_HELPERS
	select BACKLIGHT_CLASS_DEVICE
	help
	  Choose this option if you have an TI SoC with LCDC display
	  controller, for example AM33xx in beagle-bone, DA8xx, or
	  OMAP-L1xx.  This driver replaces the FB_DA8XX fbdev driver.

config DRM_TILCDC_PANEL_LEGACY
	bool "Support device tree blobs using TI LCDC Panel binding"
	default y
	depends on DRM_TILCDC
	depends on OF
	depends on BACKLIGHT_CLASS_DEVICE
	depends on PM
	select OF_OVERLAY
	select DRM_PANEL_SIMPLE
	help
	  Modifies the live device tree at early boot to convert the legacy
	  "ti,tilcdc,panel" devicetree node to the standard panel-dpi node.
	  This allows to maintain backward compatibility for boards which
	  were using the deprecated tilcdc_panel driver.
	  If you find "ti,tilcdc,panel"-string from your DTB, you probably
	  need this. Otherwise you do not.
```
