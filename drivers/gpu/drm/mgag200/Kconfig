## drivers/gpu/drm/panel/msm8953-generated/Kconfig
```kconfig
menu "MSM8953 panel drivers generated with linux-mdss-dsi-panel-driver-generator"
	depends on GPIOLIB && OF && REGULATOR
	depends on DRM_MIPI_DSI

config DRM_PANEL_MSM8953_GENERATED
	tristate "Select all generated MSM8953 panel drivers by default"

config DRM_PANEL_ASUS_ZE520KL_ILI7807B_BOE
	tristate "Asus ZE520KL ILI7807B BOE"
	default DRM_PANEL_MSM8953_GENERATED

config DRM_PANEL_ASUS_ZE520KL_R63350_TM
	tristate "Asus ZE520KL R63350 TM"
	default DRM_PANEL_MSM8953_GENERATED

config DRM_PANEL_ASUS_ZE552KL_ILI7807B_CTC
	tristate "Asus ZE552KL ILI7807B CTC"
	default DRM_PANEL_MSM8953_GENERATED

config DRM_PANEL_ASUS_ZE552KL_NT35596_TXD
	tristate "Asus ZE552KL NT35596 TXD"
	default DRM_PANEL_MSM8953_GENERATED

config DRM_PANEL_ASUS_ZE552KL_OTM1901A_LCE
	tristate "Asus ZE552KL OTM1901A LCE"
	default DRM_PANEL_MSM8953_GENERATED

config DRM_PANEL_ASUS_ZE552KL_R63350_TM
	tristate "Asus ZE552KL R63350 TM"
	default DRM_PANEL_MSM8953_GENERATED

config DRM_PANEL_BOE_BS052FHM_A00_6C01
	tristate "Boe BS052FHM A00 6C01"
	default DRM_PANEL_MSM8953_GENERATED

config DRM_PANEL_CSOT_622_V0
	tristate "Csot 622 V0"
	default DRM_PANEL_MSM8953_GENERATED

config DRM_PANEL_FAIRPHONE_FP3_HX83112B
	tristate "Fairphone FP3 HX83112B"
	default DRM_PANEL_MSM8953_GENERATED

config DRM_PANEL_HIMAX_HX8399C_FHDPLUS
	tristate "Himax HX8399C FHDPLUS"
	default DRM_PANEL_MSM8953_GENERATED

config DRM_PANEL_HUAWEI_MILAN_BOE_OTM1906C
	tristate "Huawei MILAN BOE OTM1906C"
	default DRM_PANEL_MSM8953_GENERATED

config DRM_PANEL_HUAWEI_MILAN_BOE_TD4322
	tristate "Huawei MILAN BOE TD4322"
	default DRM_PANEL_MSM8953_GENERATED

config DRM_PANEL_HUAWEI_MILAN_BOE_TEST1906C
	tristate "Huawei MILAN BOE TEST1906C"
	default DRM_PANEL_MSM8953_GENERATED

config DRM_PANEL_HUAWEI_MILAN_CTC_NT35596S
	tristate "Huawei MILAN CTC NT35596S"
	default DRM_PANEL_MSM8953_GENERATED

config DRM_PANEL_HUAWEI_MILAN_CTC_OTM1906C
	tristate "Huawei MILAN CTC OTM1906C"
	default DRM_PANEL_MSM8953_GENERATED

config DRM_PANEL_HUAWEI_MILAN_JDI_R63452
	tristate "Huawei MILAN JDI R63452"
	default DRM_PANEL_MSM8953_GENERATED

config DRM_PANEL_HUAWEI_MILAN_TIANMA_FIC8736
	tristate "Huawei MILAN TIANMA FIC8736"
	default DRM_PANEL_MSM8953_GENERATED

config DRM_PANEL_HUAWEI_MILAN_TIANMA_FOCAL8716
	tristate "Huawei MILAN TIANMA FOCAL8716"
	default DRM_PANEL_MSM8953_GENERATED

config DRM_PANEL_HUAWEI_MILAN_TIANMA_OTM1906C
	tristate "Huawei MILAN TIANMA OTM1906C"
	default DRM_PANEL_MSM8953_GENERATED

config DRM_PANEL_LENOVO_CD_18781Y_FT8201
	tristate "Lenovo CD 18781Y FT8201"
	default DRM_PANEL_MSM8953_GENERATED

config DRM_PANEL_LENOVO_CD_18781Y_HX83100A
	tristate "Lenovo CD 18781Y HX83100A"
	default DRM_PANEL_MSM8953_GENERATED

config DRM_PANEL_LENOVO_CD_18781Y_JD9365
	tristate "Lenovo CD 18781Y JD9365"
	default DRM_PANEL_MSM8953_GENERATED

config DRM_PANEL_LENOVO_KUNTAO_549
	tristate "Lenovo KUNTAO 549"
	default DRM_PANEL_MSM8953_GENERATED

config DRM_PANEL_MDSS_FT8716_FHD
	tristate "Mdss FT8716 FHD"
	default DRM_PANEL_MSM8953_GENERATED

config DRM_PANEL_MDSS_ILI7807_FHD
	tristate "Mdss ILI7807 FHD"
	default DRM_PANEL_MSM8953_GENERATED

config DRM_PANEL_MDSS_ILI7807_FHDPLUS
	tristate "Mdss ILI7807 FHDPLUS"
	default DRM_PANEL_MSM8953_GENERATED

config DRM_PANEL_MDSS_NT35596_EBBG
	tristate "Mdss NT35596 EBBG"
	default DRM_PANEL_MSM8953_GENERATED

config DRM_PANEL_MDSS_OTM1911_FHD
	tristate "Mdss OTM1911 FHD"
	default DRM_PANEL_MSM8953_GENERATED

config DRM_PANEL_MDSS_OTM1911_FHDPLUS
	tristate "Mdss OTM1911 FHDPLUS"
	default DRM_PANEL_MSM8953_GENERATED

config DRM_PANEL_MDSS_R63350
	tristate "Mdss R63350"
	default DRM_PANEL_MSM8953_GENERATED

config DRM_PANEL_MOTOROLA_ALI_BOE
	tristate "Motorola ALI BOE"
	default DRM_PANEL_MSM8953_GENERATED

config DRM_PANEL_MOTOROLA_ALI_TIANMA
	tristate "Motorola ALI TIANMA"
	default DRM_PANEL_MSM8953_GENERATED

config DRM_PANEL_OFILM_622_V0
	tristate "Ofilm 622 V0"
	default DRM_PANEL_MSM8953_GENERATED

config DRM_PANEL_TENOR_HX8399C_AUO
	tristate "Tenor HX8399C_AUO"
	default DRM_PANEL_MSM8953_GENERATED

config DRM_PANEL_TENOR_ILI7807D_DJN_AUO
	tristate "Tenor ILI7807D_DJN_AUO"
	default DRM_PANEL_MSM8953_GENERATED

config DRM_PANEL_TENOR_ILI7807D_DJN
	tristate "Tenor ILI7807D_DJN"
	default DRM_PANEL_MSM8953_GENERATED

config DRM_PANEL_TIANMA_622_V0
	tristate "Tianma 622 V0"
	default DRM_PANEL_MSM8953_GENERATED

config DRM_PANEL_TIANMA_TL052VDXP02
	tristate "Tianma TL052VDXP02"
	default DRM_PANEL_MSM8953_GENERATED

config DRM_PANEL_XIAOMI_AUO_R61322
	tristate "Xiaomi AUO R61322"
	default DRM_PANEL_MSM8953_GENERATED

config DRM_PANEL_XIAOMI_BOE_ILI9885
	tristate "Xiaomi BOE ILI9885"
	default DRM_PANEL_MSM8953_GENERATED

config DRM_PANEL_XIAOMI_EBBG_R63350
	tristate "Xiaomi EBBG R63350"
	default DRM_PANEL_MSM8953_GENERATED

config DRM_PANEL_XIAOMI_NT35532
	tristate "Xiaomi NT35532"
	default DRM_PANEL_MSM8953_GENERATED

config DRM_PANEL_XIAOMI_NT36672_CSOT_FHDPLUS_E7
	tristate "Xiaomi NT36672 CSOT FHDPLUS E7"
	default DRM_PANEL_MSM8953_GENERATED

config DRM_PANEL_XIAOMI_NT36672_TIANMA_FHDPLUS_E7
	tristate "Xiaomi NT36672 TIANMA FHDPLUS E7"
	default DRM_PANEL_MSM8953_GENERATED

config DRM_PANEL_XIAOMI_ONCLITE_HX8394F
	tristate "Xiaomi ONCLITE HX8394F"
	default DRM_PANEL_MSM8953_GENERATED

config DRM_PANEL_XIAOMI_ONCLITE_ILI9881
	tristate "Xiaomi ONCLITE ILI9881"
	default DRM_PANEL_MSM8953_GENERATED

config DRM_PANEL_XIAOMI_ONCLITE_OTM1901A
	tristate "Xiaomi ONCLITE OTM1901A"
	default DRM_PANEL_MSM8953_GENERATED

config DRM_PANEL_XIAOMI_OTM1911
	tristate "Xiaomi OTM1911"
	default DRM_PANEL_MSM8953_GENERATED

config DRM_PANEL_XIAOMI_ROSY_FT8006M_BOE
	tristate "Xiaomi ROSY FT8006M BOE"
	default DRM_PANEL_MSM8953_GENERATED

config DRM_PANEL_XIAOMI_ROSY_FT8613_CSOT
	tristate "Xiaomi ROSY FT8613 CSOT"
	default DRM_PANEL_MSM8953_GENERATED

config DRM_PANEL_XIAOMI_ROSY_FT8613_EBBG
	tristate "Xiaomi ROSY FT8613 EBBG"
	default DRM_PANEL_MSM8953_GENERATED

config DRM_PANEL_XIAOMI_TD4310_EBBG_FHDPLUS_E7
	tristate "Xiaomi TD4310 EBBG FHDPLUS E7"
	default DRM_PANEL_MSM8953_GENERATED

config DRM_PANEL_XIAOMI_TD4310_FHDPLUS_E7_G55
	tristate "Xiaomi TD4310 FHDPLUS E7 G55"
	default DRM_PANEL_MSM8953_GENERATED

config DRM_PANEL_XIAOMI_TD4310_FHDPLUS_E7
	tristate "Xiaomi TD4310 FHDPLUS E7"
	default DRM_PANEL_MSM8953_GENERATED

config DRM_PANEL_XIAOMI_TIANMA_NT35596
	tristate "Xiaomi TIANMA NT35596"
	default DRM_PANEL_MSM8953_GENERATED

config DRM_PANEL_XIAOMI_TIANMA_R63350
	tristate "Xiaomi TIANMA R63350"
	default DRM_PANEL_MSM8953_GENERATED

config DRM_PANEL_XIAOMI_YSL_HX8394F
	tristate "Xiaomi YSL HX8394F"
	default DRM_PANEL_MSM8953_GENERATED

config DRM_PANEL_XIAOMI_YSL_ILI7807D
	tristate "Xiaomi YSL ILI7807D"
	default DRM_PANEL_MSM8953_GENERATED

config DRM_PANEL_XIAOMI_YSL_ILI9881C
	tristate "Xiaomi YSL ILI9881C"
	default DRM_PANEL_MSM8953_GENERATED

endmenu
```

## drivers/gpu/drm/panfrost/Kconfig
```kconfig
# SPDX-License-Identifier: GPL-2.0

config DRM_PANFROST
	tristate "Panfrost (DRM support for ARM Mali Midgard/Bifrost GPUs)"
	depends on DRM
	depends on ARM || ARM64 || COMPILE_TEST
	depends on !GENERIC_ATOMIC64    # for IOMMU_IO_PGTABLE_LPAE
	depends on MMU
	select DRM_SCHED
	select IOMMU_SUPPORT
	select IOMMU_IO_PGTABLE_LPAE
	select DRM_GEM_SHMEM_HELPER
	select PM_DEVFREQ
	select DEVFREQ_GOV_SIMPLE_ONDEMAND
	select WANT_DEV_COREDUMP
	help
	  DRM driver for ARM Mali Midgard (T6xx, T7xx, T8xx) and
	  Bifrost (G3x, G5x, G7x) GPUs.
```

## drivers/gpu/drm/panthor/Kconfig
```kconfig
# SPDX-License-Identifier: GPL-2.0 or MIT

config DRM_PANTHOR
	tristate "Panthor (DRM support for ARM Mali CSF-based GPUs)"
	depends on DRM
	depends on ARM || ARM64 || COMPILE_TEST
	depends on !GENERIC_ATOMIC64  # for IOMMU_IO_PGTABLE_LPAE
	depends on MMU
	select DEVFREQ_GOV_SIMPLE_ONDEMAND
	select DRM_EXEC
	select DRM_GEM_SHMEM_HELPER
	select DRM_GPUVM
	select DRM_SCHED
	select IOMMU_IO_PGTABLE_LPAE
	select IOMMU_SUPPORT
	select PM_DEVFREQ
	help
	  DRM driver for ARM Mali CSF-based GPUs.

	  This driver is for Mali (or Immortalis) Valhall Gxxx GPUs.

	  Note that the Mali-G68 and Mali-G78, while Valhall architecture, will
	  be supported with the panfrost driver as they are not CSF GPUs.
```

## drivers/gpu/drm/pl111/Kconfig
```kconfig
# SPDX-License-Identifier: GPL-2.0-only
config DRM_PL111
	tristate "DRM Support for PL111 CLCD Controller"
	depends on DRM
	depends on ARM || ARM64 || COMPILE_TEST
	depends on VEXPRESS_CONFIG || VEXPRESS_CONFIG=n
	depends on COMMON_CLK
	select DRM_KMS_HELPER
	select DRM_GEM_DMA_HELPER
	select DRM_BRIDGE
	select DRM_PANEL_BRIDGE
	select VT_HW_CONSOLE_BINDING if FRAMEBUFFER_CONSOLE
	help
	  Choose this option for DRM support for the PL111 CLCD controller.
	  If M is selected the module will be called pl111_drm.
```

## drivers/gpu/drm/qxl/Kconfig
```kconfig
# SPDX-License-Identifier: GPL-2.0-only
config DRM_QXL
	tristate "QXL virtual GPU"
	depends on DRM && PCI && HAS_IOPORT
	select DRM_CLIENT_SELECTION
	select DRM_KMS_HELPER
	select DRM_TTM
	select DRM_TTM_HELPER
	select DRM_EXEC
	select CRC32
	help
	  QXL virtual GPU for Spice virtualization desktop integration.
	  Do not enable this driver unless your distro ships a corresponding
	  X.org QXL driver that can handle kernel modesetting.
```

## drivers/gpu/drm/radeon/Kconfig
```kconfig
# SPDX-License-Identifier: MIT

config DRM_RADEON
	tristate "ATI Radeon"
	depends on DRM && PCI
	depends on AGP || !AGP
	select FW_LOADER
	select DRM_CLIENT_SELECTION
	select DRM_DISPLAY_DP_HELPER
	select DRM_DISPLAY_HELPER
        select DRM_KMS_HELPER
	select DRM_SUBALLOC_HELPER
        select DRM_TTM
	select DRM_TTM_HELPER
	select FB_IOMEM_HELPERS if DRM_FBDEV_EMULATION
	select DRM_EXEC
	select SND_HDA_COMPONENT if SND_HDA_CORE
	select POWER_SUPPLY
	select HWMON
	select BACKLIGHT_CLASS_DEVICE
	select INTERVAL_TREE
	select I2C
	select I2C_ALGOBIT
	# radeon depends on ACPI_VIDEO when ACPI is enabled, for select to work
	# ACPI_VIDEO's dependencies must also be selected.
	select INPUT if ACPI
	select ACPI_VIDEO if ACPI
	# On x86 ACPI_VIDEO also needs ACPI_WMI
	select X86_PLATFORM_DEVICES if ACPI && X86
	select ACPI_WMI if ACPI && X86
	help
	  Choose this option if you have an ATI Radeon graphics card.  There
	  are both PCI and AGP versions.  You don't need to choose this to
	  run the Radeon in plain VGA mode.

	  If M is selected, the module will be called radeon.

config DRM_RADEON_USERPTR
	bool "Always enable userptr support"
	depends on DRM_RADEON
	select MMU_NOTIFIER
	help
	  This option selects CONFIG_MMU_NOTIFIER if it isn't already
	  selected to enabled full userptr support.
```

## drivers/gpu/drm/rcar-du/Kconfig
```kconfig
# SPDX-License-Identifier: GPL-2.0
config DRM_RCAR_DU
	tristate "DRM Support for R-Car Display Unit"
	depends on DRM && OF
	depends on ARM || ARM64
	depends on ARCH_RENESAS || COMPILE_TEST
	imply DRM_RCAR_CMM
	imply DRM_RCAR_LVDS
	select DRM_KMS_HELPER
	select DRM_KMS_CMA_HELPER
	select DRM_GEM_CMA_HELPER
	select VIDEOMODE_HELPERS
	help
	  Choose this option if you have an R-Car chipset.
	  If M is selected the module will be called rcar-du-drm.

config DRM_RCAR_CMM
	tristate "R-Car DU Color Management Module (CMM) Support"
	depends on DRM && OF
	depends on DRM_RCAR_DU
	help
	  Enable support for R-Car Color Management Module (CMM).

config DRM_RCAR_DW_HDMI
	tristate "R-Car Gen3 and RZ/G2 DU HDMI Encoder Support"
	depends on DRM && OF
	select DRM_DW_HDMI
	help
	  Enable support for R-Car Gen3 or RZ/G2 internal HDMI encoder.

config DRM_RCAR_LVDS
	tristate "R-Car DU LVDS Encoder Support"
	depends on DRM && DRM_BRIDGE && OF
	select DRM_KMS_HELPER
	select DRM_PANEL
	select OF_FLATTREE
	select OF_OVERLAY
	help
	  Enable support for the R-Car Display Unit embedded LVDS encoders.

config DRM_RCAR_VSP
	bool "R-Car DU VSP Compositor Support" if ARM
	default y if ARM64
	depends on DRM_RCAR_DU
	depends on VIDEO_RENESAS_VSP1=y || (VIDEO_RENESAS_VSP1 && DRM_RCAR_DU=m)
	help
	  Enable support to expose the R-Car VSP Compositor as KMS planes.

config DRM_RCAR_WRITEBACK
	bool
	default y if ARM64
	depends on DRM_RCAR_DU
```

## drivers/gpu/drm/renesas/Kconfig
```kconfig
# SPDX-License-Identifier: GPL-2.0-only

source "drivers/gpu/drm/renesas/rcar-du/Kconfig"
source "drivers/gpu/drm/renesas/rz-du/Kconfig"
source "drivers/gpu/drm/renesas/shmobile/Kconfig"
```

## drivers/gpu/drm/renesas/rcar-du/Kconfig
```kconfig
# SPDX-License-Identifier: GPL-2.0
config DRM_RCAR_DU
	tristate "DRM Support for R-Car Display Unit"
	depends on DRM && OF
	depends on ARM || ARM64 || COMPILE_TEST
	depends on ARCH_RENESAS || COMPILE_TEST
	select DRM_KMS_HELPER
	select DRM_DISPLAY_HELPER
	select DRM_BRIDGE_CONNECTOR
	select DRM_GEM_DMA_HELPER
	select VIDEOMODE_HELPERS
	help
	  Choose this option if you have an R-Car chipset.
	  If M is selected the module will be called rcar-du-drm.

config DRM_RCAR_USE_CMM
	bool "R-Car DU Color Management Module (CMM) Support"
	depends on DRM_RCAR_DU
	default DRM_RCAR_DU
	help
	  Enable support for R-Car Color Management Module (CMM).

config DRM_RCAR_CMM
	def_tristate DRM_RCAR_DU
	depends on DRM_RCAR_USE_CMM

config DRM_RCAR_DW_HDMI
	tristate "R-Car Gen3 and RZ/G2 DU HDMI Encoder Support"
	depends on DRM && OF
	depends on DRM_RCAR_DU || COMPILE_TEST
	select DRM_DW_HDMI
	help
	  Enable support for R-Car Gen3 or RZ/G2 internal HDMI encoder.

config DRM_RCAR_USE_LVDS
	bool "R-Car DU LVDS Encoder Support"
	depends on DRM_BRIDGE && OF
	depends on DRM_RCAR_DU || COMPILE_TEST
	default DRM_RCAR_DU
	help
	  Enable support for the R-Car Display Unit embedded LVDS encoders.

config DRM_RCAR_LVDS
	def_tristate DRM_RCAR_DU
	depends on DRM_RCAR_USE_LVDS
	depends on PM
	select DRM_KMS_HELPER
	select DRM_PANEL
	select RESET_CONTROLLER

config DRM_RCAR_USE_MIPI_DSI
	bool "R-Car DU MIPI DSI Encoder Support"
	depends on DRM_BRIDGE && OF
	depends on DRM_RCAR_DU || COMPILE_TEST
	default DRM_RCAR_DU
	help
	  Enable support for the R-Car Display Unit embedded MIPI DSI encoders.

config DRM_RCAR_MIPI_DSI
	def_tristate DRM_RCAR_DU
	depends on DRM_RCAR_USE_MIPI_DSI
	select DRM_MIPI_DSI
	select RESET_CONTROLLER

config DRM_RCAR_VSP
	bool "R-Car DU VSP Compositor Support" if ARM
	default y if ARM64
	depends on DRM_RCAR_DU
	depends on VIDEO_RENESAS_VSP1=y || (VIDEO_RENESAS_VSP1 && DRM_RCAR_DU=m)
	help
	  Enable support to expose the R-Car VSP Compositor as KMS planes.

config DRM_RCAR_WRITEBACK
	bool
	default y if ARM64
	depends on DRM_RCAR_DU
```

## drivers/gpu/drm/renesas/rz-du/Kconfig
```kconfig
# SPDX-License-Identifier: GPL-2.0
config DRM_RZG2L_DU
	tristate "DRM Support for RZ/G2L Display Unit"
	depends on ARCH_RZG2L || COMPILE_TEST
	depends on DRM && OF
	depends on VIDEO_RENESAS_VSP1
	select DRM_CLIENT_SELECTION
	select DRM_GEM_DMA_HELPER
	select DRM_KMS_HELPER
	select DRM_DISPLAY_HELPER
	select DRM_BRIDGE_CONNECTOR
	select VIDEOMODE_HELPERS
	help
	  Choose this option if you have an RZ/G2L alike chipset.
	  If M is selected the module will be called rzg2l-du-drm.

config DRM_RZG2L_USE_MIPI_DSI
	bool "RZ/G2L MIPI DSI Encoder Support"
	depends on DRM_BRIDGE && OF
	depends on DRM_RZG2L_DU || COMPILE_TEST
	default DRM_RZG2L_DU
	help
	  Enable support for the RZ/G2L Display Unit embedded MIPI DSI encoders.

config DRM_RZG2L_MIPI_DSI
	def_tristate DRM_RZG2L_DU
	depends on DRM_RZG2L_USE_MIPI_DSI
	select DRM_MIPI_DSI
```

## drivers/gpu/drm/renesas/shmobile/Kconfig
```kconfig
# SPDX-License-Identifier: GPL-2.0
config DRM_SHMOBILE
	tristate "DRM Support for SH Mobile"
	depends on DRM && PM
	depends on ARCH_RENESAS || ARCH_SHMOBILE || COMPILE_TEST
	select BACKLIGHT_CLASS_DEVICE
	select DRM_KMS_HELPER
	select DRM_GEM_DMA_HELPER
	select VIDEOMODE_HELPERS
	help
	  Choose this option if you have an SH Mobile chipset.
	  If M is selected the module will be called shmob-drm.
```
