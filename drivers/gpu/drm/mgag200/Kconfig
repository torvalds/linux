## drivers/gpu/drm/mgag200/Kconfig
```kconfig
# SPDX-License-Identifier: GPL-2.0-only
config DRM_MGAG200
	tristate "Matrox G200"
	depends on DRM && PCI
	select DRM_CLIENT_SELECTION
	select DRM_GEM_SHMEM_HELPER
	select DRM_KMS_HELPER
	select I2C
	select I2C_ALGOBIT
	help
	 This is a KMS driver for Matrox G200 chips. It supports the original
	 MGA G200 desktop chips and the server variants. It requires 0.3.0
	 of the modesetting userspace driver, and a version of mga driver
	 that will fail on KMS enabled devices.

config DRM_MGAG200_DISABLE_WRITECOMBINE
	bool "Disable Write Combine mapping of VRAM"
	depends on DRM_MGAG200 && PREEMPT_RT
	help
	  The VRAM of the G200 is mapped with Write-Combine to improve
	  performances. This can interfere with real-time tasks; even if they
	  are running on other CPU cores than the graphics output.
	  Enable this option only if you run realtime tasks on a server with a
	  Matrox G200.
```

## drivers/gpu/drm/msm/Kconfig
```kconfig
# SPDX-License-Identifier: GPL-2.0-only

config DRM_MSM
	tristate "MSM DRM"
	depends on DRM
	depends on ARCH_QCOM || SOC_IMX5 || COMPILE_TEST
	depends on COMMON_CLK
	depends on IOMMU_SUPPORT
	depends on OF
	depends on QCOM_AOSS_QMP || QCOM_AOSS_QMP=n
	depends on QCOM_OCMEM || QCOM_OCMEM=n
	depends on QCOM_LLCC || QCOM_LLCC=n
	depends on QCOM_COMMAND_DB || QCOM_COMMAND_DB=n
	depends on PM
	select IOMMU_IO_PGTABLE
	select QCOM_MDT_LOADER if ARCH_QCOM
	select REGULATOR
	select DRM_EXEC
	select DRM_GPUVM
	select DRM_SCHED
	select SHMEM
	select TMPFS
	select QCOM_SCM
	select QCOM_UBWC_CONFIG
	select WANT_DEV_COREDUMP
	select SND_SOC_HDMI_CODEC if SND_SOC
	select SYNC_FILE
	select PM_OPP
	select NVMEM
	select PM_GENERIC_DOMAINS
	select TRACE_GPU_MEM
	help
	  DRM/KMS driver for MSM/snapdragon.

config DRM_MSM_GPU_STATE
	bool
	depends on DRM_MSM && (DEBUG_FS || DEV_COREDUMP)
	default y

config DRM_MSM_GPU_SUDO
	bool "Enable SUDO flag on submits"
	depends on DRM_MSM && EXPERT
	default n
	help
	  Enable userspace that has CAP_SYS_RAWIO to submit GPU commands
	  that are run from RB instead of IB1.  This essentially gives
	  userspace kernel level access, but is useful for firmware
	  debugging.

	  Only use this if you are a driver developer.  This should *not*
	  be enabled for production kernels.  If unsure, say N.

config DRM_MSM_VALIDATE_XML
	bool "Validate XML register files against schema"
	depends on DRM_MSM && EXPERT
	depends on $(success,$(PYTHON3) -c "import lxml")
	help
	  Validate XML files with register definitions against rules-fd schema.
	  This option is mostly targeting DRM MSM developers. If unsure, say N.

config DRM_MSM_KMS
	def_bool n
	depends on DRM_MSM
	select DRM_BRIDGE
	select DRM_BRIDGE_CONNECTOR
	select DRM_CLIENT_SELECTION
	select DRM_DISPLAY_HELPER
	select DRM_KMS_HELPER
	select DRM_PANEL
	select DRM_PANEL_BRIDGE

config DRM_MSM_KMS_FBDEV
	def_bool DRM_FBDEV_EMULATION
	depends on DRM_MSM_KMS
	select FB_SYSMEM_HELPERS

config DRM_MSM_MDSS
	bool
	depends on DRM_MSM
	default n

config DRM_MSM_MDP4
	bool "Enable MDP4 support in MSM DRM driver"
	depends on DRM_MSM
	select DRM_MSM_KMS
	default y
	help
	  Compile in support for the Mobile Display Processor v4 (MDP4) in
	  the MSM DRM driver. It is the older display controller found in
	  devices using APQ8064/MSM8960/MSM8x60 platforms.

config DRM_MSM_MDP5
	bool "Enable MDP5 support in MSM DRM driver"
	depends on DRM_MSM
	select DRM_MSM_MDSS
	select DRM_MSM_KMS
	default y
	help
	  Compile in support for the Mobile Display Processor v5 (MDP5) in
	  the MSM DRM driver. It is the display controller found in devices
	  using e.g. APQ8016/MSM8916/APQ8096/MSM8996/MSM8974/SDM6x0 platforms.

config DRM_MSM_DPU
	bool "Enable DPU support in MSM DRM driver"
	depends on DRM_MSM
	select DRM_MSM_MDSS
	select DRM_MSM_KMS
	select DRM_DISPLAY_DSC_HELPER
	default y
	help
	  Compile in support for the Display Processing Unit in
	  the MSM DRM driver. It is the display controller found in devices
	  using e.g. SDM845 and newer platforms.

config DRM_MSM_DP
	bool "Enable DisplayPort support in MSM DRM driver"
	depends on DRM_MSM
	depends on DRM_MSM_KMS
	select DRM_DISPLAY_HDMI_AUDIO_HELPER
	select RATIONAL
	select DRM_DISPLAY_DP_AUX_BUS
	select DRM_DISPLAY_DP_HELPER
	default y
	help
	  Compile in support for DP driver in MSM DRM driver. DP external
	  display support is enabled through this config option. It can
	  be primary or secondary display on device.

config DRM_MSM_DSI
	bool "Enable DSI support in MSM DRM driver"
	depends on DRM_MSM
	depends on DRM_MSM_KMS
	select DRM_PANEL
	select DRM_MIPI_DSI
	select DRM_DISPLAY_DSC_HELPER
	default y
	help
	  Choose this option if you have a need for MIPI DSI connector
	  support.

config DRM_MSM_DSI_28NM_PHY
	bool "Enable DSI 28nm PHY driver in MSM DRM"
	depends on DRM_MSM_DSI
	default y
	help
	  Choose this option if the 28nm DSI PHY is used on the platform.

config DRM_MSM_DSI_20NM_PHY
	bool "Enable DSI 20nm PHY driver in MSM DRM"
	depends on DRM_MSM_DSI
	default y
	help
	  Choose this option if the 20nm DSI PHY is used on the platform.

config DRM_MSM_DSI_28NM_8960_PHY
	bool "Enable DSI 28nm 8960 PHY driver in MSM DRM"
	depends on DRM_MSM_DSI
	default y
	help
	  Choose this option if the 28nm DSI PHY 8960 variant is used on the
	  platform.

config DRM_MSM_DSI_14NM_PHY
	bool "Enable DSI 14nm PHY driver in MSM DRM (used by MSM8996/APQ8096)"
	depends on DRM_MSM_DSI
	default y
	help
	  Choose this option if DSI PHY on 8996 is used on the platform.

config DRM_MSM_DSI_10NM_PHY
	bool "Enable DSI 10nm PHY driver in MSM DRM (used by SDM845)"
	depends on DRM_MSM_DSI
	default y
	help
	  Choose this option if DSI PHY on SDM845 is used on the platform.

config DRM_MSM_DSI_7NM_PHY
	bool "Enable DSI 7nm/5nm/4nm PHY driver in MSM DRM"
	depends on DRM_MSM_DSI
	default y
	help
	  Choose this option if DSI PHY on SM8150/SM8250/SM8350/SM8450/SM8550/SC7280
	  is used on the platform.

config DRM_MSM_HDMI
	bool "Enable HDMI support in MSM DRM driver"
	depends on DRM_MSM
	depends on DRM_MSM_KMS
	default y
	select DRM_DISPLAY_HDMI_HELPER
	select DRM_DISPLAY_HDMI_STATE_HELPER
	help
	  Compile in support for the HDMI output MSM DRM driver. It can
	  be a primary or a secondary display on device. Note that this is used
	  only for the direct HDMI output. If the device outputs HDMI data
	  through some kind of DSI-to-HDMI bridge, this option can be disabled.

config DRM_MSM_HDMI_HDCP
	bool "Enable HDMI HDCP support in MSM DRM driver"
	depends on DRM_MSM && DRM_MSM_HDMI
	default y
	help
	  Choose this option to enable HDCP state machine
```

## drivers/gpu/drm/msm/dsi/Kconfig
```kconfig
config DRM_MSM_DSI
	bool "Enable DSI support in MSM DRM driver"
	depends on DRM_MSM
	select DRM_PANEL
	select DRM_MIPI_DSI
	default y
	help
	  Choose this option if you have a need for MIPI DSI connector
	  support.

if DRM_MSM_DSI

config DRM_MSM_DSI_PLL
	bool "Enable DSI PLL driver in MSM DRM"
	default y
	help
	  Choose this option to enable DSI PLL driver which provides DSI
	  source clocks under common clock framework.

config DRM_MSM_DSI_28NM_PHY
	bool "Enable DSI 28nm PHY driver in MSM DRM"
	default y
	help
	  Choose this option if the 28nm DSI PHY is used on the platform.

config DRM_MSM_DSI_20NM_PHY
	bool "Enable DSI 20nm PHY driver in MSM DRM"
	default y
	help
	  Choose this option if the 20nm DSI PHY is used on the platform.

config DRM_MSM_DSI_28NM_8960_PHY
	bool "Enable DSI 28nm 8960 PHY driver in MSM DRM"
	depends on DRM_MSM_DSI
	default y
	help
	  Choose this option if the 28nm DSI PHY 8960 variant is used on the
	  platform.

endif
```

## drivers/gpu/drm/msm/edp/Kconfig
```kconfig
config DRM_MSM_EDP
	bool "Enable EDP support in MSM DRM driver"
	depends on DRM_MSM
	default y
	help
	  Choose this option if you have a need for Embedded Display
	  Port encoder support.
```

## drivers/gpu/drm/msm/hdmi/Kconfig
```kconfig
config DRM_MSM_HDMI
	bool "Enable HDMI support in MSM DRM driver"
	depends on DRM_MSM
	default y
	help
	  Choose this option if you have a need for HDMI connector
	  support.
```

## drivers/gpu/drm/mxsfb/Kconfig
```kconfig
# SPDX-License-Identifier: GPL-2.0-only
config DRM_MXS
	bool
	help
	  Choose this option to select drivers for MXS FB devices

config DRM_MXSFB
	tristate "i.MX (e)LCDIF LCD controller"
	depends on DRM && OF
	depends on COMMON_CLK
	depends on ARCH_MXS || ARCH_MXC || COMPILE_TEST
	select DRM_CLIENT_SELECTION
	select DRM_MXS
	select DRM_KMS_HELPER
	select DRM_GEM_DMA_HELPER
	select DRM_PANEL
	select DRM_PANEL_BRIDGE
	help
	  Choose this option if you have an LCDIF or eLCDIF LCD controller.
	  Those devices are found in various i.MX SoC (including i.MX23,
	  i.MX28, i.MX6SX, i.MX7 and i.MX8M).

	  If M is selected the module will be called mxsfb.

config DRM_IMX_LCDIF
	tristate "i.MX LCDIFv3 LCD controller"
	depends on DRM && OF
	depends on COMMON_CLK
	depends on ARCH_MXC || COMPILE_TEST
	select DRM_CLIENT_SELECTION
	select DRM_MXS
	select DRM_KMS_HELPER
	select DRM_GEM_DMA_HELPER
	select DRM_PANEL
	select DRM_PANEL_BRIDGE
	help
	  Choose this option if you have an LCDIFv3 LCD controller.
	  Those devices are found in various i.MX SoC (i.MX8MP,
	  i.MXRT).

	  If M is selected the module will be called imx-lcdif.
```

## drivers/gpu/drm/nouveau/Kconfig
```kconfig
# SPDX-License-Identifier: GPL-2.0-only
config DRM_NOUVEAU
	tristate "Nouveau (NVIDIA) cards"
	depends on DRM && PCI
	select IOMMU_API
	select FW_LOADER
	select FW_CACHE if PM_SLEEP
	select DRM_CLIENT_SELECTION
	select DRM_DISPLAY_DP_HELPER
	select DRM_DISPLAY_HDMI_HELPER
	select DRM_DISPLAY_HELPER
	select DRM_KMS_HELPER
	select DRM_TTM
	select DRM_TTM_HELPER
	select DRM_EXEC
	select DRM_GPUVM
	select DRM_SCHED
	select I2C
	select I2C_ALGOBIT
	select BACKLIGHT_CLASS_DEVICE if DRM_NOUVEAU_BACKLIGHT
	select X86_PLATFORM_DEVICES if ACPI && X86
	select ACPI_WMI if ACPI && X86
	select MXM_WMI if ACPI && X86
	select POWER_SUPPLY
	# Similar to i915, we need to select ACPI_VIDEO and it's dependencies
	select BACKLIGHT_CLASS_DEVICE if ACPI && X86
	select INPUT if ACPI && X86
	select THERMAL if ACPI && X86
	select ACPI_VIDEO if ACPI && X86
	select SND_HDA_COMPONENT if SND_HDA_CORE
	help
	  Choose this option for open-source NVIDIA support.

config NOUVEAU_PLATFORM_DRIVER
	bool "Nouveau (NVIDIA) SoC GPUs"
	depends on DRM_NOUVEAU && ARCH_TEGRA
	default y
	help
	  Support for Nouveau platform driver, used for SoC GPUs as found
	  on NVIDIA Tegra K1.

config NOUVEAU_DEBUG
	int "Maximum debug level"
	depends on DRM_NOUVEAU
	range 0 7
	default 5
	help
	  Selects the maximum debug level to compile support for.

	  0 - fatal
	  1 - error
	  2 - warning
	  3 - info
	  4 - debug
	  5 - trace (recommended)
	  6 - paranoia
	  7 - spam

	  The paranoia and spam levels will add a lot of extra checks which
	  may potentially slow down driver operation.

config NOUVEAU_DEBUG_DEFAULT
	int "Default debug level"
	depends on DRM_NOUVEAU
	range 0 7
	default 3
	help
	  Selects the default debug level

config NOUVEAU_DEBUG_MMU
	bool "Enable additional MMU debugging"
	depends on DRM_NOUVEAU
	default n
	help
	  Say Y here if you want to enable verbose MMU debug output.

config NOUVEAU_DEBUG_PUSH
	bool "Enable additional push buffer debugging"
	depends on DRM_NOUVEAU
	default n
	help
	  Say Y here if you want to enable verbose push buffer debug output
	  and sanity checks.

config DRM_NOUVEAU_BACKLIGHT
	bool "Support for backlight control"
	depends on DRM_NOUVEAU
	default y
	help
	  Say Y here if you want to control the backlight of your display
	  (e.g. a laptop panel).

config DRM_NOUVEAU_SVM
	bool "(EXPERIMENTAL) Enable SVM (Shared Virtual Memory) support"
	depends on DEVICE_PRIVATE
	depends on DRM_NOUVEAU
	depends on STAGING
	select HMM_MIRROR
	select MMU_NOTIFIER
	default n
	help
	  Say Y here if you want to enable experimental support for
	  Shared Virtual Memory (SVM).

config DRM_NOUVEAU_CH7006
	tristate "Chrontel ch7006 TV encoder"
	depends on DRM_NOUVEAU
	default m
	help
	  Support for Chrontel ch7006 and similar TV encoders.

	  This driver is currently only useful if you're also using
	  the nouveau driver.

config DRM_NOUVEAU_SIL164
	tristate "Silicon Image sil164 TMDS transmitter"
	depends on DRM_NOUVEAU
	default m
	help
	  Support for sil164 and similar single-link (or dual-link
	  when used in pairs) TMDS transmitters.
```

## drivers/gpu/drm/nova/Kconfig
```kconfig
config DRM_NOVA
	tristate "Nova DRM driver"
	depends on DRM=y
	depends on PCI
	depends on RUST
	select AUXILIARY_BUS
	default n
	help
	  Choose this if you want to build the Nova DRM driver for Nvidia
	  GSP-based GPUs.

	  This driver is work in progress and may not be functional.

	  If M is selected, the module will be called nova.
```

## drivers/gpu/drm/omapdrm/Kconfig
```kconfig
config DRM_OMAP
	tristate "OMAP DRM"
	depends on DRM
	depends on ARCH_OMAP2PLUS || ARCH_MULTIPLATFORM
	select OMAP2_DSS
	select DRM_KMS_HELPER
	default n
	help
	  DRM display driver for OMAP2/3/4 based boards.

if DRM_OMAP

source "drivers/gpu/drm/omapdrm/dss/Kconfig"
source "drivers/gpu/drm/omapdrm/displays/Kconfig"

endif
```

## drivers/gpu/drm/omapdrm/displays/Kconfig
```kconfig
# SPDX-License-Identifier: GPL-2.0-only
menu "OMAPDRM External Display Device Drivers"

config DRM_OMAP_PANEL_DSI_CM
	tristate "Generic DSI Command Mode Panel"
	depends on BACKLIGHT_CLASS_DEVICE
	help
	  Driver for generic DSI command mode panels.

endmenu
```
