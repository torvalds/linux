## drivers/gpu/drm/amd/display/Kconfig
```kconfig
# SPDX-License-Identifier: MIT
menu "Display Engine Configuration"
	depends on DRM && DRM_AMDGPU

config DRM_AMD_DC
	bool "AMD DC - Enable new display engine"
	default y
	depends on BROKEN || !CC_IS_CLANG || X86_64 || SPARC64 || ARM64
	select SND_HDA_COMPONENT if SND_HDA_CORE
	# !CC_IS_CLANG: https://github.com/ClangBuiltLinux/linux/issues/1752
	select DRM_AMD_DC_DCN if (X86 || PPC_LONG_DOUBLE_128 || (ARM64 && KERNEL_MODE_NEON && !CC_IS_CLANG))
	help
	  Choose this option if you want to use the new display engine
	  support for AMDGPU. This adds required support for Vega and
	  Raven ASICs.

	  calculate_bandwidth() is presently broken on all !(X86_64 || SPARC64 || ARM64)
	  architectures built with Clang (all released versions), whereby the stack
	  frame gets blown up to well over 5k.  This would cause an immediate kernel
	  panic on most architectures.  We'll revert this when the following bug report
	  has been resolved: https://github.com/llvm/llvm-project/issues/41896.

config DRM_AMD_DC_DCN
	def_bool n
	help
	  Raven, Navi, and newer family support for display engine

config DRM_AMD_DC_HDCP
	bool "Enable HDCP support in DC"
	depends on DRM_AMD_DC
	help
	  Choose this option if you want to support HDCP authentication.

config DRM_AMD_DC_SI
	bool "AMD DC support for Southern Islands ASICs"
	depends on DRM_AMDGPU_SI
	depends on DRM_AMD_DC
	help
	  Choose this option to enable new AMD DC support for SI asics
	  by default. This includes Tahiti, Pitcairn, Cape Verde, Oland.
	  Hainan is not supported by AMD DC and it has no physical DCE6.

config DEBUG_KERNEL_DC
	bool "Enable kgdb break in DC"
	depends on DRM_AMD_DC
	depends on KGDB
	help
	  Choose this option if you want to hit kdgb_break in assert.

config DRM_AMD_SECURE_DISPLAY
        bool "Enable secure display support"
        depends on DEBUG_FS
        depends on DRM_AMD_DC_DCN
        help
            Choose this option if you want to
            support secure display

            This option enables the calculation
            of crc of specific region via debugfs.
            Cooperate with specific DMCU FW.


endmenu
```

## drivers/gpu/drm/amd/lib/Kconfig
```kconfig
menu "AMD Library routines"

#
# Closed hash table
#
config CHASH
	tristate
	default DRM_AMDGPU
	help
	 Statically sized closed hash table implementation with low
	 memory and CPU overhead.

config CHASH_STATS
	bool "Closed hash table performance statistics"
	depends on CHASH
	default n
	help
	 Enable collection of performance statistics for closed hash tables.

config CHASH_SELFTEST
	bool "Closed hash table self test"
	depends on CHASH
	default n
	help
	 Runs a selftest during module load. Several module parameters
	 are available to modify the behaviour of the test.

endmenu
```

## drivers/gpu/drm/amd/powerplay/Kconfig
```kconfig
config DRM_AMD_POWERPLAY
	bool  "Enable AMD powerplay component"
	depends on DRM_AMDGPU
	default n
	help
	  select this option will enable AMD powerplay component.
```

## drivers/gpu/drm/arc/Kconfig
```kconfig
config DRM_ARCPGU
	tristate "ARC PGU"
	depends on DRM && OF
	select DRM_KMS_CMA_HELPER
	select DRM_KMS_FB_HELPER
	select DRM_KMS_HELPER
	help
	  Choose this option if you have an ARC PGU controller.

	  If M is selected the module will be called arcpgu.
```

## drivers/gpu/drm/arm/Kconfig
```kconfig
# SPDX-License-Identifier: GPL-2.0
menu "ARM devices"
	depends on DRM

config DRM_HDLCD
	tristate "ARM HDLCD"
	depends on DRM && OF && (ARM || ARM64 || COMPILE_TEST)
	depends on COMMON_CLK
	select DRM_CLIENT_SELECTION
	select DRM_KMS_HELPER
	select DRM_GEM_DMA_HELPER
	help
	  Choose this option if you have an ARM High Definition Colour LCD
	  controller.

	  If M is selected the module will be called hdlcd.

config DRM_HDLCD_SHOW_UNDERRUN
	bool "Show underrun conditions"
	depends on DRM_HDLCD
	default n
	help
	  Enable this option to show in red colour the pixels that the
	  HDLCD device did not fetch from framebuffer due to underrun
	  conditions.

config DRM_MALI_DISPLAY
	tristate "ARM Mali Display Processor"
	depends on DRM && OF && (ARM || ARM64 || COMPILE_TEST)
	depends on COMMON_CLK
	select DRM_CLIENT_SELECTION
	select DRM_KMS_HELPER
	select DRM_GEM_DMA_HELPER
	select VIDEOMODE_HELPERS
	help
	  Choose this option if you want to compile the ARM Mali Display
	  Processor driver. It supports the DP500, DP550 and DP650 variants
	  of the hardware.

	  If compiled as a module it will be called mali-dp.

source "drivers/gpu/drm/arm/display/Kconfig"

endmenu
```

## drivers/gpu/drm/arm/display/Kconfig
```kconfig
# SPDX-License-Identifier: GPL-2.0
config DRM_KOMEDA
	tristate "ARM Komeda display driver"
	depends on DRM && OF
	depends on COMMON_CLK
	select DRM_KMS_HELPER
	select DRM_KMS_CMA_HELPER
	select DRM_GEM_CMA_HELPER
	select VIDEOMODE_HELPERS
	help
	  Choose this option if you want to compile the ARM Komeda display
	  Processor driver. It supports the D71 variants of the hardware.

	  If compiled as a module it will be called komeda.
```

## drivers/gpu/drm/armada/Kconfig
```kconfig
# SPDX-License-Identifier: GPL-2.0-only
config DRM_ARMADA
	tristate "DRM support for Marvell Armada SoCs"
	depends on DRM && HAVE_CLK && ARM && MMU
	select DRM_CLIENT_SELECTION
	select DRM_KMS_HELPER
	select FB_IOMEM_HELPERS if DRM_FBDEV_EMULATION
	help
	  Support the "LCD" controllers found on the Marvell Armada 510
	  devices.  There are two controllers on the device, each controller
	  supports graphics and video overlays.

	  This driver provides no built-in acceleration; acceleration is
	  performed by other IP found on the SoC.  This driver provides
	  kernel mode setting and buffer management to userspace.
```

## drivers/gpu/drm/aspeed/Kconfig
```kconfig
config DRM_ASPEED_GFX
	tristate "ASPEED BMC Display Controller"
	depends on DRM && OF
	depends on (COMPILE_TEST || ARCH_ASPEED)
	select DRM_KMS_HELPER
	select DRM_KMS_CMA_HELPER
	select DMA_CMA if HAVE_DMA_CONTIGUOUS
	select CMA if HAVE_DMA_CONTIGUOUS
	select MFD_SYSCON
	help
	  Chose this option if you have an ASPEED AST2500 SOC Display
	  Controller (aka GFX).

	  If M is selected this module will be called aspeed_gfx.
```

## drivers/gpu/drm/ast/Kconfig
```kconfig
# SPDX-License-Identifier: GPL-2.0-only
config DRM_AST
	tristate "AST server chips"
	depends on DRM && PCI
	select DRM_CLIENT_SELECTION
	select DRM_GEM_SHMEM_HELPER
	select DRM_KMS_HELPER
	select I2C
	select I2C_ALGOBIT
	help
	 Say yes for experimental AST GPU driver. Do not enable
	 this driver without having a working -modesetting,
	 and a version of AST that knows to fail if KMS
	 is bound to the driver. These GPUs are commonly found
	 in server chipsets.
```

## drivers/gpu/drm/atmel-hlcdc/Kconfig
```kconfig
# SPDX-License-Identifier: GPL-2.0-only
config DRM_ATMEL_HLCDC
	tristate "DRM Support for ATMEL HLCDC Display Controller"
	depends on DRM && OF && COMMON_CLK && MFD_ATMEL_HLCDC && ARM
	select DRM_GEM_CMA_HELPER
	select DRM_KMS_HELPER
	select DRM_KMS_CMA_HELPER
	select DRM_PANEL
	help
	  Choose this option if you have an ATMEL SoC with an HLCDC display
	  controller (i.e. at91sam9n12, at91sam9x5 family or sama5d3 family).
```

## drivers/gpu/drm/bochs/Kconfig
```kconfig
# SPDX-License-Identifier: GPL-2.0-only
config DRM_BOCHS
	tristate "DRM Support for bochs dispi vga interface (qemu stdvga)"
	depends on DRM && PCI && MMU
	select DRM_KMS_HELPER
	select DRM_VRAM_HELPER
	select DRM_TTM
	select DRM_TTM_HELPER
	help
	  Choose this option for qemu.
	  If M is selected the module will be called bochs-drm.
```
