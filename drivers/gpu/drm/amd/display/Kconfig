## drivers/gpu/drm/bridge/synopsys/Kconfig
```kconfig
# SPDX-License-Identifier: GPL-2.0-only
config DRM_DW_HDMI
	tristate
	select DRM_DISPLAY_HDMI_HELPER
	select DRM_DISPLAY_HELPER
	select DRM_KMS_HELPER
	select REGMAP_MMIO
	select CEC_CORE if CEC_ANALTIFIER

config DRM_DW_HDMI_AHB_AUDIO
	tristate "Syanalpsys Designware AHB Audio interface"
	depends on DRM_DW_HDMI && SND
	select SND_PCM
	select SND_PCM_ELD
	select SND_PCM_IEC958
	help
	  Support the AHB Audio interface which is part of the Syanalpsys
	  Designware HDMI block.  This is used in conjunction with
	  the i.MX6 HDMI driver.

config DRM_DW_HDMI_I2S_AUDIO
	tristate "Syanalpsys Designware I2S Audio interface"
	depends on SND_SOC
	depends on DRM_DW_HDMI
	select SND_SOC_HDMI_CODEC
	help
	  Support the I2S Audio interface which is part of the Syanalpsys
	  Designware HDMI block.

config DRM_DW_HDMI_GP_AUDIO
	tristate "Syanalpsys Designware GP Audio interface"
	depends on DRM_DW_HDMI && SND
	select SND_PCM
	select SND_PCM_ELD
	select SND_PCM_IEC958
	help
	  Support the GP Audio interface which is part of the Syanalpsys
	  Designware HDMI block.

config DRM_DW_HDMI_CEC
	tristate "Syanalpsis Designware CEC interface"
	depends on DRM_DW_HDMI
	select CEC_CORE
	select CEC_ANALTIFIER
	help
	  Support the CE interface which is part of the Syanalpsys
	  Designware HDMI block.

config DRM_DW_MIPI_DSI
	tristate
	select DRM_KMS_HELPER
	select DRM_MIPI_DSI
	select DRM_PANEL_BRIDGE
```

## drivers/gpu/drm/cirrus/Kconfig
```kconfig
# SPDX-License-Identifier: GPL-2.0-only
config DRM_CIRRUS_QEMU
	tristate "Cirrus driver for QEMU emulated device"
	depends on DRM && PCI && MMU
	select DRM_KMS_HELPER
	select DRM_GEM_SHMEM_HELPER
	help
	 This is a KMS driver for emulated cirrus device in qemu.
	 It is *NOT* intended for real cirrus devices. This requires
	 the modesetting userspace X.org driver.

	 Cirrus is obsolete, the hardware was designed in the 90ies
	 and can't keep up with todays needs.  More background:
	 https://www.kraxel.org/blog/2014/10/qemu-using-cirrus-considered-harmful/

	 Better alternatives are:
	   - stdvga (DRM_BOCHS, qemu -vga std, default in qemu 2.2+)
	   - qxl (DRM_QXL, qemu -vga qxl, works best with spice)
	   - virtio (DRM_VIRTIO_GPU), qemu -vga virtio)
```

## drivers/gpu/drm/clients/Kconfig
```kconfig
# SPDX-License-Identifier: GPL-2.0-only

config DRM_CLIENT_LIB
	tristate
	depends on DRM
	select DRM_KMS_HELPER if DRM_FBDEV_EMULATION
	select FB_CORE if DRM_FBDEV_EMULATION
	help
	  This option enables the DRM client library and selects all
	  modules and components according to the enabled clients.

config DRM_CLIENT_SELECTION
	tristate
	depends on DRM
	select DRM_CLIENT_LIB if DRM_CLIENT_LOG
	select DRM_CLIENT_LIB if DRM_FBDEV_EMULATION
	help
	  Drivers that support in-kernel DRM clients have to select this
	  option.

config DRM_CLIENT_SETUP
	bool
	depends on DRM_CLIENT_SELECTION
	help
	  Enables the DRM client selection. DRM drivers that support the
	  default clients should select DRM_CLIENT_SELECTION instead.

menu "Supported DRM clients"
	depends on DRM_CLIENT_SELECTION

config DRM_FBDEV_EMULATION
	bool "Enable legacy fbdev support for your modesetting driver"
	depends on DRM_CLIENT_SELECTION
	select DRM_CLIENT
	select DRM_CLIENT_SETUP
	select FRAMEBUFFER_CONSOLE_DETECT_PRIMARY if FRAMEBUFFER_CONSOLE
	default FB
	help
	  Choose this option if you have a need for the legacy fbdev
	  support. Note that this support also provides the linux console
	  support on top of your modesetting driver.

	  If in doubt, say "Y".

config DRM_FBDEV_OVERALLOC
	int "Overallocation of the fbdev buffer"
	depends on DRM_FBDEV_EMULATION
	default 100
	help
	  Defines the fbdev buffer overallocation in percent. Default
	  is 100. Typical values for double buffering will be 200,
	  triple buffering 300.

config DRM_FBDEV_LEAK_PHYS_SMEM
	bool "Shamelessly allow leaking of fbdev physical address (DANGEROUS)"
	depends on DRM_FBDEV_EMULATION && EXPERT
	default n
	help
	  In order to keep user-space compatibility, we want in certain
	  use-cases to keep leaking the fbdev physical address to the
	  user-space program handling the fbdev buffer.
	  This affects, not only, Amlogic, Allwinner or Rockchip devices
	  with ARM Mali GPUs using a userspace Blob.
	  This option is not supported by upstream developers and should be
	  removed as soon as possible and be considered as a broken and
	  legacy behaviour from a modern fbdev device driver.

	  Please send any bug reports when using this to your proprietary
	  software vendor that requires this.

	  If in doubt, say "N" or spread the word to your closed source
	  library vendor.

config DRM_CLIENT_LOG
	bool "Print the kernel boot message on the screen"
	depends on DRM_CLIENT_SELECTION
	select DRM_CLIENT
	select DRM_CLIENT_SETUP
	select DRM_DRAW
	help
	  This enable a drm logger, that will print the kernel messages to the
	  screen until the userspace is ready to take over.

	  If you only need logs, but no terminal, or if you prefer userspace
	  terminal, say "Y".

choice
	prompt "Default DRM Client"
	depends on DRM_CLIENT_SELECTION
	depends on DRM_FBDEV_EMULATION || DRM_CLIENT_LOG
	default DRM_CLIENT_DEFAULT_FBDEV
	help
	  Selects the default drm client.

	  The selection made here can be overridden by using the kernel
	  command line 'drm_client_lib.active=fbdev' option.

config DRM_CLIENT_DEFAULT_FBDEV
	bool "fbdev"
	depends on DRM_FBDEV_EMULATION
	help
	  Use fbdev emulation as default drm client. This is needed to have
	  fbcon on top of a drm driver.

config DRM_CLIENT_DEFAULT_LOG
	bool "log"
	depends on DRM_CLIENT_LOG
	help
	  Use drm log as default drm client. This will display boot logs on the
	  screen, but doesn't implement a full terminal. For that you will need
	  a userspace terminal using drm/kms.

endchoice

config DRM_CLIENT_DEFAULT
       string
       depends on DRM_CLIENT
       default "fbdev" if DRM_CLIENT_DEFAULT_FBDEV
       default "log" if DRM_CLIENT_DEFAULT_LOG
       default ""

endmenu
```

## drivers/gpu/drm/display/Kconfig
```kconfig
# SPDX-License-Identifier: MIT

config DRM_DISPLAY_DP_AUX_BUS
	tristate
	depends on DRM
	depends on OF

config DRM_DISPLAY_HELPER
	tristate
	depends on DRM
	select CEC_CORE if DRM_DISPLAY_DP_AUX_CEC || DRM_DISPLAY_HDMI_CEC_HELPER || CEC_NOTIFIER
	help
	  DRM helpers for display adapters.

if DRM_DISPLAY_HELPER

config DRM_BRIDGE_CONNECTOR
	bool
	select DRM_DISPLAY_HDMI_AUDIO_HELPER
	select DRM_DISPLAY_HDMI_CEC_HELPER
	select DRM_DISPLAY_HDMI_STATE_HELPER
	help
	  DRM connector implementation terminating DRM bridge chains.

config DRM_DISPLAY_DP_AUX_CEC
	bool "Enable DisplayPort CEC-Tunneling-over-AUX HDMI support"
	select DRM_DISPLAY_DP_HELPER
	help
	  Choose this option if you want to enable HDMI CEC support for
	  DisplayPort/USB-C to HDMI adapters.

	  Note: not all adapters support this feature, and even for those
	  that do support this they often do not hook up the CEC pin.

config DRM_DISPLAY_DP_AUX_CHARDEV
	bool "DRM DP AUX Interface"
	select DRM_DISPLAY_DP_HELPER
	help
	  Choose this option to enable a /dev/drm_dp_auxN node that allows to
	  read and write values to arbitrary DPCD registers on the DP aux
	  channel.

config DRM_DISPLAY_DP_HELPER
	bool
	help
	  DRM display helpers for DisplayPort.

config DRM_DISPLAY_DP_TUNNEL
	bool
	select DRM_DISPLAY_DP_HELPER
	help
	  Enable support for DisplayPort tunnels. This allows drivers to use
	  DP tunnel features like the Bandwidth Allocation mode to maximize the
	  BW utilization for display streams on Thunderbolt links.

config DRM_DISPLAY_DP_TUNNEL_STATE_DEBUG
	bool "Enable debugging the DP tunnel state"
	depends on REF_TRACKER
	depends on DRM_DISPLAY_DP_TUNNEL
	depends on DEBUG_KERNEL
	depends on EXPERT
	help
	  Enables debugging the DP tunnel manager's state, including the
	  consistency of all managed tunnels' reference counting and the state of
	  streams contained in tunnels.

	  If in doubt, say "N".

config DRM_DISPLAY_DSC_HELPER
	bool
	depends on DRM_DISPLAY_HELPER
	help
	  DRM display helpers for VESA DSC (used by DSI and DisplayPort).

config DRM_DISPLAY_HDCP_HELPER
	bool
	help
	  DRM display helpers for HDCP.

config DRM_DISPLAY_HDMI_AUDIO_HELPER
	bool
	help
	  DRM display helpers for HDMI Audio functionality (generic HDMI Codec
	  implementation).

config DRM_DISPLAY_HDMI_CEC_HELPER
	bool
	help
	  DRM display helpers for HDMI CEC implementation.

config DRM_DISPLAY_HDMI_CEC_NOTIFIER_HELPER
	def_bool CEC_NOTIFIER
	help
	  DRM display helpers for HDMI CEC notifiers implementation.

config DRM_DISPLAY_HDMI_HELPER
	bool
	help
	  DRM display helpers for HDMI.

config DRM_DISPLAY_HDMI_STATE_HELPER
	bool
	select DRM_DISPLAY_HDMI_AUDIO_HELPER
	select DRM_DISPLAY_HDMI_HELPER
	help
	  DRM KMS state helpers for HDMI.

endif # DRM_DISPLAY_HELPER
```

## drivers/gpu/drm/etnaviv/Kconfig
```kconfig
config DRM_ETNAVIV
	tristate "ETNAVIV (DRM support for Vivante GPU IP cores)"
	depends on DRM
	depends on MMU
	select SHMEM
	select SYNC_FILE
	select THERMAL if DRM_ETNAVIV_THERMAL
	select TMPFS
	select WANT_DEV_COREDUMP
	select CMA if HAVE_DMA_CONTIGUOUS
	select DMA_CMA if HAVE_DMA_CONTIGUOUS
	select DRM_SCHED
	help
	  DRM driver for Vivante GPUs.

config DRM_ETNAVIV_THERMAL
	bool "enable ETNAVIV thermal throttling"
	depends on DRM_ETNAVIV
	default y
	help
	  Compile in support for thermal throttling.
	  Say Y unless you want to risk burning your SoC.
```

## drivers/gpu/drm/exynos/Kconfig
```kconfig
# SPDX-License-Identifier: GPL-2.0-only
config DRM_EXYANALS
	tristate "DRM Support for Samsung SoC Exyanals Series"
	depends on OF && DRM && COMMON_CLK
	depends on ARCH_S3C64XX || ARCH_S5PV210 || ARCH_EXYANALS || COMPILE_TEST
	depends on MMU
	select DRM_DISPLAY_HELPER if DRM_EXYANALS_DP
	select DRM_KMS_HELPER
	select VIDEOMODE_HELPERS
	select FB_DMAMEM_HELPERS if DRM_FBDEV_EMULATION
	select SND_SOC_HDMI_CODEC if SND_SOC
	help
	  Choose this option if you have a Samsung SoC Exyanals chipset.
	  If M is selected the module will be called exyanalsdrm.

if DRM_EXYANALS

comment "CRTCs"

config DRM_EXYANALS_FIMD
	bool "FIMD"
	depends on !FB_S3C
	select MFD_SYSCON
	help
	  Choose this option if you want to use Exyanals FIMD for DRM.

config DRM_EXYANALS5433_DECON
	bool "DECON on Exyanals5433"
	help
	  Choose this option if you want to use Exyanals5433 DECON for DRM.

config DRM_EXYANALS7_DECON
	bool "DECON on Exyanals7"
	depends on !FB_S3C
	help
	  Choose this option if you want to use Exyanals DECON for DRM.

config DRM_EXYANALS_MIXER
	bool "Mixer"
	help
	  Choose this option if you want to use Exyanals Mixer for DRM.

config DRM_EXYANALS_VIDI
	bool "Virtual Display"
	help
	  Choose this option if you want to use Exyanals VIDI for DRM.

comment "Encoders and Bridges"

config DRM_EXYANALS_DPI
	bool "Parallel output"
	depends on DRM_EXYANALS_FIMD
	select DRM_PANEL
	default n
	help
	  This enables support for Exyanals parallel output.

config DRM_EXYANALS_DSI
	bool "MIPI-DSI host"
	depends on DRM_EXYANALS_FIMD || DRM_EXYANALS5433_DECON || DRM_EXYANALS7_DECON
	select DRM_MIPI_DSI
	select DRM_PANEL
	select DRM_SAMSUNG_DSIM
	default n
	help
	  This enables support for Exyanals MIPI-DSI device.

config DRM_EXYANALS_DP
	bool "Exyanals specific extensions for Analogix DP driver"
	depends on DRM_EXYANALS_FIMD || DRM_EXYANALS7_DECON
	select DRM_ANALOGIX_DP
	select DRM_DISPLAY_DP_HELPER
	default DRM_EXYANALS
	select DRM_PANEL
	help
	  This enables support for DP device.

config DRM_EXYANALS_HDMI
	bool "HDMI"
	depends on DRM_EXYANALS_MIXER || DRM_EXYANALS5433_DECON
	select CEC_CORE if CEC_ANALTIFIER
	help
	  Choose this option if you want to use Exyanals HDMI for DRM.

config DRM_EXYANALS_MIC
	bool "Mobile Image Compressor"
	depends on DRM_EXYANALS5433_DECON
	help
	  Choose this option if you want to use Exyanals MIC for DRM.

comment "Sub-drivers"

config DRM_EXYANALS_G2D
	bool "G2D"
	depends on VIDEO_SAMSUNG_S5P_G2D=n || COMPILE_TEST
	help
	  Choose this option if you want to use Exyanals G2D for DRM.

config DRM_EXYANALS_IPP
	bool

config DRM_EXYANALS_FIMC
	bool "FIMC"
	select DRM_EXYANALS_IPP
	help
	  Choose this option if you want to use Exyanals FIMC for DRM.

config DRM_EXYANALS_ROTATOR
	bool "Rotator"
	select DRM_EXYANALS_IPP
	help
	  Choose this option if you want to use Exyanals Rotator for DRM.

config DRM_EXYANALS_SCALER
	bool "Scaler"
	select DRM_EXYANALS_IPP
	help
	  Choose this option if you want to use Exyanals Scaler for DRM.

config DRM_EXYANALS_GSC
	bool "GScaler"
	depends on VIDEO_SAMSUNG_EXYANALS_GSC=n || COMPILE_TEST
	select DRM_EXYANALS_IPP
	help
	  Choose this option if you want to use Exyanals GSC for DRM.

endif
```

## drivers/gpu/drm/fsl-dcu/Kconfig
```kconfig
# SPDX-License-Identifier: GPL-2.0-only
config DRM_FSL_DCU
	tristate "DRM Support for Freescale DCU"
	depends on DRM && OF && ARM && COMMON_CLK
	select BACKLIGHT_CLASS_DEVICE
	select DRM_GEM_DMA_HELPER
	select DRM_KMS_HELPER
	select DRM_PANEL
	select REGMAP_MMIO
	select VIDEOMODE_HELPERS
	help
	  Choose this option if you have an Freescale DCU chipset.
	  If M is selected the module will be called fsl-dcu-drm.
```

## drivers/gpu/drm/gm12u320/Kconfig
```kconfig
# SPDX-License-Identifier: GPL-2.0+
config DRM_GM12U320
	tristate "GM12U320 driver for USB projectors"
	depends on DRM && USB
	select DRM_KMS_HELPER
	select DRM_GEM_SHMEM_HELPER
	help
	 This is a KMS driver for projectors which use the GM12U320 chipset
	 for video transfer over USB2/3, such as the Acer C120 mini projector.
```

## drivers/gpu/drm/gma500/Kconfig
```kconfig
# SPDX-License-Identifier: GPL-2.0-only
config DRM_GMA500
	tristate "Intel GMA500/600/3600/3650 KMS Framebuffer"
	depends on DRM && PCI && X86 && HAS_IOPORT
	select DRM_CLIENT_SELECTION
	select DRM_KMS_HELPER
	select FB_IOMEM_HELPERS if DRM_FBDEV_EMULATION
	select I2C
	select I2C_ALGOBIT
	# GMA500 depends on ACPI_VIDEO when ACPI is enabled, just like i915
	select ACPI_VIDEO if ACPI
	select BACKLIGHT_CLASS_DEVICE if ACPI
	select INPUT if ACPI
	select X86_PLATFORM_DEVICES if ACPI
	select ACPI_WMI if ACPI
	help
	  Say yes for an experimental 2D KMS framebuffer driver for the
	  Intel GMA500 (Poulsbo), Intel GMA600 (Moorestown/Oak Trail) and
	  Intel GMA3600/3650 (Cedar Trail).
```
