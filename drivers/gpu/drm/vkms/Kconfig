## drivers/gpu/pvr/Kconfig
```kconfig
config PVR_SGX
	tristate "PowerVR SGX support"
	depends on (ARCH_S5PV210 || SOC_EXYNOS5410)
	default y
	help
	  Enable this option to build support for the PowerVR SGX 3D core.

	  To compile this driver as a module, choose M here:
	  this will generate two modules, called pvrsrvkm and s3c_lcd.

choice
	prompt "PowerVR build type"
	depends on PVR_SGX
	default PVR_BUILD_RELEASE

config PVR_BUILD_RELEASE
	bool "Release"

config PVR_BUILD_DEBUG
	bool "Debug"
endchoice

config PVR_SGX_DVFS
	bool "Enables DVFS for SGX"
	depends on PVR_SGX
	default y
	help
	  This enables DVFS for SGX.

config PVR_SGX_ACTIVE_POWER_MANAGEMENT
	bool "Enables Active Power Management for SGX"
	depends on PVR_SGX
	default y
	help
	  This enables active power management for SGX.
```

## drivers/gpu/rogue/Kconfig
```kconfig
# SPDX-License-Identifier: GPL-2.0
config POWERVR_ROGUE
	tristate "PowerVR Rogue"
	default n
	help
	  Driver for PowerVR Rogue hardware.
	  
	  Say Y here if your SoC contains a PowerVR Rogue GPU. For more
	  information, see <http://www.imgtec.com/powervr/>.
```

## drivers/gpu/rogue_m/Kconfig
```kconfig
# SPDX-License-Identifier: GPL-2.0
config POWERVR_ROGUE_M
	tristate "PowerVR Rogue M"
	select PM_OPP
	default n
	help
	  Driver for PowerVR Rogue hardware.

	  Say Y here if your SoC contains a PowerVR Rogue GPU. For more
	  information, see <http://www.imgtec.com/powervr/>.
```

## drivers/gpu/stub/Kconfig
```kconfig
config STUB_POULSBO
	tristate "Intel GMA500 Stub Driver"
	depends on PCI
	# Poulsbo stub depends on ACPI_VIDEO when ACPI is enabled
	# but for select to work, need to select ACPI_VIDEO's dependencies, ick
	select VIDEO_OUTPUT_CONTROL if ACPI
	select BACKLIGHT_CLASS_DEVICE if ACPI
	select INPUT if ACPI
	select ACPI_VIDEO if ACPI
	help
	  Choose this option if you have a system that has Intel GMA500
	  (Poulsbo) integrated graphics. If M is selected, the module will
	  be called Poulsbo. This driver is a stub driver for Poulsbo that
	  will call poulsbo.ko to enable the acpi backlight control sysfs
	  entry file because there have no poulsbo native driver can support
	  intel opregion.
```

## drivers/gpu/trace/Kconfig
```kconfig
# SPDX-License-Identifier: GPL-2.0-only

config TRACE_GPU_MEM
	bool "Enable GPU memory usage tracepoints"
	default n
	help
	  Choose this option to enable tracepoints for tracking
	  global and per-process GPU memory usage. Intended for
	  performance profiling and required for Android.

	  Tracepoint availability varies by GPU driver.

	  If in doubt, say "N".
```

## drivers/gpu/vga/Kconfig
```kconfig
# SPDX-License-Identifier: GPL-2.0-only
config VGA_SWITCHEROO
	bool "Laptop Hybrid Graphics - GPU switching support"
	depends on X86
	depends on ACPI
	depends on PCI
	depends on (FRAMEBUFFER_CONSOLE=n || FB=y)
	select VGA_ARB
	help
	  Many laptops released in 2008/9/10 have two GPUs with a multiplexer
	  to switch between them. This adds support for dynamic switching when
	  X isn't running and delayed switching until the next logoff. This
	  feature is called hybrid graphics, ATI PowerXpress, and Nvidia
	  HybridPower.
```

## drivers/gpu/vithar/Kconfig
```kconfig
menuconfig VITHAR
	tristate "Enable Vithar DDK"
	default n
	help
	  Choose this option to enable 3D rendering with vithar DDK.

config VITHAR_RT_PM
	bool "Enable Runtime power management"
	depends on VITHAR
	default n
	help
	  Choose this option to enable runtime power management on vithar DDK.

config VITHAR_DVFS
	bool "Enable DVFS"
	depends on VITHAR
	default n
	help
	  Choose this option to enable DVFS on vithar DDK.
```

## drivers/greybus/Kconfig
```kconfig
# SPDX-License-Identifier: GPL-2.0
menuconfig GREYBUS
	tristate "Greybus support"
	depends on SYSFS
	help
	  This option enables the Greybus driver core.  Greybus is a
	  hardware protocol that was designed to provide Unipro with a
	  sane application layer.  It was originally designed for the
	  ARA project, a module phone system, but has shown up in other
	  phones, and can be tunneled over other busses in order to
	  control hardware devices.

	  Say Y here to enable support for these types of drivers.

	  To compile this code as a module, choose M here: the module
	  will be called greybus.ko

if GREYBUS

config GREYBUS_BEAGLEPLAY
	tristate "Greybus BeaglePlay driver"
	depends on SERIAL_DEV_BUS
	select CRC_CCITT
	help
	  Select this option if you have a BeaglePlay where CC1352
	  co-processor acts as Greybus SVC.

	  To compile this code as a module, chose M here: the module
	  will be called gb-beagleplay.ko

config GREYBUS_ES2
	tristate "Greybus ES3 USB host controller"
	depends on USB
	help
	  Select this option if you have a Toshiba ES3 USB device that
	  acts as a Greybus "host controller".  This device is a bridge
	  from a USB device to a Unipro network.

	  To compile this code as a module, choose M here: the module
	  will be called gb-es2.ko

endif	# GREYBUS
```

## drivers/gsensor/Kconfig
```kconfig
#
# I2C gsensor chip drivers configuration
#

menuconfig GSENSOR 
	bool "Gsensor support"

if GSENSOR

config SENSORS_BMA250
	tristate "BMA250 acceleration sensor support"
	depends on I2C
	help
	  If you say yes here you get support for Bosch Sensortec's 
	  acceleration sensors BMA250.

config MEMSIC_ECOMPASS
	tristate "MEMSIC eCompass Driver Support"
	depends on I2C
	help
	  If you say yes here you get support for the MEMSIC eCompass

config SENSORS_MXC622X
	tristate "MEMSIC Accelerometer Sensor MXC622X Driver Support"
	depends on I2C && MEMSIC_ECOMPASS
	help
	  If you say yes here you get support for the MEMSIC accelerometer sensor


###### not supported yet ######
if 0
config SENSORS_MXC6202X
	tristate "MEMSIC Accelerometer Sensor MXC6202X Driver Support"
	depends on I2C
	help
	  If you say yes here you get support for the MEMSIC accelerometer sensor

config SENSORS_MMC31XX
	tristate "MEMSIC Magnetic Sensor MMC31XX Driver Support"
	depends on I2C
	help
	  If you say yes here you get support for the MEMSIC magnateic sensor
endif
###### not supported yet ########


endif
```

## drivers/gud/Kconfig
```kconfig
#
# MobiCore configuration
#
config MOBICORE_SUPPORT
	tristate "Linux MobiCore Support"
	depends on ARM_TRUSTZONE
	---help---
	  Enable Linux Kernel MobiCore Support

config MOBICORE_DEBUG
    bool "MobiCore Module debug mode"
    depends on MOBICORE_SUPPORT
    ---help---
      Enable Debug mode in the MobiCore Driver.
      It enables printing information about mobicore operations

config MOBICORE_VERBOSE
    bool "MobiCore Module verbose debug mode"
    depends on MOBICORE_DEBUG
    ---help---
      Enable Verbose Debug mode in the MobiCore Driver.
      It enables printing extra information about mobicore operations
      Beware: this is only useful for debuging deep in the driver because
      it prints too much logs


config MOBICORE_API
    tristate "Linux MobiCore API"
    depends on MOBICORE_SUPPORT
    ---help---
      Enable Linux Kernel MobiCore API
```

## drivers/hardkernel/Kconfig
```kconfig
menu "ODROID Specific Hardware"

config ODROID_TOUCHSCREEN_ADS7846
	tristate "ADS7846/TSC2046/AD7873 and AD(S)7843 based touchscreens"
	depends on SPI_MASTER
	depends on HWMON = n || HWMON
	default n
	help
	  Say Y here if you have a touchscreen interface using the
	  ADS7846/TSC2046/AD7873 or ADS7843/AD7843 controller,
	  and your board-specific setup code includes that in its
	  table of SPI devices.

	  If HWMON is selected, and the driver is told the reference voltage
	  on your board, you will also get hwmon interfaces for the voltage
	  (and on ads7846/tsc2046/ad7873, temperature) sensors of this chip.

	  If unsure, say N (but it's safe to say "Y").

	  To compile this driver as a module, choose M here: the
	  module will be called ads7846.

config ODROID_AML_GPIO_LIB
	tristate "GPIO-LIB Driver for AMLogic GPIO IRQ "
	default n
	depends on GPIO_AMLOGIC
	help
	    GPIO-LIB for AMLogic GPIO IRQ
	    sysfs location is /sys/class/aml_gpio/...

if ODROID_AML_GPIO_LIB = y

config ALLOC_CPU_FOR_IRQ
    int "Alloction CPU for AMLogic GPIO IRQ"
    default 3
    help
        Allocation CPU for IRQ(0..3)
        Default alloction is CPU(3)

endif

endmenu
```
