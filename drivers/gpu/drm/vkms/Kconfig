## drivers/gpu/drm/vkms/Kconfig
```kconfig
# SPDX-License-Identifier: GPL-2.0-only

config DRM_VKMS
	tristate "Virtual KMS (EXPERIMENTAL)"
	depends on DRM && MMU
	select DRM_CLIENT_SELECTION
	select DRM_KMS_HELPER
	select DRM_GEM_SHMEM_HELPER
	select CRC32
	default n
	help
	  Virtual Kernel Mode-Setting (VKMS) is used for testing or for
	  running GPU in a headless machines. Choose this option to get
	  a VKMS.

	  If M is selected the module will be called vkms.

config DRM_VKMS_KUNIT_TEST
	tristate "KUnit tests for VKMS" if !KUNIT_ALL_TESTS
	depends on DRM_VKMS && KUNIT
	default KUNIT_ALL_TESTS
	help
	  This builds unit tests for VKMS. This option is not useful for
	  distributions or general kernels, but only for kernel
	  developers working on VKMS.

	  For more information on KUnit and unit tests in general,
	  please refer to the KUnit documentation in
	  Documentation/dev-tools/kunit/.

	  If in doubt, say "N".
```

## drivers/gpu/drm/vmwgfx/Kconfig
```kconfig
# SPDX-License-Identifier: GPL-2.0
config DRM_VMWGFX
	tristate "DRM driver for VMware Virtual GPU"
	depends on DRM && PCI && MMU
	depends on X86 || ARM64
	select DRM_TTM
	select DRM_TTM_HELPER
	select MAPPING_DIRTY_HELPERS
	# Only needed for the transitional use of drm_crtc_init - can be removed
	# again once vmwgfx sets up the primary plane itself.
	select DRM_KMS_HELPER
	help
	  Choose this option if you would like to run 3D acceleration
	  in a VMware virtual machine.
	  This is a KMS enabled DRM driver for the VMware SVGA2
	  virtual hardware.
	  The compiled module will be called "vmwgfx.ko".

config DRM_VMWGFX_MKSSTATS
	bool "Enable mksGuestStats instrumentation of vmwgfx by default"
	depends on DRM_VMWGFX
	depends on X86
	default n
	help
	   Choose this option to instrument the kernel driver for mksGuestStats.
```

## drivers/gpu/drm/xe/Kconfig
```kconfig
# SPDX-License-Identifier: GPL-2.0-only
config DRM_XE
	tristate "Intel Xe2 Graphics"
	depends on DRM && PCI
	depends on KUNIT || !KUNIT
	depends on INTEL_VSEC || !INTEL_VSEC
	depends on X86_PLATFORM_DEVICES || !(X86 && ACPI)
	depends on PAGE_SIZE_4KB || COMPILE_TEST || BROKEN
	select INTERVAL_TREE
	# we need shmfs for the swappable backing store, and in particular
	# the shmem_readpage() which depends upon tmpfs
	select SHMEM
	select TMPFS
	select DRM_BUDDY
	select DRM_CLIENT_SELECTION
	select DRM_KMS_HELPER
	select DRM_KUNIT_TEST_HELPERS if DRM_XE_KUNIT_TEST != n
	select DRM_PANEL
	select DRM_SUBALLOC_HELPER
	select DRM_DISPLAY_DP_HELPER
	select DRM_DISPLAY_DSC_HELPER
	select DRM_DISPLAY_HDCP_HELPER
	select DRM_DISPLAY_HDMI_HELPER
	select DRM_DISPLAY_HELPER
	select DRM_MIPI_DSI
	select RELAY
	select IRQ_WORK
	# xe depends on ACPI_VIDEO when ACPI is enabled
	# but for select to work, need to select ACPI_VIDEO's dependencies, ick
	select BACKLIGHT_CLASS_DEVICE if ACPI
	select INPUT if ACPI
	select ACPI_VIDEO if X86 && ACPI
	select ACPI_WMI if X86 && ACPI
	select SYNC_FILE
	select CRC32
	select SND_HDA_I915 if SND_HDA_CORE
	select CEC_CORE if CEC_NOTIFIER
	select VMAP_PFN
	select DRM_TTM
	select DRM_TTM_HELPER
	select DRM_EXEC
	select DRM_GPUSVM if !UML && DEVICE_PRIVATE
	select DRM_GPUVM
	select DRM_SCHED
	select MMU_NOTIFIER
	select WANT_DEV_COREDUMP
	select AUXILIARY_BUS
	select REGMAP if I2C
	help
	  Driver for Intel Xe2 series GPUs and later. Experimental support
	  for Xe series is also available.

	  If "M" is selected, the module will be called xe.

config DRM_XE_DISPLAY
	bool "Enable display support"
	depends on DRM_XE && DRM_XE=m && HAS_IOPORT
	select FB_IOMEM_HELPERS if DRM_FBDEV_EMULATION
	select I2C
	select I2C_ALGOBIT
	default y
	help
	  Disable this option only if you want to compile out display support.

config DRM_XE_DP_TUNNEL
	bool "Enable DP tunnel support"
	depends on DRM_XE_DISPLAY
	depends on USB4
	select DRM_DISPLAY_DP_TUNNEL
	default y
	help
	  Choose this option to detect DP tunnels and enable the Bandwidth
	  Allocation mode for such tunnels. This allows using the maximum
	  resolution allowed by the link BW on all displays sharing the
	  link BW, for instance on a Thunderbolt link.

	  If in doubt say "Y".

config DRM_XE_GPUSVM
	bool "Enable CPU to GPU address mirroring"
	depends on DRM_XE
	depends on !UML
	depends on DEVICE_PRIVATE
	default y
	select DRM_GPUSVM
	help
	  Enable this option if you want support for CPU to GPU address
	  mirroring.

	  If in doubt say "Y".

config DRM_XE_PAGEMAP
	bool "Enable device memory pool for SVM"
	depends on DRM_XE_GPUSVM
	select GET_FREE_REGION
	default y
	help
	  Disable this option only if you don't want to expose local device
	  memory for SVM. Will reduce KMD memory footprint when disabled.

	  If in doubt say "Y".

config DRM_XE_FORCE_PROBE
	string "Force probe xe for selected Intel hardware IDs"
	depends on DRM_XE
	help
	  This is the default value for the xe.force_probe module
	  parameter. Using the module parameter overrides this option.

	  Force probe the xe for Intel graphics devices that are
	  recognized but not properly supported by this kernel version. It is
	  recommended to upgrade to a kernel version with proper support as soon
	  as it is available.

	  It can also be used to block the probe of recognized and fully
	  supported devices.

	  Use "" to disable force probe. If in doubt, use this.

	  Use "<pci-id>[,<pci-id>,...]" to force probe the xe for listed
	  devices. For example, "4500" or "4500,4571".

	  Use "*" to force probe the driver for all known devices.

	  Use "!" right before the ID to block the probe of the device. For
	  example, "4500,!4571" forces the probe of 4500 and blocks the probe of
	  4571.

	  Use "!*" to block the probe of the driver for all known devices.

menu "drm/Xe Debugging"
depends on DRM_XE
depends on EXPERT
source "drivers/gpu/drm/xe/Kconfig.debug"
endmenu

menu "drm/xe Profile Guided Optimisation"
	visible if EXPERT
	depends on DRM_XE
	source "drivers/gpu/drm/xe/Kconfig.profile"
endmenu
```

## drivers/gpu/drm/xe/Kconfig.debug
```kconfig
# SPDX-License-Identifier: GPL-2.0-only
config DRM_XE_WERROR
	bool "Force GCC to throw an error instead of a warning when compiling"
	# As this may inadvertently break the build, only allow the user
	# to shoot oneself in the foot iff they aim really hard
	depends on EXPERT
	# We use the dependency on !COMPILE_TEST to not be enabled in
	# allmodconfig or allyesconfig configurations
	depends on !COMPILE_TEST
	default n
	help
	  Add -Werror to the build flags for (and only for) xe.ko.
	  Do not enable this unless you are writing code for the xe.ko module.

	  Recommended for driver developers only.

	  If in doubt, say "N".

config DRM_XE_DEBUG
	bool "Enable additional driver debugging"
	depends on DRM_XE
	depends on EXPERT
	depends on !COMPILE_TEST
	default n
	help
	  Choose this option to turn on extra driver debugging that may affect
	  performance but will catch some internal issues.

	  Recommended for driver developers only.

	  If in doubt, say "N".

config DRM_XE_DEBUG_VM
	bool "Enable extra VM debugging info"
	default n
	help
	  Enable extra VM debugging info

	  Recommended for driver developers only.

	  If in doubt, say "N".

config DRM_XE_DEBUG_MEMIRQ
	bool "Enable extra memirq debugging"
	default n
	help
	  Choose this option to enable additional debugging info for
	  memory based interrupts.

	  Recommended for driver developers only.

	  If in doubt, say "N".

config DRM_XE_DEBUG_SRIOV
	bool "Enable extra SR-IOV debugging"
	default n
	select DRM_XE_DEBUG_MEMIRQ
	help
	  Enable extra SR-IOV debugging info.

	  Recommended for driver developers only.

	  If in doubt, say "N".

config DRM_XE_DEBUG_MEM
	bool "Enable passing SYS/VRAM addresses to user space"
	default n
	help
	  Pass object location trough uapi. Intended for extended
	  testing and development only.

	  Recommended for driver developers only.

	  If in doubt, say "N".

config DRM_XE_KUNIT_TEST
        tristate "KUnit tests for the drm xe driver" if !KUNIT_ALL_TESTS
	depends on DRM_XE && KUNIT && DEBUG_FS
	default KUNIT_ALL_TESTS
	select DRM_EXPORT_FOR_TESTS if m
	help
	  Choose this option to allow the driver to perform selftests under
	  the kunit framework

	  Recommended for driver developers only.

	  If in doubt, say "N".

config DRM_XE_LARGE_GUC_BUFFER
        bool "Enable larger guc log buffer"
        default n
        help
          Choose this option when debugging guc issues.
          Buffer should be large enough for complex issues.

          Recommended for driver developers only.

          If in doubt, say "N".

config DRM_XE_USERPTR_INVAL_INJECT
       bool "Inject userptr invalidation -EINVAL errors"
       default n
       help
         Choose this option when debugging error paths that
	 are hit during checks for userptr invalidations.

	 Recomended for driver developers only.
	 If in doubt, say "N".
```

## drivers/gpu/drm/xen/Kconfig
```kconfig
# SPDX-License-Identifier: GPL-2.0-only
config DRM_XEN
	bool

config DRM_XEN_FRONTEND
	tristate "Para-virtualized frontend driver for Xen guest OS"
	depends on XEN && DRM
	select DRM_XEN
	select DRM_KMS_HELPER
	select VIDEOMODE_HELPERS
	select XEN_XENBUS_FRONTEND
	select XEN_FRONT_PGDIR_SHBUF
	help
	  Choose this option if you want to enable a para-virtualized
	  frontend DRM/KMS driver for Xen guest OSes.
```

## drivers/gpu/drm/xlnx/Kconfig
```kconfig
config DRM_ZYNQMP_DPSUB
	tristate "ZynqMP DisplayPort Controller Driver"
	depends on ARCH_ZYNQMP || COMPILE_TEST
	depends on COMMON_CLK && DRM && OF
	depends on DMADEVICES
	depends on PHY_XILINX_ZYNQMP
	depends on XILINX_ZYNQMP_DPDMA
	select DMA_ENGINE
	select DRM_CLIENT_SELECTION
	select DRM_DISPLAY_DP_HELPER
	select DRM_DISPLAY_HELPER
	select DRM_BRIDGE_CONNECTOR
	select DRM_GEM_DMA_HELPER
	select DRM_KMS_HELPER
	select GENERIC_PHY
	help
	  This is a DRM/KMS driver for ZynqMP DisplayPort controller. Choose
	  this option if you have a Xilinx ZynqMP SoC with DisplayPort
	  subsystem.

config DRM_ZYNQMP_DPSUB_AUDIO
	bool "ZynqMP DisplayPort Audio Support"
	depends on DRM_ZYNQMP_DPSUB
	depends on SND && SND_SOC
	depends on SND_SOC=y || DRM_ZYNQMP_DPSUB=m
	select SND_SOC_GENERIC_DMAENGINE_PCM
	help
	  Choose this option to enable DisplayPort audio support in the ZynqMP
	  DisplayPort driver.
```

## drivers/gpu/drm/zte/Kconfig
```kconfig
config DRM_ZTE
	tristate "DRM Support for ZTE SoCs"
	depends on DRM && ARCH_ZX
	select DRM_KMS_CMA_HELPER
	select DRM_KMS_FB_HELPER
	select DRM_KMS_HELPER
	help
	  Choose this option to enable DRM on ZTE ZX SoCs.
```

## drivers/gpu/host1x/Kconfig
```kconfig
config TEGRA_HOST1X
	tristate "NVIDIA Tegra host1x driver"
	depends on ARCH_TEGRA || (ARM && COMPILE_TEST)
	help
	  Driver for the NVIDIA Tegra host1x hardware.

	  The Tegra host1x module is the DMA engine for register access to
	  Tegra's graphics- and multimedia-related modules. The modules served
	  by host1x are referred to as clients. host1x includes some other
	  functionality, such as synchronization.

if TEGRA_HOST1X

config TEGRA_HOST1X_FIREWALL
	bool "Enable HOST1X security firewall"
	default y
	help
	  Say yes if kernel should protect command streams from tampering.

	  If unsure, choose Y.

endif
```

## drivers/gpu/host1x/drm/Kconfig
```kconfig
config DRM_TEGRA
	bool "NVIDIA Tegra DRM"
	depends on DRM
	select DRM_KMS_HELPER
	select DRM_KMS_FB_HELPER
	select FB_SYS_FILLRECT
	select FB_SYS_COPYAREA
	select FB_SYS_IMAGEBLIT
	help
	  Choose this option if you have an NVIDIA Tegra SoC.

	  To compile this driver as a module, choose M here: the module
	  will be called tegra-drm.

if DRM_TEGRA

config DRM_TEGRA_STAGING
	bool "Enable HOST1X interface"
	depends on STAGING
	help
	  Say yes if HOST1X should be available for userspace DRM users.

	  If unsure, choose N.

config DRM_TEGRA_DEBUG
	bool "NVIDIA Tegra DRM debug support"
	help
	  Say yes here to enable debugging support.

endif
```

## drivers/gpu/ion/Kconfig
```kconfig
menuconfig ION
	tristate "Ion Memory Manager"
	select GENERIC_ALLOCATOR
	select DMA_SHARED_BUFFER
	help
	  Chose this option to enable the ION Memory Manager.

config ION_TEGRA
	tristate "Ion for Tegra"
	depends on ARCH_TEGRA && ION
	help
	  Choose this option if you wish to use ion on an nVidia Tegra.

config ION_EXYNOS
	tristate "Ion for Exynos"
	depends on ARCH_EXYNOS && ION
	select CMA
	help
	  Choose this option if you wish to use ion on a Samsung Exynos.

config ION_EXYNOS_CONTIGHEAP_SIZE
	int "Size in Kilobytes of memory pool of EXYNOS_CONTIG_HEAP"
	depends on ION_EXYNOS && CMA
	default 45056

config ION_EXYNOS_DRM_MFC_SH
	bool "ION Heap for drm mfc sh"
	depends on EXYNOS_CONTENT_PATH_PROTECTION
	default y

config ION_EXYNOS_DRM_MSGBOX_SH
	bool "ION Heap for drm msgbox sh"
	depends on EXYNOS_CONTENT_PATH_PROTECTION
	default y

config ION_EXYNOS_DRM_MFC_FW
	bool "ION Heap for drm fw"
	depends on EXYNOS_CONTENT_PATH_PROTECTION
	default y

config ION_EXYNOS_DRM_SECTBL
	bool "ION Heap for drm sectbl"
	depends on EXYNOS_CONTENT_PATH_PROTECTION
	default y

config ION_EXYNOS_DRM_MEMSIZE_FIMD_VIDEO
	int "Reserved memsize in kilobytes for FIMD VIDEO"
	depends on EXYNOS_CONTENT_PATH_PROTECTION
	default 98304

config ION_EXYNOS_DRM_MEMSIZE_MFC_OUTPUT
	int "Reserved memsize in kilobytes for MFC OUTPUT"
	depends on EXYNOS_CONTENT_PATH_PROTECTION
	default 60416

config ION_EXYNOS_DRM_MEMSIZE_MFC_INPUT
	int "Reserved memsize in kilobytes for MFC INPUT"
	depends on EXYNOS_CONTENT_PATH_PROTECTION
	default 16384

config ION_EXYNOS_DRM_MEMSIZE_G2D_WFD
	int "Reserved memsize in kilobytes for G2D WFD"
	depends on EXYNOS_CONTENT_PATH_PROTECTION
	default 12288
```

## drivers/gpu/ipu-v3/Kconfig
```kconfig
# SPDX-License-Identifier: GPL-2.0-only
config IMX_IPUV3_CORE
	tristate "IPUv3 core support"
	depends on SOC_IMX5 || SOC_IMX6Q || COMPILE_TEST
	depends on DRM || !DRM # if DRM=m, this can't be 'y'
	select BITREVERSE
	select GENERIC_ALLOCATOR if DRM
	select GENERIC_IRQ_CHIP
	help
	  Choose this if you have a i.MX5/6 system and want to use the Image
	  Processing Unit. This option only enables IPU base support.
```

## drivers/gpu/mali/Kconfig
```kconfig
config MALI
	tristate "ARM Mali GPU modules"
	depends on ARM && m
        select UMP
        select MALI400
	default n
	help
	  This enables the generation of mali.ko and ump.ko.

source "drivers/gpu/mali/mali/Kconfig"
source "drivers/gpu/mali/ump/Kconfig"
```

## drivers/gpu/mali/mali/Kconfig
```kconfig
config MALI400
	tristate "Mali-300/400/450 support"
	depends on ARM
	select FB
	---help---
	  This enables support for the Mali-300, Mali-400, and Mali-450 GPUs.

	  To compile this driver as a module, choose M here: the module will be
	  called mali.

config MALI400_DEBUG
	bool "Enable debug in Mali driver"
	depends on MALI400
	---help---
	  This enabled extra debug checks and messages in the Mali-300/400/450
	  driver.

config MALI400_PROFILING
	bool "Enable Mali profiling"
	depends on MALI400 && TRACEPOINTS
	---help---
	  This enables gator profiling of Mali GPU events.

config MALI400_GPU_UTILIZATION
	bool "Enable Mali GPU utilization tracking"
	depends on MALI400
	---help---
	  This enables gathering and processing of the utilization of Mali GPU.
	  This data can be used as a basis to change GPU operating frequency.
```

## drivers/gpu/mali/ump/Kconfig
```kconfig
config UMP
	tristate "UMP support"
	depends on ARM && MALI400
	---help---
	  This enables support for the UMP memory allocation and sharing API.

	  To compile this driver as a module, choose M here: the module will be
	  called ump.

config UMP_DEBUG
	bool "Enable extra debug in UMP"
	depends on UMP
	default y
	---help---
	  This enabled extra debug checks and messages in UMP.
```
