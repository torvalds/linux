## drivers/video/tegra/Kconfig
```kconfig
if ARCH_TEGRA

comment "NVIDIA Tegra Display Driver options"

config TEGRA_GRHOST
	tristate "Tegra graphics host driver"
	depends on TEGRA_IOVMM
        default n
	help
	  Driver for the Tegra graphics host hardware.

config TEGRA_DC
	tristate "Tegra Display Contoller"
	depends on ARCH_TEGRA
	select FB_MODE_HELPERS
	select I2C
	help
	  Tegra display controller support.

config FB_TEGRA
	tristate "Tegra Framebuffer driver"
	depends on TEGRA_DC && FB = y
	select FB_CFB_FILLRECT
	select FB_CFB_COPYAREA
	select FB_CFB_IMAGEBLIT
	default FB
	help
	  Framebuffer device support for the Tegra display controller.

config TEGRA_NVMAP
	bool "Tegra GPU memory management driver (nvmap)"
	default y
	help
	  Say Y here to include the memory management driver for the Tegra
	  GPU, multimedia and display subsystems

config NVMAP_RECLAIM_UNPINNED_VM
	bool "Virtualize IOVMM memory in nvmap"
	depends on TEGRA_NVMAP && TEGRA_IOVMM
	default y
	help
	  Say Y here to enable nvmap to reclaim I/O virtual memory after
	  it has been unpinned, and re-use it for other handles. This can
	  allow a larger virtual I/O VM space than would normally be
	  supported by the hardware, at a slight cost in performance.

config NVMAP_ALLOW_SYSMEM
	bool "Allow physical system memory to be used by nvmap"
	depends on TEGRA_NVMAP
	default y
	help
	  Say Y here to allow nvmap to use physical system memory (i.e.,
	  shared with the operating system but not translated through
	  an IOVMM device) for allocations.

config NVMAP_HIGHMEM_ONLY
	bool "Use only HIGHMEM for nvmap"
	depends on TEGRA_NVMAP && (NVMAP_ALLOW_SYSMEM || TEGRA_IOVMM) && HIGHMEM
	default n
	help
	  Say Y here to restrict nvmap system memory allocations (both
	  physical system memory and IOVMM) to just HIGHMEM pages.

config NVMAP_CARVEOUT_KILLER
	bool "Reclaim nvmap carveout by killing processes"
	depends on TEGRA_NVMAP
	default n
	help
	  Say Y here to allow the system to reclaim carveout space by killing
	  processes. This will kill the largest consumers of lowest priority
	  first.

endif
```

## drivers/virt/Kconfig
```kconfig
# SPDX-License-Identifier: GPL-2.0-only
#
# Virtualization support drivers
#

menuconfig VIRT_DRIVERS
	bool "Virtualization drivers"
	help
	  Say Y here to get to see options for device drivers that support
	  virtualization environments.

	  If you say N, all options in this submenu will be skipped and disabled.

if VIRT_DRIVERS

config VMGENID
	tristate "Virtual Machine Generation ID driver"
	default y
	depends on ACPI
	help
	  Say Y here to use the hypervisor-provided Virtual Machine Generation ID
	  to reseed the RNG when the VM is cloned. This is highly recommended if
	  you intend to do any rollback / cloning / snapshotting of VMs.

	  Prefer Y to M so that this protection is activated very early.

config FSL_HV_MANAGER
	tristate "Freescale hypervisor management driver"
	depends on FSL_SOC
	select EPAPR_PARAVIRT
	help
          The Freescale hypervisor management driver provides several services
	  to drivers and applications related to the Freescale hypervisor:

          1) An ioctl interface for querying and managing partitions.

          2) A file interface to reading incoming doorbells.

          3) An interrupt handler for shutting down the partition upon
	     receiving the shutdown doorbell from a manager partition.

          4) A kernel interface for receiving callbacks when a managed
	     partition shuts down.

source "drivers/virt/vboxguest/Kconfig"

source "drivers/virt/nitro_enclaves/Kconfig"

source "drivers/virt/acrn/Kconfig"

source "drivers/virt/coco/efi_secret/Kconfig"

source "drivers/virt/coco/sev-guest/Kconfig"

source "drivers/virt/gunyah/Kconfig"

endif
```

## drivers/virt/acrn/Kconfig
```kconfig
# SPDX-License-Identifier: GPL-2.0
config ACRN_HSM
	tristate "ACRN Hypervisor Service Module"
	depends on ACRN_GUEST
	select EVENTFD
	help
	  ACRN Hypervisor Service Module (HSM) is a kernel module which
	  communicates with ACRN userspace through ioctls and talks to
	  the ACRN Hypervisor through hypercalls. HSM will only run in
	  a privileged management VM, called Service VM, to manage User
	  VMs and do I/O emulation. Not required for simply running
	  under ACRN as a User VM.

	  To compile as a module, choose M, the module will be called
	  acrn. If unsure, say N.
```

## drivers/virt/coco/Kconfig
```kconfig
# SPDX-License-Identifier: GPL-2.0-only
#
# Confidential computing related collateral
#

source "drivers/virt/coco/efi_secret/Kconfig"

source "drivers/virt/coco/pkvm-guest/Kconfig"

source "drivers/virt/coco/sev-guest/Kconfig"

source "drivers/virt/coco/tdx-guest/Kconfig"

source "drivers/virt/coco/arm-cca-guest/Kconfig"

source "drivers/virt/coco/guest/Kconfig"
```

## drivers/virt/coco/efi_secret/Kconfig
```kconfig
# SPDX-License-Identifier: GPL-2.0-only
config EFI_SECRET
	tristate "EFI secret area securityfs support"
	depends on EFI && (X86_64 || ARM64)
	select EFI_COCO_SECRET
	select SECURITYFS
	help
	  This is a driver for accessing the EFI secret area via securityfs.
	  The EFI secret area is a memory area designated by the firmware for
	  confidential computing secret injection (for example for AMD SEV
	  guests).  The driver exposes the secrets as files in
	  <securityfs>/secrets/coco.  Files can be read and deleted (deleting
	  a file wipes the secret from memory).

	  To compile this driver as a module, choose M here.
	  The module will be called efi_secret.
```

## drivers/virt/coco/guest/Kconfig
```kconfig
# SPDX-License-Identifier: GPL-2.0-only
#
# Confidential computing shared guest collateral
#
config TSM_GUEST
	bool

config TSM_REPORTS
	select TSM_GUEST
	select CONFIGFS_FS
	tristate

config TSM_MEASUREMENTS
	select TSM_GUEST
	select CRYPTO_HASH_INFO
	select CRYPTO
	bool
```

## drivers/virt/coco/pkvm-guest/Kconfig
```kconfig
config ARM_PKVM_GUEST
	bool "Arm pKVM protected guest driver"
	depends on ARM64 && DMA_RESTRICTED_POOL
	help
	  Protected guests running under the pKVM hypervisor on arm64
	  are isolated from the host and must issue hypercalls to enable
	  interaction with virtual devices. This driver implements
	  support for probing and issuing these hypercalls.

	  If unsure, say 'N'.
```

## drivers/virt/coco/sev-guest/Kconfig
```kconfig
config SEV_GUEST
	tristate "AMD SEV Guest driver"
	default m
	depends on AMD_MEM_ENCRYPT
	select CRYPTO
	select CRYPTO_AEAD2
	select CRYPTO_GCM
	select TSM_REPORTS
	help
	  SEV-SNP firmware provides the guest a mechanism to communicate with
	  the PSP without risk from a malicious hypervisor who wishes to read,
	  alter, drop or replay the messages sent. The driver provides
	  userspace interface to communicate with the PSP to request the
	  attestation report and more.

	  If you choose 'M' here, this module will be called sev-guest.
```

## drivers/virt/coco/tdx-guest/Kconfig
```kconfig
config TDX_GUEST_DRIVER
	tristate "TDX Guest driver"
	depends on INTEL_TDX_GUEST
	select TSM_REPORTS
	select TSM_MEASUREMENTS
	help
	  The driver provides userspace interface to communicate with
	  the TDX module to request the TDX guest details like attestation
	  report.

	  To compile this driver as module, choose M here. The module will
	  be called tdx-guest.
```

## drivers/virt/coco/tdx-host/Kconfig
```kconfig
config TDX_HOST_SERVICES
	tristate
	depends on INTEL_TDX_HOST
	select FW_LOADER
	select FW_UPLOAD
	default m
```
