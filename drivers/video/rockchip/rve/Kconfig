## drivers/video/rockchip/rve/Kconfig
```kconfig
# SPDX-License-Identifier: GPL-2.0
menuconfig ROCKCHIP_RVE
	tristate "RVE"
	depends on ARCH_ROCKCHIP
	help
	  RVE module.

if ROCKCHIP_RVE

config ROCKCHIP_RVE_PROC_FS
	bool "Enable RVE procfs"
	select ROCKCHIP_RVE_DEBUGGER
	depends on PROC_FS
	help
	  Enable procfs to debug RVE driver.

config ROCKCHIP_RVE_DEBUG_FS
	bool "Enable RVE debugfs"
	select ROCKCHIP_RVE_DEBUGGER
	depends on DEBUG_FS
	help
	  Enable debugfs to debug RVE driver.

config ROCKCHIP_RVE_DEBUGGER
	bool
	help
	  Enabling the debugger of RVE, you can use procfs and debugfs for debugging.

endif
```

## drivers/video/rockchip/screen/Kconfig
```kconfig
# SPDX-License-Identifier: GPL-2.0
choice
	depends on FB_ROCKCHIP || DRM_ROCKCHIP
	prompt  "LCD Panel Select"

config LCD_GENERAL
	bool "General lcd panel"
	help 
	  select if the panel do not need initialization
config LCD_MIPI
	bool "rk mipi dsi lcd"	
endchoice
```

## drivers/video/rockchip/transmitter/Kconfig
```kconfig
menuconfig RK_TRSM
	bool "RockChip display transmitter support"
	depends on FB_ROCKCHIP || DRM_ROCKCHIP

config RK2928_LVDS
	bool "RK2928/RK2926 lvds transmitter support"
        depends on ARCH_RK2928 && RK_TRSM

config RK3026_LVDS
	depends on ARCH_RK3026 && RK_TRSM
	bool "RK3026/RK3028A lvds transmitter support"
	default y	

config RK32_LVDS
	bool "RK32 lvds transmitter support"
	depends on RK_TRSM

config RK31XX_LVDS
	bool "RK312x/RK3190/3368 lvds transmitter support"
	depends on RK_TRSM
	help
		If use LVDS or RGB output interface,selete this module.

config RK610_LVDS
	bool "RK610(Jetta) lvds transmitter support"
	depends on MFD_RK610 && RK_TRSM 
	help
		Support Jetta(RK610) to output LCD1 and LVDS.

config RK616_LVDS
        bool "RK616(JettaB) lvds,lcd,scaler vido interface support"
        depends on MFD_RK616 && RK_TRSM
        help
           RK616(Jetta B) LVDS,LCD,scaler transmitter support.
		

config DP_ANX6345
	bool "RGB to DisplayPort transmitter anx6345,anx9804,anx9805 support"
	depends on RK_TRSM

config DP501
	bool"RGB to DisplayPort transmitter dp501 support"
	depends on RK_TRSM

config RK32_DP
	bool "RK32 RGB to DisplayPort transmitter support "
	depends on RK_TRSM

config RK_VGA
         bool "VGA support on RockChip platform"
         depends on RK_TRSM
         default y
         help
           say y here will enable VGA on RockChip platform

config MIPI_DSI
	depends on RK_TRSM
	bool "Rockchip MIPI DSI support"

config TC358768_RGB2MIPI
        tristate "toshiba TC358768 RGB to MIPI DSI"
	depends on MIPI_DSI
        help
        "a chip that change RGB interface parallel signal into DSI serial signal"

config SSD2828_RGB2MIPI
        tristate "solomon SSD2828 RGB to MIPI DSI"
		depends on MIPI_DSI
        help
        "a chip that change RGB interface parallel signal into DSI serial signal"

config RK32_MIPI_DSI
        tristate "rk32 mipi dsi support"
        depends on MIPI_DSI
        help
           Rockchip mipi dsi support.		

			
config RK616_MIPI_DSI_RST
	bool "Reset the rockchip mipi dsi"
	depends on MFD_RK616 && RK616_MIPI_DSI && RK616_USE_MCLK_12M
	default y
	help
	 if you say y here: inset the hdmi, mipi lcd will be reset. 
```

## drivers/video/rockchip/tve/Kconfig
```kconfig
# SPDX-License-Identifier: GPL-2.0
#
# TV Encoder drivers configuration
#

menuconfig RK_TVENCODER
	bool "Rockchip TV Encoder support"
   	depends on FB_ROCKCHIP
	help
		Support RockChip TV Encoder if you say y here.

source "drivers/video/rockchip/tve/rk1000/Kconfig"
source "drivers/video/rockchip/tve/rk3036/Kconfig"
source "drivers/video/rockchip/tve/rk610/Kconfig"
source "drivers/video/rockchip/tve/gm7122/Kconfig"
```

## drivers/video/rockchip/tve/gm7122/Kconfig
```kconfig
# SPDX-License-Identifier: GPL-2.0
config GM7122_TV_ENCODER
	bool "gm7122 tv encoder support"
	depends on RK_TVENCODER
	default n
	help
		Support GM7122 output CVBS.
```

## drivers/video/rockchip/tve/rk1000/Kconfig
```kconfig
# SPDX-License-Identifier: GPL-2.0
#
# TV Encoder RK1000 drivers configuration
#

config RK1000_TVOUT
	bool "RK1000 TV Encoder support"
	depends on RK_TVENCODER
	select MFD_RK1000
	help
		Support rk1000 to output YPbPr and CVBS.
		
config RK1000_TVOUT_YPbPr
	bool "Support YPbPr Output"
	depends on RK1000_TVOUT
config RK1000_TVOUT_CVBS
	bool "Support CVBS Output"
	depends on RK1000_TVOUT
```

## drivers/video/rockchip/tve/rk3036/Kconfig
```kconfig
config RK3036_TV_ENCODER
	bool "rk3036/3128 tv encoder support"
	depends on (LCDC_RK3036 || LCDC_RK312X) && RK_TVENCODER
	default n
	help
		Support RK3036 output CVBS.
```

## drivers/video/rockchip/tve/rk610/Kconfig
```kconfig
config RK610_TVOUT
	bool "RK610(Jetta) tvout support"
	depends on MFD_RK610
	default n
	help
		Support Jetta(RK610) to output YPbPr and CVBS.
		
config RK610_TVOUT_YPbPr
	bool "support YPbPr output"
	depends on RK610_TVOUT

config RK610_TVOUT_CVBS
	bool "support CVBS output"
	depends on RK610_TVOUT
```

## drivers/video/rockchip/vcodec/Kconfig
```kconfig
# SPDX-License-Identifier: GPL-2.0
menu "VCODEC"
	depends on ARCH_ROCKCHIP

config RK_VCODEC
	tristate "VCODEC (VPU HEVC) service driver in kernel"
	depends on ARCH_ROCKCHIP
	default n

endmenu
```

## drivers/video/rockchip/vehicle/Kconfig
```kconfig
# SPDX-License-Identifier: GPL-2.0
config VIDEO_REVERSE_IMAGE
	bool "Rockchip Fast Reverse Image driver"
	depends on ARCH_ROCKCHIP && ROCKCHIP_DRM_DIRECT_SHOW
	depends on VIDEO_ROCKCHIP_CIF && PHY_ROCKCHIP_CSI2_DPHY
	help
	  fast reverse Image module.

if VIDEO_REVERSE_IMAGE

config VIDEO_REVERSE_NVP6324
	bool "nvp6324 for reverse sensor"
	help
	  Say y if use nvp6324.

config VIDEO_REVERSE_NVP6188
	bool "nvp6188 for reverse sensor"
	help
	  Say y if use nvp6188.

config VIDEO_REVERSE_MAX96714
	bool "max96714 for reverse sensor"
	help
	  Say y if use max96714.

config VIDEO_REVERSE_GC2145
	bool "gc2145 for reverse sensor"
	help
	  Say y if use gc2145.

config VIDEO_REVERSE_TP2825
	bool "tp2825 for reverse sensor"
	help
	  Say y if use tp2825.

config VIDEO_REVERSE_AD7181
	bool "ad7181 for reverse sensor"
	help
	  Say y if use ad7181.

endif
```

## drivers/video/rockchip/vpu/Kconfig
```kconfig
# SPDX-License-Identifier: GPL-2.0
menu "ROCKCHIP_MPP"
	depends on ARCH_ROCKCHIP

config ROCKCHIP_MPP_SERVICE
	tristate "ROCKCHIP MPP SERVICE driver"
	default n
	help
	  rockchip mpp service.

config ROCKCHIP_MPP_DEVICE
	tristate "ROCKCHIP MPP DEVICE driver"
	depends on ROCKCHIP_MPP_SERVICE
	default n
	help
	  rockchip mpp module.

endmenu
```

## drivers/video/rockchip/vtunnel/Kconfig
```kconfig
# SPDX-License-Identifier: (GPL-2.0+ OR MIT)

menu "Rockchip video tunnel support"

config ROCKCHIP_VIDEO_TUNNEL
	tristate "Rockchip video tunnel device support"
	depends on ARCH_ROCKCHIP
	default n
	help
	  Rockchip videotunnel device support.

endmenu
```

## drivers/video/samsung/Kconfig
```kconfig
#
# S3C Video configuration
#

config FB_S5P
	tristate "S5P Framebuffer support"
	select FB_CFB_FILLRECT
	select FB_CFB_COPYAREA
	select FB_CFB_IMAGEBLIT
	depends on FB && (ARCH_S5PV210 || ARCH_EXYNOS4) && !FB_S3C
	default n
	help
	  This enables support for Samsung Display Controller (FIMD)

config FB_S5P_SPLASH_SCREEN
	bool "SPLASH_SCREEN on LCD"
	depends on FB_S5P
	default y

config FB_S5P_LCD_INIT
	bool "LCD init in kernel"
	depends on FB_S5P
	default y

config FB_S5P_DEBUG
	bool "S5P Framebuffer debug messages"
	depends on FB_S5P

config FB_S5P_TRACE_UNDERRUN
	bool "S5P Framebuffer FIFO underrun trace"
	depends on FB_S5P

config FB_S5P_DEFAULT_WINDOW
	int "Default Window (0-4)"
	depends on FB_S5P
	default "0"
	help
	  This indicates the default window number, and which is used as console framebuffer

config FB_S5P_NR_BUFFERS
	int "Number of frame buffers (1-3)"
	depends on FB_S5P
	default "2"
	help
	  This indicates the number of buffers for pan display,
	  1 means no pan display and
	  2 means the double size of video buffer will be allocated for default window

config FB_S5P_VIRTUAL
	bool "Virtual Screen"
	depends on FB_S5P
	default n
	help
	  This uses 1920 x 1080 virtual screen.

config FB_S5P_X_VRES
	int "xres_virtual"
	depends on FB_S5P && FB_S5P_VIRTUAL
	default "1920"
	help
	  This indicates var.xres_virtual which has to be bigger than var.xres.

config FB_S5P_Y_VRES
	int "yres_virtual"
	depends on FB_S5P && FB_S5P_VIRTUAL
	default "1080"
	help
	  This indicates var.yres_virtual which has to be bigger than var.yres.

config VIDEO_SAMSUNG_MEMSIZE_FIMD
	int "Memory size in kbytes for FIMD"
	depends on FB_S5P
	default "24576"

config VIDEO_SAMSUNG_MEMSIZE_FIMD_VIDEO
	int "Memory size in kbytes for FIMD Video Layer"
	depends on FB_S5P && EXYNOS4_CONTENT_PATH_PROTECTION
	default "16384"

config FB_S5P_MIPI_DSIM
	bool "Samsung MIPI DSIM"
	depends on FB_S5P
	default n
	---help---
	  This enables support for Samsung MIPI DSIM feature

choice
depends on FB_S5P
prompt "Select LCD Type"
default FB_S5P_AMS369FG06
config FB_S5P_LTE480WV
	bool "LTE480WV"
	depends on MACH_SMDKV310 || MACH_SMDKC210 || MACH_SMDKV210 || MACH_SMDKC110
	help
	  This enables support for Samsung LTE480WV 4.8" WVGA LCD panel

config FB_S5P_HT101HD1
	bool "HT101HD1"
	depends on MACH_SMDKV310 || MACH_SMDKC210 || MACH_SMDKV210 || MACH_SMDKC110
	help
	  This enables support for HT101HD1 10.1" WXVGA(1366*768) LCD panel

config FB_S5P_WA101S
	bool "WA101S"
	depends on MACH_SMDKV310 || MACH_SMDKC210 || MACH_SMDK4X12
	select TOUCHSCREEN_S5PV310_MT
	help
	  This enables support for 10.1" 1366*768 LCD panel

config FB_S5P_AMS369FG06
	bool "AMS369FG06"
	depends on MACH_SMDKV310 || MACH_SMDKC210
	select SPI_BITBANG
	select SPI_GPIO
	help
	  This enables support for Samsung AMS369FG06 3.7" WVGA AMOLED panel

config FB_S5P_LMS501KF03
	bool "LMS501KF03"
	depends on MACH_SMDK4X12
	select SPI_BITBANG
	select SPI_GPIO
	help
	  This enables support for Samsung LMS501KF03 5.01" WVGA TFT LCD panel

config FB_S5P_DUMMY_MIPI_LCD
	bool "DUMMY MIPI LCD"
	depends on FB_S5P_MIPI_DSIM
	---help---
	  This enables support for Samsung DUMMY MIPI LCD

config FB_S5P_LG4591
	bool "LG4591 MIPI LCD"
	depends on FB_S5P_MIPI_DSIM
	---help---
	  This enables support for LG4591 MIPI LCD

config FB_S5P_S6E8AA1
	bool "SMD S6E8AA1 MIPI LCD"
	depends on FB_S5P_MIPI_DSIM
	---help---
	  This enables support for SMD S6E8AA1 MIPI LCD

config FB_S5P_LTN101AL03
	bool "LTN101AL03"
	depends on MACH_ODROID_4X12
	help
	  This enables support for 10.1" 1280*800 LCD panel

config FB_S5P_LP101WH1
	bool "LP101WH1"
	depends on MACH_ODROID_4X12
	help
	  This enables support for 10.1" 1366*768 LCD panel

config FB_S5P_U133WA01
	bool "U133WA01"
	depends on MACH_ODROID_4X12
	help
	  This enables support for 13.3" 1366*768 LCD panel

config FB_S5P_FAKE_FB
    bool "fake fb"
	depends on MACH_ODROID_4X12
	help
	  This enables support for odroid-u virtual panel
    
endchoice

config FB_S5P_V2
	tristate "S5P Framebuffer version 2 support"
	select FB_CFB_FILLRECT
	select FB_CFB_COPYAREA
	select FB_CFB_IMAGEBLIT
	select FRAMEBUFFER_CONSOLE_DETECT_PRIMARY
	depends on FB && (FB_S3C != y) && (FB_S3C != m) && (ARCH_S3C64XX || ARCH_S5P64XX || ARCH_S5PC1XX || ARCH_S5P6450)
	default n
	---help---
	  This enables support for Samsung Display Controller (FIMD)

config FB_S5P_V2_DEBUG
        bool "S5P Framebuffer version 2 debug messages"
        depends on FB_S5P_V2

config FB_S5P_V2_TRACE_UNDERRUN
        bool "S5P Framebuffer version 2 FIFO underrun trace"
        depends on FB_S5P_V2

config FB_S5P_V2_DEFAULT_WINDOW
	int "Default Window (0-4)"
	depends on FB_S5P_V2
	default "1"
	---help---
	  This indicates the default window number, and which is used as console framebuffer

config FB_S5P_V2_YPANSTEP
	int "Vertical Panning Step (0-2)"
	depends on FB_S5P_V2
	default "1"
	---help---
	  This indicates the number of vertical steps for pan display, 0 means no pan display and
	  1 means the double size of video buffer will be allocated for default window

choice
depends on FB_S5P_V2
prompt "Select LCD Type"
default FB_S5P_V2_LTE480WV
config FB_S5P_V2_LTE480WV
	bool "LTE480WV"
	---help---
	  This enables support for Samsung LTE480WV 4.8\" WVGA LCD panel

config FB_S5P_V2_TL2796
	bool "TL2796"
	---help---
	  This enables support for Samsung  TL2796 WVGA LCD panel
endchoice
```

## drivers/video/sun3i/Kconfig
```kconfig
menu "Display options for sun3i"
	depends on FB && ARCH_SUN3I

config LYCHEE_FB_SUN3I
	tristate "FB Controller Driver Support(sun3i)"
	---help---
	default m

config LYCHEE_HDMI_SUN3I
	tristate "HDMI Driver Support(sun3i)"
	depends on LYCHEE_FB_SUN3I
	---help---
	default m

endmenu
```

## drivers/video/sunxi/Kconfig
```kconfig
menu "Display options for sun4i/sun5i"
	depends on FB
	depends on ARCH_SUN4I || ARCH_SUN5I

config LYCHEE_FB_SUN4I
	tristate "DISP Driver Support(sun4i)"
	select FB_SUNXI
        depends on FB && ARCH_SUN4I
        ---help---
        default m

config LYCHEE_FB_SUN5I
	tristate "DISP Driver Support(sun5i)"
	select FB_SUNXI
        depends on FB && ARCH_SUN5I
        ---help---
        default m

config FB_SUNXI
        tristate
	select FB_SUNXI_RESERVED_MEM if MALI
	select FB_MODE_HELPERS
	select FB_CFB_FILLRECT
	select FB_CFB_COPYAREA
	select FB_CFB_IMAGEBLIT

config FB_SUNXI_RESERVED_MEM
	bool "Reserve memory block for sunxi/fb"
	depends on FB_SUNXI
	default y

config FB_SUNXI_UMP
	bool "Enable FB/UMP Integration"
	depends on MALI && FB_SUNXI
	default y

config LYCHEE_LCD_SUN4I
	tristate "LCD Driver Support(sun4i)"
	select FB_SUNXI_LCD
        depends on LYCHEE_FB_SUN4I
        ---help---
        default m

config LYCHEE_LCD_SUN5I
	tristate "LCD Driver Support(sun5i)"
	select FB_SUNXI_LCD
        depends on LYCHEE_FB_SUN5I
        ---help---
        default m

config FB_SUNXI_LCD
        tristate

config LYCHEE_HDMI_SUN4I
	tristate "HDMI Driver Support(sun4i)"
	select FB_SUNXI_HDMI
        depends on LYCHEE_LCD_SUN4I
        ---help---
        default m

config LYCHEE_HDMI_SUN5I
	tristate "HDMI Driver Support(sun5i)"
	select FB_SUNXI_HDMI
        depends on LYCHEE_LCD_SUN5I
        ---help---
        default m

config FB_SUNXI_HDMI
        tristate
endmenu
```
