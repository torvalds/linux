## drivers/video/rockchip/mpp/Kconfig
```kconfig
# SPDX-License-Identifier: (GPL-2.0+ OR MIT)

menuconfig ROCKCHIP_MPP_SERVICE
	tristate "mpp service framework"
	depends on ARCH_ROCKCHIP
	help
	  rockchip mpp service framework.

if ROCKCHIP_MPP_SERVICE

config ROCKCHIP_MPP_PROC_FS
	bool "mpp service procfs"
	depends on PROC_FS
	default y
	help
	  rockchip mpp service procfs.

config ROCKCHIP_MPP_RKVDEC
	bool "RKV decoder device driver"
	help
	  rockchip mpp rkv combo decoder and hevc decoder.

config ROCKCHIP_MPP_RKVDEC2
	bool "RKV decoder v2 device driver"
	help
	  rockchip mpp rkv combo decoder v2.

config ROCKCHIP_MPP_RKVENC
	bool "RKV encoder device driver"
	help
	  rockchip mpp rkv combo encoder.

config ROCKCHIP_MPP_RKVENC2
	bool "RKV encoder v2 device driver"
	help
	  rockchip mpp rkv combo encoder v2.

config ROCKCHIP_MPP_VDPU1
	bool "VPU decoder v1 device driver"
	help
	  rockchip mpp vpu decoder v1.

config ROCKCHIP_MPP_VEPU1
	bool "VPU encoder v1 device driver"
	help
	  rockchip mpp vpu encoder v1.

config ROCKCHIP_MPP_VDPU2
	bool "VPU decoder v2 device driver"
	help
	  rockchip mpp vpu decoder v2.

config ROCKCHIP_MPP_VEPU2
	bool "VPU encoder v2 device driver"
	help
	  rockchip mpp vpu encoder v2.

config ROCKCHIP_MPP_IEP2
	bool "IEP v2 device driver"
	help
	  rockchip iep v2.

config ROCKCHIP_MPP_JPGDEC
	bool "RKV jpeg decoder v1 device driver"
	help
	  rockchip mpp rkv jpeg decoder.

config ROCKCHIP_MPP_AV1DEC
	bool "AV1 decoder device driver"
	help
	  rockchip mpp av1 decoder.

config ROCKCHIP_MPP_VDPP
	bool "VDPP device driver"
	help
	  rockchip vdpp.

endif
```

## drivers/video/rockchip/mpp_osal/Kconfig
```kconfig
# SPDX-License-Identifier: (GPL-2.0+ OR MIT)

config ROCKCHIP_MPP_OSAL
	bool "mpp osal"
	depends on CPU_RV1106
	default y
	help
	  rockchip mpp osal adapt for kmpp
```

## drivers/video/rockchip/rga/Kconfig
```kconfig
# SPDX-License-Identifier: GPL-2.0
menu "RGA"
	depends on ARCH_ROCKCHIP

config ROCKCHIP_RGA
	tristate "ROCKCHIP_RGA"
	help
	  rk30 rga module.

endmenu
```

## drivers/video/rockchip/rga2/Kconfig
```kconfig
# SPDX-License-Identifier: GPL-2.0
menuconfig ROCKCHIP_RGA2
	tristate "RGA2"
	depends on ARCH_ROCKCHIP && !ROCKCHIP_MULTI_RGA
	help
	  rk32 rga2 module.

if ROCKCHIP_RGA2

config ROCKCHIP_RGA2_PROC_FS
	bool "Enable RGA2 procfs"
	select ROCKCHIP_RGA2_DEBUGGER
	depends on PROC_FS
	help
	  Enable procfs to debug RGA driver.

config ROCKCHIP_RGA2_DEBUG_FS
	bool "Enable RGA2 debugfs"
	select ROCKCHIP_RGA2_DEBUGGER
	depends on DEBUG_FS
	default y
	help
	  Enable debugfs to debug RGA driver.

config ROCKCHIP_RGA2_DEBUGGER
	bool
	help
	  Enabling the debugger of RGA2, you can use procfs and debugfs for debugging.

endif
```

## drivers/video/rockchip/rga3/Kconfig
```kconfig
# SPDX-License-Identifier: GPL-2.0
menuconfig ROCKCHIP_MULTI_RGA
	tristate "MULTI_RGA"
	depends on ARCH_ROCKCHIP
	help
	  multi_rga module.

if ROCKCHIP_MULTI_RGA

config ROCKCHIP_RGA_ASYNC
	bool "Enable async mode"
	depends on SYNC_FILE
	default y
	help
	  Asynchronous calls will be supported.

config ROCKCHIP_RGA_PROC_FS
	bool "Enable RGA procfs"
	select ROCKCHIP_RGA_DEBUGGER
	depends on PROC_FS
	help
	  Enable procfs to debug multi RGA driver.

config ROCKCHIP_RGA_DEBUG_FS
	bool "Enable RGA debugfs"
	select ROCKCHIP_RGA_DEBUGGER
	depends on DEBUG_FS
	default y
	help
	  Enable debugfs to debug multi RGA driver.

config ROCKCHIP_RGA_DEBUGGER
	bool
	help
	  Enabling the debugger of multi RGA, you can use procfs and debugfs for debugging.

endif
```
