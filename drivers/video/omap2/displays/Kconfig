## drivers/video/omap2/displays/Kconfig
```kconfig
menu "OMAP2/3 Display Device Drivers"
        depends on OMAP2_DSS

config PANEL_GENERIC_DPI
        tristate "Generic DPI Panel"
	depends on OMAP2_DSS_DPI
        help
	  Generic DPI panel driver.
	  Supports DVI output for Beagle and OMAP3 SDP.
	  Supports LCD Panel used in TI SDP3430 and EVM boards,
	  OMAP3517 EVM boards and CM-T35.

config PANEL_DVI
	tristate "DVI output"
	depends on OMAP2_DSS_DPI
	help
	  Driver for external monitors, connected via DVI. The driver uses i2c
	  to read EDID information from the monitor.

config PANEL_LGPHILIPS_LB035Q02
	tristate "LG.Philips LB035Q02 LCD Panel"
	depends on OMAP2_DSS_DPI && SPI
	help
	  LCD Panel used on the Gumstix Overo Palo35

config PANEL_SHARP_LS037V7DW01
        tristate "Sharp LS037V7DW01 LCD Panel"
        depends on OMAP2_DSS_DPI
        depends on BACKLIGHT_CLASS_DEVICE
        help
          LCD Panel used in TI's SDP3430 and EVM boards

config PANEL_NEC_NL8048HL11_01B
	tristate "NEC NL8048HL11-01B Panel"
	depends on OMAP2_DSS_DPI
	depends on SPI
	depends on BACKLIGHT_CLASS_DEVICE
	help
		This NEC NL8048HL11-01B panel is TFT LCD
		used in the Zoom2/3/3630 sdp boards.

config PANEL_PICODLP
	tristate "TI PICO DLP mini-projector"
	depends on OMAP2_DSS_DPI && I2C
	help
		A mini-projector used in TI's SDP4430 and EVM boards
		For more info please visit http://www.dlp.com/projector/

config PANEL_TAAL
        tristate "Taal DSI Panel"
        depends on OMAP2_DSS_DSI
        depends on BACKLIGHT_CLASS_DEVICE
        help
          Taal DSI command mode panel from TPO.

config PANEL_TPO_TD043MTEA1
        tristate "TPO TD043MTEA1 LCD Panel"
        depends on OMAP2_DSS_DPI && SPI
        help
          LCD Panel used in OMAP3 Pandora

config PANEL_ACX565AKM
	tristate "ACX565AKM Panel"
	depends on OMAP2_DSS_SDI && SPI
	depends on BACKLIGHT_CLASS_DEVICE
	help
	  This is the LCD panel used on Nokia N900

config PANEL_N8X0
	tristate "N8X0 Panel"
	depends on OMAP2_DSS_RFBI && SPI
	depends on BACKLIGHT_CLASS_DEVICE
	help
	  This is the LCD panel used on Nokia N8x0
endmenu
```

## drivers/video/omap2/dss/Kconfig
```kconfig
menuconfig OMAP2_DSS
        tristate "OMAP2+ Display Subsystem support (EXPERIMENTAL)"
        depends on ARCH_OMAP2PLUS
        help
	  OMAP2+ Display Subsystem support.

if OMAP2_DSS

config OMAP2_VRAM_SIZE
	int "VRAM size (MB)"
	range 0 32
	default 0
	help
	  The amount of SDRAM to reserve at boot time for video RAM use.
	  This VRAM will be used by omapfb and other drivers that need
	  large continuous RAM area for video use.

	  You can also set this with "vram=<bytes>" kernel argument, or
	  in the board file.

config OMAP2_DSS_DEBUG_SUPPORT
        bool "Debug support"
	default y
	help
	  This enables debug messages. You need to enable printing
	  with 'debug' module parameter.

config OMAP2_DSS_COLLECT_IRQ_STATS
	bool "Collect DSS IRQ statistics"
	depends on OMAP2_DSS_DEBUG_SUPPORT
	default n
	help
	  Collect DSS IRQ statistics, printable via debugfs.

	  The statistics can be found from
	  <debugfs>/omapdss/dispc_irq for DISPC interrupts, and
	  <debugfs>/omapdss/dsi_irq for DSI interrupts.

config OMAP2_DSS_DPI
	bool "DPI support"
	default y
	help
	  DPI Interface. This is the Parallel Display Interface.

config OMAP2_DSS_RFBI
	bool "RFBI support"
        default n
	help
	  MIPI DBI support (RFBI, Remote Framebuffer Interface, in Texas
	  Instrument's terminology).

	  DBI is a bus between the host processor and a peripheral,
	  such as a display or a framebuffer chip.

	  See http://www.mipi.org/ for DBI spesifications.

config OMAP2_DSS_VENC
	bool "VENC support"
        default y
	help
	  OMAP Video Encoder support for S-Video and composite TV-out.

config OMAP4_DSS_HDMI
	bool "HDMI support"
	depends on ARCH_OMAP4
        default y
	help
	  HDMI Interface. This adds the High Definition Multimedia Interface.
	  See http://www.hdmi.org/ for HDMI specification.

config OMAP2_DSS_SDI
	bool "SDI support"
	depends on ARCH_OMAP3
        default n
	help
	  SDI (Serial Display Interface) support.

	  SDI is a high speed one-way display serial bus between the host
	  processor and a display.

config OMAP2_DSS_DSI
	bool "DSI support"
	depends on ARCH_OMAP3 || ARCH_OMAP4
        default n
	help
	  MIPI DSI (Display Serial Interface) support.

	  DSI is a high speed half-duplex serial interface between the host
	  processor and a peripheral, such as a display or a framebuffer chip.

	  See http://www.mipi.org/ for DSI spesifications.

config OMAP2_DSS_FAKE_VSYNC
	bool "Fake VSYNC irq from manual update displays"
	default n
	help
	  If this is selected, DSI will generate a fake DISPC VSYNC interrupt
	  when DSI has sent a frame. This is only needed with DSI or RFBI
	  displays using manual mode, and you want VSYNC to, for example,
	  time animation.

config OMAP2_DSS_MIN_FCK_PER_PCK
	int "Minimum FCK/PCK ratio (for scaling)"
	range 0 32
	default 0
	help
	  This can be used to adjust the minimum FCK/PCK ratio.

	  With this you can make sure that DISPC FCK is at least
	  n x PCK. Video plane scaling requires higher FCK than
	  normally.

	  If this is set to 0, there's no extra constraint on the
	  DISPC FCK. However, the FCK will at minimum be
	  2xPCK (if active matrix) or 3xPCK (if passive matrix).

	  Max FCK is 173MHz, so this doesn't work if your PCK
	  is very high.

config OMAP2_DSS_SLEEP_BEFORE_RESET
	bool "Sleep 50ms before DSS reset"
	default y
	help
	  For some unknown reason we may get SYNC_LOST errors from the display
	  subsystem at initialization time if we don't sleep before resetting
	  the DSS. See the source (dss.c) for more comments.

	  However, 50ms is quite long time to sleep, and with some
	  configurations the SYNC_LOST may never happen, so the sleep can
	  be disabled here.

config OMAP2_DSS_SLEEP_AFTER_VENC_RESET
	bool "Sleep 20ms after VENC reset"
	default y
	help
	  There is a 20ms sleep after VENC reset which seemed to fix the
	  reset. The reason for the bug is unclear, and it's also unclear
	  on what platforms this happens.

	  This option enables the sleep, and is enabled by default. You can
	  disable the sleep if it doesn't cause problems on your platform.

endif
```

## drivers/video/omap2/omapfb/Kconfig
```kconfig
menuconfig FB_OMAP2
        tristate "OMAP2+ frame buffer support"
        depends on FB && OMAP2_DSS

	select OMAP2_VRAM
	select OMAP2_VRFB if ARCH_OMAP2 || ARCH_OMAP3
        select FB_CFB_FILLRECT
        select FB_CFB_COPYAREA
        select FB_CFB_IMAGEBLIT
        help
	  Frame buffer driver for OMAP2+ based boards.

config FB_OMAP2_DEBUG_SUPPORT
        bool "Debug support for OMAP2+ FB"
	default y
	depends on FB_OMAP2
	help
	  Support for debug output. You have to enable the actual printing
	  with 'debug' module parameter.

config FB_OMAP2_NUM_FBS
	int "Number of framebuffers"
	range 1 10
	default 3
	depends on FB_OMAP2
	help
	  Select the number of framebuffers created. OMAP2/3 has 3 overlays
	  so normally this would be 3.
```

## drivers/video/rockchip/Kconfig
```kconfig
# SPDX-License-Identifier: GPL-2.0
source "drivers/video/rockchip/rga/Kconfig"
source "drivers/video/rockchip/rga2/Kconfig"
source "drivers/video/rockchip/rga3/Kconfig"
source "drivers/video/rockchip/rve/Kconfig"
source "drivers/video/rockchip/iep/Kconfig"
source "drivers/video/rockchip/mpp/Kconfig"
source "drivers/video/rockchip/dvbm/Kconfig"
```

## drivers/video/rockchip/dp/Kconfig
```kconfig
# SPDX-License-Identifier: GPL-2.0
menu "DP"

config ROCKCHIP_DP
	tristate "ROCKCHIP fb cdn dp driver"
	depends on RK_HDMI
	select SND_SOC_HDMI_CODEC if SND_SOC
	help
	  This selects support for Rockchip SoC specific extensions
	  for the cdn DP driver. If you want to enable Dp on
	  RK3399 based SoC with rkfb, you should select this
	  option.
endmenu
```

## drivers/video/rockchip/dvbm/Kconfig
```kconfig
# SPDX-License-Identifier: (GPL-2.0+ OR MIT)

menuconfig ROCKCHIP_DVBM
	tristate "RK Direct Video Buffer Manager driver"
	depends on ARCH_ROCKCHIP
	help
	  rockchip dvbm module.

if ROCKCHIP_DVBM

config ROCKCHIP_DVBM_PROC_FS
	bool "enable dvbm procfs"
	depends on PROC_FS
	default y
	help
	  rockchip dvbm procfs.

endif
```

## drivers/video/rockchip/hdmi/Kconfig
```kconfig
# SPDX-License-Identifier: GPL-2.0
menuconfig RK_HDMI
       bool "Rockchip HDMI support"
       depends on FB_ROCKCHIP || DRM_ROCKCHIP
       select FB_MODE_HELPERS

source "drivers/video/rockchip/hdmi/rockchip-hdmiv1/Kconfig"
source "drivers/video/rockchip/hdmi/rockchip-hdmiv2/Kconfig"

config RK_HDMI_DEBUG
		bool "Rockchip HDMI Debugging"
        depends on RK_HDMI
        default n
		help
		  Enableds verbose debugging the the HDMI drivers
```

## drivers/video/rockchip/hdmi/chips/Kconfig
```kconfig
config  HDMI_RK30
        bool "RK30 HDMI support"
        depends on LCDC_RK30
        help
           Support rk30 hdmi if you say y here

if HDMI_RK30
source "drivers/video/rockchip/hdmi/chips/rk30/Kconfig"
endif

config  HDMI_RK2928
        bool "RK2928 HDMI support"
        depends on LCDC_RK2928
        help
           Support rk2928 hdmi if you say y here

if HDMI_RK2928
source "drivers/video/rockchip/hdmi/chips/rk2928/Kconfig"
endif

config  HDMI_CAT66121
        bool "CAT66121 HDMI support"
        help
           Support cat66121 hdmi if you say y here

if HDMI_CAT66121
source "drivers/video/rockchip/hdmi/chips/cat66121/Kconfig"
endif

config  HDMI_RK610
        bool "RK610 HDMI support"
        depends on MFD_RK610
        help
           Support rk610 hdmi if you say y here

if HDMI_RK610
source "drivers/video/rockchip/hdmi/chips/rk610/Kconfig"
endif

config  HDMI_RK616
        bool "RK616 HDMI support"
#depends on MFD_RK616 || ARCH_RK3026
		default y
        help
           Support rk616 hdmi if you say y here

if HDMI_RK616
source "drivers/video/rockchip/hdmi/chips/rk616/Kconfig"
endif

choice
	prompt "HDMI Source LCDC select"
config HDMI_SOURCE_LCDC0
	bool "lcdc0"
config HDMI_SOURCE_LCDC1
	bool "lcdc1"
endchoice
```

## drivers/video/rockchip/hdmi/chips/cat66121/Kconfig
```kconfig
config SUPPORT_HDCP
	bool "HDCP support"
        depends on HDMI_CAT66121
        default n
	help
	  HDCP Interface. This adds the High Definition Content Protection Interface.
	  See http://www.digital-cp.com/ for HDCP specification.
```

## drivers/video/rockchip/hdmi/chips/rk2928/Kconfig
```kconfig
config HDCP_RK2928
	bool "RK2928 HDCP support"
        depends on HDMI_RK2928
        default n
	help
	  HDCP Interface. This adds the High Definition Content Protection Interface.
	  See http://www.digital-cp.com/ for HDCP specification.

config HDCP_RK2928_DEBUG
	bool "RK2928 HDCP Debugging"
        depends on HDCP_RK2928
        default n
	help
	  Enableds verbose debugging the the HDCP drivers
```

## drivers/video/rockchip/hdmi/chips/rk2928/hdcp/Kconfig
```kconfig
config HDCP_RK30
	bool "RK30 HDCP support"
        depends on LCDC_RK30 && HDMI_RK30
        default n
	help
	  HDCP Interface. This adds the High Definition Content Protection Interface.
	  See http://www.digital-cp.com/ for HDCP specification.

config HDCP_RK30_DEBUG
	bool "RK30 HDCP Debugging"
        depends on HDCP_RK30
        default n
	help
	  Enableds verbose debugging the the HDCP drivers
```

## drivers/video/rockchip/hdmi/chips/rk3036/Kconfig
```kconfig
config HDCP_RK3036
	bool "RK3036 HDCP support"
        default n
	help
	  HDCP Interface. This adds the High Definition Content Protection Interface.
	  See http://www.digital-cp.com/ for HDCP specification.

config HDCP_RK3036_DEBUG
	bool "RK3036 HDCP Debugging"
        depends on HDCP_RK3036
        default n
	help
	  Enableds verbose debugging the the HDCP drivers
```

## drivers/video/rockchip/hdmi/chips/rk610/Kconfig
```kconfig
config HDCP_RK610
	bool "RK610 HDCP support"
        depends on HDMI_RK610
        default n
	help
	  HDCP Interface. This adds the High Definition Content Protection Interface.
	  See http://www.digital-cp.com/ for HDCP specification.

config HDCP_RK610_DEBUG
	bool "RK610 HDCP Debugging"
        depends on HDCP_RK610
        default n
	help
	  Enableds verbose debugging the the HDCP drivers
```

## drivers/video/rockchip/hdmi/chips/rk616/Kconfig
```kconfig
config HDCP_RK616
	bool "RK616 HDCP support"
        depends on HDMI_RK616 || ARCH_RK3026
        default n
	help
	  HDCP Interface. This adds the High Definition Content Protection Interface.
	  See http://www.digital-cp.com/ for HDCP specification.

config HDCP_RK616_DEBUG
	bool "RK616 HDCP Debugging"
        depends on HDCP_RK616
        default n
	help
	  Enableds verbose debugging the the HDCP drivers
```

## drivers/video/rockchip/hdmi/rockchip-hdmiv1/Kconfig
```kconfig
config  RK_HDMI_V1
        bool "RockChip HDMI V1 support"
        depends on RK_HDMI
        help
           Support rockchip hdmi version 1 if you say y here.
```

## drivers/video/rockchip/hdmi/rockchip-hdmiv2/Kconfig
```kconfig
# SPDX-License-Identifier: GPL-2.0
config  RK_HDMI_V2
        bool "RockChip HDMI V2 support"
        depends on RK_HDMI
        default y
        help
		Rockchip hdmi version 2 which support hdmi 2.0.
```

## drivers/video/rockchip/iep/Kconfig
```kconfig
# SPDX-License-Identifier: GPL-2.0
menu "IEP"
	depends on ARCH_ROCKCHIP

config IEP
	tristate "ROCKCHIP IEP driver"
	help
	  rockchip iep module.

endmenu
```

## drivers/video/rockchip/lcdc/Kconfig
```kconfig
config LCDC_RK2928
        tristate "rk2928 lcdc support"
        depends on (DRM_ROCKCHIP || FB_ROCKCHIP) && ARCH_RK2928
        help
          Driver for rk2928 lcdc .

config LCDC_RK30
        tristate "rk30 lcdc support"
        depends on (DRM_ROCKCHIP || FB_ROCKCHIP) && ARCH_RK30XX
        help
          Driver for rk30 lcdc .There are two lcd controllers on rk30

config LCDC_RK3066B
        tristate "rk3066b lcdc support"
        depends on (DRM_ROCKCHIP || FB_ROCKCHIP) && ARCH_RK3066B
        help
          Driver for rk3066b  lcdc.

config LCDC_RK3188
        bool "rk3188 lcdc support"
        depends on DRM_ROCKCHIP || FB_ROCKCHIP 
	depends on ARM
        help
          Driver for rk3188/rk302x/rk319x lcdc.There are two lcd controllers on rk3188

config LCDC_RK3288
        bool "rk3288 lcdc support"
        depends on DRM_ROCKCHIP || FB_ROCKCHIP 
	depends on ARM
        help
          Driver for rk3288 lcdc.There are two lcd controllers on rk3288

config LCDC_RK3036
	bool "rk3036 lcdc support"
	depends on DRM_ROCKCHIP || FB_ROCKCHIP 
	depends on ARM
        help
          Driver for rk3036 lcdc.

config LCDC_RK312X
        bool "rk312x lcdc support"
        depends on DRM_ROCKCHIP || FB_ROCKCHIP
	depends on ARM
        help
          Driver for rk312x lcdc.

config LCDC_RK3368
	bool "rk3368 lcdc support"
	depends on DRM_ROCKCHIP || FB_ROCKCHIP
	depends on ARM64
	help
	  Driver for rk3368 lcdc.There are one lcd controllers on rk3368

config LCDC_RK322X
	bool "rk322x lcdc support"
	depends on FB_ROCKCHIP
	help
	  Driver for rk322x lcdc.There are one lcd controllers on rk322x

config LCDC_LITE_RK3X
	bool "rk lcdc lite support"
	depends on FB_ROCKCHIP
	help
	  Driver for rk lcdc lite.There are one lcd controllers on rk3366 or
	  on other chips in future
```
