## drivers/video/logo/Kconfig
```kconfig
# SPDX-License-Identifier: GPL-2.0-only
#
# Logo configuration
#

menuconfig LOGO
	bool "Bootup logo"
	depends on FB_CORE || SGI_NEWPORT_CONSOLE
	help
	  Enable and select frame buffer bootup logos.
	  Monochrome logos will also be used by the DRM panic handler, if
	  enabled.

if LOGO

config FB_LOGO_EXTRA
	bool
	depends on FB=y
	default y if SPU_BASE

config LOGO_LINUX_MONO
	bool "Standard black and white Linux logo"
	default y

config LOGO_LINUX_MONO_FILE
	string "Monochrome logo .pbm file"
	depends on LOGO_LINUX_MONO
	default "drivers/video/logo/logo_linux_mono.pbm"
	help
	  Takes a path to a monochromatic logo in the portable pixmap file
	  format (.pbm). This defaults to the Tux penguin.

	  For example, the below ImageMagick command can be used to reduce
	  an image to black and white and convert it into a pbm file:

	    magick source_image -compress none destination.pbm

config LOGO_LINUX_VGA16
	bool "Standard 16-color Linux logo"
	default y

config LOGO_LINUX_VGA16_FILE
	string "16-color logo .ppm file"
	depends on LOGO_LINUX_VGA16
	default "drivers/video/logo/logo_linux_vga16.ppm"
	help
	  Takes a path to a logo in the portable pixmap file format (.ppm),
	  using the 16 colors from the drivers/video/logo/clut_vga16.ppm
	  palette. This defaults to the Tux penguin.

	  For example, the below ImageMagick command can be used to reduce an
	  image to the VGA 16 colors palette and convert into a ppm file:

	    magick source_image -compress none \
	      -remap drivers/video/logo/clut_vga16.ppm destination.ppm

config LOGO_LINUX_CLUT224
	bool "Standard 224-color Linux logo"
	default y

config LOGO_LINUX_CLUT224_FILE
	string "224-color logo .ppm file"
	depends on LOGO_LINUX_CLUT224
	default "drivers/video/logo/logo_linux_clut224.ppm"
	help
	  Takes a path to a 224-color logo in the portable pixmap file
	  format (.ppm). This defaults to the Tux penguin.

	  For example, the below ImageMagick command can be used to reduce
	  an image palette to 224 colors and convert it into a ppm file:

	    magick source_image -compress none -colors 224 destination.ppm

config LOGO_DEC_CLUT224
	bool "224-color Digital Equipment Corporation Linux logo"
	depends on MACH_DECSTATION || ALPHA
	default y

config LOGO_MAC_CLUT224
	bool "224-color Macintosh Linux logo"
	depends on MAC
	default y

config LOGO_PARISC_CLUT224
	bool "224-color PA-RISC Linux logo"
	depends on PARISC
	default y

config LOGO_SGI_CLUT224
	bool "224-color SGI Linux logo"
	depends on SGI_IP22 || SGI_IP27 || SGI_IP32
	default y

config LOGO_SUN_CLUT224
	bool "224-color Sun Linux logo"
	depends on SPARC
	default y

config LOGO_SUPERH_MONO
	bool "Black and white SuperH Linux logo"
	depends on SUPERH
	default y

config LOGO_SUPERH_VGA16
	bool "16-color SuperH Linux logo"
	depends on SUPERH
	default y

config LOGO_SUPERH_CLUT224
	bool "224-color SuperH Linux logo"
	depends on SUPERH
	default y

endif # LOGO
```

## drivers/video/mmp/Kconfig
```kconfig
menuconfig MMP_DISP
        tristate "Marvell MMP Display Subsystem support"
        depends on CPU_PXA910 || CPU_MMP2 || CPU_MMP3 || CPU_PXA988
        help
	  Marvell Display Subsystem support.

if MMP_DISP
source "drivers/video/mmp/hw/Kconfig"
source "drivers/video/mmp/panel/Kconfig"
source "drivers/video/mmp/fb/Kconfig"
endif
```

## drivers/video/mmp/hw/Kconfig
```kconfig
if MMP_DISP

config MMP_DISP_CONTROLLER
	bool "mmp display controller hw support"
	depends on CPU_PXA910 || CPU_MMP2 || CPU_MMP3 || CPU_PXA988
	default n
	help
		Marvell MMP display hw controller support
		this controller is used on Marvell PXA910,
		MMP2, MMP3, PXA988 chips

config MMP_DISP_SPI
	bool "mmp display controller spi port"
	depends on MMP_DISP_CONTROLLER && SPI_MASTER
	default y
	help
		Marvell MMP display hw controller spi port support
		will register as a spi master for panel usage

endif
```

## drivers/video/mmp/panel/Kconfig
```kconfig
config MMP_PANEL_TPOHVGA
	bool "tpohvga panel TJ032MD01BW support"
	depends on SPI_MASTER
	default n
	help
		tpohvga panel support
```

## drivers/video/omap/Kconfig
```kconfig
config FB_OMAP
	tristate "OMAP frame buffer support"
	depends on FB
	depends on ARCH_OMAP1
	select FB_CFB_FILLRECT
	select FB_CFB_COPYAREA
	select FB_CFB_IMAGEBLIT
	help
          Frame buffer driver for OMAP based boards.

config FB_OMAP_LCDC_EXTERNAL
	bool "External LCD controller support"
	depends on FB_OMAP
	help
	  Say Y here, if you want to have support for boards with an
	  external LCD controller connected to the SoSSI/RFBI interface.

config FB_OMAP_LCDC_HWA742
	bool "Epson HWA742 LCD controller support"
	depends on FB_OMAP && FB_OMAP_LCDC_EXTERNAL
	help
	  Say Y here if you want to have support for the external
	  Epson HWA742 LCD controller.

config FB_OMAP_MANUAL_UPDATE
	bool "Default to manual update mode"
	depends on FB_OMAP && FB_OMAP_LCDC_EXTERNAL
	help
	  Say Y here, if your user-space applications are capable of
	  notifying the frame buffer driver when a change has occurred in
	  the frame buffer content and thus a reload of the image data to
	  the external frame buffer is required. If unsure, say N.

config FB_OMAP_LCD_MIPID
	bool "MIPI DBI-C/DCS compatible LCD support"
	depends on FB_OMAP && SPI_MASTER
	help
	  Say Y here if you want to have support for LCDs compatible with
	  the Mobile Industry Processor Interface DBI-C/DCS
	  specification. (Supported LCDs: Philips LPH8923, Sharp LS041Y3)

config FB_OMAP_CONSISTENT_DMA_SIZE
	int "Consistent DMA memory size (MB)"
	depends on FB_OMAP
	range 1 14
	default 2
	help
	  Increase the DMA consistent memory size according to your video
	  memory needs, for example if you want to use multiple planes.
	  The size must be 2MB aligned.
	  If unsure say 1.

config FB_OMAP_DMA_TUNE
        bool "Set DMA SDRAM access priority high"
        depends on FB_OMAP
        help
          On systems in which video memory is in system memory
          (SDRAM) this will speed up graphics DMA operations.
          If you have such a system and want to use rotation
          answer yes. Answer no if you have a dedicated video
          memory, or don't use any of the accelerated features.
```

## drivers/video/omap2/Kconfig
```kconfig
config OMAP2_VRFB
	bool

if ARCH_OMAP2PLUS

source "drivers/video/omap2/dss/Kconfig"
source "drivers/video/omap2/omapfb/Kconfig"
source "drivers/video/omap2/displays-new/Kconfig"

endif
```

## drivers/video/omap2/displays-new/Kconfig
```kconfig
menu "OMAP Display Device Drivers (new device model)"
        depends on OMAP2_DSS

config DISPLAY_ENCODER_TFP410
        tristate "TFP410 DPI to DVI Encoder"
	help
	  Driver for TFP410 DPI to DVI encoder.

config DISPLAY_ENCODER_TPD12S015
        tristate "TPD12S015 HDMI ESD protection and level shifter"
	help
	  Driver for TPD12S015, which offers HDMI ESD protection and level
	  shifting.

config DISPLAY_CONNECTOR_DVI
        tristate "DVI Connector"
	depends on I2C
	help
	  Driver for a generic DVI connector.

config DISPLAY_CONNECTOR_HDMI
        tristate "HDMI Connector"
	help
	  Driver for a generic HDMI connector.

config DISPLAY_CONNECTOR_ANALOG_TV
        tristate "Analog TV Connector"
	help
	  Driver for a generic analog TV connector.

config DISPLAY_PANEL_DPI
	tristate "Generic DPI panel"
	help
	  Driver for generic DPI panels.

config DISPLAY_PANEL_DSI_CM
	tristate "Generic DSI Command Mode Panel"
	help
	  Driver for generic DSI command mode panels.

config DISPLAY_PANEL_SONY_ACX565AKM
	tristate "ACX565AKM Panel"
	depends on SPI && BACKLIGHT_CLASS_DEVICE
	help
	  This is the LCD panel used on Nokia N900

config DISPLAY_PANEL_LGPHILIPS_LB035Q02
	tristate "LG.Philips LB035Q02 LCD Panel"
	depends on SPI
	help
	  LCD Panel used on the Gumstix Overo Palo35

config DISPLAY_PANEL_SHARP_LS037V7DW01
        tristate "Sharp LS037V7DW01 LCD Panel"
        depends on BACKLIGHT_CLASS_DEVICE
        help
          LCD Panel used in TI's SDP3430 and EVM boards

config DISPLAY_PANEL_TPO_TD043MTEA1
        tristate "TPO TD043MTEA1 LCD Panel"
        depends on SPI
        help
          LCD Panel used in OMAP3 Pandora

config DISPLAY_PANEL_NEC_NL8048HL11
	tristate "NEC NL8048HL11 Panel"
	depends on SPI
	depends on BACKLIGHT_CLASS_DEVICE
	help
		This NEC NL8048HL11 panel is TFT LCD used in the
		Zoom2/3/3630 sdp boards.

endmenu
```
