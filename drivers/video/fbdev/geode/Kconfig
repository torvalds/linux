## drivers/video/fbdev/geode/Kconfig
```kconfig
#
# Geode family framebuffer configuration
#
config FB_GEODE
	bool "AMD Geode family framebuffer support"
	depends on FB && PCI && (X86_32 || (X86 && COMPILE_TEST))
	---help---
	  Say 'Y' here to allow you to select framebuffer drivers for
	  the AMD Geode family of processors.

config FB_GEODE_LX
	tristate "AMD Geode LX framebuffer support"
	depends on FB && FB_GEODE
	select FB_CFB_FILLRECT
	select FB_CFB_COPYAREA
	select FB_CFB_IMAGEBLIT
	---help---
	  Framebuffer driver for the display controller integrated into the
	  AMD Geode LX processors.

	  To compile this driver as a module, choose M here: the module will
	  be called lxfb.

	  If unsure, say N.

config FB_GEODE_GX
	tristate "AMD Geode GX framebuffer support"
	depends on FB && FB_GEODE
	select FB_CFB_FILLRECT
	select FB_CFB_COPYAREA
	select FB_CFB_IMAGEBLIT
	---help---
	  Framebuffer driver for the display controller integrated into the
	  AMD Geode GX processors.

	  To compile this driver as a module, choose M here: the module will be
	  called gxfb.

	  If unsure, say N.

config FB_GEODE_GX1
	tristate "AMD Geode GX1 framebuffer support"
	depends on FB && FB_GEODE
	select FB_CFB_FILLRECT
	select FB_CFB_COPYAREA
	select FB_CFB_IMAGEBLIT
	---help---
	  Framebuffer driver for the display controller integrated into the
	  AMD Geode GX1 processor.

	  To compile this driver as a module, choose M here: the module will be
	  called gx1fb.

	  If unsure, say N.
```

## drivers/video/fbdev/mmp/Kconfig
```kconfig
# SPDX-License-Identifier: GPL-2.0-only
menuconfig MMP_DISP
	tristate "Marvell MMP Display Subsystem support"
	depends on CPU_PXA910 || CPU_MMP2
	help
	  Marvell Display Subsystem support.

if MMP_DISP
source "drivers/video/fbdev/mmp/hw/Kconfig"
source "drivers/video/fbdev/mmp/panel/Kconfig"
source "drivers/video/fbdev/mmp/fb/Kconfig"
endif
```

## drivers/video/fbdev/mmp/fb/Kconfig
```kconfig
# SPDX-License-Identifier: GPL-2.0-only
config MMP_FB
	tristate "fb driver for Marvell MMP Display Subsystem"
	depends on FB
	select FB_IOMEM_HELPERS
	default y
	help
		fb driver for Marvell MMP Display Subsystem
```

## drivers/video/fbdev/mmp/hw/Kconfig
```kconfig
# SPDX-License-Identifier: GPL-2.0-only
if MMP_DISP

config MMP_DISP_CONTROLLER
	bool "mmp display controller hw support"
	depends on CPU_PXA910 || CPU_MMP2
	help
		Marvell MMP display hw controller support
		this controller is used on Marvell PXA910 and
		MMP2 chips

config MMP_DISP_SPI
	bool "mmp display controller spi port"
	depends on MMP_DISP_CONTROLLER && SPI_MASTER
	default y
	help
		Marvell MMP display hw controller spi port support
		will register as a spi master for panel usage

endif
```

## drivers/video/fbdev/mmp/panel/Kconfig
```kconfig
# SPDX-License-Identifier: GPL-2.0-only
config MMP_PANEL_TPOHVGA
	bool "tpohvga panel TJ032MD01BW support"
	depends on SPI_MASTER
	help
		tpohvga panel support
```

## drivers/video/fbdev/msm/Kconfig
```kconfig
# SPDX-License-Identifier: GPL-2.0-only
if FB_MSM

config FB_MSM_MDSS_COMMON
	bool

config FB_MSM_MDP_NONE
	bool "MDP HW None"
	help
	This is used for platforms without Mobile Display Sub System (MDSS).
	mdm platform don't have MDSS hardware block.

	Say Y here if this is mdm platform.

config FB_MSM_QPIC
	bool
	select FB_MSM_MDSS_COMMON

config FB_MSM_QPIC_ILI_QVGA_PANEL
	bool "Qpic MIPI ILI QVGA Panel"
	select FB_MSM_QPIC
	help
	Support for MIPI ILI QVGA (240x320) panel ILI TECHNOLOGY 9341
	with on-chip full display RAM use parallel interface.

config FB_MSM_QPIC_PANEL_DETECT
	bool "Qpic Panel Detect"
	select FB_MSM_QPIC_ILI_QVGA_PANEL
	help
	Support for Qpic panel auto detect.

endif
```

## drivers/video/fbdev/mxc/Kconfig
```kconfig
config FB_MXC
	tristate "MXC Framebuffer support"
	depends on FB
	select FB_CFB_FILLRECT
	select FB_CFB_COPYAREA
	select FB_CFB_IMAGEBLIT
	select FB_MODE_HELPERS
	default y
	help
	  This is a framebuffer device for the MXC LCD Controller.
	  See <http://www.linux-fbdev.org/> for information on framebuffer
	  devices.

	  If you plan to use the LCD display with your MXC system, say
	  Y here.

config FB_MXC_SYNC_PANEL
	depends on FB_MXC
	tristate "Synchronous Panel Framebuffer"

config FB_MXC_MIPI_DSI_SAMSUNG
	tristate "MXC MIPI_DSI_SAMSUNG"
	depends on FB_MXC_SYNC_PANEL
	depends on FB_MXS

config FB_MXC_TRULY_WVGA_SYNC_PANEL
	tristate "TRULY WVGA Panel"
	depends on FB_MXC_SYNC_PANEL
	depends on FB_MXC_MIPI_DSI_SAMSUNG

config FB_MXC_LDB
	tristate "MXC LDB"
	depends on FB_MXC_SYNC_PANEL
	depends on MXC_IPU_V3 || FB_MXS
	select VIDEOMODE_HELPERS

config FB_MXC_HDMI
	depends on FB_MXC_SYNC_PANEL
	depends on MXC_IPU_V3
	depends on I2C
	tristate "MXC HDMI driver support"
	select MFD_MXC_HDMI
	help
	  Driver for the on-chip MXC HDMI controller.

config FB_MXC_EDID
     depends on FB_MXC && I2C
     tristate "MXC EDID support"
     default y

config FB_MXS_SII902X
	tristate "Si Image SII9022 DVI/HDMI Interface Chip"
	depends on FB_MXS && I2C

config HANNSTAR_CABC
	tristate "Hannstar CABC function"
	help
	  Say yes here to support switching on/off Hannstar CABC
	  function.  This function turns backlight density of a
	  display panel automatically according to the content
	  shown on the panel.

config FB_MXC_EINK_PANEL
	depends on FB_MXC
	depends on DMA_ENGINE
	select FB_DEFERRED_IO
	tristate "E-Ink Panel Framebuffer"

config FB_MXC_EINK_V2_PANEL
	depends on FB_MXC
	depends on DMA_ENGINE
	select FB_DEFERRED_IO
	tristate "E-Ink Panel Framebuffer based on EPDC V2"

config FB_MXC_EINK_AUTO_UPDATE_MODE
	bool "E-Ink Auto-update Mode Support"
	depends on FB_MXC_EINK_PANEL
```

## drivers/video/fbdev/omap/Kconfig
```kconfig
# SPDX-License-Identifier: GPL-2.0-only
config FB_OMAP
	tristate "OMAP frame buffer support"
	depends on FB
	depends on ARCH_OMAP1
	select FB_CFB_FILLRECT
	select FB_CFB_COPYAREA
	select FB_CFB_IMAGEBLIT
	help
	  Frame buffer driver for OMAP based boards.

config FB_OMAP_LCDC_EXTERNAL
	bool "External LCD controller support"
	depends on FB_OMAP
	help
	  Say Y here, if you want to have support for boards with an
	  external LCD controller connected to the SoSSI/RFBI interface.

config FB_OMAP_LCDC_HWA742
	bool "Epson HWA742 LCD controller support"
	depends on FB_OMAP && FB_OMAP_LCDC_EXTERNAL
	help
	  Say Y here if you want to have support for the external
	  Epson HWA742 LCD controller.

config FB_OMAP_MANUAL_UPDATE
	bool "Default to manual update mode"
	depends on FB_OMAP && FB_OMAP_LCDC_EXTERNAL
	help
	  Say Y here, if your user-space applications are capable of
	  notifying the frame buffer driver when a change has occurred in
	  the frame buffer content and thus a reload of the image data to
	  the external frame buffer is required. If unsure, say N.

config FB_OMAP_LCD_MIPID
	bool "MIPI DBI-C/DCS compatible LCD support"
	depends on FB_OMAP && SPI_MASTER
	help
	  Say Y here if you want to have support for LCDs compatible with
	  the Mobile Industry Processor Interface DBI-C/DCS
	  specification. (Supported LCDs: Philips LPH8923, Sharp LS041Y3)

config FB_OMAP_LCD_H3
	bool "TPS65010 LCD controller on OMAP-H3"
	depends on MACH_OMAP_H3
	depends on TPS65010=y
	default y
	help
	  Say Y here if you want to have support for the LCD on the
	  H3 board.

config FB_OMAP_DMA_TUNE
	bool "Set DMA SDRAM access priority high"
	depends on FB_OMAP
	help
	  On systems in which video memory is in system memory
	  (SDRAM) this will speed up graphics DMA operations.
	  If you have such a system and want to use rotation
	  answer yes. Answer no if you have a dedicated video
	  memory, or don't use any of the accelerated features.
```

## drivers/video/fbdev/omap2/Kconfig
```kconfig
# SPDX-License-Identifier: GPL-2.0-only
if OF && (ARCH_OMAP2PLUS || COMPILE_TEST)

source "drivers/video/fbdev/omap2/omapfb/Kconfig"

endif
```

## drivers/video/fbdev/omap2/omapfb/Kconfig
```kconfig
config OMAP2_VRFB
	bool

menuconfig FB_OMAP2
	tristate "OMAP2+ frame buffer support"
	depends on FB
	depends on DRM_OMAP = n
	depends on GPIOLIB

	select FB_OMAP2_DSS
	select OMAP2_VRFB if ARCH_OMAP2 || ARCH_OMAP3
	select FB_CFB_FILLRECT
	select FB_CFB_COPYAREA
	select FB_CFB_IMAGEBLIT
	help
	  Frame buffer driver for OMAP2+ based boards.

if FB_OMAP2

config FB_OMAP2_DEBUG_SUPPORT
	bool "Debug support for OMAP2+ FB"
	default y
	depends on FB_OMAP2
	help
	  Support for debug output. You have to enable the actual printing
	  with 'debug' module parameter.

config FB_OMAP2_NUM_FBS
	int "Number of framebuffers"
	range 1 10
	default 3
	depends on FB_OMAP2
	help
	  Select the number of framebuffers created. OMAP2/3 has 3 overlays
	  so normally this would be 3.

source "drivers/video/fbdev/omap2/omapfb/dss/Kconfig"
source "drivers/video/fbdev/omap2/omapfb/displays/Kconfig"

endif
```

## drivers/video/fbdev/omap2/omapfb/displays/Kconfig
```kconfig
menu "OMAPFB Panel and Encoder Drivers"
	depends on FB_OMAP2_DSS

config FB_OMAP2_ENCODER_OPA362
	tristate "OPA362 external analog amplifier"
	help
	  Driver for OPA362 external analog TV amplifier controlled
	  through a GPIO.

config FB_OMAP2_ENCODER_TFP410
	tristate "TFP410 DPI to DVI Encoder"
	help
	  Driver for TFP410 DPI to DVI encoder.

config FB_OMAP2_ENCODER_TPD12S015
	tristate "TPD12S015 HDMI ESD protection and level shifter"
	help
	  Driver for TPD12S015, which offers HDMI ESD protection and level
	  shifting.

config FB_OMAP2_CONNECTOR_DVI
	tristate "DVI Connector"
	depends on I2C
	help
	  Driver for a generic DVI connector.

config FB_OMAP2_CONNECTOR_HDMI
	tristate "HDMI Connector"
	help
	  Driver for a generic HDMI connector.

config FB_OMAP2_CONNECTOR_ANALOG_TV
	tristate "Analog TV Connector"
	help
	  Driver for a generic analog TV connector.

config FB_OMAP2_PANEL_DPI
	tristate "Generic DPI panel"
	help
	  Driver for generic DPI panels.

config FB_OMAP2_PANEL_DSI_CM
	tristate "Generic DSI Command Mode Panel"
	depends on BACKLIGHT_CLASS_DEVICE
	help
	  Driver for generic DSI command mode panels.

config FB_OMAP2_PANEL_SONY_ACX565AKM
	tristate "ACX565AKM Panel"
	depends on SPI && BACKLIGHT_CLASS_DEVICE
	help
	  This is the LCD panel used on Nokia N900

config FB_OMAP2_PANEL_LGPHILIPS_LB035Q02
	tristate "LG.Philips LB035Q02 LCD Panel"
	depends on SPI
	help
	  LCD Panel used on the Gumstix Overo Palo35

config FB_OMAP2_PANEL_SHARP_LS037V7DW01
	tristate "Sharp LS037V7DW01 LCD Panel"
	depends on BACKLIGHT_CLASS_DEVICE
	help
	  LCD Panel used in TI's SDP3430 and EVM boards

config FB_OMAP2_PANEL_TPO_TD028TTEC1
	tristate "TPO TD028TTEC1 LCD Panel"
	depends on SPI
	help
	  LCD panel used in Openmoko.

config FB_OMAP2_PANEL_TPO_TD043MTEA1
	tristate "TPO TD043MTEA1 LCD Panel"
	depends on SPI
	help
	  LCD Panel used in OMAP3 Pandora

config FB_OMAP2_PANEL_NEC_NL8048HL11
	tristate "NEC NL8048HL11 Panel"
	depends on SPI
	depends on BACKLIGHT_CLASS_DEVICE
	help
	  This NEC NL8048HL11 panel is TFT LCD used in the
	  Zoom2/3/3630 sdp boards.

endmenu
```

## drivers/video/geode/Kconfig
```kconfig
#
# Geode family framebuffer configuration
#
config FB_GEODE
	bool "AMD Geode family framebuffer support (EXPERIMENTAL)"
	depends on FB && PCI && EXPERIMENTAL && X86
	---help---
	  Say 'Y' here to allow you to select framebuffer drivers for
	  the AMD Geode family of processors.

config FB_GEODE_LX
	tristate "AMD Geode LX framebuffer support (EXPERIMENTAL)"
	depends on FB && FB_GEODE
	select FB_CFB_FILLRECT
	select FB_CFB_COPYAREA
	select FB_CFB_IMAGEBLIT
	---help---
	  Framebuffer driver for the display controller integrated into the
	  AMD Geode LX processors.

	  To compile this driver as a module, choose M here: the module will
	  be called lxfb.

	  If unsure, say N.

config FB_GEODE_GX
	tristate "AMD Geode GX framebuffer support (EXPERIMENTAL)"
	depends on FB && FB_GEODE && EXPERIMENTAL
	select FB_CFB_FILLRECT
	select FB_CFB_COPYAREA
	select FB_CFB_IMAGEBLIT
	---help---
	  Framebuffer driver for the display controller integrated into the
	  AMD Geode GX processors.

	  To compile this driver as a module, choose M here: the module will be
	  called gxfb.

	  If unsure, say N.

config FB_GEODE_GX_SET_FBSIZE
	bool "Manually specify the Geode GX framebuffer size"
	depends on FB_GEODE_GX
	default n
	---help---
	  If you want to manually specify the size of your GX framebuffer,
	  say Y here, otherwise say N to dynamically probe it.

	  Say N unless you know what you are doing.

config FB_GEODE_GX_FBSIZE
	hex "Size of the GX framebuffer, in bytes"
	depends on FB_GEODE_GX_SET_FBSIZE
	default "0x1600000"
	---help---
	  Specify the size of the GX framebuffer.  Normally, you will
	  want this to be MB aligned.  Common values are 0x80000 (8MB)
	  and 0x1600000 (16MB).  Don't change this unless you know what
	  you are doing

config FB_GEODE_GX1
	tristate "AMD Geode GX1 framebuffer support (EXPERIMENTAL)"
	depends on FB && FB_GEODE && EXPERIMENTAL
	select FB_CFB_FILLRECT
	select FB_CFB_COPYAREA
	select FB_CFB_IMAGEBLIT
	---help---
	  Framebuffer driver for the display controller integrated into the
	  AMD Geode GX1 processor.

	  To compile this driver as a module, choose M here: the module will be
	  called gx1fb.

	  If unsure, say N.
```

## drivers/video/hdmi/Kconfig
```kconfig
#
# Display drivers configuration
#
menu "HDMI"
config HDMI
	bool "HDMI support"
    select FB_WORK_IPP
	select FB_SCALING_OSD
if HDMI
source "drivers/video/hdmi/chips/Kconfig"


config HDMI_SAVE_DATA
	bool "enable hdmi save data"	
	help 
		Enable hdmi save data in rtc register
		
config HDMI_DUAL_DISP
	bool "dual display support"
	depends on RK610_HDMI
	help
		Support output lcd and hdmi at the same time.

#config HDMI_DEBUG
#	bool "hdmi debug"
endif

endmenu
```

## drivers/video/hdmi/chips/Kconfig
```kconfig
choice
	prompt "HDMI chips select"
config ANX7150
	bool "anx7150"
config ANX9030
	bool "anx9030"
config RK610_HDMI
	bool "RK610(Jetta) hdmi support"
	depends on MFD_RK610
	help
		Support Jetta(RK610) to hdmi.
endchoice
```

## drivers/video/hdmi/hdmi-new/Kconfig
```kconfig
#
# Display drivers configuration
#

source "drivers/video/hdmi/hdmi-new/chips/Kconfig"
```

## drivers/video/hdmi/hdmi-new/chips/Kconfig
```kconfig
choice
	prompt "HDMI chips select"
config ANX7150_NEW
	bool "anx7150"
config ANX9030_NEW
	bool "anx9030"
endchoice
```

## drivers/video/hdmi/hdmi-old/Kconfig
```kconfig
#
# Display drivers configuration
#

source "drivers/video/hdmi/hdmi-old/chips/Kconfig"
```

## drivers/video/hdmi/hdmi-old/chips/Kconfig
```kconfig
choice
	prompt "HDMI chips select"
config ANX7150
	bool "anx7150"
config ANX9030
	bool "anx9030"
endchoice
```
