## drivers/input/lightsensor/Kconfig
```kconfig
#
# gsensor drivers configuration
#

menuconfig LIGHT_SENSOR_DEVICE
	bool "light_sensor device support"
	default n	
	help
	  Enable this to be able to choose the drivers for controlling the
	  light_sensor on some platforms, for example on PDAs.

if LIGHT_SENSOR_DEVICE

config CM3202
  bool "cm3202"
	depends on LIGHT_SENSOR_DEVICE
	default n
	help	 
	  To have support for your specific gsesnor you will have to
	  select the proper drivers which depend on this option.

config LS_CM3217
  bool "cm3217"
	depends on LIGHT_SENSOR_DEVICE
	default n
	help	 
	  To have support for your specific gsesnor you will have to
	  select the proper drivers which depend on this option.
	  
endif
```

## drivers/input/magnetometer/Kconfig
```kconfig
#
# Magnetometer sensors
#

comment "Magnetometer sensors"

config COMPASS_AK8975
  tristate "Asahi Kasei AK8975 3-Axis Magnetometer"
  depends on I2C
  help
  Say yes here to build support for Asahi Kasei AK8975 3-Axis
  Magnetometer.

  To compile this driver as a module, choose M here: the module
  will be called ak8975.

config COMPASS_AK8973
  tristate "Asahi Kasei AK8973 3-Axis Magnetometer"
  depends on I2C
  help
  Say yes here to build support for Asahi Kasei AK8973 3-Axis
  Magnetometer.

  To compile this driver as a module, choose M here: the module
  will be called ak8973.
```
