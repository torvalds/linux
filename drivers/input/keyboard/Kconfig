## drivers/input/touchscreen/ct36x/Kconfig
```kconfig
# SPDX-License-Identifier: GPL-2.0
#
# Adc hardware configuration
#

config CT360_TS
	tristate "ct360"

config CT361_TS
	tristate "ct361"

config CT363_TS
	tristate "ct363"
```

## drivers/input/touchscreen/cyttsp5/Kconfig
```kconfig
# SPDX-License-Identifier: GPL-2.0-only
#
#  Touchscreen driver configuration
#
config TOUCHSCREEN_CYPRESS_CYTTSP5
	tristate "Parade TrueTouch Gen5 Touchscreen Driver"
	help
	  Core driver for Parade TrueTouch(tm) Standard Product
	  Geneartion5 touchscreen controllers.

	  Say Y here if you have a Parade Gen5 touchscreen.

	  If unsure, say N.

	  To compile this driver as a module, choose M here: the
	  module will be called cyttsp5.

config TOUCHSCREEN_CYPRESS_CYTTSP5_DEVICETREE_SUPPORT
	bool "Enable Device Tree support"
	depends on TOUCHSCREEN_CYPRESS_CYTTSP5 && OF
	help
	  Say Y here to enable support for device tree.

	  If unsure, say N.

config TOUCHSCREEN_CYPRESS_CYTTSP5_I2C
	tristate "Parade TrueTouch Gen5 I2C"
	depends on TOUCHSCREEN_CYPRESS_CYTTSP5
	select I2C
	help
	  Say Y here to enable I2C bus interface to Parade TrueTouch(tm)
	  Standard Product Generation5 touchscreen controller.

	  If unsure, say Y.

	  To compile this driver as a module, choose M here: the
	  module will be called cyttsp5_i2c.

config TOUCHSCREEN_CYPRESS_CYTTSP5_SPI
	tristate "Parade TrueTouch Gen5 SPI"
	depends on TOUCHSCREEN_CYPRESS_CYTTSP5
	select SPI
	help
	  Say Y here to enable SPI bus interface to Parade TrueTouch(tm)
	  Standard Product Generation5 touchscreen controller.

	  If unsure, say N.

	  To compile this driver as a module, choose M here: the
	  module will be called cyttsp5_spi.

choice
	bool "Parade TrueTouch Gen5 MultiTouch Protocol"
	depends on TOUCHSCREEN_CYPRESS_CYTTSP5
	default TOUCHSCREEN_CYPRESS_CYTTSP5_MT_B
	help
	  This option controls which MultiTouch protocol will be used to
	  report the touch events.

config TOUCHSCREEN_CYPRESS_CYTTSP5_MT_A
	bool "Protocol A"
	help
	  Select to enable MultiTouch touch reporting using protocol A
	  on Parade TrueTouch(tm) Standard Product Generation4 touchscreen
	  controller.

config TOUCHSCREEN_CYPRESS_CYTTSP5_MT_B
	bool "Protocol B"
	help
	  Select to enable MultiTouch touch reporting using protocol B
	  on Parade TrueTouch(tm) Standard Product Generation4 touchscreen
	  controller.

endchoice

config TOUCHSCREEN_CYPRESS_CYTTSP5_BUTTON
	bool "Parade TrueTouch Gen5 MultiTouch CapSense Button"
	depends on TOUCHSCREEN_CYPRESS_CYTTSP5
	help
	  Say Y here to enable CapSense reporting on Parade TrueTouch(tm)
	  Standard Product Generation5 touchscreen controller.

	  If unsure, say N.

config TOUCHSCREEN_CYPRESS_CYTTSP5_PROXIMITY
	bool "Parade TrueTouch Gen5 Proximity"
	depends on TOUCHSCREEN_CYPRESS_CYTTSP5
	help
	  Say Y here to enable proximity reporting on Parade TrueTouch(tm)
	  Standard Product Generation5 touchscreen controller.

	  If unsure, say N.

config TOUCHSCREEN_CYPRESS_CYTTSP5_DEVICE_ACCESS
	tristate "Parade TrueTouch Gen5 MultiTouch Device Access"
	depends on TOUCHSCREEN_CYPRESS_CYTTSP5
	help
	  Say Y here to enable Parade TrueTouch(tm) Standard Product
	  Generation5 touchscreen controller device access module.

	  This modules adds an interface to access touchscreen
	  controller using driver sysfs nodes.

	  If unsure, say N.

	  To compile this driver as a module, choose M here: the
	  module will be called cyttsp5_device_access.

config TOUCHSCREEN_CYPRESS_CYTTSP5_DEVICE_ACCESS_API
	bool "Enable Device Access kernel API"
	depends on TOUCHSCREEN_CYPRESS_CYTTSP5_DEVICE_ACCESS
	help
	  Say Y here to enable Device access kernel API which provides
	  access to Parade TrueTouch(tm) Standard Product Generation5
	  touchscreen controller for other modules.

	  If unsure, say N.

config TOUCHSCREEN_CYPRESS_CYTTSP5_TEST_DEVICE_ACCESS_API
	tristate "Simple Test module for Device Access kernel API"
	depends on TOUCHSCREEN_CYPRESS_CYTTSP5_DEVICE_ACCESS
	depends on TOUCHSCREEN_CYPRESS_CYTTSP5_DEVICE_ACCESS_API
	help
	  Say Y here to enable test module for Device access kernel API.

	  If unsure, say N.

	  To compile this driver as a module, choose M here: the
	  module will be called cyttsp5_test_device_access_api.

config TOUCHSCREEN_CYPRESS_CYTTSP5_LOADER
	tristate "Parade TrueTouch Gen5 MultiTouch Loader"
	depends on TOUCHSCREEN_CYPRESS_CYTTSP5
	help
	  Say Y here to enable Parade TrueTouch(tm) Standard Product
	  Generation5 touchscreen controller FW Loader module.

	  This module enables support for Firmware upgrade.

	  If unsure, say Y.

	  To compile this driver as a module, choose M here: the
	  module will be called cyttsp5_loader.

config TOUCHSCREEN_CYPRESS_CYTTSP5_PLATFORM_FW_UPGRADE
	bool "FW upgrade from header file"
	depends on TOUCHSCREEN_CYPRESS_CYTTSP5_LOADER
	help
	  Say Y here to include Parade TrueTouch(tm) Standard Product
	  Generation5 device Firmware into driver.

	  Need proper header file for this.

	  If unsure, say N.

config TOUCHSCREEN_CYPRESS_CYTTSP5_BINARY_FW_UPGRADE
	bool "FW upgrade from binary file"
	depends on TOUCHSCREEN_CYPRESS_CYTTSP5_LOADER
	help
	  Say Y here to include Parade TrueTouch(tm) Standard Product
	  Generation5 device Firmware into kernel as binary blob.

	  This should be enabled for manual FW upgrade support.

	  If unsure, say Y.

config TOUCHSCREEN_CYPRESS_CYTTSP5_PLATFORM_TTCONFIG_UPGRADE
	bool "TT Configuration upgrade from header file"
	depends on TOUCHSCREEN_CYPRESS_CYTTSP5_LOADER
	help
	  Say Y here to include Parade TrueTouch(tm) Standard Product
	  Generation5 device TrueTouch Configuration into kernel itself.

	  Need proper header file for this.

	  If unsure, say N.

config TOUCHSCREEN_CYPRESS_CYTTSP5_MANUAL_TTCONFIG_UPGRADE
	bool "TT Configuration upgrade via SysFs"
	depends on TOUCHSCREEN_CYPRESS_CYTTSP5_LOADER
	help
	  Say Y here to provide a SysFs interface to upgrade TrueTouch
	  Configuration with a binary configuration file.

	  Need proper binary version of config file for this
	  feature.

	  If unsure, say Y.

config TOUCHSCREEN_CYPRESS_CYTTSP5_DEBUG_MDL
	tristate "Parade TrueTouch Gen5 MultiTouch Debug Module"
	depends on TOUCHSCREEN_CYPRESS_CYTTSP5
	help
	  Say Y here to enable Parade TrueTouch(tm) Standard Product
	  Generation5 Debug module.

	  This module adds support for verbose printing touch
	  information.

	  If unsure, say N.

	  To compile this driver as a module, choose M here: the
	  module will be called cyttsp5_debug.

          
```

## drivers/input/touchscreen/gt9xx/Kconfig
```kconfig
if TOUCHSCREEN_GT9XX

config GT911
	bool "GT911 Support"
	default n

	---help---
		Say Y here if you have a touchscreen interface using the
		two goodix gt911, and your board-specific initialization
		code includes that in its table of IIC devices.
		If unsure, say N.

endif
```

## drivers/input/touchscreen/nt36523/Kconfig
```kconfig
#
# Novatek NT36523 touchscreen driver configuration
#
config TOUCHSCREEN_NT36523_SPI
	tristate "Novatek NT36523 no flash SPI driver"
	default n
	help
	  Say Y here if you have a Novatek NT36523 no flash touchscreen connected
	  to your system by SPI bus.

	  If unsure, say N.
```

## drivers/input/touchscreen/rmi4/Kconfig
```kconfig
# SPDX-License-Identifier: GPL-2.0
#
# RMI4 configuration
#
config RMI4_BUS
	bool "Synaptics RMI4 bus support"
	depends on TOUCHSCREEN_SYNAPTICS_RMI4_I2C_RK
	help
	  Say Y here if you want to support the Synaptics RMI4 bus.

	  If unsure, say Y.

	  This feature is not currently available as
	  a loadable module.

config RMI4_DEBUG
	bool "Synaptics RMI4 debugging"
	depends on RMI4_BUS
	help
	  Say Y here to enable debug feature in the RMI4 driver.

	  Note that the RMI4 driver debug features can generate a lot of
	  output (potentially clogging up your dmesg output) and generally
	  slow down driver operation.  It's recommended to enable them only
	  if you are actively developing/debugging RMI4 features.

	  If unsure, say N.

config RMI4_I2C
	bool "RMI4 I2C Support"
	depends on RMI4_BUS && I2C
	help
	  Say Y here if you want to support RMI4 devices connected to an I2C
	  bus.

	  If unsure, say Y.

	  This feature is not currently available as a loadable module.

config RMI4_I2C_SCL_RATE
	int "RMI4 I2C SCL RATE Support"
	depends on RMI4_I2C

config RMI4_SPI
	bool "RMI4 SPI Support"
	depends on RMI4_BUS && SPI
	help
	  Say Y here if you want to support RMI4 devices connected to an SPI
	  bus.

	  If unsure, say Y.

	  This feature is not currently available as a loadable module.

config RMI4_GENERIC
	bool "RMI4 Generic driver"
	depends on RMI4_BUS
	help
	  Say Y here if you want to support generic RMI4 devices.

	  This is pretty much required if you want to do anything useful with
	  your RMI device.

	  This feature is not currently available as a loadable module.


config RMI4_F1A
	tristate "RMI4 Function 1A (capacitive button sensor)"
	depends on RMI4_BUS && RMI4_GENERIC
	help
	  Say Y here if you want to add support for RMI4 function 1A.

	  Function 1A provides self testing for touchscreens and touchpads.

	  To compile this driver as a module, choose M here: the
	  module will be called rmi-f1a.

config RMI4_F09
	tristate "RMI4 Function 09 (self testing)"
	depends on RMI4_BUS && RMI4_GENERIC
	help
	  Say Y here if you want to add support for RMI4 function 09.

	  Function 09 provides self testing for touchscreens and touchpads.

	  To compile this driver as a module, choose M here: the
	  module will be called rmi-f09.

config RMI4_F11
	tristate "RMI4 Function 11 (2D pointing)"
	depends on RMI4_BUS && RMI4_GENERIC
	help
	  Say Y here if you want to add support for RMI4 function 11.

	  Function 11 provides 2D multifinger pointing for touchscreens and
	  touchpads.  For sensors that support relative pointing, F11 also
	  provides mouse input.

	  To compile this driver as a module, choose M here: the
	  module will be called rmi-f11.

config RMI4_F11_PEN
	bool "RMI4 F11 Pen Support"
	depends on RMI4_F11
	help
	  Say Y here to add support for pen input to RMI4 function 11.

	  If this feature is enabled, when pen inputs are detected they
	  will be reported to the input stream as MT_TOOL_PEN.  Otherwise,
	  pens will be treated the same as fingers.

	  Not all UI implementations deal gracefully with pen discrimination.
	  If your system is not recognizing pen touches and you know your
	  sensor supports pen input, you probably want to turn this feature
	  off.

config RMI4_VIRTUAL_BUTTON
	tristate "RMI4 Vitual Button"
	depends on RMI4_F11
	help
	  Say Y here if you want to add support for RMI4 virtual button to F11.

	  The virtual button feature implement the virtual button device in
	  certain RMI4 touch sensors.

	  This works only if your sensor supports F11 gestures.

config RMI4_F17
	tristate "RMI4 Function 17 (pointing sticks)"
	depends on RMI4_BUS && RMI4_GENERIC
	help
	  Say Y here if you want to add support for RMI4 function 17.

	  Function 19 provides support for capacitive and resistive
	  pointing sticks.

	  To compile this driver as a module, choose M here: the
	  module will be called rmi-f17.

config RMI4_F19
	tristate "RMI4 Function 19 (0D pointing)"
	depends on RMI4_BUS && RMI4_GENERIC
	help
	  Say Y here if you want to add support for RMI4 function 19.

	  Function 19 provides support for capacitive buttons for sensors
	  that implement capacitive buttons.

	  To compile this driver as a module, choose M here: the
	  module will be called rmi-f19.
	  
config RMI4_F21
	tristate "RMI4 Function 21 (2D Force)"
	depends on RMI4_BUS && RMI4_GENERIC
	help
	  Say Y here if you want to add support for RMI4 function 21.

	  Function 21 provides 2D Force Sensing for ForcePad products.

	  To compile this driver as a module, choose M here: the
	  module will be called rmi-f21.

config RMI4_F34
	tristate "RMI4 Function 34 (device reflash)"
	depends on RMI4_BUS && RMI4_GENERIC
	help
	  Say Y here if you want to add support for RMI4 function 34.

	  Function 34 provides firmware upgrade capability for your sensor.

	  To compile this driver as a module, choose M here: the
	  module will be called rmi-f34.
config RMI4_REFLASH_WHEN_BOOT
	tristate "RMI4 Function 34 (device reflash when system boot)"
	depends on RMI4_BUS && RMI4_GENERIC

config RMI4_F54
	tristate "RMI4 Function 54 (analog diagnostics)"
	depends on RMI4_BUS && RMI4_GENERIC
	help
	  Say Y here if you want to add support for RMI4 function 54.

	  Function 54 provides access to various diagnostic features in
	  certain RMI4 touch sensors.

	  To compile this driver as a module, choose M here: the
	  module will be called rmi-f54.

config RMI4_DEV
	tristate "Synaptics direct RMI device support (rmidev)"
	depends on GPIO_SYSFS && (RMI4_I2C || RMI4_SPI)
	help
	  Say Y here to add support for rmidev.

	  The rmidev feature implements a character device providing access
	  to RMI4 sensor register maps.

	  To compile this driver as a module, choose M here: the
	  module will be called rmi-dev.
```
