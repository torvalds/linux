## drivers/input/sensors/accel/Kconfig
```kconfig
# SPDX-License-Identifier: GPL-2.0
#
# gsensor drivers configuration
#

menuconfig GSENSOR_DEVICE
	tristate "g_sensor device support"
	default n
	help
	  Enable this to be able to choose the drivers for controlling the
	  g_sensor on some platforms, for example on PDAs.

if GSENSOR_DEVICE
config GS_MMA8452
	tristate "gsensor mma8451/mma8452/mma8453/mma8653"
	default n
	help
	  To have support for your specific gsesnor you will have to
	  select the proper drivers which depend on this option.

config STK8BAXX_ACC
	tristate "gsensor STK8BAXX"
	default n
	help
	  To have support for your specific gsesnor you will have to
	  select the proper drivers which depend on this option.

config MPU6880_ACC
	tristate "Sensor mpu6880_acc"
	default n
	help
	  To have support for your specific gsesnor you will have to
	  select the proper drivers which depend on this option.

config MPU6500_ACC
	tristate "Sensor mpu6500_acc"
	default n
	help
	  To have support for your specific gsesnor you will have to
	  select the proper drivers which depend on this option.

config GS_KXTIK
	tristate "gsensor kxtik"
	help
	  To have support for your specific gsesnor you will have to
	  select the proper drivers which depend on this option.

config GS_KXTJ9
	tristate "gsensor kxtj9"
	help
	  To have support for your specific gsesnor you will have to
	  select the proper drivers which depend on this option.

config GS_LIS3DH
	tristate "gsensor lis3dh"
	default n
	help
	  To have support for your specific gsesnor you will have to
	  select the proper drivers which depend on this option.

config GS_MMA7660
	tristate "gsensor mma7660"
	default n
	help
	  To have support for your specific gsesnor you will have to
	  select the proper drivers which depend on this option.

config GS_MC3230
	tristate "gsensor mc3230"
	help
	  To have support for your specific gsesnor you will have to
	  select the proper drivers which depend on this option.

config GS_SC7660
	tristate "gsensor sc7660"
	help
	  To have support for your specific gsesnor you will have to
	  select the proper drivers which depend on this option.

config GS_SC7A20
	tristate "gsensor sc7a20"
	help
	  To have support for your specific gsesnor you will have to
	  select the proper drivers which depend on this option.

config GS_SC7A30
	tristate "gsensor sc7a30"
	help
	  To have support for your specific gsesnor you will have to
	  select the proper drivers which depend on this option.

config GS_MXC6225
	tristate "gsensor mxc6225"
	help
	  To have support for your sepcific gsensor you will have to
	  select het proper drivers which depend on this option.

config GS_MXC6655XA
	tristate "gsensor mxc6655xa"
	help
	  To have support for your sepcific gsensor you will have to
	  select het proper drivers which depend on this option.

config GS_DMT10
	tristate "gsensor dmard10"
	help
	  To have support for your sepcific gsensor you will have to
	  select het proper drivers which depend on this option.

config GS_LSM303D
	tristate "gsensor lsm303d"
	default n
	help
	  To have support for your sepcific gsensor you will have to
	  select het proper drivers which depend on this option.

config GS_BMA023
	tristate "gsensor bma023"
	help
	  To have support for your specific gsesnor you will have to
	  select the proper drivers which depend on this option.

config LSM330_ACC
	tristate "gsensor lsm330"
	default n
	help
	  To have support for your specific gsesnor you will have to
	  select the proper drivers which depend on this option.

config BMA2XX_ACC
	tristate "Sensor bma2xx_acc"
	default n
	help
	  To have support for your specific gsesnor you will have to
	  select the proper drivers which depend on this option.

config GS_DA215S
	tristate "gsensor da215s"
	help
	  To have support for your specific gsesnor you will have to
	  select the proper drivers which depend on this option.

config GS_DA223
	tristate "gsensor da223"
	help
	  To have support for your specific gsesnor you will have to
	  select the proper drivers which depend on this option.

config GS_DA228E
	tristate "gsensor da228e"
	help
	  To have support for your specific gsesnor you will have to
	  select the proper drivers which depend on this option.

config ICM2060X_ACC
	tristate "gsensor icm2060x"
	help
	  To have support for your specific gsesnor you will have to
	  select the proper drivers which depend on this option.

endif
```

## drivers/input/sensors/angle/Kconfig
```kconfig
# SPDX-License-Identifier: GPL-2.0
#
# gsensor drivers configuration
#

menuconfig ANGLE_DEVICE
	tristate "angle device support"
	help
	  Enable this to be able to choose the drivers for controlling the
	  g_sensor on some platforms, for example on PDAs.

if ANGLE_DEVICE

config ANGLE_KXTIK
	tristate "angle kxtik"
	help
	  To have support for your specific gsesnor you will have to
	  select the proper drivers which depend on this option.

config ANGLE_LIS3DH
	tristate "angle lis3dh"
	help
	  To have support for your specific gsesnor you will have to
	  select the proper drivers which depend on this option.

endif
```

## drivers/input/sensors/compass/Kconfig
```kconfig
# SPDX-License-Identifier: GPL-2.0
#
# Magnetometer drivers configuration
#

menuconfig COMPASS_DEVICE
	tristate "Magnetometer sensors"
	default y
	help
	  Say Y here, and a list of Magnetometer sensors drivers will be displayed.
	  Everything that didn't fit into the other categories is here. This option
	  doesn't affect the kernel.

	  If unsure, say Y.

if COMPASS_DEVICE

config COMPASS_AK8975
  tristate "Asahi Kasei AK8975 3-Axis Magnetometer"
  depends on I2C
  default y
  help
  Say yes here to build support for Asahi Kasei AK8975 3-Axis
  Magnetometer.

  To compile this driver as a module, choose M here: the module
  will be called ak8975.

config COMPASS_AK8963
  tristate "Asahi Kasei AK8963 3-Axis Magnetometer"
  depends on I2C
  default y
  help
  Say yes here to build support for Asahi Kasei AK8963 3-Axis Magnetometer.

  To compile this driver as a module, choose M here: the module
  will be called ak8963.


config COMPASS_AK09911
  tristate "Asahi Kasei AK09911 3-Axis Magnetometer"
  depends on I2C
  help
  Say yes here to build support for Asahi Kasei AK09911 3-Axis Magnetometer.

  To compile this driver as a module, choose M here: the module
  will be called AK09911.

config COMPASS_MMC328X
  tristate "Mmc328x 3-Axis Magnetometer"
  depends on I2C
  help
  Say yes here to build support for mmc3280 3-Axis
  Magnetometer.

  To compile this driver as a module, choose M here: the module
  will be called mmc3280. 

endif
```

## drivers/input/sensors/gyro/Kconfig
```kconfig
# SPDX-License-Identifier: GPL-2.0
#
# gyroscope drivers configuration
#

menuconfig GYROSCOPE_DEVICE
	tristate "gyroscope device support"
	default n

if GYROSCOPE_DEVICE

config GYRO_L3G4200D
	tristate "gyroscope l3g4200d"
	default n

config GYRO_K3G
	tristate "gyroscope k3g"
	default n

config GYRO_L3G20D
	tristate "gyroscope l3g20d"
	default n

config GYRO_EWTSA
	tristate "gyroscope ewtsa"
	default n

config GYRO_MPU6500
	tristate "gyroscope mpu6500_gyro"
        default n

config GYRO_MPU6880
	tristate "gyroscope mpu6880_gyro"
	default n

config GYRO_LSM330
	tristate "gyroscope lsm330_gyro"
	default n

config GYRO_ICM2060X
	tristate "gyroscope icm2060x_gyro"
endif
```

## drivers/input/sensors/hall/Kconfig
```kconfig
# SPDX-License-Identifier: GPL-2.0
#
# hall  sensor drivers configuration
#

menuconfig HALL_DEVICE
	tristate "hall sensor device support"

if HALL_DEVICE
config HS_OCH165T
	tristate "hall sensor och165t"

config HS_MH248
	tristate "hall sensor mh248"

endif
```

## drivers/input/sensors/lsensor/Kconfig
```kconfig
# SPDX-License-Identifier: GPL-2.0
#
# light and position sensor drivers configuration
#

menuconfig LIGHT_DEVICE
	tristate "light sensor device support"
	default n

if LIGHT_DEVICE
config LS_CM3217
	tristate "light sensor cm3217"
	default n
	
config LS_CM3218
	tristate "light sensor cm3218"
	default n
 
config LS_CM3232
	tristate "light sensor cm3232"
	default n
 
config LS_AL3006
	tristate "light sensor al3006"
	default n

config LS_STK3171
	tristate "light sensor stk3171"
	default n	 

config LS_ISL29023
	tristate "light sensor isl29023"
	default n	  
	
config LS_AP321XX
	tristate "light sensor ap321xx"
	default n

config LS_US5152
	tristate "light sensor us5152"
        default n

config LS_STK3410
	tristate "light sensor stk3410"
	default n

config LS_EM3071X
	tristate "light sensor em3071x"
endif
```

## drivers/input/sensors/pressure/Kconfig
```kconfig
# SPDX-License-Identifier: GPL-2.0
#
# pressure sensor drivers configuration
#

menuconfig PRESSURE_DEVICE
	tristate "pressure sensor device support"
	default n

if PRESSURE_DEVICE
 config PR_MS5607
	 tristate "pressure sensor ms5607"
	 default n
 
endif
```

## drivers/input/sensors/psensor/Kconfig
```kconfig
# SPDX-License-Identifier: GPL-2.0
#
# light and position sensor drivers configuration
#

menuconfig PROXIMITY_DEVICE
	tristate "proximity sensor device support"
	default n

if PROXIMITY_DEVICE

config PS_AL3006
	tristate "psensor al3006"
	default n

config PS_STK3171
	tristate "psensor stk3171"
	default n

config PS_AP321XX
	tristate "psensor ap321xx"
	default n

config PS_STK3332
	tristate "proximity sensor stk3332"

config PS_STK3410
	tristate "proximity sensor stk3410"
	default n

config PS_EM3071X
	tristate "proximity sensor em3071x"

config PS_UCS14620
	tristate "proximity sensor ucs14620"
	default n

endif
```

## drivers/input/sensors/temperature/Kconfig
```kconfig
# SPDX-License-Identifier: GPL-2.0
#
# temperature sensor drivers configuration
#

menuconfig TEMPERATURE_DEVICE
	tristate "temperature sensor device support"
	default n

if TEMPERATURE_DEVICE
 config TMP_MS5607
	tristate"temperature sensor ms5607"
 	default n
 
endif
```
