## drivers/input/ts/Kconfig
```kconfig
# SPDX-License-Identifier: GPL-2.0
#
# all auto touch screen drivers configuration
#

menuconfig TS_AUTO
	bool "auto touch screen driver support"
	default n	

if TS_AUTO

source "drivers/input/ts/chips/Kconfig"

endif
```

## drivers/input/ts/chips/Kconfig
```kconfig
# SPDX-License-Identifier: GPL-2.0
menuconfig TS_AUTO_I2C
	bool "Support auto touch screen with I2C"
	default n	
	
if TS_AUTO_I2C

config TS_FT5306
bool "touch screen ft5306"
	default n
 
config TS_GT8110
	bool "touch screen gt8110"
	default n	

config TS_GT828
	bool "touch screen gt828"
	default n

config TS_CT360
	bool "touch screen ct360"
	default n
	
endif

config TS_AUTO_SPI
	bool "Support auto touch screen with SPI"
	depends on SPI_MASTER

if TS_AUTO_SPI
	
endif

config TS_AUTO_SERIAL
	bool "Support auto touch screen with UART"
	
if TS_AUTO_SERIAL
	
endif
```

## drivers/interconnect/Kconfig
```kconfig
# SPDX-License-Identifier: GPL-2.0-only
menuconfig INTERCONNECT
	bool "On-Chip Interconnect management support"
	help
	  Support for management of the on-chip interconnects.

	  This framework is designed to provide a generic interface for
	  managing the interconnects in a SoC.

	  If unsure, say no.

if INTERCONNECT

source "drivers/interconnect/imx/Kconfig"
source "drivers/interconnect/mediatek/Kconfig"
source "drivers/interconnect/qcom/Kconfig"
source "drivers/interconnect/samsung/Kconfig"

config INTERCONNECT_CLK
	tristate
	depends on COMMON_CLK
	help
	  Support for wrapping clocks into the interconnect nodes.

config INTERCONNECT_KUNIT_TEST
	tristate "KUnit tests for Interconnect framework"
	depends on KUNIT
	default KUNIT_ALL_TESTS
	help
	  This builds the KUnit test suite for the generic system interconnect
	  framework.

	  The tests cover the core functionality of the interconnect subsystem,
	  including provider/consumer APIs, topology management, and bandwidth
	  aggregation logic.

	  If unsure, say N.

endif
```

## drivers/interconnect/imx/Kconfig
```kconfig
config INTERCONNECT_IMX
	tristate "i.MX interconnect drivers"
	depends on ARCH_MXC || COMPILE_TEST
	help
	  Generic interconnect drivers for i.MX SOCs

config INTERCONNECT_IMX8MM
	tristate "i.MX8MM interconnect driver"
	depends on INTERCONNECT_IMX

config INTERCONNECT_IMX8MN
	tristate "i.MX8MN interconnect driver"
	depends on INTERCONNECT_IMX

config INTERCONNECT_IMX8MQ
	tristate "i.MX8MQ interconnect driver"
	depends on INTERCONNECT_IMX

config INTERCONNECT_IMX8MP
	tristate "i.MX8MP interconnect driver"
	depends on INTERCONNECT_IMX
```

## drivers/interconnect/mediatek/Kconfig
```kconfig
# SPDX-License-Identifier: GPL-2.0-only

config INTERCONNECT_MTK
	bool "MediaTek interconnect drivers"
	depends on ARCH_MEDIATEK || COMPILE_TEST
	help
	  Support for MediaTek's bus interconnect hardware.

config INTERCONNECT_MTK_DVFSRC_EMI
	tristate "MediaTek DVFSRC EMI interconnect driver"
	depends on INTERCONNECT_MTK && MTK_DVFSRC
	help
	  This is a driver for the MediaTek External Memory Interface
	  interconnect on SoCs equipped with the integrated Dynamic
	  Voltage Frequency Scaling Resource Collector (DVFSRC) MCU

config INTERCONNECT_MTK_MT8183
	tristate "MediaTek MT8183 interconnect driver"
	depends on INTERCONNECT_MTK_DVFSRC_EMI
	help
	  This is a driver for the MediaTek bus interconnect on MT8183-based
	  platforms.

config INTERCONNECT_MTK_MT8195
	tristate "MediaTek MT8195 interconnect driver"
	depends on INTERCONNECT_MTK_DVFSRC_EMI
	help
	  This is a driver for the MediaTek bus interconnect on MT8195-based
	  platforms.
```
