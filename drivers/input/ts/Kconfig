## drivers/iommu/arm/Kconfig
```kconfig
# SPDX-License-Identifier: GPL-2.0-only
# ARM IOMMU support
config ARM_SMMU
	tristate "ARM Ltd. System MMU (SMMU) Support"
	depends on ARM64 || ARM || COMPILE_TEST
	depends on !GENERIC_ATOMIC64	# for IOMMU_IO_PGTABLE_LPAE
	select IOMMU_API
	select IOMMU_IO_PGTABLE_LPAE
	select ARM_DMA_USE_IOMMU if ARM
	help
	  Support for implementations of the ARM System MMU architecture
	  versions 1 and 2.

	  Say Y here if your SoC includes an IOMMU device implementing
	  the ARM SMMU architecture.

if ARM_SMMU
config ARM_SMMU_LEGACY_DT_BINDINGS
	bool "Support the legacy \"mmu-masters\" devicetree bindings"
	depends on ARM_SMMU=y && OF
	help
	  Support for the badly designed and deprecated "mmu-masters"
	  devicetree bindings. This allows some DMA masters to attach
	  to the SMMU but does not provide any support via the DMA API.
	  If you're lucky, you might be able to get VFIO up and running.

	  If you say Y here then you'll make me very sad. Instead, say N
	  and move your firmware to the utopian future that was 2016.

config ARM_SMMU_DISABLE_BYPASS_BY_DEFAULT
	bool "Disable unmatched stream bypass by default" if EXPERT
	default y
	help
	  If your firmware is broken and fails to describe StreamIDs which
	  Linux should know about in order to manage the SMMU correctly and
	  securely, and you don't want to boot with the 'arm-smmu.disable_bypass=0'
	  command line parameter, then as a last resort you can turn it off
	  by default here. But don't. This option may be removed at any time.

	  Note that 'arm-smmu.disable_bypass=1' will still take precedence.

config ARM_SMMU_MMU_500_CPRE_ERRATA
	bool "Enable errata workaround for CPRE in SMMU reset path"
	default y
	help
	  Say Y here (by default) to apply workaround to disable
	  MMU-500's next-page prefetcher for sake of 4 known errata.

	  Say N here only when it is sure that any errata related to
	  prefetch enablement are not applicable on the platform.
	  Refer silicon-errata.rst for info on errata IDs.

config ARM_SMMU_QCOM
	def_tristate y
	depends on ARCH_QCOM
	select QCOM_SCM
	help
	  When running on a Qualcomm platform that has the custom variant
	  of the ARM SMMU, this needs to be built into the SMMU driver.

config ARM_SMMU_QCOM_DEBUG
	bool "ARM SMMU QCOM implementation defined debug support"
	depends on ARM_SMMU_QCOM=y
	help
	  Support for implementation specific debug features in ARM SMMU
	  hardware found in QTI platforms. This include support for
	  the Translation Buffer Units (TBU) that can be used to obtain
	  additional information when debugging memory management issues
	  like context faults.

	  Say Y here to enable debug for issues such as context faults
	  or TLB sync timeouts which requires implementation defined
	  register dumps.
endif

config ARM_SMMU_V3
	tristate "ARM Ltd. System MMU Version 3 (SMMUv3) Support"
	depends on ARM64
	select IOMMU_API
	select IOMMU_IO_PGTABLE_LPAE
	select GENERIC_MSI_IRQ
	select IOMMUFD_DRIVER if IOMMUFD
	help
	  Support for implementations of the ARM System MMU architecture
	  version 3 providing translation support to a PCIe root complex.

	  Say Y here if your system includes an IOMMU device implementing
	  the ARM SMMUv3 architecture.

if ARM_SMMU_V3
config ARM_SMMU_V3_SVA
	bool "Shared Virtual Addressing support for the ARM SMMUv3"
	select IOMMU_SVA
	select IOMMU_IOPF
	select MMU_NOTIFIER
	help
	  Support for sharing process address spaces with devices using the
	  SMMUv3.

	  Say Y here if your system supports SVA extensions such as PCIe PASID
	  and PRI.

config ARM_SMMU_V3_IOMMUFD
	bool "Enable IOMMUFD features for ARM SMMUv3 (EXPERIMENTAL)"
	depends on IOMMUFD
	help
	  Support for IOMMUFD features intended to support virtual machines
	  with accelerated virtual IOMMUs.

	  Say Y here if you are doing development and testing on this feature.

config ARM_SMMU_V3_KUNIT_TEST
	tristate "KUnit tests for arm-smmu-v3 driver"  if !KUNIT_ALL_TESTS
	depends on KUNIT
	depends on ARM_SMMU_V3_SVA
	default KUNIT_ALL_TESTS
	help
	  Enable this option to unit-test arm-smmu-v3 driver functions.

	  If unsure, say N.

config TEGRA241_CMDQV
	bool "NVIDIA Tegra241 CMDQ-V extension support for ARM SMMUv3"
	depends on ACPI
	help
	  Support for NVIDIA CMDQ-Virtualization extension for ARM SMMUv3. The
	  CMDQ-V extension is similar to v3.3 ECMDQ for multi command queues
	  support, except with virtualization capabilities.

	  Say Y here if your system is NVIDIA Tegra241 (Grace) or it has the same
	  CMDQ-V extension.
endif

config QCOM_IOMMU
	# Note: iommu drivers cannot (yet?) be built as modules
	bool "Qualcomm IOMMU Support"
	depends on ARCH_QCOM || COMPILE_TEST
	depends on !GENERIC_ATOMIC64	# for IOMMU_IO_PGTABLE_LPAE
	select QCOM_SCM
	select IOMMU_API
	select IOMMU_IO_PGTABLE_LPAE
	select ARM_DMA_USE_IOMMU
	help
	  Support for IOMMU on certain Qualcomm SoCs.
```

## drivers/iommu/generic_pt/Kconfig
```kconfig
# SPDX-License-Identifier: GPL-2.0-only

menuconfig GENERIC_PT
	bool "Generic Radix Page Table" if COMPILE_TEST
	help
	  Generic library for building radix tree page tables.

	  Generic PT provides a set of HW page table formats and a common
	  set of APIs to work with them.

if GENERIC_PT
config DEBUG_GENERIC_PT
	bool "Extra debugging checks for GENERIC_PT"
	help
	  Enable extra run time debugging checks for GENERIC_PT code. This
	  incurs a runtime cost and should not be enabled for production
	  kernels.

	  The kunit tests require this to be enabled to get full coverage.

config IOMMU_PT
	tristate "IOMMU Page Tables"
	select IOMMU_API
	depends on IOMMU_SUPPORT
	depends on GENERIC_PT
	help
	  Generic library for building IOMMU page tables

	  IOMMU_PT provides an implementation of the page table operations
	  related to struct iommu_domain using GENERIC_PT. It provides a single
	  implementation of the page table operations that can be shared by
	  multiple drivers.

if IOMMU_PT
config IOMMU_PT_AMDV1
	tristate "IOMMU page table for 64-bit AMD IOMMU v1"
	depends on !GENERIC_ATOMIC64 # for cmpxchg64
	help
	  iommu_domain implementation for the AMD v1 page table. AMDv1 is the
	  "host" page table. It supports granular page sizes of almost every
	  power of 2 and decodes the full 64-bit IOVA space.

	  Selected automatically by an IOMMU driver that uses this format.

config IOMMU_PT_VTDSS
       tristate "IOMMU page table for Intel VT-d Second Stage"
	depends on !GENERIC_ATOMIC64 # for cmpxchg64
	help
	  iommu_domain implementation for the Intel VT-d's 64 bit 3/4/5
	  level Second Stage page table. It is similar to the X86_64 format with
	  4K/2M/1G page sizes.

	  Selected automatically by an IOMMU driver that uses this format.

config IOMMU_PT_X86_64
	tristate "IOMMU page table for x86 64-bit, 4/5 levels"
	depends on !GENERIC_ATOMIC64 # for cmpxchg64
	help
	  iommu_domain implementation for the x86 64-bit 4/5 level page table.
	  It supports 4K/2M/1G page sizes and can decode a sign-extended
	  portion of the 64-bit IOVA space.

	  Selected automatically by an IOMMU driver that uses this format.

config IOMMU_PT_KUNIT_TEST
	tristate "IOMMU Page Table KUnit Test" if !KUNIT_ALL_TESTS
	depends on KUNIT
	depends on IOMMU_PT_AMDV1 || !IOMMU_PT_AMDV1
	depends on IOMMU_PT_X86_64 || !IOMMU_PT_X86_64
	depends on IOMMU_PT_VTDSS || !IOMMU_PT_VTDSS
	default KUNIT_ALL_TESTS
	help
	  Enable kunit tests for GENERIC_PT and IOMMU_PT that covers all the
	  enabled page table formats. The test covers most of the GENERIC_PT
	  functions provided by the page table format, as well as covering the
	  iommu_domain related functions.

endif
endif
```

## drivers/iommu/intel/Kconfig
```kconfig
# SPDX-License-Identifier: GPL-2.0-only
# Intel IOMMU support
config DMAR_TABLE
	bool

config DMAR_PERF
	bool

config DMAR_DEBUG
	bool

config INTEL_IOMMU
	bool "Support for Intel IOMMU using DMA Remapping Devices"
	depends on PCI_MSI && ACPI && X86
	select IOMMU_API
	select IOMMU_IOVA
	select IOMMU_IOPF
	select IOMMUFD_DRIVER if IOMMUFD
	select NEED_DMA_MAP_STATE
	select DMAR_TABLE
	select SWIOTLB
	select PCI_ATS
	select PCI_PRI
	select PCI_PASID
	help
	  DMA remapping (DMAR) devices support enables independent address
	  translations for Direct Memory Access (DMA) from devices.
	  These DMA remapping devices are reported via ACPI tables
	  and include PCI device scope covered by these DMA
	  remapping devices.

if INTEL_IOMMU

config INTEL_IOMMU_DEBUGFS
	bool "Export Intel IOMMU internals in Debugfs"
	depends on IOMMU_DEBUGFS
	select DMAR_PERF
	select DMAR_DEBUG
	help
	  !!!WARNING!!!

	  DO NOT ENABLE THIS OPTION UNLESS YOU REALLY KNOW WHAT YOU ARE DOING!!!

	  Expose Intel IOMMU internals in Debugfs.

	  This option is -NOT- intended for production environments, and should
	  only be enabled for debugging Intel IOMMU.

config INTEL_IOMMU_SVM
	bool "Support for Shared Virtual Memory with Intel IOMMU"
	depends on X86_64
	select MMU_NOTIFIER
	select IOMMU_SVA
	help
	  Shared Virtual Memory (SVM) provides a facility for devices
	  to access DMA resources through process address space by
	  means of a Process Address Space ID (PASID).

config INTEL_IOMMU_DEFAULT_ON
	bool "Enable Intel DMA Remapping Devices by default"
	default y
	help
	  Selecting this option will enable a DMAR device at boot time if
	  one is found. If this option is not selected, DMAR support can
	  be enabled by passing intel_iommu=on to the kernel.

config INTEL_IOMMU_FLOPPY_WA
	def_bool y
	depends on X86
	help
	  Floppy disk drivers are known to bypass DMA API calls
	  thereby failing to work when IOMMU is enabled. This
	  workaround will setup a 1:1 mapping for the first
	  16MiB to make floppy (an ISA device) work.

config INTEL_IOMMU_SCALABLE_MODE_DEFAULT_ON
	bool "Enable Intel IOMMU scalable mode by default"
	default y
	help
	  Selecting this option will enable by default the scalable mode if
	  hardware presents the capability. The scalable mode is defined in
	  VT-d 3.0. The scalable mode capability could be checked by reading
	  /sys/devices/virtual/iommu/dmar*/intel-iommu/ecap. If this option
	  is not selected, scalable mode support could also be enabled by
	  passing intel_iommu=sm_on to the kernel. If not sure, please use
	  the default value.

config INTEL_IOMMU_PERF_EVENTS
	bool "Intel IOMMU performance events"
	default y
	depends on INTEL_IOMMU && PERF_EVENTS
	help
	  Selecting this option will enable the performance monitoring
	  infrastructure in the Intel IOMMU. It collects information about
	  key events occurring during operation of the remapping hardware,
	  to aid performance tuning and debug. These are available on modern
	  processors which support Intel VT-d 4.0 and later.

endif # INTEL_IOMMU
```

## drivers/iommu/iommufd/Kconfig
```kconfig
# SPDX-License-Identifier: GPL-2.0-only
config IOMMUFD
	tristate "IOMMU Userspace API"
	select INTERVAL_TREE
	select INTERVAL_TREE_SPAN_ITER
	select IOMMU_API
	default n
	help
	  Provides /dev/iommu, the user API to control the IOMMU subsystem as
	  it relates to managing IO page tables that point at user space memory.

	  If you don't know what to do here, say N.

if IOMMUFD
config IOMMUFD_VFIO_CONTAINER
	bool "IOMMUFD provides the VFIO container /dev/vfio/vfio"
	depends on VFIO_GROUP && !VFIO_CONTAINER
	default VFIO_GROUP && !VFIO_CONTAINER
	help
	  IOMMUFD will provide /dev/vfio/vfio instead of VFIO. This relies on
	  IOMMUFD providing compatibility emulation to give the same ioctls.
	  It provides an option to build a kernel with legacy VFIO components
	  removed.

	  IOMMUFD VFIO container emulation is known to lack certain features
	  of the native VFIO container, such as peer-to-peer
	  DMA mapping, PPC IOMMU support, as well as other potentially
	  undiscovered gaps.  This option is currently intended for the
	  purpose of testing IOMMUFD with unmodified userspace supporting VFIO
	  and making use of the Type1 VFIO IOMMU backend.  General purpose
	  enabling of this option is currently discouraged.

	  Unless testing IOMMUFD, say N here.

config IOMMUFD_TEST
	bool "IOMMU Userspace API Test support"
	depends on DEBUG_KERNEL
	depends on FAULT_INJECTION
	depends on RUNTIME_TESTING_MENU
	default n
	help
	  This is dangerous, do not enable unless running
	  tools/testing/selftests/iommu
endif
```

## drivers/iommu/riscv/Kconfig
```kconfig
# SPDX-License-Identifier: GPL-2.0-only
# RISC-V IOMMU support

config RISCV_IOMMU
	bool "RISC-V IOMMU Support"
	default RISCV
	depends on GENERIC_MSI_IRQ
	depends on (RISCV || COMPILE_TEST) && 64BIT
	select IOMMU_API
	select GENERIC_PT
	select IOMMU_PT
	select IOMMU_PT_RISCV64
	help
	  Support for implementations of the RISC-V IOMMU architecture that
	  complements the RISC-V MMU capabilities, providing similar address
	  translation and protection functions for accesses from I/O devices.

	  Say Y here if your SoC includes an IOMMU device implementing
	  the RISC-V IOMMU architecture.

config RISCV_IOMMU_PCI
	def_bool y if RISCV_IOMMU && PCI_MSI
	help
	  Support for the PCIe implementation of RISC-V IOMMU architecture.
```

## drivers/ipack/Kconfig
```kconfig
# SPDX-License-Identifier: GPL-2.0-only
#
# IPACK configuration.
#

menuconfig IPACK_BUS
	tristate "IndustryPack bus support"
	depends on HAS_IOMEM
	---help---
	  This option provides support for the IndustryPack framework.  There
	  are IndustryPack carrier boards, which interface another bus (such as
	  PCI) to an IndustryPack bus, and IndustryPack modules, that are
	  hosted on these buses.  While IndustryPack modules can provide a
	  large variety of functionality, they are most often found in
	  industrial control applications.

	  Say N if unsure.

if IPACK_BUS

source "drivers/ipack/carriers/Kconfig"

source "drivers/ipack/devices/Kconfig"

endif # IPACK
```

## drivers/ipack/carriers/Kconfig
```kconfig
config BOARD_TPCI200
	tristate "Support for the TEWS TPCI-200 IndustryPack carrier board"
	depends on IPACK_BUS
	depends on PCI
	help
	  This driver adds support for the TEWS TPCI200 IndustryPack carrier board.
	default n
```

## drivers/ipack/devices/Kconfig
```kconfig
config SERIAL_IPOCTAL
	tristate "IndustryPack IP-OCTAL uart support"
	depends on IPACK_BUS && TTY
	help
	  This driver supports the IPOCTAL serial port device for the IndustryPack bus.
	default n
```
