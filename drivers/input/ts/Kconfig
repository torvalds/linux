## drivers/isdn/Kconfig
```kconfig
# SPDX-License-Identifier: GPL-2.0-only
#
# ISDN device configuration
#

menuconfig ISDN
	bool "ISDN support"
	depends on NET && NETDEVICES
	depends on !S390 && !UML
	help
	  ISDN ("Integrated Services Digital Network", called RNIS in France)
	  is a fully digital telephone service that can be used for voice and
	  data connections.  If your computer is equipped with an ISDN
	  adapter you can use it to connect to your Internet service provider
	  (with SLIP or PPP) faster than via a conventional telephone modem
	  (though still much slower than with DSL) or to make and accept
	  voice calls (eg. turning your PC into a software answering machine
	  or PABX).

	  Select this option if you want your kernel to support ISDN.

if ISDN

source "drivers/isdn/capi/Kconfig"

source "drivers/isdn/mISDN/Kconfig"

endif # ISDN
```

## drivers/isdn/act2000/Kconfig
```kconfig
config ISDN_DRV_ACT2000
	tristate "IBM Active 2000 support"
	depends on ISA
	help
	  Say Y here if you have an IBM Active 2000 ISDN card. In order to use
	  this card, additional firmware is necessary, which has to be loaded
	  into the card using a utility which is part of the latest
	  isdn4k-utils package. Please read the file
	  <file:Documentation/isdn/README.act2000> for more information.
```

## drivers/isdn/capi/Kconfig
```kconfig
# SPDX-License-Identifier: GPL-2.0-only
config ISDN_CAPI
	def_bool ISDN && BT
	help
	  This provides CAPI (the Common ISDN Application Programming
	  Interface) Version 2.0, a standard making it easy for programs to
	  access ISDN hardware in a device independent way. (For details see
	  <https://www.capi.org/>.)  CAPI supports making and accepting voice
	  and data connections, controlling call options and protocols,
	  as well as ISDN supplementary services like call forwarding or
	  three-party conferences (if supported by the specific hardware
	  driver).

	  This subsystem requires a hardware specific driver.
	  See CONFIG_BT_CMTP for the last remaining regular driver
	  in the kernel that uses the CAPI subsystem.

config CAPI_TRACE
	def_bool BT_CMTP
	help
	  If you say Y here, the kernelcapi driver can make verbose traces
	  of CAPI messages. This feature can be enabled/disabled via IOCTL for
	  every controller (default disabled).

config ISDN_CAPI_MIDDLEWARE
	def_bool BT_CMTP && TTY
	help
	  This option will enhance the capabilities of the /dev/capi20
	  interface.  It will provide a means of moving a data connection,
	  established via the usual /dev/capi20 interface to a special tty
	  device.  If you want to use pppd with pppdcapiplugin to dial up to
	  your ISP, say Y here.
```

## drivers/isdn/gigaset/Kconfig
```kconfig
menu "Siemens Gigaset"
	depends on ISDN_I4L

config ISDN_DRV_GIGASET
	tristate "Siemens Gigaset support (isdn)"
	depends on ISDN_I4L
	select CRC_CCITT
	select BITREVERSE
	help
	  This driver supports the Siemens Gigaset SX205/255 family of
	  ISDN DECT bases, including the predecessors Gigaset 3070/3075
	  and 4170/4175 and their T-Com versions Sinus 45isdn and Sinus
	  721X.
	  If you have one of these devices, say M here and for at least
	  one of the connection specific parts that follow.
	  This will build a module called "gigaset".

if ISDN_DRV_GIGASET!=n

config GIGASET_BASE
	tristate "Gigaset base station support"
	depends on ISDN_DRV_GIGASET && USB
	help
	  Say M here if you want to use the USB interface of the Gigaset
	  base for connection to your system.
	  This will build a module called "bas_gigaset".

config GIGASET_M105
	tristate "Gigaset M105 support"
	depends on ISDN_DRV_GIGASET && USB
	help
	  Say M here if you want to connect to the Gigaset base via DECT
	  using a Gigaset M105 (Sinus 45 Data 2) USB DECT device.
	  This will build a module called "usb_gigaset".

config GIGASET_M101
	tristate "Gigaset M101 support"
	depends on ISDN_DRV_GIGASET
	help
	  Say M here if you want to connect to the Gigaset base via DECT
	  using a Gigaset M101 (Sinus 45 Data 1) RS232 DECT device.
	  This will build a module called "ser_gigaset".

config GIGASET_DEBUG
	bool "Gigaset debugging"
	help
	  This enables debugging code in the Gigaset drivers.
	  If in doubt, say yes.

config GIGASET_UNDOCREQ
	bool "Support for undocumented USB requests"
	help
	  This enables support for USB requests we only know from
	  reverse engineering (currently M105 only). If you need
	  features like configuration mode of M105, say yes. If you
	  care about your device, say no.

endif

endmenu
```

## drivers/isdn/hardware/Kconfig
```kconfig
# SPDX-License-Identifier: GPL-2.0-only
#
# ISDN hardware drivers
#
comment "CAPI hardware drivers"

source "drivers/isdn/hardware/avm/Kconfig"
```

## drivers/isdn/hardware/avm/Kconfig
```kconfig
#
# ISDN AVM drivers
#

menu "Active AVM cards"
	depends on NET && ISDN && ISDN_CAPI!=n

config CAPI_AVM
	bool "Support AVM cards"
	help
	  Enable support for AVM active ISDN cards.

config ISDN_DRV_AVMB1_B1ISA
	tristate "AVM B1 ISA support"
	depends on CAPI_AVM && ISDN_CAPI && ISA
	help
	  Enable support for the ISA version of the AVM B1 card.

config ISDN_DRV_AVMB1_B1PCI
	tristate "AVM B1 PCI support"
	depends on CAPI_AVM && ISDN_CAPI && PCI
	help
	  Enable support for the PCI version of the AVM B1 card.

config ISDN_DRV_AVMB1_B1PCIV4
	bool "AVM B1 PCI V4 support"
	depends on ISDN_DRV_AVMB1_B1PCI
	help
	  Enable support for the V4 version of AVM B1 PCI card.

config ISDN_DRV_AVMB1_T1ISA
	tristate "AVM T1/T1-B ISA support"
	depends on CAPI_AVM && ISDN_CAPI && ISA
	help
	  Enable support for the AVM T1 T1B card.
	  Note: This is a PRI card and handle 30 B-channels.

config ISDN_DRV_AVMB1_B1PCMCIA
	tristate "AVM B1/M1/M2 PCMCIA support"
	depends on CAPI_AVM && ISDN_CAPI
	help
	  Enable support for the PCMCIA version of the AVM B1 card.

config ISDN_DRV_AVMB1_AVM_CS
	tristate "AVM B1/M1/M2 PCMCIA cs module"
	depends on ISDN_DRV_AVMB1_B1PCMCIA && PCMCIA
	help
	  Enable the PCMCIA client driver for the AVM B1/M1/M2
	  PCMCIA cards.

config ISDN_DRV_AVMB1_T1PCI
	tristate "AVM T1/T1-B PCI support"
	depends on CAPI_AVM && ISDN_CAPI && PCI
	help
	  Enable support for the AVM T1 T1B card.
	  Note: This is a PRI card and handle 30 B-channels.

config ISDN_DRV_AVMB1_C4
	tristate "AVM C4/C2 support"
	depends on CAPI_AVM && ISDN_CAPI && PCI
	help
	  Enable support for the AVM C4/C2 PCI cards.
	  These cards handle 4/2 BRI ISDN lines (8/4 channels).

endmenu
```

## drivers/isdn/hardware/eicon/Kconfig
```kconfig
#
# ISDN DIVAS Eicon driver
#

menuconfig CAPI_EICON
	bool "Active Eicon DIVA Server cards"
	help
	  Enable support for Eicon Networks active ISDN cards.

if CAPI_EICON

config ISDN_DIVAS
	tristate "Support Eicon DIVA Server cards"
	depends on PROC_FS && PCI
	help
	  Say Y here if you have an Eicon Networks DIVA Server PCI ISDN card.
	  In order to use this card, additional firmware is necessary, which
	  has to be downloaded into the card using the divactrl utility.

if ISDN_DIVAS

config ISDN_DIVAS_BRIPCI
	bool "DIVA Server BRI/PCI support"
	help
	  Enable support for DIVA Server BRI-PCI.

config ISDN_DIVAS_PRIPCI
	bool "DIVA Server PRI/PCI support"
	help
	  Enable support for DIVA Server PRI-PCI.

config ISDN_DIVAS_DIVACAPI
	tristate "DIVA CAPI2.0 interface support"
	help
	  You need this to provide the CAPI interface
	  for DIVA Server cards.

config ISDN_DIVAS_USERIDI
	tristate "DIVA User-IDI interface support"
	help
	  Enable support for user-mode IDI interface.

config ISDN_DIVAS_MAINT
	tristate "DIVA Maint driver support"
	depends on m
	help
	  Enable Divas Maintenance driver.

endif # ISDN_DIVAS

endif # CAPI_EICON
```
