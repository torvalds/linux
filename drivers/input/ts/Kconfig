## drivers/interconnect/qcom/Kconfig
```kconfig
# SPDX-License-Identifier: GPL-2.0-only
config INTERCONNECT_QCOM
	tristate "Qualcomm Network-on-Chip interconnect drivers"
	depends on ARCH_QCOM
	help
	  Support for Qualcomm's Network-on-Chip interconnect hardware.

config INTERCONNECT_QCOM_BCM_VOTER
	tristate

config INTERCONNECT_QCOM_QOS_RPM
	tristate

config INTERCONNECT_QCOM_MSM8916
	tristate "Qualcomm MSM8916 interconnect driver"
	depends on INTERCONNECT_QCOM
	depends on QCOM_SMD_RPM
	select INTERCONNECT_QCOM_SMD_RPM
	help
	  This is a driver for the Qualcomm Network-on-Chip on msm8916-based
	  platforms.

config INTERCONNECT_QCOM_MSM8939
	tristate "Qualcomm MSM8939 interconnect driver"
	depends on INTERCONNECT_QCOM
	depends on QCOM_SMD_RPM
	select INTERCONNECT_QCOM_SMD_RPM
	help
	  This is a driver for the Qualcomm Network-on-Chip on msm8939-based
	  platforms.

config INTERCONNECT_QCOM_MSM8974
	tristate "Qualcomm MSM8974 interconnect driver"
	depends on INTERCONNECT_QCOM
	depends on QCOM_SMD_RPM
	select INTERCONNECT_QCOM_SMD_RPM
	help
	 This is a driver for the Qualcomm Network-on-Chip on msm8974-based
	 platforms.

config INTERCONNECT_QCOM_MSM8996
	tristate "Qualcomm MSM8996 interconnect driver"
	depends on INTERCONNECT_QCOM
	depends on QCOM_SMD_RPM
	select INTERCONNECT_QCOM_SMD_RPM
	help
	  This is a driver for the Qualcomm Network-on-Chip on msm8996-based
	  platforms.

config INTERCONNECT_QCOM_OSM_L3
	tristate "Qualcomm OSM L3 interconnect driver"
	depends on INTERCONNECT_QCOM || COMPILE_TEST
	help
	  Say y here to support the Operating State Manager (OSM) interconnect
	  driver which controls the scaling of L3 caches on Qualcomm SoCs.

config INTERCONNECT_QCOM_QCM2290
	tristate "Qualcomm QCM2290 interconnect driver"
	depends on INTERCONNECT_QCOM
	depends on QCOM_SMD_RPM
	select INTERCONNECT_QCOM_SMD_RPM
	help
	  This is a driver for the Qualcomm Network-on-Chip on qcm2290-based
	  platforms.

config INTERCONNECT_QCOM_QCS404
	tristate "Qualcomm QCS404 interconnect driver"
	depends on INTERCONNECT_QCOM
	depends on QCOM_SMD_RPM
	select INTERCONNECT_QCOM_SMD_RPM
	help
	  This is a driver for the Qualcomm Network-on-Chip on qcs404-based
	  platforms.

config INTERCONNECT_QCOM_RPMH_POSSIBLE
	tristate
	default INTERCONNECT_QCOM
	depends on QCOM_RPMH || (COMPILE_TEST && !QCOM_RPMH)
	depends on QCOM_COMMAND_DB || (COMPILE_TEST && !QCOM_COMMAND_DB)
	depends on OF || COMPILE_TEST
	help
	  Compile-testing RPMH drivers is possible on other platforms,
	  but in order to avoid link failures, drivers must not be built-in
	  when QCOM_RPMH or QCOM_COMMAND_DB are loadable modules

config INTERCONNECT_QCOM_RPMH
	tristate

config INTERCONNECT_QCOM_SC7180
	tristate "Qualcomm SC7180 interconnect driver"
	depends on INTERCONNECT_QCOM_RPMH_POSSIBLE
	select INTERCONNECT_QCOM_RPMH
	select INTERCONNECT_QCOM_BCM_VOTER
	help
	  This is a driver for the Qualcomm Network-on-Chip on sc7180-based
	  platforms.

config INTERCONNECT_QCOM_SC7280
	tristate "Qualcomm SC7280 interconnect driver"
	depends on INTERCONNECT_QCOM_RPMH_POSSIBLE
	select INTERCONNECT_QCOM_RPMH
	select INTERCONNECT_QCOM_BCM_VOTER
	help
	  This is a driver for the Qualcomm Network-on-Chip on sc7280-based
	  platforms.

config INTERCONNECT_QCOM_SC8180X
	tristate "Qualcomm SC8180X interconnect driver"
	depends on INTERCONNECT_QCOM_RPMH_POSSIBLE
	select INTERCONNECT_QCOM_RPMH
	select INTERCONNECT_QCOM_BCM_VOTER
	help
	  This is a driver for the Qualcomm Network-on-Chip on sc8180x-based
	  platforms.

config INTERCONNECT_QCOM_SC8280XP
	tristate "Qualcomm SC8280XP interconnect driver"
	depends on INTERCONNECT_QCOM_RPMH_POSSIBLE
	select INTERCONNECT_QCOM_RPMH
	select INTERCONNECT_QCOM_BCM_VOTER
	help
	  This is a driver for the Qualcomm Network-on-Chip on SC8280XP-based
	  platforms.

config INTERCONNECT_QCOM_SDM660
	tristate "Qualcomm SDM660 interconnect driver"
	depends on INTERCONNECT_QCOM
	depends on QCOM_SMD_RPM
	select INTERCONNECT_QCOM_SMD_RPM
	help
	  This is a driver for the Qualcomm Network-on-Chip on sdm660-based
	  platforms.

config INTERCONNECT_QCOM_SDM845
	tristate "Qualcomm SDM845 interconnect driver"
	depends on INTERCONNECT_QCOM_RPMH_POSSIBLE
	select INTERCONNECT_QCOM_RPMH
	select INTERCONNECT_QCOM_BCM_VOTER
	help
	  This is a driver for the Qualcomm Network-on-Chip on sdm845-based
	  platforms.

config INTERCONNECT_QCOM_ANORAK
        tristate "ANORAK interconnect driver"
        depends on INTERCONNECT_QCOM
        depends on QCOM_RPMH && QCOM_COMMAND_DB && OF
        select INTERCONNECT_QCOM_BCM_VOTER
        select INTERCONNECT_QCOM_RPMH
        select INTERCONNECT_QCOM_QOS
        help
          This is a driver for the Qualcomm Technologies, Inc. Network-on-Chip
          on Anorak-based platforms. Interconnect driver provides interfaces
          for setting bandwidth between two endpoints (path). It also used to
          configure NOC QoS settings (Quality of Service).

config INTERCONNECT_QCOM_NEO
	tristate "NEO interconnect driver"
	depends on INTERCONNECT_QCOM
	depends on QCOM_RPMH && QCOM_COMMAND_DB && OF
	select INTERCONNECT_QCOM_BCM_VOTER
	select INTERCONNECT_QCOM_RPMH
	select INTERCONNECT_QCOM_QOS
	help
	  This is a driver for the Qualcomm Technologies, Inc. Network-on-Chip
	  on Neo-based platforms. Interconnect driver provides interfaces
	  for setting bandwidth between two endpoints (path). It also used to
	  configure NOC QoS settings (Quality of Service).

config INTERCONNECT_QCOM_SDX55
	tristate "Qualcomm SDX55 interconnect driver"
	depends on INTERCONNECT_QCOM_RPMH_POSSIBLE
	select INTERCONNECT_QCOM_RPMH
	select INTERCONNECT_QCOM_BCM_VOTER
	help
	  This is a driver for the Qualcomm Network-on-Chip on sdx55-based
	  platforms.

config INTERCONNECT_QCOM_SDX65
	tristate "Qualcomm SDX65 interconnect driver"
	depends on INTERCONNECT_QCOM_RPMH_POSSIBLE
	select INTERCONNECT_QCOM_RPMH
	select INTERCONNECT_QCOM_BCM_VOTER
	help
	  This is a driver for the Qualcomm Network-on-Chip on sdx65-based
	  platforms.

config INTERCONNECT_QCOM_SM6350
	tristate "Qualcomm SM6350 interconnect driver"
	depends on INTERCONNECT_QCOM_RPMH_POSSIBLE
	select INTERCONNECT_QCOM_RPMH
	select INTERCONNECT_QCOM_BCM_VOTER
	help
	  This is a driver for the Qualcomm Network-on-Chip on sm6350-based
	  platforms.

config INTERCONNECT_QCOM_SM6150
	tristate "SM6150 interconnect driver"
	depends on INTERCONNECT_QCOM
	depends on QCOM_RPMH && QCOM_COMMAND_DB && OF
	select INTERCONNECT_QCOM_BCM_VOTER
	select INTERCONNECT_QCOM_RPMH
	select INTERCONNECT_QCOM_QOS
	help
	  This is a driver for the Qualcomm Technologies, Inc. Network-on-Chip
	  on sm6150-based platforms. The interconnect provider collects and
	  aggreagates the cosumer bandwidth requests to satisfy constraints
	  placed on Network-on-Chip performance states.

config INTERCONNECT_QCOM_SM8150
	tristate "SM8150 interconnect driver"
	depends on INTERCONNECT_QCOM
	depends on QCOM_RPMH && QCOM_COMMAND_DB && OF
	select INTERCONNECT_QCOM_BCM_VOTER
	select INTERCONNECT_QCOM_RPMH
	select INTERCONNECT_QCOM_QOS
	help
	  This is a driver for the Qualcomm Technologies, Inc. Network-on-Chip
	  on sm8150-based platforms. The interconnect provider collects and
	  aggregates the cosumer bandwidth requests to satisfy constraints
	  placed on Network-on-Chip performance states.

config INTERCONNECT_QCOM_SM8250
	tristate "Qualcomm SM8250 interconnect driver"
	depends on INTERCONNECT_QCOM_RPMH_POSSIBLE
	select INTERCONNECT_QCOM_RPMH
	select INTERCONNECT_QCOM_BCM_VOTER
	help
	  This is a driver for the Qualcomm Network-on-Chip on sm8250-based
	  platforms.

config INTERCONNECT_QCOM_SM8350
	tristate "Qualcomm SM8350 interconnect driver"
	depends on INTERCONNECT_QCOM_RPMH_POSSIBLE
	select INTERCONNECT_QCOM_RPMH
	select INTERCONNECT_QCOM_BCM_VOTER
	help
	  This is a driver for the Qualcomm Network-on-Chip on SM8350-based
	  platforms.

config INTERCONNECT_QCOM_SM8450
	tristate "Qualcomm SM8450 interconnect driver"
	depends on INTERCONNECT_QCOM_RPMH_POSSIBLE
	select INTERCONNECT_QCOM_RPMH
	select INTERCONNECT_QCOM_BCM_VOTER
	help
	  This is a driver for the Qualcomm Network-on-Chip on SM8450-based
	  platforms.

config INTERCONNECT_QCOM_CLIFFS
	tristate "CLIFFS interconnect driver"
	depends on INTERCONNECT_QCOM
	depends on OF
	select INTERCONNECT_QCOM_BCM_VOTER
	select INTERCONNECT_QCOM_RPMH
	select INTERCONNECT_QCOM_QOS
	help
	  This is a driver for the Qualcomm Technologies, Inc. Network-on-Chip
	  on Cliffs-based platforms. Interconnect driver provides interfaces
	  for setting bandwidth between two endpoints (path). It also used to
	  configure NOC QoS settings (Quality of Service).

config INTERCONNECT_QCOM_VOLCANO
	tristate "VOLCANO interconnect driver"
	depends on INTERCONNECT_QCOM
	depends on QCOM_RPMH && QCOM_COMMAND_DB && OF
	select INTERCONNECT_QCOM_BCM_VOTER
	select INTERCONNECT_QCOM_RPMH
	select INTERCONNECT_QCOM_QOS
	help
	  This is a driver for the Qualcomm Technologies, Inc. Network-on-Chip
	  on volcano-based platforms. The interconnect provider collects and
	  aggregates the consumer bandwidth requests to satisfy constraints
	  placed on Network-on-Chip performance states.

config INTERCONNECT_QCOM_PINEAPPLE
	tristate "PINEAPPLE interconnect driver"
	depends on INTERCONNECT_QCOM
	depends on OF
	select INTERCONNECT_QCOM_BCM_VOTER
	select INTERCONNECT_QCOM_RPMH
	select INTERCONNECT_QCOM_QOS
	help
	  This is a driver for the Qualcomm Technologies, Inc. Network-on-Chip
	  on Pineapple-based platforms. Interconnect driver provides interfaces
	  for setting bandwidth between two endpoints (path). It also used to
	  configure NOC QoS settings (Quality of Service).

config INTERCONNECT_QCOM_NIOBE
	tristate "NIOBE interconnect driver"
	depends on INTERCONNECT_QCOM
	depends on QCOM_RPMH && QCOM_COMMAND_DB && OF
	select INTERCONNECT_QCOM_BCM_VOTER
	select INTERCONNECT_QCOM_RPMH
	select INTERCONNECT_QCOM_QOS
	help
	  This is a driver for the Qualcomm Technologies, Inc. Network-on-Chip
	  on Niobe-based platforms. Interconnect driver provides interfaces
	  for setting bandwidth between two endpoints (path). It also used to
	  configure NOC QoS settings (Quality of Service).

config INTERCONNECT_QCOM_SERAPH
	tristate "SERAPH interconnect driver"
	depends on INTERCONNECT_QCOM
	depends on OF
	select INTERCONNECT_QCOM_BCM_VOTER
	select INTERCONNECT_QCOM_RPMH
	select INTERCONNECT_QCOM_QOS
	help
	  This is a driver for the Qualcomm Technologies, Inc. Network-on-Chip
	  on Seraph-based platforms. Interconnect driver provides interfaces
	  for setting bandwidth between two endpoints (path). It also used to
	  configure NOC QoS settings (Quality of Service).

config INTERCONNECT_QCOM_RPM
	tristate

config INTERCONNECT_QCOM_SMD_RPM
	tristate

config INTERCONNECT_QCOM_QOS
	tristate

config INTERCONNECT_QCOM_KALAMA
	tristate "KALAMA interconnect driver"
	depends on INTERCONNECT_QCOM
	depends on OF
	select INTERCONNECT_QCOM_BCM_VOTER
	select INTERCONNECT_QCOM_RPMH
	select INTERCONNECT_QCOM_QOS
	help
	  This is a driver for the Qualcomm Technologies, Inc. Network-on-Chip
	  on Kalama-based platforms. Interconnect driver provides interfaces
	  for setting bandwidth between two endpoints (path). It also used to
	  configure NOC QoS settings (Quality of Service).

config INTERCONNECT_QCOM_BLAIR
	tristate "BLAIR interconnect driver"
	depends on INTERCONNECT_QCOM
	depends on MSM_RPM_SMD
	select INTERCONNECT_QCOM_RPM
	select INTERCONNECT_QCOM_QOS_RPM
	help
	  This is a driver for the Qualcomm Technologies, Inc. Network-on-Chip
	  on blair-based platforms. The interconnect provider collects and
	  aggreagates the cosumer bandwidth requests to satisfy constraints
	  placed on Network-on-Chip performance states.

config INTERCONNECT_QCOM_HOLI
	tristate "HOLI interconnect driver"
	depends on INTERCONNECT_QCOM
	depends on MSM_RPM_SMD
	select INTERCONNECT_QCOM_RPM
	select INTERCONNECT_QCOM_QOS_RPM
	help
	  This is a driver for the Qualcomm Technologies, Inc. Network-on-Chip
	  on holi-based platforms. The interconnect provider collects and
	  aggregates the consumer bandwidth requests to satisfy constraints
	  placed on Network-on-Chip performance states.

config INTERCONNECT_QCOM_PITTI
	tristate "PITTI interconnect driver"
	depends on INTERCONNECT_QCOM
	depends on MSM_RPM_SMD
	select INTERCONNECT_QCOM_RPM
	select INTERCONNECT_QCOM_QOS_RPM
	help
	  This is a driver for the Qualcomm Technologies, Inc. Network-on-Chip
	  on pitti-based platforms. The interconnect provider collects and
	  aggregates the consumer bandwidth requests to satisfy constraints
	  placed on Network-on-Chip performance states.

config INTERCONNECT_QCOM_DEBUG
	tristate "QCOM-specific interconnect debug features"
	depends on INTERCONNECT_QCOM
	help
          This driver provides QCOM-specific interconnect debug features. These
          features include optionally printing all enabled interconnect votes
          when entering suspend.

config INTERCONNECT_QCOM_LEMANS
	tristate "LEMANS interconnect driver"
	depends on INTERCONNECT_QCOM
	depends on QCOM_RPMH && QCOM_COMMAND_DB && OF
	select INTERCONNECT_QCOM_BCM_VOTER
	select INTERCONNECT_QCOM_RPMH
	select INTERCONNECT_QCOM_QOS
	help
	  This is a driver for the Qualcomm Technologies, Inc. Network-on-Chip
	  on lemans-based platforms. The interconnect provider collects and
	  aggreagates the cosumer bandwidth requests to satisfy constraints
	  placed on Network-on-Chip performance states.

config INTERCONNECT_QCOM_MONACO_AUTO
	tristate "MONACO_AUTO interconnect driver"
	depends on INTERCONNECT_QCOM
	depends on QCOM_RPMH && QCOM_COMMAND_DB && OF
	select INTERCONNECT_QCOM_BCM_VOTER
	select INTERCONNECT_QCOM_RPMH
	select INTERCONNECT_QCOM_QOS
	help
	  This is a driver for the Qualcomm Technologies, Inc. Network-on-Chip
	  on monaco_auto-based platforms. The interconnect provider collects and
	  aggregates the consumer bandwidth requests to satisfy constraints
	  placed on Network-on-Chip performance states.

config INTERCONNECT_QCOM_MDM9X07
	tristate "MDM9X07 interconnect driver"
	depends on INTERCONNECT_QCOM
	depends on MSM_RPM_SMD
	select INTERCONNECT_QCOM_RPM
	select INTERCONNECT_QCOM_QOS
	help
	  This is a driver for the Qualcomm Technologies, Inc. Network-on-Chip
	  on mdm9x07-based platforms. The interconnect provider collects and
	  aggregates the consumer bandwidth requests to satisfy constraints
	  placed on Network-on-Chip performance states.
```

## drivers/interconnect/samsung/Kconfig
```kconfig
# SPDX-License-Identifier: GPL-2.0-only
config INTERCONNECT_SAMSUNG
	bool "Samsung SoC interconnect drivers"
	depends on ARCH_EXYANALS || COMPILE_TEST
	help
	  Interconnect drivers for Samsung SoCs.

config INTERCONNECT_EXYANALS
	tristate "Exyanals SoC generic interconnect driver"
	depends on INTERCONNECT_SAMSUNG
	default y if ARCH_EXYANALS
	help
	  Generic interconnect driver for Samsung Exyanals SoCs (e.g. Exyanals3250,
	  Exyanals4210, Exyanals4412, Exyanals542x, Exyanals5433).
	  Choose Y here only if you build for such Samsung SoC.
```
