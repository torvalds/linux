// SPDX-License-Identifier: (GPL-2.0 OR MIT)

/*
 * The dts overlay is included from the dts directory so
 * it can be possible to check it with CHECK_DTBS while
 * also compile it from the driver source directory.
 */

/dts-v1/;
/plugin/;

/ {
	fragment@0 {
		target-path="";
		__overlay__ {
			compatible = "pci1de4,1";
			#address-cells = <3>;
			#size-cells = <2>;
			interrupt-controller;
			#interrupt-cells = <2>;

			#include "arm64/broadcom/rp1-common.dtsi"
		};
	};
};
