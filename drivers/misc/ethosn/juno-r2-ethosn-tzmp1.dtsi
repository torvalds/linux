/*
 *
 * (C) COPYRIGHT 2022 Arm Limited.
 *
 * This program is free software and is provided to you under the terms of the
 * GNU General Public License version 2 as published by the Free Software
 * Foundation, and any use by you of this program is subject to the terms
 * of such GNU licence.
 *
 * This program is distributed in the hope that it will be useful,
 * but WITHOUT ANY WARRANTY; without even the implied warranty of
 * MERCHANTABILITY or FITNESS FOR A PARTICULAR PURPOSE. See the
 * GNU General Public License for more details.
 *
 * You should have received a copy of the GNU General Public License
 * along with this program; if not, you can access it online at
 * http://www.gnu.org/licenses/gpl-2.0.html.
 *
 * SPDX-License-Identifier: GPL-2.0-only
 *
 */

/ {

	reserved-memory {
		#address-cells = <2>;
		#size-cells = <2>;
		ranges;

		/* 'ethosn_protected_reserved' must be page aligned (page size = 0x1000) */
		 ethosn_protected_reserved: ethosn_protected_reserved@880000000 {
			/* Must be kept in sync with protected memory regions in TF-A */
			reg = <0x8 0x80000000 0 0x004400000>;
			status = "disabled";
			no-map;
		};
	};
};
