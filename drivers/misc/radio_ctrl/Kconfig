## drivers/misc/radio_ctrl/Kconfig
```kconfig
config RADIO_CTRL_CLASS
	bool "Radio Modem Controller Class"
	default n

config MDM6600_CTRL
	bool "Motorola MDM6X00 Modem Controller"
	default n
	select RADIO_CTRL_CLASS
	---help---
	  Enables the device driver to control and interface with
	  the modem co-processor.  This module is needed to monitor
	  modem panics, interact with the modem during factory resets,
	  and allow modem power up/down support.

	  If unsure, say N.

config WRIGLEY_CTRL
	bool "Motorola Wrigley Modem Controller"
	default n
	select RADIO_CTRL_CLASS
	---help---
	  Enables the device driver to control and interface with
	  the Wrigley modem co-processor.  This module is needed to monitor
	  modem panics, interact with the modem during factory resets,
	  and allow modem power up/down support.

	  If unsure, say N.
```

## drivers/misc/rk2928_callpad_misc/Kconfig
```kconfig
#
# rk2928 callpad misc device configuration
#

menuconfig RK2928_CALLPAD_MISC
	tristate "3G module audio for phonepad"
	---help---
	  Say Y here if you have a support modem

config AUDIO_SWITCH
	bool "RK2928 callpad audio switch"
	default n
```

## drivers/misc/rk29_modem/Kconfig
```kconfig
# SPDX-License-Identifier: GPL-2.0
#
# USB Serial device configuration
#

menuconfig RK29_SUPPORT_MODEM
	tristate "RK29 support Modem"
#	depends on USB11_HOST_EN
	---help---
	  Say Y here if you have a support modem

choice
	depends on RK29_SUPPORT_MODEM
	prompt  "Select 3G Modem"

    config MODEM_ROCKCHIP_DEMO
  	bool "ROCKCHIP_GENERAL_MODEM_DEVICE"

    config MODEM_LONGCHEER_U6300V
  	bool "LONGCHEER_U6300V"

    config MODEM_THINKWILL_MW100G
        bool "THINKWILL_MW100G"

endchoice
```

## drivers/misc/rk628/Kconfig
```kconfig
# SPDX-License-Identifier: GPL-2.0
menu "RK628 misc driver"
config RK628_MISC
	tristate "rk628 misc driver"
	default n
	help
	  Say y here to enable Rockchip rk628 misc driver.
          This option is used to support rgb/hdmi/bt1120 input and dsi/lvds/gvi/hdmi output.

config RK628_MISC_HDMITX
	bool "rk628 misc hdmitx driver"
	default n
	depends on RK628_MISC
	depends on DRM
	help
	  Say y here to enable Rockchip rk628 misc hdmitx driver.
	  This option is used to support hdmi output.

config ROCKCHIP_THUNDER_BOOT_RK628
	bool "Rockchip RK628 Thunder Boot support"
	default n
	depends on RK628_MISC
	help
	  Say y here to enable Rockchip rk628 thunder boot support.
	  This option make the kernel boot faster.

endmenu
```

## drivers/misc/rockchip/Kconfig
```kconfig
# SPDX-License-Identifier: GPL-2.0
#
# Misc strange devices for rockchip

config PCIE_FUNC_RKEP
	tristate "Rockchip PCIe EP function driver"
	depends on PCI
	depends on ARCH_ROCKCHIP
	select PCIE_DW_DMATEST
	help
           Enable this configuration option to enable the host side function
	   driver for Rockchip's EP demo function driver.

config PCIE_FUNC_RKEP_USERPAGES
	bool "EP function driver reserve continuous physical space for user layer"
	depends on PCIE_FUNC_RKEP=y
	help
	  Enable this configuration option to reserve continuous physical space
          for user layer in Rockchip's EP demo function driver.
```

## drivers/misc/rp1/Kconfig
```kconfig
# SPDX-License-Identifier: GPL-2.0-only
#
# RaspberryPi RP1 misc device
#

config MISC_RP1
	tristate "RaspberryPi RP1 misc device"
	depends on OF_IRQ && OF_OVERLAY && PCI_MSI && PCI_QUIRKS
	select PCI_DYNAMIC_OF_NODES
	help
	  Support the RP1 peripheral chip found on Raspberry Pi 5 board.

	  This device supports several sub-devices including e.g. Ethernet
	  controller, USB controller, I2C, SPI and UART.

	  The driver is responsible for enabling the DT node once the PCIe
	  endpoint has been configured, and handling interrupts.

	  This driver uses an overlay to load other drivers to support for
	  RP1 internal sub-devices.
```

## drivers/misc/scaler/Kconfig
```kconfig
# SPDX-License-Identifier: GPL-2.0
#
# all auto modem control drivers configuration
#

menuconfig SCALER_DEVICE
	bool "Scaler Device Support"
	default n	

if SCALER_DEVICE

config SCALER_DEVICE_DDC
	bool "Scaler Device Support DDC Read EDID"
	default n	

source "drivers/misc/scaler/chips/Kconfig"
endif
```

## drivers/misc/scaler/chips/Kconfig
```kconfig
#
#config tv5735 support inport type and output type
#

config SCALER_TV5735
	bool "Support tv5735 chip"
	default n	

config SCALER_TEST
	bool "test chip"
	default n	
```

## drivers/misc/snps_accel/Kconfig
```kconfig
# SPDX-License-Identifier: GPL-2.0-only

config SNPS_ARCSYNC
	tristate "Synopsys ARCsync driver"
	help
	  This option enables the driver developed for Syncopsys ARCSync
	  module. ARCSync is used for synchronization and control of
	  multiple ARC processor assembled in a heterogeneous sub-system.
	  The driver controls ARCSync and provides a set of functions to
	  send commands to ARC processors, issue interrupts and register
	  handler ARCsync interrupt. The Synopsys VPX/NPX remoteproc and
	  accelerator drivers depend on this module.

	  This driver can also be built as a module.  If so, the module
	  will be called snps_arcsync.

config SNPS_ACCEL_APP
	tristate "Synopsys NPX/VPX application helper driver"
	select SNPS_ARCSYNC
	select DMA_SHARED_BUFFER
	help
	  Enables Synopsys VPX/NPX support to provide interface and API
	  for user-space driver in MetawareMX NN Runtime.

	  The user-space interface is described in
	  include/uapi/misc/snps_npu.h

	  If "M" is selected, the module will be called snps_accel.
```

## drivers/misc/ti-st/Kconfig
```kconfig
# SPDX-License-Identifier: GPL-2.0-only
#
# TI's shared transport line discipline and the protocol
# drivers (BT, FM and GPS)
#
menu "Texas Instruments shared transport line discipline"
config TI_ST
	tristate "Shared transport core driver"
	depends on NET && TTY
	depends on GPIOLIB || COMPILE_TEST
	select FW_LOADER
	help
	  This enables the shared transport core driver for TI
	  BT / FM and GPS combo chips. This enables protocol drivers
	  to register themselves with core and send data, the responses
	  are returned to relevant protocol drivers based on their
	  packet types.

endmenu
```

## drivers/misc/ts27010mux/Kconfig
```kconfig
#
# TS 27.010 configuration
#

menu "Motorola TS 27.010 Mux driver"

config TS27010MUX
        tristate "Motorola TS 27.010 Mux driver"
        default n

endmenu
```

## drivers/misc/uacce/Kconfig
```kconfig
config UACCE
	tristate "Accelerator Framework for User Land"
	depends on IOMMU_API
	help
	  UACCE provides interface for the user process to access the hardware
	  without interaction with the kernel space in data path.

	  The user-space interface is described in
	  include/uapi/misc/uacce/uacce.h

	  See Documentation/misc-devices/uacce.rst for more details.

	  If you don't know what to do here, say N.
```

## drivers/misc/vmw_vmci/Kconfig
```kconfig
# SPDX-License-Identifier: GPL-2.0-only
#
# VMware VMCI device
#

config VMWARE_VMCI
	tristate "VMware VMCI Driver"
	depends on (X86 || ARM64) && !CPU_BIG_ENDIAN && PCI
	help
	  This is VMware's Virtual Machine Communication Interface.  It enables
	  high-speed communication between host and guest in a virtual
	  environment via the VMCI virtual device.

	  If unsure, say N.

	  To compile this driver as a module, choose M here: the
	  module will be called vmw_vmci.
```

## drivers/mmc/Kconfig
```kconfig
#
# MMC subsystem configuration
#

menuconfig MMC
	tristate "MMC/SD/SDIO card support"
	depends on HAS_IOMEM
	help
	  This selects MultiMediaCard, Secure Digital and Secure
	  Digital I/O support.

	  If you want MMC/SD/SDIO support, you should say Y here and
	  also to your specific host controller driver.

if MMC

source "drivers/mmc/core/Kconfig"

source "drivers/mmc/host/Kconfig"

endif # MMC
```

## drivers/mmc/card/Kconfig
```kconfig
#
# MMC/SD card drivers
#

comment "MMC/SD/SDIO Card Drivers"

config MMC_BLOCK
	tristate "MMC block device driver"
	depends on BLOCK
	default y
	help
	  Say Y here to enable the MMC block device driver support.
	  This provides a block device driver, which you can use to
	  mount the filesystem. Almost everyone wishing MMC support
	  should say Y or M here.

config MMC_BLOCK_MINORS
	int "Number of minors per block device"
	depends on MMC_BLOCK
	range 4 256
	default 8
	help
	  Number of minors per block device. One is needed for every
	  partition on the disk (plus one for the whole disk).

	  Number of total MMC minors available is 256, so your number
	  of supported block devices will be limited to 256 divided
	  by this number.

	  Default is 8 to be backwards compatible with previous
	  hardwired device numbering.

	  If unsure, say 8 here.

config MMC_BLOCK_BOUNCE
	bool "Use bounce buffer for simple hosts"
	depends on MMC_BLOCK
	default y
	help
	  SD/MMC is a high latency protocol where it is crucial to
	  send large requests in order to get high performance. Many
	  controllers, however, are restricted to continuous memory
	  (i.e. they can't do scatter-gather), something the kernel
	  rarely can provide.

	  Say Y here to help these restricted hosts by bouncing
	  requests back and forth from a large buffer. You will get
	  a big performance gain at the cost of up to 64 KiB of
	  physical memory.

	  If unsure, say Y here.

config MMC_BLOCK_DEFERRED_RESUME
	bool "Deferr MMC layer resume until I/O is requested"
	depends on MMC_BLOCK
	default n
	help
	  Say Y here to enable deferred MMC resume until I/O
	  is requested. This will reduce overall resume latency and
	  save power when theres an SD card inserted but not being used.

config SDIO_UART
	tristate "SDIO UART/GPS class support"
	help
	  SDIO function driver for SDIO cards that implements the UART
	  class, as well as the GPS class which appears like a UART.

config MMC_TEST
	tristate "MMC host test driver"
	help
	  Development driver that performs a series of reads and writes
	  to a memory card in order to expose certain well known bugs
	  in host controllers. The tests are executed by writing to the
	  "test" file in debugfs under each card. Note that whatever is
	  on your card will be overwritten by these tests.

	  This driver is only of interest to those developing or
	  testing a host driver. Most people should say N here.

config MMC_SELECTIVE_PACKED_CMD_POLICY
	tristate "Change the condition of Pakced command"
	help
	  Say Y here to change packed_cmd policy
```

## drivers/mmc/core/Kconfig
```kconfig
# SPDX-License-Identifier: GPL-2.0-only
#
# MMC core configuration
#
config PWRSEQ_EMMC
	tristate "HW reset support for eMMC"
	default y
	depends on OF
	help
	  This selects Hardware reset support aka pwrseq-emmc for eMMC
	  devices. By default this option is set to y.

	  This driver can also be built as a module. If so, the module
	  will be called pwrseq_emmc.

config PWRSEQ_SD8787
	tristate "HW reset support for SD8787 BT + Wifi module"
	depends on OF && (MWIFIEX != n || BT_MRVL_SDIO != n || LIBERTAS_SDIO != n || WILC1000_SDIO != n)
	help
	  This selects hardware reset support for the SD8787 BT + Wifi
	  module. By default this option is set to n.

	  This driver can also be built as a module. If so, the module
	  will be called pwrseq_sd8787.

config PWRSEQ_SIMPLE
	tristate "Simple HW reset support for MMC"
	default y
	depends on OF
	help
	  This selects simple hardware reset support aka pwrseq-simple for MMC
	  devices. By default this option is set to y.

	  This driver can also be built as a module. If so, the module
	  will be called pwrseq_simple.

config MMC_BLOCK
	tristate "MMC block device driver"
	depends on BLOCK
	depends on RPMB || !RPMB
	imply IOSCHED_BFQ
	default y
	help
	  Say Y here to enable the MMC block device driver support.
	  This provides a block device driver, which you can use to
	  mount the filesystem. Almost everyone wishing MMC support
	  should say Y or M here.

config MMC_BLOCK_MINORS
	int "Number of minors per block device"
	depends on MMC_BLOCK
	range 4 256
	default 8
	help
	  Number of minors per block device. One is needed for every
	  partition on the disk (plus one for the whole disk).

	  Number of total MMC minors available is 256, so your number
	  of supported block devices will be limited to 256 divided
	  by this number.

	  Default is 8 to be backwards compatible with previous
	  hardwired device numbering.

	  If unsure, say 8 here.

config SDIO_UART
	tristate "SDIO UART/GPS class support"
	depends on TTY
	help
	  SDIO function driver for SDIO cards that implements the UART
	  class, as well as the GPS class which appears like a UART.

config MMC_TEST
	tristate "MMC host test driver"
	help
	  Development driver that performs a series of reads and writes
	  to a memory card in order to expose certain well known bugs
	  in host controllers. The tests are executed by writing to the
	  "test" file in debugfs under each card. Note that whatever is
	  on your card will be overwritten by these tests.

	  This driver is only of interest to those developing or
	  testing a host driver. Most people should say N here.

config MMC_CRYPTO
	bool "MMC Crypto Engine Support"
	depends on BLK_INLINE_ENCRYPTION
	help
	  Enable Crypto Engine Support in MMC.
	  Enabling this makes it possible for the kernel to use the crypto
	  capabilities of the MMC device (if present) to perform crypto
	  operations on data being transferred to/from the device.
```
