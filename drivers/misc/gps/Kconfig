## drivers/misc/mic/Kconfig
```kconfig
comment "Intel MIC Bus Driver"

config INTEL_MIC_BUS
	tristate "Intel MIC Bus Driver"
	depends on 64BIT && PCI && X86 && X86_DEV_DMA_OPS
	help
	  This option is selected by any driver which registers a
	  device or driver on the MIC Bus, such as CONFIG_INTEL_MIC_HOST,
	  CONFIG_INTEL_MIC_CARD, CONFIG_INTEL_MIC_X100_DMA etc.

	  If you are building a host/card kernel with an Intel MIC device
	  then say M (recommended) or Y, else say N. If unsure say N.

	  More information about the Intel MIC family as well as the Linux
	  OS and tools for MIC to use with this driver are available from
	  <http://software.intel.com/en-us/mic-developer>.

comment "SCIF Bus Driver"

config SCIF_BUS
	tristate "SCIF Bus Driver"
	depends on 64BIT && PCI && X86 && X86_DEV_DMA_OPS
	help
	  This option is selected by any driver which registers a
	  device or driver on the SCIF Bus, such as CONFIG_INTEL_MIC_HOST
	  and CONFIG_INTEL_MIC_CARD.

	  If you are building a host/card kernel with an Intel MIC device
	  then say M (recommended) or Y, else say N. If unsure say N.

	  More information about the Intel MIC family as well as the Linux
	  OS and tools for MIC to use with this driver are available from
	  <http://software.intel.com/en-us/mic-developer>.

comment "VOP Bus Driver"

config VOP_BUS
	tristate "VOP Bus Driver"
	depends on 64BIT && PCI && X86 && X86_DEV_DMA_OPS
	help
	  This option is selected by any driver which registers a
	  device or driver on the VOP Bus, such as CONFIG_INTEL_MIC_HOST
	  and CONFIG_INTEL_MIC_CARD.

	  If you are building a host/card kernel with an Intel MIC device
	  then say M (recommended) or Y, else say N. If unsure say N.

	  More information about the Intel MIC family as well as the Linux
	  OS and tools for MIC to use with this driver are available from
	  <http://software.intel.com/en-us/mic-developer>.

comment "Intel MIC Host Driver"

config INTEL_MIC_HOST
	tristate "Intel MIC Host Driver"
	depends on 64BIT && PCI && X86
	depends on INTEL_MIC_BUS && SCIF_BUS && MIC_COSM && VOP_BUS
	help
	  This enables Host Driver support for the Intel Many Integrated
	  Core (MIC) family of PCIe form factor coprocessor devices that
	  run a 64 bit Linux OS. The driver manages card OS state and
	  enables communication between host and card. Intel MIC X100
	  devices are currently supported.

	  If you are building a host kernel with an Intel MIC device then
	  say M (recommended) or Y, else say N. If unsure say N.

	  More information about the Intel MIC family as well as the Linux
	  OS and tools for MIC to use with this driver are available from
	  <http://software.intel.com/en-us/mic-developer>.

comment "Intel MIC Card Driver"

config INTEL_MIC_CARD
	tristate "Intel MIC Card Driver"
	depends on 64BIT && X86
	depends on INTEL_MIC_BUS && SCIF_BUS && MIC_COSM && VOP_BUS
	select VIRTIO
	help
	  This enables card driver support for the Intel Many Integrated
	  Core (MIC) device family. The card driver communicates shutdown/
	  crash events to the host and allows registration/configuration of
	  virtio devices. Intel MIC X100 devices are currently supported.

	  If you are building a card kernel for an Intel MIC device then
	  say M (recommended) or Y, else say N. If unsure say N.

	  For more information see
	  <http://software.intel.com/en-us/mic-developer>.

comment "SCIF Driver"

config SCIF
	tristate "SCIF Driver"
	depends on 64BIT && PCI && X86 && SCIF_BUS && IOMMU_SUPPORT
	select IOMMU_IOVA
	help
	  This enables SCIF Driver support for the Intel Many Integrated
	  Core (MIC) family of PCIe form factor coprocessor devices that
	  run a 64 bit Linux OS. The Symmetric Communication Interface
	  (SCIF (pronounced as skiff)) is a low level communications API
	  across PCIe currently implemented for MIC.

	  If you are building a host kernel with an Intel MIC device then
	  say M (recommended) or Y, else say N. If unsure say N.

	  More information about the Intel MIC family as well as the Linux
	  OS and tools for MIC to use with this driver are available from
	  <http://software.intel.com/en-us/mic-developer>.

comment "Intel MIC Coprocessor State Management (COSM) Drivers"

config MIC_COSM
	tristate "Intel MIC Coprocessor State Management (COSM) Drivers"
	depends on 64BIT && PCI && X86 && SCIF
	help
	  This enables COSM driver support for the Intel Many
	  Integrated Core (MIC) family of PCIe form factor coprocessor
	  devices. COSM drivers implement functions such as boot,
	  shutdown, reset and reboot of MIC devices.

	  If you are building a host kernel with an Intel MIC device then
	  say M (recommended) or Y, else say N. If unsure say N.

	  More information about the Intel MIC family as well as the Linux
	  OS and tools for MIC to use with this driver are available from
	  <http://software.intel.com/en-us/mic-developer>.

comment "VOP Driver"

config VOP
	tristate "VOP Driver"
	depends on 64BIT && PCI && X86 && VOP_BUS
	select VHOST_RING
	select VIRTIO
	help
	  This enables VOP (Virtio over PCIe) Driver support for the Intel
	  Many Integrated Core (MIC) family of PCIe form factor coprocessor
	  devices. The VOP driver allows virtio drivers, e.g. net, console
	  and block drivers, on the card connect to user space virtio
	  devices on the host.

	  If you are building a host kernel with an Intel MIC device then
	  say M (recommended) or Y, else say N. If unsure say N.

	  More information about the Intel MIC family as well as the Linux
	  OS and tools for MIC to use with this driver are available from
	  <http://software.intel.com/en-us/mic-developer>.

if VOP
source "drivers/vhost/Kconfig.vringh"
endif
```

## drivers/misc/mlcore/Kconfig
```kconfig
config MLCORE_DRIVER
    tristate "MLCore Machine Learning Kernel Driver"
    depends on PROC_FS
    help
      A kernel-space ML helper driver with /proc and ioctl support.
      Useful for hybrid kernel/user-space machine learning interaction.
```

## drivers/misc/mpu3050/Kconfig
```kconfig
menu "Motion Sensors Support"

choice
    tristate "Motion Processing Unit"
    depends on I2C
    default MPU_NONE

config MPU_NONE
    bool "None"
    help
      This disables support for motion processing using the MPU family of 
      motion processing units.

config MPU_SENSORS_MPU3050
    tristate "MPU3050"
    depends on I2C
    help
      If you say yes here you get support for the MPU3050 Gyroscope driver
      This driver can also be built as a module.  If so, the module
      will be called mpu3050.

config MPU_SENSORS_MPU6000
    tristate "MPU6000"
    depends on I2C
    help
      If you say yes here you get support for the MPU6000 Gyroscope driver
      This driver can also be built as a module.  If so, the module
      will be called mpu6000.

endchoice

choice
    prompt "Accelerometer Type"
    depends on MPU_SENSORS_MPU3050
    default MPU_SENSORS_BMA150

config MPU_SENSORS_ACCELEROMETER_NONE
    bool "NONE"
    depends on MPU_SENSORS_MPU3050 || MPU_SENSORS_MPU6000
    help
      This disables accelerometer support for the MPU3050

config MPU_SENSORS_ADXL346
    bool "ADI adxl346"
    depends on MPU_SENSORS_MPU3050
    help
      This enables support for the ADI adxl346 accelerometer

config MPU_SENSORS_BMA150
    bool "Bosch BMA150"
    depends on MPU_SENSORS_MPU3050
    help
      This enables support for the Bosch BMA150 accelerometer
 
config MPU_SENSORS_BMA222
    bool "Bosch BMA222"
    depends on MPU_SENSORS_MPU3050
    help
      This enables support for the Bosch BMA222 accelerometer
      
config MPU_SENSORS_KXSD9
    bool "Kionix KXSD9"
    depends on MPU_SENSORS_MPU3050
    help
      This enables support for the Kionix KXSD9 accelerometer

config MPU_SENSORS_KXTF9
    bool "Kionix KXTF9"
    depends on MPU_SENSORS_MPU3050
    help
      This enables support for the Kionix KXFT9 accelerometer

config MPU_SENSORS_LIS331DLH
    bool "ST lis331dlh"
    depends on MPU_SENSORS_MPU3050
    help
      This enables support for the ST lis331dlh accelerometer

config MPU_SENSORS_LIS3DH
    bool "ST lis3dh"
    depends on MPU_SENSORS_MPU3050
    help
      This enables support for the ST lis3dh accelerometer

config MPU_SENSORS_LSM303DLHA
    bool "ST lsm303dlh"
    depends on MPU_SENSORS_MPU3050
    help
      This enables support for the ST lsm303dlh accelerometer

config MPU_SENSORS_MMA8450
    bool "Freescale mma8450"
    depends on MPU_SENSORS_MPU3050
    help
      This enables support for the Freescale mma8450 accelerometer

config MPU_SENSORS_MMA845X
    bool "Freescale mma8451/8452/8453"
    depends on MPU_SENSORS_MPU3050
    help
      This enables support for the Freescale mma8451/8452/8453 accelerometer

endchoice

choice
    prompt "Compass Type"
    depends on MPU_SENSORS_MPU6000 || MPU_SENSORS_MPU3050
    default MPU_SENSORS_AK8975

config MPU_SENSORS_COMPASS_NONE
    bool "NONE"
    depends on MPU_SENSORS_MPU6000 || MPU_SENSORS_MPU3050
    help
      This disables compass support for the MPU6000

config MPU_SENSORS_AK8975
    bool "AKM ak8975"
    depends on MPU_SENSORS_MPU6000 || MPU_SENSORS_MPU3050
    help
      This enables support for the AKM ak8975 compass

config MPU_SENSORS_MMC314X
    bool "MEMSIC mmc314x"
    depends on MPU_SENSORS_MPU3050
    help
      This enables support for the MEMSIC mmc314x compass

config MPU_SENSORS_AMI30X
    bool "Aichi Steel ami30X"
    depends on MPU_SENSORS_MPU3050
    help
      This enables support for the Aichi Steel ami304/ami305 compass

config MPU_SENSORS_AMI306
    bool "Aichi Steel ami306"
    depends on MPU_SENSORS_MPU3050
    help
      This enables support for the Aichi Steel ami306 compass

config MPU_SENSORS_HMC5883
    bool "Honeywell hmc5883"
    depends on MPU_SENSORS_MPU3050
    help
      This enables support for the Honeywell hmc5883 compass

config MPU_SENSORS_LSM303DLHM
    bool "ST lsm303dlh"
    depends on MPU_SENSORS_MPU3050
    help
      This enables support for the ST lsm303dlh compass

config MPU_SENSORS_MMC314X
    bool "MEMSIC mmc314xMS"
    depends on MPU_SENSORS_MPU3050
    help
      This enables support for the MEMSIC mmc314xMS compass

config MPU_SENSORS_YAS529
    bool "Yamaha yas529"
    depends on MPU_SENSORS_MPU3050
    help
      This enables support for the Yamaha yas529 compass

config MPU_SENSORS_YAS530
    bool "Yamaha yas530"
    depends on MPU_SENSORS_MPU3050
    help
      This enables support for the Yamaha yas530 compass

config MPU_SENSORS_HSCDTD002B
    bool "Alps hscdtd002b"
    depends on MPU_SENSORS_MPU3050
    help
      This enables support for the Alps hscdtd002b compass

config MPU_SENSORS_HSCDTD004A
    bool "Alps hscdtd004a"
    depends on MPU_SENSORS_MPU3050
    help
      This enables support for the Alps hscdtd004a compass

endchoice

choice
    prompt "Pressure Type"
    depends on MPU_SENSORS_MPU6000 || MPU_SENSORS_MPU3050
    default MPU_SENSORS_BMA085

config MPU_SENSORS_PRESSURE_NONE
    bool "NONE"
    depends on MPU_SENSORS_MPU6000 || MPU_SENSORS_MPU3050
    help
      This disables pressure sensor support for the MPU6000

config MPU_SENSORS_BMA085
    bool "Bosch BMA085"
    depends on MPU_SENSORS_MPU6000 || MPU_SENSORS_MPU3050
    help
      This enables support for the Bosch bma085 pressure sensor

endchoice

config MPU_SENSORS_TIMERIRQ
    tristate "Timer IRQ"
    help
      If you say yes here you get access to the timerirq device handle which
      can be used to select on.  This can be used instead of IRQ's, sleeping,
      or timer threads.  Reading from this device returns the same type of
      information as reading from the MPU and slave IRQ's.

endmenu
```

## drivers/misc/ocxl/Kconfig
```kconfig
# SPDX-License-Identifier: GPL-2.0-only
#
# Open Coherent Accelerator (OCXL) compatible devices
#

config OCXL_BASE
	bool
	select PPC_COPRO_BASE

config OCXL
	tristate "OpenCAPI coherent accelerator support"
	depends on PPC_POWERNV && PCI && EEH
	select OCXL_BASE
	select HOTPLUG_PCI_POWERNV
	default m
	help
	  Select this option to enable the ocxl driver for Open
	  Coherent Accelerator Processor Interface (OpenCAPI) devices.

	  OpenCAPI allows FPGA and ASIC accelerators to be coherently
	  attached to a CPU over an OpenCAPI link.

	  The ocxl driver enables userspace programs to access these
	  accelerators through devices in /dev/ocxl/.

	  For more information, see https://opencapi.org.

	  This is not to be confused with the support for IBM CAPI
	  accelerators (CONFIG_CXL), which are PCI-based instead of a
	  dedicated OpenCAPI link, and don't follow the same protocol.

	  If unsure, say N.
```

## drivers/misc/pvpanic/Kconfig
```kconfig
# SPDX-License-Identifier: GPL-2.0+
#
# Pvpanic Kconfig
#
# Copyright (C) 2021 Oracle.
#

config PVPANIC
	bool "pvpanic device support"
	help
	  This option allows to select a specific pvpanic device driver.
	  pvpanic is a paravirtualized device provided by QEMU; it lets
	  a virtual machine (guest) communicate panic events to the host.

config PVPANIC_MMIO
	tristate "pvpanic MMIO device support"
	depends on HAS_IOMEM && (ACPI || OF) && PVPANIC
	help
	  This driver provides support for the MMIO pvpanic device.

config PVPANIC_PCI
	tristate "pvpanic PCI device support"
	depends on PCI && PVPANIC
	help
	  This driver provides support for the PCI pvpanic device.
	  pvpanic is a paravirtualized device provided by QEMU which
	  forwards the panic events from the guest to the host.
```
