## drivers/misc/iwmc3200top/Kconfig
```kconfig
config IWMC3200TOP
        tristate "Intel Wireless MultiCom Top Driver"
        depends on MMC && EXPERIMENTAL
        select FW_LOADER
	---help---
	  Intel Wireless MultiCom 3200 Top driver is responsible for
	  for firmware load and enabled coms enumeration

config IWMC3200TOP_DEBUG
	bool "Enable full debug output of iwmc3200top Driver"
	depends on IWMC3200TOP
	---help---
	  Enable full debug output of iwmc3200top Driver

config IWMC3200TOP_DEBUGFS
	bool "Enable Debugfs debugging interface for iwmc3200top"
	depends on IWMC3200TOP
	---help---
	  Enable creation of debugfs files for iwmc3200top
```

## drivers/misc/keba/Kconfig
```kconfig
# SPDX-License-Identifier: GPL-2.0
config KEBA_CP500
	tristate "KEBA CP500 system FPGA support"
	depends on X86_64 || ARM64 || COMPILE_TEST
	depends on PCI
	depends on I2C
	select AUXILIARY_BUS
	help
	  This driver supports the KEBA CP500 system FPGA, which is used in
	  KEBA CP500 devices. It registers all sub devices present on the CP500
	  system FPGA as separate devices. A driver is needed for each sub
	  device.

	  This driver can also be built as a module. If so, the module will be
	  called cp500.

config KEBA_LAN9252
	tristate "KEBA CP500 LAN9252 configuration"
	depends on SPI
	depends on KEBA_CP500 || COMPILE_TEST
	help
	  This driver is used for updating the configuration of the LAN9252
	  controller on KEBA CP500 devices.

	  This driver can also be built as a module. If so, the module will be
	  called lan9252.
```

## drivers/misc/lis3lv02d/Kconfig
```kconfig
# SPDX-License-Identifier: GPL-2.0-only
#
# STMicroelectonics LIS3LV02D and similar accelerometers
#

config SENSORS_LIS3_SPI
	tristate "STMicroeletronics LIS3LV02Dx three-axis digital accelerometer (SPI)"
	depends on !ACPI && SPI_MASTER && INPUT
	select SENSORS_LIS3LV02D
	default n
	help
	  This driver provides support for the LIS3LV02Dx accelerometer connected
	  via SPI. The accelerometer data is readable via
	  /sys/devices/platform/lis3lv02d.

	  This driver also provides an absolute input class device, allowing
	  the laptop to act as a pinball machine-esque joystick.

	  This driver can also be built as modules.  If so, the core module
	  will be called lis3lv02d and a specific module for the SPI transport
	  is called lis3lv02d_spi.

config SENSORS_LIS3_I2C
	tristate "STMicroeletronics LIS3LV02Dx three-axis digital accelerometer (I2C)"
	depends on I2C && INPUT
	select SENSORS_LIS3LV02D
	default n
	help
	  This driver provides support for the LIS3LV02Dx accelerometer connected
	  via I2C. The accelerometer data is readable via
	  /sys/devices/platform/lis3lv02d.

	  This driver also provides an absolute input class device, allowing
	  the device to act as a pinball machine-esque joystick.

	  This driver can also be built as modules.  If so, the core module
	  will be called lis3lv02d and a specific module for the I2C transport
	  is called lis3lv02d_i2c.
```

## drivers/misc/mchp_pci1xxxx/Kconfig
```kconfig
config GP_PCI1XXXX
       tristate "Microchip PCI1XXXX PCIe to GPIO Expander + OTP/EEPROM manager"
       depends on PCI
       depends on GPIOLIB
       depends on NVMEM_SYSFS
       select GPIOLIB_IRQCHIP
       select AUXILIARY_BUS
       help
         PCI1XXXX is a PCIe GEN 3 switch with one of the endpoints having
         multiple functions and one of the functions is a GPIO controller
         which also has registers to interface with the OTP and EEPROM.
         Select yes, no or module here to include or exclude the driver
         for the GPIO function.
```

## drivers/misc/mediatek/Kconfig
```kconfig
menu "Mediatek Peripherals "

config MTK_PLATFORM
        string "MTK platform name"
source "drivers/misc/mediatek/btif/Kconfig"

menu "Modem & Connectivity related configs"
source "drivers/misc/mediatek/connectivity/Kconfig"
endmenu

endmenu  # CONN
```

## drivers/misc/mediatek/btif/Kconfig
```kconfig
config MTK_BTIF
	tristate"MediaTek BTIF Driver"
	help
	  MTK connectivity BTIF driver for A/D die
```

## drivers/misc/mediatek/connectivity/Kconfig
```kconfig
config MTK_COMBO
	tristate "MediaTek Connectivity Combo Chip Support"
	help
	  MTK connectivity combo chip driver for MT66xx

#
# MTK Combo Chip Selection
#

choice
	prompt "Select Chip"
	depends on MTK_COMBO

config MTK_COMBO_CHIP_MT6620
	bool "MT6620"
	help
	  this config is used to decided combo chip version
	  in current platform
	  is
	  MT6620

config MTK_COMBO_CHIP_MT6628
	bool "MT6628"
	help
	  this config is used to decided combo chip version
	  in current platform
	  is
	  MT6628

config MTK_COMBO_CHIP_MT6630
	bool "MT6630"
	help
	  this config is used to decided combo chip version
	  in current platform
	  is
	  MT6630

config MTK_COMBO_CHIP_CONSYS_6572
	bool "CONSYS_6572"
	help
	  this config is used to decided SOC consys version
	  in current platform
	  is
	  MT6572

config MTK_COMBO_CHIP_CONSYS_6582
	bool "CONSYS_6582"
	help
	  this config is used to decided SOC consys version
	  in current platform
	  is
	  MT6582

config MTK_COMBO_CHIP_CONSYS_8127
	bool "CONSYS_8127"
	help
	  this config is used to decided SOC consys version
	  in current platform
	  is
	  MT6572

config MTK_COMBO_CHIP_CONSYS_7623
	bool "CONSYS_7623"
	#select MTK_PLATFORM::="mt7623"
	help
	  this config is used to decide SOC consys version
	  in current platform is MT7623 and prepare proper
	  system services like radio power on/off and firmware
	  download for the Bluetotoh and Wifi.


config MTK_COMBO_CHIP_CONSYS_6752
	bool "CONSYS_6752"
	help
	  this config is used to decided SOC consys version
	  in current platform
	  is
	  MT6752

config MTK_COMBO_CHIP_CONSYS_6592
	bool "CONSYS_6592"
	help
	  this config is used to decided SOC consys version
	  in current platform
	  is
	  MT6592

config MTK_COMBO_CHIP_CONSYS_8163
	bool "CONSYS_8163"
	help
	  this config is used to decided SOC consys version
	  in current platform
	  is
	  MT8163

config MTK_COMBO_CHIP_CONSYS_6735
	bool "CONSYS_6735"
	help
	  this config is used to decided SOC consys version
	  in current platform
	  is
	  MT6735

config MTK_COMBO_CHIP_CONSYS_6755
	bool "CONSYS_6755"
	help
	  this config is used to decided SOC consys version
	  in current platform
	  is
	  MT6755

config MTK_COMBO_CHIP_CONSYS_6580
	bool "CONSYS_6580"
	help
	  this config is used to decided SOC consys version
	  in current platform
	  is
	  MT6580

config MTK_COMBO_CHIP_CONSYS_6797
	bool "CONSYS_6797"
	help
	  this config is used to decided SOC consys version
	  in current platform
	  is
	  MT6797
endchoice

config MTK_COMBO_CHIP
	string
	default "MT6620" if MTK_COMBO_CHIP_MT6620
	default "MT6628" if MTK_COMBO_CHIP_MT6628
	default "MT6630" if MTK_COMBO_CHIP_MT6630
	default "CONSYS_6572" if MTK_COMBO_CHIP_CONSYS_6572
	default "CONSYS_6582" if MTK_COMBO_CHIP_CONSYS_6582
	default "CONSYS_8127" if MTK_COMBO_CHIP_CONSYS_8127
	default "CONSYS_7623" if MTK_COMBO_CHIP_CONSYS_7623
	default "CONSYS_6752" if MTK_COMBO_CHIP_CONSYS_6752
	default "CONSYS_6755" if MTK_COMBO_CHIP_CONSYS_6755
	default "CONSYS_6592" if MTK_COMBO_CHIP_CONSYS_6592
	default "CONSYS_8163" if MTK_COMBO_CHIP_CONSYS_8163
	default "CONSYS_6735" if MTK_COMBO_CHIP_CONSYS_6735
	default "CONSYS_6580" if MTK_COMBO_CHIP_CONSYS_6580
	default "CONSYS_6797" if MTK_COMBO_CHIP_CONSYS_6797
	help
	  this feature is used to identify combo chip version or SOC chip
	  consys version.

#
# Target Platform Selection
#
config MTK_COMBO_PLAT_PATH
	string "Platform folder name"
	depends on MTK_COMBO
	default "sample" if MTK_COMBO_PLAT_SAMPLE
	help
	  Specify platform folder under common driver platform folder:
	  mtk_wcn_combo/common/platform/*

#
# MTK COMBO Chip Configuration
#
config MTK_COMBO_COMM
	depends on MTK_COMBO
	tristate "MediaTek Combo Chip Common part driver"
	help
	  MediaTek combo chip common part driver

#config MTK_COMBO_COMM_PS
#	depends on MTK_COMBO_COMM
#	bool "Enable PS support"
#	default n
#	help
#	  Enable PS support of common UART interface

config MTK_COMBO_COMM_UART
	depends on MTK_COMBO_COMM
	tristate "Common interface UART"
	help
	  Use UART for common part interface type

config MTK_COMBO_COMM_SDIO
	depends on MTK_COMBO_COMM
	tristate "Common interface SDIO"
	help
	  Use SDIO for common part interface type

config MTK_COMBO_COMM_NPWR
	depends on MTK_COMBO_COMM
	bool "Enable NPWR support"
	default n
	help
	  Enable NPWR support of new power on swquence

config MTK_COMBO_COMM_APO
	depends on MTK_COMBO_COMM
	bool "Enable always power on support"
	#default y
	help
	  Enable chip will always power on

config MTK_COMBO_BT
	tristate "MediaTek Combo Chip BT driver"
	depends on BT && MTK_COMBO
	select MTK_BTIF
	help
	  MTK BT /dev/stpbt driver for Bluedroid

config MTK_COMBO_BT_HCI
	tristate "MediaTek Combo Chip BlueZ driver"
	depends on BT && MTK_COMBO
	select MTK_BTIF
	help
	  MTK BT driver for BlueZ

config MTK_COMBO_WIFI
	tristate "MediaTek combo chip Wi-Fi support"
	depends on MTK_COMBO
	select MTK_BTIF
	select WIRELESS_EXT
	select WEXT_PRIV

config MTK_WAPI_SUPPORT
	bool "MTK_WAPI_SUPPORT"
	depends on MTK_COMBO_WIFI
	#default y
	help
	  if it is set to TRUE: Support WAPI (WLAN Authentication and
	  Privacy Infrastructure)

config MTK_PASSPOINT_R1_SUPPORT
	bool "MTK_PASSPOINT_R1_SUPPORT"
	depends on MTK_COMBO_WIFI
	help
	  Support Passpoint R1 (Hotspot 2.0 R1)

config MTK_PASSPOINT_R2_SUPPORT
	bool "MTK_PASSPOINT_R2_SUPPORT"
	depends on MTK_COMBO_WIFI
	help
	   Support Passpoint R2

config MTK_WIFI_MCC_SUPPORT
	bool "MTK_WIFI_MCC_SUPPORT"
	depends on MTK_COMBO_WIFI
	#default y
	help
	   if it is set to TRUE, wlan will support Multi-Channel Concurrency,
	   otherwise, only support Single Channel Concurrency

config MTK_DHCPV6C_WIFI
	bool "MTK_DHCPV6C_WIFI"
	help
	  no: disable this feature

config MTK_CONN_LTE_IDC_SUPPORT
	bool "MediaTek CONN LTE IDC support"
	select MTK_CONN_MD
	#default y
	help
	  This option enables CONN LTE IDC support

menuconfig GPS
        tristate "GPS drivers"
        #default y
        ---help---
          Say Y here for supporting GPS.

if GPS
config MTK_GPS
        tristate "MediaTek GPS driver"
        #default y
        ---help---
          MTK GPS driver
          To switch gps nmea port driver.
          Set "yes" to turn on.
          Set "no" to turn off.
endif # GPS

config MTK_GPS_SUPPORT
        tristate "MediaTek GPS driver"
        select MTK_GPS
        help
          to switch GPS feature on the platform.
          Set "yes" to turn on and set "no"
          (with MTK_AGPS_APP=no at the same time)
          to turn off.

config MTK_GPS_REGISTER_SETTING
	tristate "MediaTek GPS Register Setting"
	depends on MTK_COMBO_GPS
	help
	   GPS register settings.

config MTK_GPS_EMI
	tristate "MediaTek GPS EMI Driver"
	depends on MTK_COMBO_GPS
	help
	   GPS EMI driver is for MNL OFFLOAD feature.
```

## drivers/misc/mei/Kconfig
```kconfig
# SPDX-License-Identifier: GPL-2.0
# Copyright (c) 2003-2019, Intel Corporation. All rights reserved.
config INTEL_MEI
	tristate "Intel Management Engine Interface"
	depends on X86 && PCI
	default X86_64 || MATOM
	help
	  The Intel Management Engine (Intel ME) provides Manageability,
	  Security and Media services for system containing Intel chipsets.
	  if selected /dev/mei misc device will be created.

	  For more information see
	  <https://software.intel.com/en-us/manageability/>

if INTEL_MEI

config INTEL_MEI_ME
	tristate "ME Enabled Intel Chipsets"
	default y
	help
	  MEI support for ME Enabled Intel chipsets.

	  Supported Chipsets are:
	  7 Series Chipset Family
	  6 Series Chipset Family
	  5 Series Chipset Family
	  4 Series Chipset Family
	  Mobile 4 Series Chipset Family
	  ICH9
	  82946GZ/GL
	  82G35 Express
	  82Q963/Q965
	  82P965/G965
	  Mobile PM965/GM965
	  Mobile GME965/GLE960
	  82Q35 Express
	  82G33/G31/P35/P31 Express
	  82Q33 Express
	  82X38/X48 Express

config INTEL_MEI_TXE
	tristate "Intel Trusted Execution Environment with ME Interface"
	help
	  MEI Support for Trusted Execution Environment device on Intel SoCs

	  Supported SoCs:
	  Intel Bay Trail

config INTEL_MEI_GSC
	tristate "Intel MEI GSC embedded device"
	depends on INTEL_MEI_ME
	depends on DRM_I915
	help
	  Intel auxiliary driver for GSC devices embedded in Intel graphics devices.

	  An MEI device here called GSC can be embedded in an
	  Intel graphics devices, to support a range of chassis
	  tasks such as graphics card firmware update and security
	  tasks.

config INTEL_MEI_VSC_HW
	tristate "Intel visual sensing controller device transport driver"
	depends on ACPI && SPI
	depends on GPIOLIB || COMPILE_TEST
	help
	  Intel SPI transport driver between host and Intel visual sensing
	  controller (IVSC) device.

	  This driver can also be built as a module. If so, the module
	  will be called mei-vsc-hw.

config INTEL_MEI_VSC
	tristate "Intel visual sensing controller device with ME interface"
	depends on INTEL_MEI_VSC_HW
	help
	  Intel MEI over SPI driver for Intel visual sensing controller
	  (IVSC) device embedded in IA platform. It supports camera sharing
	  between IVSC for context sensing and IPU for typical media usage.
	  Select this config should enable transport layer for IVSC device.

	  This driver can also be built as a module. If so, the module
	  will be called mei-vsc.

config INTEL_MEI_LB
	tristate "Intel Late Binding (LB) support on ME Interface"
	depends on INTEL_MEI_ME
	depends on DRM_XE
	help
	  Enable support for Intel Late Binding (LB) via the MEI interface.

	  Late Binding is a method for applying firmware updates at runtime,
	  allowing the Intel Xe driver to load firmware payloads such as
	  fan controller or voltage regulator. These firmware updates are
	  authenticated and versioned, and do not require firmware flashing
	  or system reboot.

source "drivers/misc/mei/hdcp/Kconfig"
source "drivers/misc/mei/pxp/Kconfig"
source "drivers/misc/mei/gsc_proxy/Kconfig"

endif
```

## drivers/misc/mei/gsc_proxy/Kconfig
```kconfig
# SPDX-License-Identifier: GPL-2.0
# Copyright (c) 2022-2023, Intel Corporation. All rights reserved.
#
config INTEL_MEI_GSC_PROXY
	tristate "Intel GSC Proxy services of ME Interface"
	select INTEL_MEI_ME
	depends on DRM_I915
	help
         MEI Support for GSC Proxy Services on Intel platforms.

         MEI GSC proxy enables messaging between GSC service on
         Intel graphics card and services on CSE (MEI) firmware
         residing SoC or PCH.
```

## drivers/misc/mei/hdcp/Kconfig
```kconfig
# SPDX-License-Identifier: GPL-2.0
# Copyright (c) 2019, Intel Corporation. All rights reserved.
#
config INTEL_MEI_HDCP
	tristate "Intel HDCP2.2 services of ME Interface"
	depends on INTEL_MEI_ME
	depends on DRM_I915
	help
	  MEI Support for HDCP2.2 Services on Intel platforms.

	  Enables the ME FW services required for HDCP2.2 support through
	  I915 display driver of Intel.
```

## drivers/misc/mei/pxp/Kconfig
```kconfig
# SPDX-License-Identifier: GPL-2.0
# Copyright (c) 2020, Intel Corporation. All rights reserved.
#
config INTEL_MEI_PXP
	tristate "Intel PXP services of ME Interface"
	select INTEL_MEI_ME
	depends on DRM_I915
	help
	  MEI Support for PXP Services on Intel platforms.

	  Enables the ME FW services required for PXP support through
	  I915 display driver of Intel.
```
