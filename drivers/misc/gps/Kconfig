## drivers/misc/gps/Kconfig
```kconfig
# SPDX-License-Identifier: GPL-2.0
#
# gps device configuration
#

menuconfig GPS_DEVICES
	bool "support GPS devices"
	default n
	---help---
	 Say Y here if you support gps

if GPS_DEVICES

source "drivers/misc/gps/rk_gps/Kconfig"	

config GPS_GNS7560
	bool "gns7560 support"
	default n
	

endif # RK29_GPS
```

## drivers/misc/gps/hv5820b/Kconfig
```kconfig
#
# gps device configuration
#



config GPS_HV5820B
	bool "HV5820B support"
	default n
```

## drivers/misc/gps/rk_gps/Kconfig
```kconfig
# SPDX-License-Identifier: GPL-2.0
#
# gps device configuration
#



config GPS_RK
	tristate "rk gps support"
	default M
```

## drivers/misc/habanalabs/Kconfig
```kconfig
# SPDX-License-Identifier: GPL-2.0-only
#
# HabanaLabs AI accelerators driver
#

config HABANA_AI
	tristate "HabanaAI accelerators (habanalabs)"
	depends on PCI && HAS_IOMEM
	select GENERIC_ALLOCATOR
	select HWMON
	select DMA_SHARED_BUFFER
	select CRC32
	help
	  Enables PCIe card driver for Habana's AI Processors (AIP) that are
	  designed to accelerate Deep Learning inference and training workloads.

	  The driver manages the PCIe devices and provides IOCTL interface for
	  the user to submit workloads to the devices.

	  The user-space interface is described in
	  include/uapi/misc/habanalabs.h

	  If unsure, say N.

	  To compile this driver as a module, choose M here: the
	  module will be called habanalabs.
```

## drivers/misc/inv_mpu/Kconfig
```kconfig
config MPU_SENSORS_TIMERIRQ
	tristate "MPU Timer IRQ"
	help
	  If you say yes here you get access to the timerirq device handle which
	  can be used to select on.  This can be used instead of IRQ's, sleeping,
	  or timer threads.  Reading from this device returns the same type of
	  information as reading from the MPU and slave IRQ's.

menuconfig: INV_SENSORS
	tristate "Motion Processing Unit"
	depends on I2C
	default n

if INV_SENSORS

choice
	prompt "MPU Master"
	depends on I2C && INV_SENSORS
	default MPU_SENSORS_MPU3050

config MPU_SENSORS_MPU3050
	bool "MPU3050"
	depends on I2C
	select MPU_SENSORS_MPU3050_GYRO
	help
	  If you say yes here you get support for the MPU3050 Gyroscope driver
	  This driver can also be built as a module.  If so, the module
	  will be called mpu3050.

config MPU_SENSORS_MPU6050A2
	bool "MPU6050A2"
	depends on I2C
	select MPU_SENSORS_MPU6050_GYRO
	help
	  If you say yes here you get support for the MPU6050A2 Gyroscope driver
	  This driver can also be built as a module.  If so, the module
	  will be called mpu6050a2.

config MPU_SENSORS_MPU6050B1
	bool "MPU6050B1"
	select MPU_SENSORS_MPU6050_GYRO
	depends on I2C
	help
	  If you say yes here you get support for the MPU6050 Gyroscope driver
	  This driver can also be built as a module.  If so, the module
	  will be called mpu6050b1.

endchoice

choice
	prompt "Gyroscope Type"
	depends on I2C && INV_SENSORS
	default MPU_SENSORS_MPU3050_GYRO

config MPU_SENSORS_MPU3050_GYRO
	bool "MPU3050 built in gyroscope"
	depends on MPU_SENSORS_MPU3050

config MPU_SENSORS_MPU6050_GYRO
	bool "MPU6050 built in gyroscope"
	depends on MPU_SENSORS_MPU6050B1 || MPU_SENSORS_MPU6050A2

endchoice

source "drivers/misc/inv_mpu/accel/Kconfig"
source "drivers/misc/inv_mpu/compass/Kconfig"
source "drivers/misc/inv_mpu/pressure/Kconfig"

config MPU_USERSPACE_DEBUG
	bool "MPU Userspace debugging ioctls"
	help
	  Allows the ioctls MPU_SET_MPU_PLATFORM_DATA and
	  MPU_SET_EXT_SLAVE_PLATFORM_DATA, which allows userspace applications
	  to override the slave address and orientation.  This is dangerous
	  and could cause the devices not to work.

endif #INV_SENSORS
```

## drivers/misc/inv_mpu/accel/Kconfig
```kconfig
menuconfig INV_SENSORS_ACCELEROMETERS
	bool "Accelerometer Slave Sensors"
	default y
	---help---
	  Say Y here to get to see options for device drivers for various
	  accelerometrs for integration with the MPU3050 or MPU6050 driver.
	  This option alone does not add any kernel code.

	  If you say N, all options in this submenu will be skipped and disabled.

if INV_SENSORS_ACCELEROMETERS

config MPU_SENSORS_ADXL34X
	tristate "ADI adxl34x"
	depends on MPU_SENSORS_MPU3050 || MPU_SENSORS_MPU6050B1 || MPU_SENSORS_MPU6050A2
	help
	  This enables support for the ADI adxl345 or adxl346 accelerometers.
	  This support is for integration with the MPU3050 gyroscope device
	  driver.  Only one accelerometer can be registered at a time.
	  Specifying more that one accelerometer in the board file will result
	  in runtime errors.

config MPU_SENSORS_BMA222
	tristate "Bosch BMA222"
	depends on MPU_SENSORS_MPU3050 || MPU_SENSORS_MPU6050B1 || MPU_SENSORS_MPU6050A2
	help
	  This enables support for the Bosch BMA222 accelerometer
	  This support is for integration with the MPU3050 gyroscope device
	  driver.  Only one accelerometer can be registered at a time.
	  Specifying more that one accelerometer in the board file will result
	  in runtime errors.

config MPU_SENSORS_BMA150
	tristate "Bosch BMA150"
	depends on MPU_SENSORS_MPU3050 || MPU_SENSORS_MPU6050B1 || MPU_SENSORS_MPU6050A2
	help
	  This enables support for the Bosch BMA150 accelerometer
	  This support is for integration with the MPU3050 gyroscope device
	  driver.  Only one accelerometer can be registered at a time.
	  Specifying more that one accelerometer in the board file will result
	  in runtime errors.

config MPU_SENSORS_BMA250
	tristate "Bosch BMA250"
	depends on MPU_SENSORS_MPU3050 || MPU_SENSORS_MPU6050B1 || MPU_SENSORS_MPU6050A2
	help
	  This enables support for the Bosch BMA250 accelerometer
	  This support is for integration with the MPU3050 gyroscope device
	  driver.  Only one accelerometer can be registered at a time.
	  Specifying more that one accelerometer in the board file will result
	  in runtime errors.

config MPU_SENSORS_KXSD9
	tristate "Kionix KXSD9"
	depends on MPU_SENSORS_MPU3050 || MPU_SENSORS_MPU6050B1 || MPU_SENSORS_MPU6050A2
	help
	  This enables support for the Kionix KXSD9 accelerometer
	  This support is for integration with the MPU3050 gyroscope device
	  driver.  Only one accelerometer can be registered at a time.
	  Specifying more that one accelerometer in the board file will result
	  in runtime errors.

config MPU_SENSORS_KXTF9
	tristate "Kionix KXTF9"
	depends on MPU_SENSORS_MPU3050 || MPU_SENSORS_MPU6050B1 || MPU_SENSORS_MPU6050A2
	help
	  This enables support for the Kionix KXFT9 accelerometer
	  This support is for integration with the MPU3050 gyroscope device
	  driver.  Only one accelerometer can be registered at a time.
	  Specifying more that one accelerometer in the board file will result
	  in runtime errors.

config MPU_SENSORS_LIS331DLH
	tristate "ST lis331dlh"
	depends on MPU_SENSORS_MPU3050 || MPU_SENSORS_MPU6050B1 || MPU_SENSORS_MPU6050A2
	help
	  This enables support for the ST lis331dlh accelerometer
	  This support is for integration with the MPU3050 gyroscope device
	  driver.  Only one accelerometer can be registered at a time.
	  Specifying more that one accelerometer in the board file will result
	  in runtime errors.

config MPU_SENSORS_LIS3DH
	tristate "ST lis3dh"
	depends on MPU_SENSORS_MPU3050 || MPU_SENSORS_MPU6050B1 || MPU_SENSORS_MPU6050A2
	help
	  This enables support for the ST lis3dh accelerometer
	  This support is for integration with the MPU3050 gyroscope device
	  driver.  Only one accelerometer can be registered at a time.
	  Specifying more that one accelerometer in the board file will result
	  in runtime errors.

config MPU_SENSORS_LSM303DLX_A
	tristate "ST lsm303dlx"
	depends on MPU_SENSORS_MPU3050 || MPU_SENSORS_MPU6050B1 || MPU_SENSORS_MPU6050A2
	help
	  This enables support for the ST lsm303dlh and lsm303dlm accelerometers
	  This support is for integration with the MPU3050 gyroscope device
	  driver.  Only one accelerometer can be registered at a time.
	  Specifying more that one accelerometer in the board file will result
	  in runtime errors.

config MPU_SENSORS_MMA8450
	tristate "Freescale mma8450"
	depends on MPU_SENSORS_MPU3050 || MPU_SENSORS_MPU6050B1 || MPU_SENSORS_MPU6050A2
	help
	  This enables support for the Freescale mma8450 accelerometer
	  This support is for integration with the MPU3050 gyroscope device
	  driver.  Only one accelerometer can be registered at a time.
	  Specifying more that one accelerometer in the board file will result
	  in runtime errors.

config MPU_SENSORS_MMA845X
	tristate "Freescale mma8451/8452/8453"
	depends on MPU_SENSORS_MPU3050 || MPU_SENSORS_MPU6050B1 || MPU_SENSORS_MPU6050A2
	help
	  This enables support for the Freescale mma8451/8452/8453 accelerometer
	  This support is for integration with the MPU3050 gyroscope device
	  driver.  Only one accelerometer can be registered at a time.
	  Specifying more that one accelerometer in the board file will result
	  in runtime errors.

config MPU_SENSORS_MPU6050_ACCEL
	tristate "MPU6050 built in accelerometer"
	depends on MPU_SENSORS_MPU6050B1 || MPU_SENSORS_MPU6050A2
	help
	  This enables support for the MPU6050 built in accelerometer.
	  This the built in support for integration with the MPU6050 gyroscope
	  device driver.  This is the only accelerometer supported with the
	  MPU6050.  Specifying another accelerometer in the board file will
	  result in runtime errors.

endif
```

## drivers/misc/inv_mpu/compass/Kconfig
```kconfig
menuconfig INV_SENSORS_COMPASS
	bool "Compass Slave Sensors"
	default y
	---help---
	  Say Y here to get to see options for device drivers for various
	  compasses. This option alone does not add any kernel code.

	  If you say N, all options in this submenu will be skipped and disabled.

if INV_SENSORS_COMPASS

config MPU_SENSORS_AK8975
	tristate "AKM ak8975"
	help
	  This enables support for the AKM ak8975 compass
	  This support is for integration with the MPU3050 or MPU6050 gyroscope
	  device driver.  Only one compass can be registered at a time.
	  Specifying more that one compass in the board file will result
	  in runtime errors.

config MPU_SENSORS_AK8963
	tristate "AKM ak8963"
	help
	  This enables support for the AKM ak8963 compass
	  This support is for integration with the MPU3050 or MPU6050 gyroscope
	  device driver.  Only one compass can be registered at a time.
	  Specifying more that one compass in the board file will result
	  in runtime errors.

config MPU_SENSORS_AK8972
	tristate "AKM ak8972"
	help
	  This enables support for the AKM ak8972 compass
	  This support is for integration with the MPU3050 or MPU6050 gyroscope
	  device driver.  Only one compass can be registered at a time.
	  Specifying more that one compass in the board file will result
	  in runtime errors.

config MPU_SENSORS_MMC314X
	tristate "MEMSIC mmc314x"
	help
	  This enables support for the MEMSIC mmc314x compass
	  This support is for integration with the MPU3050 or MPU6050 gyroscope
	  device driver.  Only one compass can be registered at a time.
	  Specifying more that one compass in the board file will result
	  in runtime errors.

config MPU_SENSORS_AMI30X
	tristate "Aichi Steel ami30X"
	help
	  This enables support for the Aichi Steel ami304/ami305 compass
	  This support is for integration with the MPU3050 or MPU6050 gyroscope
	  device driver.  Only one compass can be registered at a time.
	  Specifying more that one compass in the board file will result
	  in runtime errors.

config MPU_SENSORS_AMI306
	tristate "Aichi Steel ami306"
	help
	  This enables support for the Aichi Steel ami306 compass
	  This support is for integration with the MPU3050 or MPU6050 gyroscope
	  device driver.  Only one compass can be registered at a time.
	  Specifying more that one compass in the board file will result
	  in runtime errors.

config MPU_SENSORS_HMC5883
	tristate "Honeywell hmc5883"
	help
	  This enables support for the Honeywell hmc5883 compass
	  This support is for integration with the MPU3050 or MPU6050 gyroscope
	  device driver.  Only one compass can be registered at a time.
	  Specifying more that one compass in the board file will result
	  in runtime errors.

config MPU_SENSORS_LSM303DLX_M
	tristate "ST lsm303dlx"
	help
	  This enables support for the ST lsm303dlh and lsm303dlm compasses
	  This support is for integration with the MPU3050 or MPU6050 gyroscope
	  device driver.  Only one compass can be registered at a time.
	  Specifying more that one compass in the board file will result
	  in runtime errors.

config MPU_SENSORS_MMC314XMS
	tristate "MEMSIC mmc314xMS"
	help
	  This enables support for the MEMSIC mmc314xMS compass
	  This support is for integration with the MPU3050 or MPU6050 gyroscope
	  device driver.  Only one compass can be registered at a time.
	  Specifying more that one compass in the board file will result
	  in runtime errors.

config MPU_SENSORS_YAS529
	tristate "Yamaha yas529"
	depends on INPUT_YAS_MAGNETOMETER
	help
	  This enables support for the Yamaha yas529 compass
	  This support is for integration with the MPU3050 or MPU6050 gyroscope
	  device driver.  Only one compass can be registered at a time.
	  Specifying more that one compass in the board file will result
	  in runtime errors.

config MPU_SENSORS_YAS530
	tristate "Yamaha yas530"
	help
	  This enables support for the Yamaha yas530 compass
	  This support is for integration with the MPU3050 or MPU6050 gyroscope
	  device driver.  Only one compass can be registered at a time.
	  Specifying more that one compass in the board file will result
	  in runtime errors.

config MPU_SENSORS_HSCDTD002B
	tristate "Alps hscdtd002b"
	help
	  This enables support for the Alps hscdtd002b compass
	  This support is for integration with the MPU3050 or MPU6050 gyroscope
	  device driver.  Only one compass can be registered at a time.
	  Specifying more that one compass in the board file will result
	  in runtime errors.

config MPU_SENSORS_HSCDTD004A
	tristate "Alps hscdtd004a"
	help
	  This enables support for the Alps hscdtd004a compass
	  This support is for integration with the MPU3050 or MPU6050 gyroscope
	  device driver.  Only one compass can be registered at a time.
	  Specifying more that one compass in the board file will result
	  in runtime errors.

endif
```

## drivers/misc/inv_mpu/pressure/Kconfig
```kconfig
menuconfig: INV_SENSORS_PRESSURE
	bool "Pressure Sensor Slaves"
	depends on INV_SENSORS
	default y
	help
	  Select y to see a list of supported pressure sensors that can be
	  integrated with the MPUxxxx set of motion processors.

if INV_SENSORS_PRESSURE

config MPU_SENSORS_BMA085
	tristate "Bosch BMA085"
	help
	  This enables support for the Bosch bma085 pressure sensor
	  This support is for integration with the MPU3050 or MPU6050 gyroscope
          device driver.  Only one accelerometer can be registered at a time.
	  Specifying more that one accelerometer in the board file will result
	  in runtime errors.

endif
```

## drivers/misc/issei/Kconfig
```kconfig
# SPDX-License-Identifier: GPL-2.0
# Copyright (C) 2023-2026 Intel Corporation
config INTEL_SSEI
	tristate "Intel Silicon Security Engine Interface"
	help
	  The ISSEI (Intel Silicon Security Engine Interface)
	  subsystem provides a communication channel between the host and the
	  Silicon Security Engine.
	  Enable this driver to get SPDM and other features on Intel client CPUs
	  released in 2024 (Lunar Lake) or later.

	  If selected, the /dev/isseiX device will be created.
	  If in doubt, select N.

if INTEL_SSEI

config INTEL_SSEI_HW_HECI
	tristate "Intel Silicon Security Engine Interface Hardware"
	depends on X86 && PCI
	help
	  HECI interface of communication channel between
	  the host and the Silicon Security Engine.

	  Implementation of ISSEI communication channel over
	  the HECI hardware PCI device.
	  This device is available on Intel client CPUs released in 2024
	  (Lunar Lake) or later.

endif
```
