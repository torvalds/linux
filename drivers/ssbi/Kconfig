## drivers/staging/b3dfg/Kconfig
```kconfig
config B3DFG
       tristate "Brontes 3d Frame Framegrabber"
       depends on PCI
       default n
       ---help---
         This driver provides support for the Brontes 3d Framegrabber
         PCI card.

         To compile this driver as a module, choose M here. The module
         will be called b3dfg.
```

## drivers/staging/bcm/Kconfig
```kconfig
config BCM_WIMAX
       tristate "Beceem BCS200/BCS220-3 and BCSM250 wimax support"
       depends on USB && NET
       help
         This is an experimental driver for the Beceem WIMAX chipset used
	 by Sprint 4G.
```

## drivers/staging/bcm2835-audio/Kconfig
```kconfig
config SND_BCM2835
        tristate "BCM2835 ALSA driver"
        depends on ARCH_BCM2835 && BCM2835_VCHIQ && SND
        select SND_PCM
        help
          Say Y or M if you want to support BCM2835 Alsa pcm card driver
```

## drivers/staging/benet/Kconfig
```kconfig
config BENET
	tristate "ServerEngines 10Gb NIC - BladeEngine"
	depends on PCI && INET && NETPOLL
	select INET_LRO
	help
	  This driver implements the NIC functionality for ServerEngines
	  10Gb network adapter BladeEngine (EC 3210).
```

## drivers/staging/board/Kconfig
```kconfig
# SPDX-License-Identifier: GPL-2.0
config STAGING_BOARD
	bool "Staging Board Support"
	depends on OF_ADDRESS && OF_IRQ && CLKDEV_LOOKUP
	help
	  Staging board base is to support continuous upstream
	  in-tree development and integration of platform devices.

	  Helps developers integrate devices as platform devices for
	  device drivers that only provide platform device bindings.
	  This in turn allows for incremental development of both
	  hardware feature support and DT binding work in parallel.
```

## drivers/staging/brcm80211/Kconfig
```kconfig
menuconfig BRCM80211
	tristate "Broadcom IEEE802.11n WLAN drivers"
	depends on WLAN

config BRCMSMAC
	bool "Broadcom IEEE802.11n PCIe SoftMAC WLAN driver"
	depends on PCI
	depends on BRCM80211 && MAC80211
	select FW_LOADER
	---help---
	  This module adds support for PCIe wireless adapters based on Broadcom
	  IEEE802.11n SoftMAC chipsets.  If you choose to build a module, it'll
	  be called brcmsmac.ko.

config BRCMFMAC
	bool "Broadcom IEEE802.11n embedded FullMAC WLAN driver"
	depends on MMC
	depends on BRCM80211 && CFG80211
	select FW_LOADER
	select WIRELESS_EXT
	select WEXT_PRIV
	---help---
	  This module adds support for embedded wireless adapters based on
	  Broadcom IEEE802.11n FullMAC chipsets.  This driver uses the kernel's
	  wireless extensions subsystem.  If you choose to build a module,
	  it'll be called brcmfmac.ko.

config BRCMDBG
	bool "Broadcom driver debug functions"
	default n
	depends on BRCM80211
	---help---
	  Selecting this enables additional code for debug purposes.
```

## drivers/staging/brcm80211/brcmfmac/Kconfig
```kconfig
menuconfig BRCMFMAC
	tristate "Broadcom fullmac wireless cards support"
	depends on MMC
	depends on CFG80211
	select FW_LOADER
	select WIRELESS_EXT
	select WEXT_PRIV
	---help---
	  This module adds support for wireless adapters based on
	  Broadcom fullmac chipsets.
	  This driver uses the kernel's wireless extensions subsystem.
	  If you choose to build a module, it'll be called brcmfmac.ko. Say M if
	  unsure.
```
