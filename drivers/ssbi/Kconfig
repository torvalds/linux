## drivers/ssbi/Kconfig
```kconfig
#
# SSBI bus support
#

menu "Qualcomm MSM SSBI bus support"

config SSBI
	tristate "Qualcomm Single-wire Serial Bus Interface (SSBI)"
	help
	  If you say yes to this option, support will be included for the
	  built-in SSBI interface on Qualcomm MSM family processors.

	  This is required for communicating with Qualcomm PMICs and
	  other devices that have the SSBI interface.

endmenu
```

## drivers/staging/Kconfig
```kconfig
# SPDX-License-Identifier: GPL-2.0
menuconfig STAGING
	bool "Staging drivers"
	help
	  This option allows you to select a number of drivers that are
	  not of the "normal" Linux kernel quality level.  These drivers
	  are placed here in order to get a wider audience to make use of
	  them.  Please note that these drivers are under heavy
	  development, may or may not work, and may contain userspace
	  interfaces that most likely will be changed in the near
	  future.

	  Using any of these drivers will taint your kernel which might
	  affect support options from both the community, and various
	  commercial support organizations.

	  If you wish to work on these drivers, to help improve them, or
	  to report problems you have with them, please see the
	  drivers/staging/<driver_name>/TODO file to see what needs to be
	  worked on, and who to contact.

	  If in doubt, say N here.


if STAGING

source "drivers/staging/wlan-ng/Kconfig"

source "drivers/staging/olpc_dcon/Kconfig"

source "drivers/staging/rtl8192u/Kconfig"

source "drivers/staging/rtl8192e/Kconfig"

source "drivers/staging/rtl8723bs/Kconfig"

source "drivers/staging/rtl8712/Kconfig"

source "drivers/staging/rts5208/Kconfig"

source "drivers/staging/octeon/Kconfig"

source "drivers/staging/vt6655/Kconfig"

source "drivers/staging/vt6656/Kconfig"

source "drivers/staging/iio/Kconfig"

source "drivers/staging/sm750fb/Kconfig"

source "drivers/staging/emxx_udc/Kconfig"

source "drivers/staging/nvec/Kconfig"

source "drivers/staging/media/Kconfig"

source "drivers/staging/board/Kconfig"

source "drivers/staging/gdm724x/Kconfig"

source "drivers/staging/fbtft/Kconfig"

source "drivers/staging/most/Kconfig"

source "drivers/staging/ks7010/Kconfig"

source "drivers/staging/greybus/Kconfig"

source "drivers/staging/vc04_services/Kconfig"

source "drivers/staging/pi433/Kconfig"

source "drivers/staging/axis-fifo/Kconfig"

source "drivers/staging/fieldbus/Kconfig"

source "drivers/staging/qlge/Kconfig"

source "drivers/staging/vme_user/Kconfig"

endif # STAGING
```

## drivers/staging/adis16255/Kconfig
```kconfig
config ADIS16255
	tristate "Analog Devices ADIS16250/16255"
	depends on SPI && SYSFS
	---help---
	If you say yes here you get support for the Analog Devices
	ADIS16250/16255 Low Power Gyroscope. The driver exposes
	orientation and gyroscope value, as well as sample rate
	to the sysfs.

	This driver can also be built as a module. If so, the module
	will be called adis16255.
```

## drivers/staging/agnx/Kconfig
```kconfig
config AGNX
	tristate "Wireless Airgo AGNX support"
	depends on WLAN_80211 && MAC80211
	---help---
	  This is an experimental driver for Airgo AGNX00 wireless chip.
```

## drivers/staging/altera-stapl/Kconfig
```kconfig
config ALTERA_STAPL
	tristate "Altera FPGA firmware download module"
	depends on I2C
	default n
	help
	  An Altera FPGA module. Say Y when you want to support this tool.
```

## drivers/staging/altpciechdma/Kconfig
```kconfig
config ALTERA_PCIE_CHDMA
	tristate "Altera PCI Express Chaining DMA driver"
	depends on PCI
	default N
	---help---
	  A reference driver that exercises the Chaining DMA logic reference
	  design generated along the Altera FPGA PCI Express soft or hard core,
	  only if instantiated using the MegaWizard, not the SOPC builder, of
	  Quartus 8.1.
```

## drivers/staging/android/Kconfig
```kconfig
# SPDX-License-Identifier: GPL-2.0
menu "Android"

config ASHMEM
	bool "Enable the Anonymous Shared Memory Subsystem"
	depends on SHMEM
	help
	  The ashmem subsystem is a new shared memory allocator, similar to
	  POSIX SHM but with different behavior and sporting a simpler
	  file-based API.

	  It is, in theory, a good memory allocator for low-memory devices,
	  because it can discard shared memory units when under memory pressure.

endmenu
```

## drivers/staging/android/fiq_debugger/Kconfig
```kconfig
config FIQ_DEBUGGER
	tristate "FIQ Mode Serial Debugger"
	default n
	depends on ARM || ARM64
	help
	  The FIQ serial debugger can accept commands even when the
	  kernel is unresponsive due to being stuck with interrupts
	  disabled.

config FIQ_DEBUGGER_NO_SLEEP
	bool "Keep serial debugger active"
	depends on FIQ_DEBUGGER
	default n
	help
	  Enables the serial debugger at boot. Passing
	  fiq_debugger.no_sleep on the kernel commandline will
	  override this config option.

config FIQ_DEBUGGER_WAKEUP_IRQ_ALWAYS_ON
	bool "Don't disable wakeup IRQ when debugger is active"
	depends on FIQ_DEBUGGER
	default n
	help
	  Don't disable the wakeup irq when enabling the uart clock.  This will
	  cause extra interrupts, but it makes the serial debugger usable with
	  on some MSM radio builds that ignore the uart clock request in power
	  collapse.

config FIQ_DEBUGGER_CONSOLE
	bool "Console on FIQ Serial Debugger port"
	depends on FIQ_DEBUGGER
	default n
	help
	  Enables a console so that printk messages are displayed on
	  the debugger serial port as the occur.

config FIQ_DEBUGGER_CONSOLE_DEFAULT_ENABLE
	bool "Put the FIQ debugger into console mode by default"
	depends on FIQ_DEBUGGER_CONSOLE
	default n
	help
	  If enabled, this puts the fiq debugger into console mode by default.
	  Otherwise, the fiq debugger will start out in debug mode.

config FIQ_DEBUGGER_TRUST_ZONE
	bool "Uart FIQ is captured by trust zone, then passed to non-secure world"
	depends on FIQ_DEBUGGER
	default n
	help
	  It is for ARM v7/V8 arch.

config FIQ_DEBUGGER_UART_OVERLAY
	bool "Install uart DT overlay"
	depends on FIQ_DEBUGGER
	select OF_OVERLAY
	default n
	help
	  If enabled, fiq debugger is calling fiq_debugger_uart_overlay()
	  that will apply overlay uart_overlay@0 to disable proper uart.

config FIQ_WATCHDOG
	bool
	select FIQ_DEBUGGER
	select PSTORE_RAM
	default n

config RK_CONSOLE_THREAD
	bool "Console write by thread"
	depends on ARCH_ROCKCHIP
	default n
	help
	  Normal kernel printk will write out to UART by "kconsole" kthread

config FIQ_DEBUGGER_FIQ_GLUE
	bool "Uart FIQ is captured by linux"
	depends on FIQ_DEBUGGER && ARM
	select FIQ_GLUE
	default n
	help
	  It is for ARM v7 arch without trust zone.
```

## drivers/staging/android/ion/Kconfig
```kconfig
# SPDX-License-Identifier: GPL-2.0
menuconfig ION
	bool "Ion Memory Manager"
	depends on HAS_DMA && MMU
	select GENERIC_ALLOCATOR
	select DMA_SHARED_BUFFER
	help
	  Choose this option to enable the ION Memory Manager,
	  used by Android to efficiently allocate buffers
	  from userspace that can be shared between drivers.
	  If you're not using Android its probably safe to
	  say N here.

config ION_SYSTEM_HEAP
	bool "Ion system heap"
	depends on ION
	help
	  Choose this option to enable the Ion system heap. The system heap
	  is backed by pages from the buddy allocator. If in doubt, say Y.

config ION_CMA_HEAP
	bool "Ion CMA heap support"
	depends on ION && DMA_CMA
	help
	  Choose this option to enable CMA heaps with Ion. This heap is backed
	  by the Contiguous Memory Allocator (CMA). If your system has these
	  regions, you should say Y here.
```

## drivers/staging/android/ion/heaps/Kconfig
```kconfig
# SPDX-License-Identifier: GPL-2.0
config ION_SYSTEM_HEAP
	bool "Ion system heap"
	depends on ION
	help
	  Choose this option to enable the Ion system heap. The system heap
	  is backed by pages from the buddy allocator. If in doubt, say Y.

config ION_CMA_HEAP
	bool "Ion CMA heap support"
	depends on ION && DMA_CMA
	help
	  Choose this option to enable CMA heaps with Ion. This heap is backed
	  by the Contiguous Memory Allocator (CMA). If your system has these
	  regions, you should say Y here.
```

## drivers/staging/android/ion/hisilicon/Kconfig
```kconfig
config HI6220_ION
        bool "Hi6220 ION Driver"
        depends on ARCH_HISI && ION
        help
          Build the Hisilicon Hi6220 ion driver.
```

## drivers/staging/android/ion_legency/Kconfig
```kconfig
menuconfig ION_LEGENCY
	bool "Legency Ion Memory Manager"
	depends on HAVE_MEMBLOCK && HAS_DMA && MMU
	select GENERIC_ALLOCATOR
	select DMA_SHARED_BUFFER
	---help---
	  Chose this option to enable the Legency ION Memory Manager,
	  used by Android to efficiently allocate buffers
	  from userspace that can be shared between drivers.
	  If you're not using Android its probably safe to
	  say N here.

config ION_LEGENCY_ROCKCHIP
	tristate "Legency Ion for Rockchip"
	depends on ARCH_ROCKCHIP && ION_LEGENCY
	help
	  Choose this option if you wish to use legency ion on an Rockchip.
```

## drivers/staging/android/switch/Kconfig
```kconfig
menuconfig ANDROID_SWITCH
	tristate "Android Switch class support"
	help
	  Say Y here to enable Android switch class support. This allows
	  monitoring switches by userspace via sysfs and uevent.

config ANDROID_SWITCH_GPIO
	tristate "Android GPIO Switch support"
	depends on GENERIC_GPIO && ANDROID_SWITCH
	help
	  Say Y here to enable GPIO based switch support.
```

## drivers/staging/arlan/Kconfig
```kconfig
config ARLAN
	tristate "Aironet Arlan 655 & IC2200 DS support"
	depends on ISA && !64BIT
	select WIRELESS_EXT
	---help---
	  Aironet makes Arlan, a class of wireless LAN adapters. These use the
	  www.Telxon.com chip, which is also used on several similar cards.
	  This driver is tested on the 655 and IC2200 series cards. Look at
	  <http://www.ylenurme.ee/~elmer/655/> for the latest information.

	  The driver is built as two modules, arlan and arlan-proc. The latter
	  is the /proc interface and is not needed most of time.

	  On some computers the card ends up in non-valid state after some
	  time. Use a ping-reset script to clear it.
```

## drivers/staging/asus_oled/Kconfig
```kconfig
config ASUS_OLED
	tristate "Asus OLED driver"
	depends on USB
	default N
	---help---
	  Enable support for the OLED display present in some Asus laptops.
```

## drivers/staging/at76_usb/Kconfig
```kconfig
config USB_ATMEL
	tristate "Atmel at76c503/at76c505/at76c505a USB cards"
	depends on WLAN_80211 && USB
	default N
	select FW_LOADER
	---help---
	  Enable support for USB Wireless devices using Atmel at76c503,
	  at76c505 or at76c505a chips.
```

## drivers/staging/ath6kl/Kconfig
```kconfig
config ATH6K_LEGACY
	tristate "Atheros AR6003 support (non mac80211)"
        depends on MMC && WLAN
        select WIRELESS_EXT
        select WEXT_PRIV
	help
	This module adds support for wireless adapters based on Atheros AR6003 chipset running over SDIO. If you choose to build it as a module, it will be called ath6kl. Pls note that AR6002 and AR6001 are not supported by this driver.

choice
	prompt "AR6003 Board Data Configuration"
	depends on ATH6K_LEGACY
	default AR600x_SD31_XXX
	help
	Select the appropriate board data template from the list below that matches your AR6003 based reference design.

config AR600x_SD31_XXX
	bool "SD31-xxx"
	help
        Board Data file for a standard SD31 reference design (File: bdata.SD31.bin)

config AR600x_WB31_XXX
	bool "WB31-xxx"
	help
        Board Data file for a standard WB31 (BT/WiFi) reference design (File: bdata.WB31.bin)

config AR600x_SD32_XXX
	bool "SD32-xxx"
	help
        Board Data file for a standard SD32 (5GHz) reference design (File: bdata.SD32.bin)

config AR600x_CUSTOM_XXX
	bool "CUSTOM-xxx"
	help
        Board Data file for a custom reference design (File: should be named as bdata.CUSTOM.bin)
endchoice

config ATH6KL_ENABLE_COEXISTENCE
	bool "BT Coexistence support"
	depends on ATH6K_LEGACY
	help
	Enables WLAN/BT coexistence support. Select the apprpriate configuration from below.

choice
	prompt "Front-End Antenna Configuration"
	depends on ATH6KL_ENABLE_COEXISTENCE
	default AR600x_DUAL_ANTENNA
	help
	Indicates the number of antennas being used by BT and WLAN. Select the appropriate configuration from the list below that matches your AR6003 based reference design.

config AR600x_DUAL_ANTENNA
	bool "Dual Antenna"
	help
        Dual Antenna Design

config AR600x_SINGLE_ANTENNA
	bool "Single Antenna"
	help
        Single Antenna Design
endchoice

choice
	prompt "Collocated Bluetooth Type"
	depends on ATH6KL_ENABLE_COEXISTENCE
	default AR600x_BT_AR3001
	help
	Select the appropriate configuration from the list below that matches your AR6003 based reference design.

config AR600x_BT_QCOM
	bool "Qualcomm BTS4020X"
	help
        Qualcomm BT (3 Wire PTA)

config AR600x_BT_CSR
	bool "CSR BC06"
	help
        CSR BT (3 Wire PTA)

config AR600x_BT_AR3001
	bool "Atheros AR3001"
	help
        Atheros BT (3 Wire PTA)
endchoice

config ATH6KL_HCI_BRIDGE
	bool "HCI over SDIO support"
	depends on ATH6K_LEGACY
	help
	Enables BT over SDIO. Applicable only for combo designs (eg: WB31)

config ATH6KL_CONFIG_GPIO_BT_RESET
	bool "Configure BT Reset GPIO"
	depends on ATH6KL_HCI_BRIDGE
	help
	Configure a WLAN GPIO for use with BT.

config AR600x_BT_RESET_PIN
	int "GPIO"
	depends on ATH6KL_CONFIG_GPIO_BT_RESET
	default 22
	help
	WLAN GPIO to be used for resetting BT

config ATH6KL_CFG80211
	bool "CFG80211 support"
	depends on ATH6K_LEGACY
	help
	Enables support for CFG80211 APIs. The default option is to use WEXT. Even with this option enabled, WEXT is not explicitly disabled and the onus of not exercising WEXT lies on the application(s) running in the user space.

config ATH6KL_HTC_RAW_INTERFACE
	bool "RAW HTC support"
	depends on ATH6K_LEGACY
	help
	Enables raw HTC interface. Allows application to directly talk to the HTC interface via the ioctl interface

config ATH6KL_VIRTUAL_SCATTER_GATHER
	bool "Virtual Scatter-Gather support"
	depends on ATH6K_LEGACY
	help
	Enables virtual scatter gather support for the hardware that does not support it natively.

config ATH6KL_SKIP_ABI_VERSION_CHECK
	bool "Skip ABI version check support"
	depends on ATH6K_LEGACY
	help
	Forces the driver to disable ABI version check. Caution: Incompatilbity between the host driver and target firmware may lead to unknown side effects.

config ATH6KL_BT_UART_FC_POLARITY
	int "UART Flow Control Polarity"
	depends on ATH6KL_LEGACY
	default 0
	help
	Configures the polarity of UART Flow Control. A value of 0 implies active low and is the default setting. Set it to 1 for active high.

config ATH6KL_DEBUG
	bool "Debug support"
	depends on ATH6K_LEGACY
	help
	Enables debug support

config ATH6KL_ENABLE_HOST_DEBUG
	bool "Host Debug support"
	depends on ATH6KL_DEBUG
	help
	Enables debug support in the driver

config ATH6KL_ENABLE_TARGET_DEBUG_PRINTS
	bool "Target Debug support - Enable UART prints"
	depends on ATH6KL_DEBUG
	help
	Enables uart prints

config AR600x_DEBUG_UART_TX_PIN
	int "GPIO"
	depends on ATH6KL_ENABLE_TARGET_DEBUG_PRINTS
	default 8
	help
	WLAN GPIO to be used for Debug UART (Tx)

config ATH6KL_DISABLE_TARGET_DBGLOGS
	bool "Target Debug support - Disable Debug logs"
	depends on ATH6KL_DEBUG
	help
	Enables debug logs
```

## drivers/staging/axis-fifo/Kconfig
```kconfig
# SPDX-License-Identifier: GPL-2.0
#
# "Xilinx AXI-Stream FIFO IP core driver"
#
config XIL_AXIS_FIFO
	tristate "Xilinx AXI-Stream FIFO IP core driver"
	depends on OF && HAS_IOMEM
	help
	  This adds support for the Xilinx AXI-Stream FIFO IP core driver.
	  The AXI Streaming FIFO allows memory mapped access to a AXI Streaming
	  interface. The Xilinx AXI-Stream FIFO IP core can be used to interface
	  to the AXI Ethernet without the need to use DMA.
```
