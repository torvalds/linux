## drivers/platform/x86/siemens/Kconfig
```kconfig
# SPDX-License-Identifier: GPL-2.0-only
#
# Siemens X86 Platform Specific Drivers
#

config SIEMENS_SIMATIC_IPC
	tristate "Siemens Simatic IPC Class driver"
	help
	  This Simatic IPC class driver is the central of several drivers. It
	  is mainly used for system identification, after which drivers in other
	  classes will take care of driving specifics of those machines.
	  i.e. LEDs and watchdog.

	  To compile this driver as a module, choose M here: the module
	  will be called simatic-ipc.

config SIEMENS_SIMATIC_IPC_BATT
	tristate "CMOS battery driver for Siemens Simatic IPCs"
	default SIEMENS_SIMATIC_IPC
	depends on HWMON
	depends on SIEMENS_SIMATIC_IPC
	help
	  This option enables support for monitoring the voltage of the CMOS
	  batteries of several Industrial PCs from Siemens.

	  To compile this driver as a module, choose M here: the module
	  will be called simatic-ipc-batt.

config SIEMENS_SIMATIC_IPC_BATT_APOLLOLAKE
	tristate "CMOS Battery monitoring for Simatic IPCs based on Apollo Lake GPIO"
	default SIEMENS_SIMATIC_IPC_BATT
	depends on PINCTRL_BROXTON
	depends on SIEMENS_SIMATIC_IPC_BATT
	help
	  This option enables CMOS battery monitoring for Simatic Industrial PCs
	  from Siemens based on Apollo Lake GPIO.

	  To compile this driver as a module, choose M here: the module
	  will be called simatic-ipc-batt-apollolake.

config SIEMENS_SIMATIC_IPC_BATT_ELKHARTLAKE
	tristate "CMOS Battery monitoring for Simatic IPCs based on Elkhart Lake GPIO"
	default SIEMENS_SIMATIC_IPC_BATT
	depends on PINCTRL_ELKHARTLAKE
	depends on SIEMENS_SIMATIC_IPC_BATT
	help
	  This option enables CMOS battery monitoring for Simatic Industrial PCs
	  from Siemens based on Elkhart Lake GPIO.

	  To compile this driver as a module, choose M here: the module
	  will be called simatic-ipc-batt-elkhartlake.

config SIEMENS_SIMATIC_IPC_BATT_F7188X
	tristate "CMOS Battery monitoring for Simatic IPCs based on Nuvoton GPIO"
	default SIEMENS_SIMATIC_IPC_BATT
	depends on GPIO_F7188X
	depends on PINCTRL_ALDERLAKE
	depends on SIEMENS_SIMATIC_IPC_BATT
	help
	  This option enables CMOS battery monitoring for Simatic Industrial PCs
	  from Siemens based on Nuvoton GPIO.

	  To compile this driver as a module, choose M here: the module
	  will be called simatic-ipc-batt-f7188x.
```

## drivers/platform/x86/tuxedo/nb04/Kconfig
```kconfig
# SPDX-License-Identifier: GPL-2.0-or-later
#
# Copyright (C) 2024-2025 Werner Sembach wse@tuxedocomputers.com
#
# TUXEDO X86 Platform Specific Drivers
#

config TUXEDO_NB04_WMI_AB
	tristate "TUXEDO NB04 WMI AB Platform Driver"
	depends on ACPI_WMI
	depends on HID
	help
	  This driver implements the WMI AB device found on TUXEDO notebooks
	  with board vendor NB04. This enables keyboard backlight control via a
	  virtual HID LampArray device.

	  When compiled as a module it will be called tuxedo_nb04_wmi_ab.
```

## drivers/platform/x86/uniwill/Kconfig
```kconfig
# SPDX-License-Identifier: GPL-2.0-or-later
#
# Uniwill X86 Platform Specific Drivers
#

menuconfig X86_PLATFORM_DRIVERS_UNIWILL
	bool "Uniwill X86 Platform Specific Device Drivers"
	depends on X86_PLATFORM_DEVICES
	help
	  Say Y here to see options for device drivers for various
	  Uniwill x86 platforms, including many OEM laptops originally
	  manufactured by Uniwill.
	  This option alone does not add any kernel code.

	  If you say N, all options in this submenu will be skipped and disabled.

if X86_PLATFORM_DRIVERS_UNIWILL

config UNIWILL_LAPTOP
	tristate "Uniwill Laptop Extras"
	default m
	depends on ACPI
	depends on ACPI_WMI
	depends on ACPI_BATTERY
	depends on HWMON
	depends on INPUT
	depends on LEDS_CLASS_MULTICOLOR
	depends on DMI
	select REGMAP
	select INPUT_SPARSEKMAP
	help
	  This driver adds support for various extra features found on Uniwill laptops,
	  like the lightbar, hwmon sensors and hotkeys. It also supports many OEM laptops
	  originally manufactured by Uniwill.

	  If you have such a laptop, say Y or M here.

endif
```

## drivers/platform/x86/x86-android-tablets/Kconfig
```kconfig
# SPDX-License-Identifier: GPL-2.0-or-later
#
# X86 Android tablet support Kconfig
#

config X86_ANDROID_TABLETS
	tristate "X86 Android tablet support"
	depends on I2C && SPI && SERIAL_DEV_BUS && ACPI && EFI && GPIOLIB && PMIC_OPREGION
	select NEW_LEDS
	select LEDS_CLASS
	help
	  X86 tablets which ship with Android as (part of) the factory image
	  typically have various problems with their DSDTs. The factory kernels
	  shipped on these devices typically have device addresses and GPIOs
	  hardcoded in the kernel, rather than specified in their DSDT.

	  With the DSDT containing a random collection of devices which may or
	  may not actually be present. This driver contains various fixes for
	  such tablets, including instantiating kernel devices for devices which
	  are missing from the DSDT.

	  If you have a x86 Android tablet say Y or M here, for a generic x86
	  distro configuration say M here.
```

## drivers/pmdomain/Kconfig
```kconfig
# SPDX-License-Identifier: GPL-2.0-only
menu "PM Domains"

source "drivers/pmdomain/actions/Kconfig"
source "drivers/pmdomain/amlogic/Kconfig"
source "drivers/pmdomain/apple/Kconfig"
source "drivers/pmdomain/arm/Kconfig"
source "drivers/pmdomain/bcm/Kconfig"
source "drivers/pmdomain/imx/Kconfig"
source "drivers/pmdomain/mediatek/Kconfig"
source "drivers/pmdomain/qcom/Kconfig"
source "drivers/pmdomain/renesas/Kconfig"
source "drivers/pmdomain/rockchip/Kconfig"
source "drivers/pmdomain/samsung/Kconfig"
source "drivers/pmdomain/st/Kconfig"
source "drivers/pmdomain/starfive/Kconfig"
source "drivers/pmdomain/sunxi/Kconfig"
source "drivers/pmdomain/tegra/Kconfig"
source "drivers/pmdomain/ti/Kconfig"
source "drivers/pmdomain/xilinx/Kconfig"

endmenu
```
