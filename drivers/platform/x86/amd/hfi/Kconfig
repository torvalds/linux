## drivers/platform/x86/intel/pmt/Kconfig
```kconfig
# SPDX-License-Identifier: GPL-2.0-only
#
# Intel Platform Monitoring Technology drivers
#

config INTEL_PMT_CLASS
	tristate
	help
	  The Intel Platform Monitoring Technology (PMT) class driver provides
	  the basic sysfs interface and file hierarchy used by PMT devices.

	  For more information, see:
	  <file:Documentation/ABI/testing/sysfs-class-intel_pmt>

	  To compile this driver as a module, choose M here: the module
	  will be called intel_pmt_class.

config INTEL_PMT_TELEMETRY
	tristate "Intel Platform Monitoring Technology (PMT) Telemetry driver"
	depends on INTEL_VSEC
	select INTEL_PMT_DISCOVERY
	select INTEL_PMT_CLASS
	help
	  The Intel Platform Monitory Technology (PMT) Telemetry driver provides
	  access to hardware telemetry metrics on devices that support the
	  feature.

	  To compile this driver as a module, choose M here: the module
	  will be called intel_pmt_telemetry.

config INTEL_PMT_CRASHLOG
	tristate "Intel Platform Monitoring Technology (PMT) Crashlog driver"
	depends on INTEL_VSEC
	select INTEL_PMT_CLASS
	help
	  The Intel Platform Monitoring Technology (PMT) crashlog driver provides
	  access to hardware crashlog capabilities on devices that support the
	  feature.

	  To compile this driver as a module, choose M here: the module
	  will be called intel_pmt_crashlog.

config INTEL_PMT_DISCOVERY
	tristate "Intel Platform Monitoring Technology (PMT) Discovery driver"
	depends on INTEL_VSEC
	select INTEL_PMT_CLASS
	help
	  The Intel Platform Monitoring Technology (PMT) discovery driver provides
	  access to details about the various PMT features and feature specific
	  attributes.

	  To compile this driver as a module, choose M here: the module
	  will be called pmt_discovery.

config INTEL_PMT_KUNIT_TEST
	tristate "KUnit tests for Intel PMT driver"
	depends on INTEL_PMT_DISCOVERY
	depends on INTEL_PMT_TELEMETRY || !INTEL_PMT_TELEMETRY
	depends on KUNIT
	help
	  Enable this option to compile and run a suite of KUnit tests for the Intel
	  Platform Monitoring Technology (PMT) driver. These tests are designed to
	  validate the driver's functionality, error handling, and overall stability,
	  helping developers catch regressions and ensure code quality during changes.

	  This option is intended for development and testing environments. It is
	  recommended to disable it in production builds. To compile this driver as a
	  module, choose M here: the module will be called pmt-discovery-kunit.
```

## drivers/platform/x86/intel/speed_select_if/Kconfig
```kconfig
menu "Intel Speed Select Techanallogy interface support"
	depends on PCI
	depends on X86_64 || COMPILE_TEST

config INTEL_SPEED_SELECT_TPMI
	tristate

config INTEL_SPEED_SELECT_INTERFACE
	tristate "Intel(R) Speed Select Techanallogy interface drivers"
	select INTEL_SPEED_SELECT_TPMI if INTEL_TPMI
	help
	  This config enables the Intel(R) Speed Select Techanallogy interface
	  drivers. The Intel(R) speed select techanallogy features are analn
	  architectural and only supported on specific Xeon(R) servers.
	  These drivers provide interface to directly communicate with hardware
	  via MMIO and Mail boxes to enumerate and control all the speed select
	  features.

	  Enable this config, if there is a need to enable and control the
	  Intel(R) Speed Select Techanallogy features from the user space.
endmenu
```

## drivers/platform/x86/intel/telemetry/Kconfig
```kconfig
# SPDX-License-Identifier: GPL-2.0-only
#
# Intel x86 Platform Specific Drivers
#

config INTEL_TELEMETRY
	tristate "Intel SoC Telemetry driver"
	depends on X86_64
	depends on MFD_INTEL_PMC_BXT
	depends on INTEL_PUNIT_IPC
	help
	  This driver provides interfaces to configure and use
	  telemetry for Intel SoC from Apollo Lake onwards.
	  It is also used to get various SoC events and parameters
	  directly via debugfs files. Various tools may use
	  this interface for SoC state monitoring.
```

## drivers/platform/x86/intel/uncore-frequency/Kconfig
```kconfig
# SPDX-License-Identifier: GPL-2.0-only
#
# Uncore Frquency control drivers
#

menu "Intel Uncore Frequency Control"
	depends on X86_64 || COMPILE_TEST

config INTEL_UNCORE_FREQ_CONTROL_TPMI
	tristate

config INTEL_UNCORE_FREQ_CONTROL
	tristate "Intel Uncore frequency control driver"
	depends on X86_64
	select INTEL_UNCORE_FREQ_CONTROL_TPMI if INTEL_TPMI
	help
	  This driver allows control of Uncore frequency limits on
	  supported server platforms.

	  Uncore frequency controls RING/LLC (last-level cache) clocks.

	  To compile this driver as a module, choose M here: the module
	  will be called intel-uncore-frequency.

endmenu
```

## drivers/platform/x86/intel/wmi/Kconfig
```kconfig
# SPDX-License-Identifier: GPL-2.0-only
#
# Intel x86 Platform Specific Drivers
#

config INTEL_WMI
	bool

config INTEL_WMI_SBL_FW_UPDATE
	tristate "Intel WMI Slim Bootloader firmware update signaling driver"
	depends on ACPI_WMI
	select INTEL_WMI
	help
	  Say Y here if you want to be able to use the WMI interface to signal
	  Slim Bootloader to trigger update on next reboot.

	  To compile this driver as a module, choose M here: the module will
	  be called intel-wmi-sbl-fw-update.

config INTEL_WMI_THUNDERBOLT
	tristate "Intel WMI thunderbolt force power driver"
	depends on ACPI_WMI
	select INTEL_WMI
	help
	  Say Y here if you want to be able to use the WMI interface on select
	  systems to force the power control of Intel Thunderbolt controllers.
	  This is useful for updating the firmware when devices are not plugged
	  into the controller.

	  To compile this driver as a module, choose M here: the module will
	  be called intel-wmi-thunderbolt.
```

## drivers/platform/x86/intel_speed_select_if/Kconfig
```kconfig
menu "Intel Speed Select Techyeslogy interface support"
	depends on PCI
	depends on X86_64 || COMPILE_TEST

config INTEL_SPEED_SELECT_INTERFACE
	tristate "Intel(R) Speed Select Techyeslogy interface drivers"
	help
	  This config enables the Intel(R) Speed Select Techyeslogy interface
	  drivers. The Intel(R) speed select techyeslogy features are yesn
	  architectural and only supported on specific Xeon(R) servers.
	  These drivers provide interface to directly communicate with hardware
	  via MMIO and Mail boxes to enumerate and control all the speed select
	  features.

	  Enable this config, if there is a need to enable and control the
	  Intel(R) Speed Select Techyeslogy features from the user space.
endmenu
```

## drivers/platform/x86/lenovo/Kconfig
```kconfig
# SPDX-License-Identifier: GPL-2.0-only
#
# Lenovo X86 Platform Specific Drivers
#

config IDEAPAD_LAPTOP
	tristate "Lenovo IdeaPad Laptop Extras"
	depends on ACPI
	depends on ACPI_BATTERY
	depends on RFKILL && INPUT
	depends on SERIO_I8042
	depends on BACKLIGHT_CLASS_DEVICE
	depends on ACPI_VIDEO || ACPI_VIDEO = n
	depends on ACPI_WMI || ACPI_WMI = n
	select ACPI_PLATFORM_PROFILE
	select INPUT_SPARSEKMAP
	select NEW_LEDS
	select LEDS_CLASS
	help
	  This is a driver for Lenovo IdeaPad netbooks contains drivers for
	  rfkill switch, hotkey, fan control and backlight control.

config LENOVO_WMI_HOTKEY_UTILITIES
	tristate "Lenovo Hotkey Utility WMI extras driver"
	depends on ACPI_WMI
	select NEW_LEDS
	select LEDS_CLASS
	imply IDEAPAD_LAPTOP
	help
	  This driver provides WMI support for Lenovo customized hotkeys function,
	  such as LED control for audio/mic mute event for Ideapad, YOGA, XiaoXin,
	  Gaming, ThinkBook and so on.

config LENOVO_WMI_CAMERA
	tristate "Lenovo WMI Camera Button driver"
	depends on ACPI_WMI
	depends on INPUT
	help
	  This driver provides support for Lenovo camera button. The Camera
	  button is a GPIO device. This driver receives ACPI notifications when
	  the camera button is switched on/off.

	  To compile this driver as a module, choose M here: the module
	  will be called lenovo-wmi-camera.

config LENOVO_YMC
	tristate "Lenovo Yoga Tablet Mode Control"
	depends on ACPI_WMI
	depends on INPUT
	depends on IDEAPAD_LAPTOP
	select INPUT_SPARSEKMAP
	help
	  This driver maps the Tablet Mode Control switch to SW_TABLET_MODE input
	  events for Lenovo Yoga notebooks.

config THINKPAD_ACPI
	tristate "ThinkPad ACPI Laptop Extras"
	depends on ACPI_EC
	depends on ACPI_BATTERY
	depends on INPUT
	depends on RFKILL || RFKILL = n
	depends on ACPI_VIDEO || ACPI_VIDEO = n
	depends on BACKLIGHT_CLASS_DEVICE
	depends on I2C
	depends on DRM
	select ACPI_PLATFORM_PROFILE
	select DRM_PRIVACY_SCREEN
	select HWMON
	select NVRAM
	select NEW_LEDS
	select LEDS_CLASS
	select INPUT_SPARSEKMAP
	help
	  This is a driver for the IBM and Lenovo ThinkPad laptops. It adds
	  support for Fn-Fx key combinations, Bluetooth control, video
	  output switching, ThinkLight control, UltraBay eject and more.
	  For more information about this driver see
	  <file:Documentation/admin-guide/laptops/thinkpad-acpi.rst> and
	  <http://ibm-acpi.sf.net/> .

	  This driver was formerly known as ibm-acpi.

	  Extra functionality will be available if the rfkill (CONFIG_RFKILL)
	  and/or ALSA (CONFIG_SND) subsystems are available in the kernel.
	  Note that if you want ThinkPad-ACPI to be built-in instead of
	  modular, ALSA and rfkill will also have to be built-in.

	  If you have an IBM or Lenovo ThinkPad laptop, say Y or M here.

config THINKPAD_ACPI_ALSA_SUPPORT
	bool "Console audio control ALSA interface"
	depends on THINKPAD_ACPI
	depends on SND
	depends on SND = y || THINKPAD_ACPI = SND
	default y
	help
	  Enables monitoring of the built-in console audio output control
	  (headphone and speakers), which is operated by the mute and (in
	  some ThinkPad models) volume hotkeys.

	  If this option is enabled, ThinkPad-ACPI will export an ALSA card
	  with a single read-only mixer control, which should be used for
	  on-screen-display feedback purposes by the Desktop Environment.

	  Optionally, the driver will also allow software control (the
	  ALSA mixer will be made read-write).  Please refer to the driver
	  documentation for details.

	  All IBM models have both volume and mute control.  Newer Lenovo
	  models only have mute control (the volume hotkeys are just normal
	  keys and volume control is done through the main HDA mixer).

config THINKPAD_ACPI_DEBUGFACILITIES
	bool "Maintainer debug facilities"
	depends on THINKPAD_ACPI
	help
	  Enables extra stuff in the thinkpad-acpi which is completely useless
	  for normal use.  Read the driver source to find out what it does.

	  Say N here, unless you were told by a kernel maintainer to do
	  otherwise.

config THINKPAD_ACPI_DEBUG
	bool "Verbose debug mode"
	depends on THINKPAD_ACPI
	help
	  Enables extra debugging information, at the expense of a slightly
	  increase in driver size.

	  If you are not sure, say N here.

config THINKPAD_ACPI_UNSAFE_LEDS
	bool "Allow control of important LEDs (unsafe)"
	depends on THINKPAD_ACPI
	help
	  Overriding LED state on ThinkPads can mask important
	  firmware alerts (like critical battery condition), or misled
	  the user into damaging the hardware (undocking or ejecting
	  the bay while buses are still active), etc.

	  LED control on the ThinkPad is write-only (with very few
	  exceptions on very ancient models), which makes it
	  impossible to know beforehand if important information will
	  be lost when one changes LED state.

	  Users that know what they are doing can enable this option
	  and the driver will allow control of every LED, including
	  the ones on the dock stations.

	  Never enable this option on a distribution kernel.

	  Say N here, unless you are building a kernel for your own
	  use, and need to control the important firmware LEDs.

config THINKPAD_ACPI_VIDEO
	bool "Video output control support"
	depends on THINKPAD_ACPI
	default y
	help
	  Allows the thinkpad_acpi driver to provide an interface to control
	  the various video output ports.

	  This feature often won't work well, depending on ThinkPad model,
	  display state, video output devices in use, whether there is a X
	  server running, phase of the moon, and the current mood of
	  Schroedinger's cat.  If you can use X.org's RandR to control
	  your ThinkPad's video output ports instead of this feature,
	  don't think twice: do it and say N here to save memory and avoid
	  bad interactions with X.org.

	  NOTE: access to this feature is limited to processes with the
	  CAP_SYS_ADMIN capability, to avoid local DoS issues in platforms
	  where it interacts badly with X.org.

	  If you are not sure, say Y here but do try to check if you could
	  be using X.org RandR instead.

config THINKPAD_ACPI_HOTKEY_POLL
	bool "Support NVRAM polling for hot keys"
	depends on THINKPAD_ACPI
	default y
	help
	  Some thinkpad models benefit from NVRAM polling to detect a few of
	  the hot key press events.  If you know your ThinkPad model does not
	  need to do NVRAM polling to support any of the hot keys you use,
	  unselecting this option will save about 1kB of memory.

	  ThinkPads T40 and newer, R52 and newer, and X31 and newer are
	  unlikely to need NVRAM polling in their latest BIOS versions.

	  NVRAM polling can detect at most the following keys: ThinkPad/Access
	  IBM, Zoom, Switch Display (fn+F7), ThinkLight, Volume up/down/mute,
	  Brightness up/down, Display Expand (fn+F8), Hibernate (fn+F12).

	  If you are not sure, say Y here.  The driver enables polling only if
	  it is strictly necessary to do so.

config THINKPAD_LMI
	tristate "Lenovo WMI-based systems management driver"
	depends on ACPI_WMI
	depends on DMI
	select FW_ATTR_CLASS
	help
	  This driver allows changing BIOS settings on Lenovo machines whose
	  BIOS support the WMI interface.

	  To compile this driver as a module, choose M here: the module will
	  be called think-lmi.

config YOGABOOK
	tristate "Lenovo Yoga Book tablet key driver"
	depends on ACPI_WMI
	depends on INPUT
	depends on I2C
	select LEDS_CLASS
	select NEW_LEDS
	help
	  Say Y here if you want to support the 'Pen' key and keyboard backlight
	  control on the Lenovo Yoga Book tablets.

	  To compile this driver as a module, choose M here: the module will
	  be called lenovo-yogabook.

config YT2_1380
	tristate "Lenovo Yoga Tablet 2 1380 fast charge driver"
	depends on SERIAL_DEV_BUS
	depends on EXTCON
	depends on ACPI
	help
	  Say Y here to enable support for the custom fast charging protocol
	  found on the Lenovo Yoga Tablet 2 1380F / 1380L models.

	  To compile this driver as a module, choose M here: the module will
	  be called lenovo-yogabook.

config LENOVO_WMI_DATA01
	tristate
	depends on ACPI_WMI

config LENOVO_WMI_EVENTS
	tristate
	depends on ACPI_WMI

config LENOVO_WMI_HELPERS
	tristate
	depends on ACPI_WMI

config LENOVO_WMI_GAMEZONE
	tristate "Lenovo GameZone WMI Driver"
	depends on ACPI_WMI
	depends on DMI
	select ACPI_PLATFORM_PROFILE
	select LENOVO_WMI_EVENTS
	select LENOVO_WMI_HELPERS
	select LENOVO_WMI_TUNING
	help
	  Say Y here if you have a WMI aware Lenovo Legion device and would like to use the
	  platform-profile firmware interface to manage power usage.

	  To compile this driver as a module, choose M here: the module will
	  be called lenovo-wmi-gamezone.

config LENOVO_WMI_TUNING
	tristate "Lenovo Other Mode WMI Driver"
	depends on ACPI_WMI
	select FW_ATTR_CLASS
	select LENOVO_WMI_DATA01
	select LENOVO_WMI_EVENTS
	select LENOVO_WMI_HELPERS
	help
	  Say Y here if you have a WMI aware Lenovo Legion device and would like to use the
	  firmware_attributes API to control various tunable settings typically exposed by
	  Lenovo software in Windows.

	  To compile this driver as a module, choose M here: the module will
	  be called lenovo-wmi-other.
```
