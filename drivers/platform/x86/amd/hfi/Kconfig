## drivers/platform/x86/amd/hfi/Kconfig
```kconfig
# SPDX-License-Identifier: GPL-2.0-only
#
# AMD Hardware Feedback Interface Driver
#

config AMD_HFI
	bool "AMD Hetero Core Hardware Feedback Driver"
	depends on ACPI
	depends on CPU_SUP_AMD
	depends on SCHED_MC_PRIO
	help
	  Select this option to enable the AMD Heterogeneous Core Hardware
	  Feedback Interface. If selected, hardware provides runtime thread
	  classification guidance to the operating system on the performance and
	  energy efficiency capabilities of each heterogeneous CPU core. These
	  capabilities may vary due to the inherent differences in the core types
	  and can also change as a result of variations in the operating
	  conditions of the system such as power and thermal limits.
```

## drivers/platform/x86/amd/hsmp/Kconfig
```kconfig
# SPDX-License-Identifier: GPL-2.0-only
#
# AMD HSMP Driver
#

config AMD_HSMP
	tristate

menu "AMD HSMP Driver"
	depends on AMD_NODE || COMPILE_TEST

config AMD_HSMP_ACPI
	tristate "AMD HSMP ACPI device driver"
	depends on ACPI
	depends on HWMON || !HWMON
	select AMD_HSMP
	help
	  Host System Management Port (HSMP) interface is a mailbox interface
	  between the x86 core and the System Management Unit (SMU) firmware.
	  The driver provides a way for user space tools to monitor and manage
	  system management functionality on EPYC and MI300A server CPUs
	  from AMD.

	  This option supports ACPI based probing.
	  You may enable this, if your platform BIOS provides an ACPI object
	  as described in amd_hsmp.rst document.

	  If you choose to compile this driver as a module the module will be
	  called hsmp_acpi.

config AMD_HSMP_PLAT
	tristate "AMD HSMP platform device driver"
	depends on HWMON || !HWMON
	select AMD_HSMP
	help
	  Host System Management Port (HSMP) interface is a mailbox interface
	  between the x86 core and the System Management Unit (SMU) firmware.
	  The driver provides a way for user space tools to monitor and manage
	  system management functionality on EPYC and MI300A server CPUs
	  from AMD.

	  This option supports platform device based probing.
	  You may enable this, if your platform BIOS does not provide
	  HSMP ACPI object.

	  If you choose to compile this driver as a module the module will be
	  called amd_hsmp.

endmenu
```

## drivers/platform/x86/amd/pmc/Kconfig
```kconfig
# SPDX-License-Identifier: GPL-2.0-only
#
# AMD PMC Driver
#

config AMD_PMC
	tristate "AMD SoC PMC driver"
	depends on ACPI && PCI && RTC_CLASS && AMD_NB
	depends on SUSPEND
	select SERIO
	help
	  The driver provides support for AMD Power Management Controller
	  primarily responsible for S2Idle transactions that are driven from
	  a platform firmware running on SMU. This driver also provides a debug
	  mechanism to investigate the S2Idle transactions and failures.

	  Say Y or M here if you have a notebook powered by AMD RYZEN CPU/APU.

	  If you choose to compile this driver as a module the module will be
	  called amd-pmc.

config AMD_MP2_STB
	bool "AMD SoC MP2 STB function"
	depends on AMD_PMC
	default AMD_PMC
	help
	  AMD MP2 STB function provides a data buffer used to log debug
	  information about the system execution during S2Idle suspend/resume.
	  A data buffer known as the STB (Smart Trace Buffer) is a circular
	  buffer which is a low-level log for the SoC which is used to debug
	  any hangs/stalls during S2Idle suspend/resume.

	  Creates debugfs to get STB, a userspace daemon can access STB log of
	  last S2Idle suspend/resume which can help to debug if hangs/stalls
	  during S2Idle suspend/resume.
```

## drivers/platform/x86/amd/pmf/Kconfig
```kconfig
# SPDX-License-Identifier: GPL-2.0-only
#
# AMD PMF Driver
#

config AMD_PMF
	tristate "AMD Platform Management Framework"
	depends on ACPI && PCI
	depends on POWER_SUPPLY
	depends on AMD_NODE
	select ACPI_PLATFORM_PROFILE
	depends on TEE && AMDTEE
	depends on AMD_SFH_HID
	depends on HAS_IOMEM
	help
	  This driver provides support for the AMD Platform Management Framework.
	  The goal is to enhance end user experience by making AMD PCs smarter,
	  quiter, power efficient by adapting to user behavior and environment.

	  To compile this driver as a module, choose M here: the module will
	  be called amd_pmf.

config AMD_PMF_DEBUG
	bool "PMF debug information"
	depends on AMD_PMF
	help
	 Enabling this option would give more debug information on the OEM fed
	 power setting values for each of the PMF feature. PMF driver gets this
	 information after evaluating a ACPI method and the information is stored
	 in the PMF config store.

	 Say Y here to enable more debug logs and Say N here if you are not sure.
```

## drivers/platform/x86/dell/Kconfig
```kconfig
# SPDX-License-Identifier: GPL-2.0-only
#
# Dell X86 Platform Specific Drivers
#

menuconfig X86_PLATFORM_DRIVERS_DELL
	bool "Dell X86 Platform Specific Device Drivers"
	depends on X86_PLATFORM_DEVICES
	help
	  Say Y here to get to see options for device drivers for various
	  Dell x86 platforms, including vendor-specific laptop extension drivers.
	  This option alone does not add any kernel code.

	  If you say N, all options in this submenu will be skipped and disabled.

if X86_PLATFORM_DRIVERS_DELL

config ALIENWARE_WMI
	tristate "Alienware Special feature control"
	default m
	depends on ACPI
	depends on LEDS_CLASS
	depends on NEW_LEDS
	depends on ACPI_WMI
	help
	 This is a driver for controlling Alienware BIOS driven
	 features.  It exposes an interface for controlling the AlienFX
	 zones on Alienware machines that don't contain a dedicated AlienFX
	 USB MCU such as the X51 and X51-R2.

config DCDBAS
	tristate "Dell Systems Management Base Driver"
	default m
	depends on X86
	help
	  The Dell Systems Management Base Driver provides a sysfs interface
	  for systems management software to perform System Management
	  Interrupts (SMIs) and Host Control Actions (system power cycle or
	  power off after OS shutdown) on certain Dell systems.

	  See <file:Documentation/driver-api/dcdbas.rst> for more details on the driver
	  and the Dell systems on which Dell systems management software makes
	  use of this driver.

	  Say Y or M here to enable the driver for use by Dell systems
	  management software such as Dell OpenManage.

config DELL_LAPTOP
	tristate "Dell Laptop Extras"
	default m
	depends on DMI
	depends on BACKLIGHT_CLASS_DEVICE
	depends on ACPI_VIDEO || ACPI_VIDEO = n
	depends on RFKILL || RFKILL = n
	depends on DELL_WMI || DELL_WMI = n
	depends on SERIO_I8042
	depends on DELL_SMBIOS
	select POWER_SUPPLY
	select LEDS_CLASS
	select NEW_LEDS
	select LEDS_TRIGGERS
	select LEDS_TRIGGER_AUDIO
	help
	This driver adds support for rfkill and backlight control to Dell
	laptops (except for some models covered by the Compal driver).

config DELL_RBU
	tristate "BIOS update support for DELL systems via sysfs"
	default m
	depends on X86
	select FW_LOADER
	select FW_LOADER_USER_HELPER
	help
	 Say m if you want to have the option of updating the BIOS for your
	 DELL system. Note you need a Dell OpenManage or Dell Update package (DUP)
	 supporting application to communicate with the BIOS regarding the new
	 image for the image update to take effect.
	 See <file:Documentation/admin-guide/dell_rbu.rst> for more details on the driver.

config DELL_RBTN
	tristate "Dell Airplane Mode Switch driver"
	default m
	depends on ACPI
	depends on INPUT
	depends on RFKILL
	help
	  Say Y here if you want to support Dell Airplane Mode Switch ACPI
	  device on Dell laptops. Sometimes it has names: DELLABCE or DELRBTN.
	  This driver register rfkill device or input hotkey device depending
	  on hardware type (hw switch slider or keyboard toggle button). For
	  rfkill devices it receive HW switch events and set correct hard
	  rfkill state.

	  To compile this driver as a module, choose M here: the module will
	  be called dell-rbtn.

#
# The DELL_SMBIOS driver depends on ACPI_WMI and/or DCDBAS if those
# backends are selected. The "depends" line prevents a configuration
# where DELL_SMBIOS=y while either of those dependencies =m.
#
config DELL_SMBIOS
	tristate "Dell SMBIOS driver"
	default m
	depends on DCDBAS || DCDBAS=n
	depends on ACPI_WMI || ACPI_WMI=n
	help
	This provides support for the Dell SMBIOS calling interface.
	If you have a Dell computer you should enable this option.

	Be sure to select at least one backend for it to work properly.

config DELL_SMBIOS_WMI
	bool "Dell SMBIOS driver WMI backend"
	default y
	depends on ACPI_WMI
	select DELL_WMI_DESCRIPTOR
	depends on DELL_SMBIOS
	help
	This provides an implementation for the Dell SMBIOS calling interface
	communicated over ACPI-WMI.

	If you have a Dell computer from >2007 you should say Y here.
	If you aren't sure and this module doesn't work for your computer
	it just won't load.

config DELL_SMBIOS_SMM
	bool "Dell SMBIOS driver SMM backend"
	default y
	depends on DCDBAS
	depends on DELL_SMBIOS
	help
	This provides an implementation for the Dell SMBIOS calling interface
	communicated over SMI/SMM.

	If you have a Dell computer from <=2017 you should say Y here.
	If you aren't sure and this module doesn't work for your computer
	it just won't load.

config DELL_SMO8800
	tristate "Dell Latitude freefall driver (ACPI SMO88XX)"
	default m
	depends on ACPI
	help
	  Say Y here if you want to support SMO88XX freefall devices
	  on Dell Latitude laptops.

	  To compile this driver as a module, choose M here: the module will
	  be called dell-smo8800.

config DELL_WMI
	tristate "Dell WMI notifications"
	default m
	depends on ACPI_WMI
	depends on DMI
	depends on INPUT
	depends on ACPI_VIDEO || ACPI_VIDEO = n
	depends on DELL_SMBIOS
	select DELL_WMI_DESCRIPTOR
	select INPUT_SPARSEKMAP
	help
	  Say Y here if you want to support WMI-based hotkeys on Dell laptops.

	  To compile this driver as a module, choose M here: the module will
	  be called dell-wmi.

config DELL_WMI_PRIVACY
	bool "Dell WMI Hardware Privacy Support"
	depends on DELL_WMI
	depends on LEDS_TRIGGER_AUDIO
	help
	  This option adds integration with the "Dell Hardware Privacy"
	  feature of Dell laptops to the dell-wmi driver.

config DELL_WMI_AIO
	tristate "WMI Hotkeys for Dell All-In-One series"
	default m
	depends on ACPI_WMI
	depends on INPUT
	select INPUT_SPARSEKMAP
	help
	  Say Y here if you want to support WMI-based hotkeys on Dell
	  All-In-One machines.

	  To compile this driver as a module, choose M here: the module will
	  be called dell-wmi-aio.

config DELL_WMI_DESCRIPTOR
	tristate
	default m
	depends on ACPI_WMI

config DELL_WMI_LED
	tristate "External LED on Dell Business Netbooks"
	default m
	depends on LEDS_CLASS
	depends on ACPI_WMI
	help
	  This adds support for the Latitude 2100 and similar
	  notebooks that have an external LED.

config DELL_WMI_SYSMAN
	tristate "Dell WMI-based Systems management driver"
	default m
	depends on ACPI_WMI
	depends on DMI
	select NLS
	select FW_ATTR_CLASS
	help
	  This driver allows changing BIOS settings on many Dell machines from
	  2018 and newer without the use of any additional software.

	  To compile this driver as a module, choose M here: the module will
	  be called dell-wmi-sysman.

endif # X86_PLATFORM_DRIVERS_DELL
```

## drivers/platform/x86/hp/Kconfig
```kconfig
# SPDX-License-Identifier: GPL-2.0-only
#
# X86 Platform Specific Drivers
#
menuconfig X86_PLATFORM_DRIVERS_HP
	bool "HP X86 Platform Specific Device Drivers"
	depends on X86_PLATFORM_DEVICES
	help
	  Say Y here to get to see options for device drivers for various
	  HP x86 platforms, including vendor-specific laptop extension drivers.
	  This option alone does not add any kernel code.

	  If you say N, all options in this submenu will be skipped and disabled.

if X86_PLATFORM_DRIVERS_HP

config HP_ACCEL
	tristate "HP laptop accelerometer"
	default m
	depends on INPUT && ACPI
	depends on SERIO_I8042
	select SENSORS_LIS3LV02D
	select NEW_LEDS
	select LEDS_CLASS
	help
	  This driver provides support for the "Mobile Data Protection System 3D"
	  or "3D DriveGuard" feature of HP laptops. On such systems the driver
	  should load automatically (via ACPI alias).

	  Support for a led indicating disk protection will be provided as
	  hp::hddprotect. For more information on the feature, refer to
	  Documentation/misc-devices/lis3lv02d.rst.

	  To compile this driver as a module, choose M here: the module will
	  be called hp_accel.

config HP_WMI
	tristate "HP WMI extras"
	default m
	depends on ACPI_WMI
	depends on INPUT
	depends on RFKILL || RFKILL = n
	select POWER_SUPPLY
	select INPUT_SPARSEKMAP
	select ACPI_PLATFORM_PROFILE
	select HWMON
	help
	  Say Y here if you want to support WMI-based hotkeys on HP laptops and
	  to read data from WMI such as docking or ambient light sensor state.

	  To compile this driver as a module, choose M here: the module will
	  be called hp-wmi.

config TC1100_WMI
	tristate "HP Compaq TC1100 Tablet WMI Extras"
	default m
	depends on !X86_64
	depends on ACPI
	depends on ACPI_WMI
	help
	  This is a driver for the WMI extensions (wireless and bluetooth power
	  control) of the HP Compaq TC1100 tablet.

config HP_BIOSCFG
	tristate "HP BIOS Configuration Driver"
	default m
	depends on ACPI_WMI
	select NLS
	select FW_ATTR_CLASS
	help
	  This driver enables administrators to securely manage BIOS settings
	  using digital certificates and public-key cryptography that eliminate
	  the need for passwords for both remote and local management. It supports
	  changing BIOS settings on many HP machines from 2018 and newer without
	  the use of any additional software.

	  To compile this driver as a module, choose M here: the module will
	  be called hp-bioscfg.

endif # X86_PLATFORM_DRIVERS_HP
```
