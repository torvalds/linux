## drivers/platform/x86/intel/Kconfig
```kconfig
# SPDX-License-Identifier: GPL-2.0-only
#
# Intel x86 Platform Specific Drivers
#

source "drivers/platform/x86/intel/atomisp2/Kconfig"
source "drivers/platform/x86/intel/int1092/Kconfig"
source "drivers/platform/x86/intel/int33fe/Kconfig"
source "drivers/platform/x86/intel/int3472/Kconfig"
source "drivers/platform/x86/intel/pmc/Kconfig"
source "drivers/platform/x86/intel/pmt/Kconfig"
source "drivers/platform/x86/intel/speed_select_if/Kconfig"
source "drivers/platform/x86/intel/telemetry/Kconfig"
source "drivers/platform/x86/intel/wmi/Kconfig"

config INTEL_HID_EVENT
	tristate "Intel HID Event"
	depends on ACPI
	depends on INPUT
	depends on I2C
	select INPUT_SPARSEKMAP
	help
	  This driver provides support for the Intel HID Event hotkey interface.
	  Some laptops require this driver for hotkey support.

	  To compile this driver as a module, choose M here: the module will
	  be called intel_hid.

config INTEL_VBTN
	tristate "Intel Virtual Button"
	depends on ACPI
	depends on INPUT
	depends on I2C
	select INPUT_SPARSEKMAP
	help
	  This driver provides support for the Intel Virtual Button interface.
	  Some laptops require this driver for power button support.

	  To compile this driver as a module, choose M here: the module will
	  be called intel_vbtn.

config INTEL_INT0002_VGPIO
	tristate "Intel ACPI INT0002 Virtual GPIO driver"
	depends on GPIOLIB && ACPI && PM_SLEEP
	select GPIOLIB_IRQCHIP
	help
	  Some peripherals on Bay Trail and Cherry Trail platforms signal a
	  Power Management Event (PME) to the Power Management Controller (PMC)
	  to wakeup the system. When this happens software needs to explicitly
	  clear the PME bus 0 status bit in the GPE0a_STS register to avoid an
	  IRQ storm on IRQ 9.

	  This is modelled in ACPI through the INT0002 ACPI device, which is
	  called a "Virtual GPIO controller" in ACPI because it defines the
	  event handler to call when the PME triggers through _AEI and _L02
	  methods as would be done for a real GPIO interrupt in ACPI.

	  To compile this driver as a module, choose M here: the module will
	  be called intel_int0002_vgpio.

config INTEL_OAKTRAIL
	tristate "Intel Oaktrail Platform Extras"
	depends on ACPI
	depends on ACPI_VIDEO || ACPI_VIDEO=n
	depends on RFKILL && BACKLIGHT_CLASS_DEVICE && ACPI
	help
	  Intel Oaktrail platform need this driver to provide interfaces to
	  enable/disable the Camera, WiFi, BT etc. devices. If in doubt, say Y
	  here; it will only load on supported platforms.

config INTEL_BXTWC_PMIC_TMU
	tristate "Intel Broxton Whiskey Cove TMU Driver"
	depends on INTEL_SOC_PMIC_BXTWC
	depends on MFD_INTEL_PMC_BXT
	select REGMAP
	help
	  Select this driver to use Intel Broxton Whiskey Cove PMIC TMU feature.
	  This driver enables the alarm wakeup functionality in the TMU unit of
	  Whiskey Cove PMIC.

config INTEL_CHTDC_TI_PWRBTN
	tristate "Intel Cherry Trail Dollar Cove TI power button driver"
	depends on INTEL_SOC_PMIC_CHTDC_TI
	depends on INPUT
	help
	  This option adds a power button driver for Dollar Cove TI
	  PMIC on Intel Cherry Trail devices.

	  To compile this driver as a module, choose M here: the module
	  will be called intel_chtdc_ti_pwrbtn.

config INTEL_ISHTP_ECLITE
	tristate "Intel ISHTP eclite controller Driver"
	depends on INTEL_ISH_HID
	depends on ACPI
	help
	  This driver is for accessing the PSE (Programmable Service Engine) -
	  an Embedded Controller like IP - using ISHTP (Integrated Sensor Hub
	  Transport Protocol) to get battery, thermal and UCSI (USB Type-C
	  Connector System Software Interface) related data from the platform.
	  Users who don't want to use discrete Embedded Controller on Intel's
	  Elkhartlake platform can leverage this integrated solution of
	  ECLite which is part of PSE subsystem.

	  To compile this driver as a module, choose M here: the module
	  will be called intel_ishtp_eclite.

config INTEL_MRFLD_PWRBTN
	tristate "Intel Merrifield Basin Cove power button driver"
	depends on INTEL_SOC_PMIC_MRFLD
	depends on INPUT
	help
	  This option adds a power button driver for Basin Cove PMIC
	  on Intel Merrifield devices.

	  To compile this driver as a module, choose M here: the module
	  will be called intel_mrfld_pwrbtn.

config INTEL_PUNIT_IPC
	tristate "Intel P-Unit IPC Driver"
	help
	  This driver provides support for Intel P-Unit Mailbox IPC mechanism,
	  which is used to bridge the communications between kernel and P-Unit.

config INTEL_RST
	tristate "Intel Rapid Start Technology Driver"
	depends on ACPI
	help
	  This driver provides support for modifying parameters on systems
	  equipped with Intel's Rapid Start Technology. When put in an ACPI
	  sleep state, these devices will wake after either a configured
	  timeout or when the system battery reaches a critical state,
	  automatically copying memory contents to disk. On resume, the
	  firmware will copy the memory contents back to RAM and resume the OS
	  as usual.

config INTEL_SMARTCONNECT
	tristate "Intel Smart Connect disabling driver"
	depends on ACPI
	help
	  Intel Smart Connect is a technology intended to permit devices to
	  update state by resuming for a short period of time at regular
	  intervals. If a user enables this functionality under Windows and
	  then reboots into Linux, the system may remain configured to resume
	  on suspend. In the absence of any userspace to support it, the system
	  will then remain awake until something triggers another suspend.

	  This driver checks to determine whether the device has Intel Smart
	  Connect enabled, and if so disables it.

config INTEL_TURBO_MAX_3
	bool "Intel Turbo Boost Max Technology 3.0 enumeration driver"
	depends on X86_64 && SCHED_MC_PRIO
	help
	  This driver reads maximum performance ratio of each CPU and set up
	  the scheduler priority metrics. In this way scheduler can prefer
	  CPU with higher performance to schedule tasks.

	  This driver is only required when the system is not using Hardware
	  P-States (HWP). In HWP mode, priority can be read from ACPI tables.

config INTEL_UNCORE_FREQ_CONTROL
	tristate "Intel Uncore frequency control driver"
	depends on X86_64
	help
	  This driver allows control of Uncore frequency limits on
	  supported server platforms.

	  Uncore frequency controls RING/LLC (last-level cache) clocks.

	  To compile this driver as a module, choose M here: the module
	  will be called intel-uncore-frequency.

config INTEL_VSEC
	tristate "Intel Vendor Specific Extended Capabilities Driver"
	depends on PCI
	select AUXILIARY_BUS
	help
	  Adds support for feature drivers exposed using Intel PCIe VSEC and
	  DVSEC.

	  To compile this driver as a module, choose M here: the module will
	  be called intel_vsec.
```

## drivers/platform/x86/intel/atomisp2/Kconfig
```kconfig
# SPDX-License-Identifier: GPL-2.0-only
#
# Intel x86 Platform Specific Drivers
#

config INTEL_ATOMISP2_PDX86
	bool

config INTEL_ATOMISP2_LED
	tristate "Intel AtomISP v2 camera LED driver"
	depends on GPIOLIB && LEDS_GPIO
	select INTEL_ATOMISP2_PDX86
	help
	  Many Bay Trail and Cherry Trail devices come with a camera attached
	  to Intel's Image Signal Processor. Linux currently does not have a
	  driver for these, so they do not work as a camera. Some of these
	  camera's have a LED which is controlled through a GPIO.

	  Some of these devices have a firmware issue where the LED gets turned
	  on at boot. This driver will turn the LED off at boot and also allows
	  controlling the LED (repurposing it) through the sysfs LED interface.

	  Which GPIO is attached to the LED is usually not described in the
	  ACPI tables, so this driver contains per-system info about the GPIO
	  inside the driver, this means that this driver only works on systems
	  the driver knows about.

	  To compile this driver as a module, choose M here: the module
	  will be called intel_atomisp2_led.

config INTEL_ATOMISP2_PM
	tristate "Intel AtomISP v2 dummy / power-management driver"
	depends on PCI && IOSF_MBI && PM
	depends on !INTEL_ATOMISP
	select INTEL_ATOMISP2_PDX86
	help
	  Power-management driver for Intel's Image Signal Processor found on
	  Bay Trail and Cherry Trail devices. This dummy driver's sole purpose
	  is to turn the ISP off (put it in D3) to save power and to allow
	  entering of S0ix modes.

	  To compile this driver as a module, choose M here: the module
	  will be called intel_atomisp2_pm.
```

## drivers/platform/x86/intel/ifs/Kconfig
```kconfig
config INTEL_IFS
	tristate "Intel In Field Scan"
	depends on X86 && CPU_SUP_INTEL && 64BIT && SMP
	# Discussion on the list has shown that the sysfs API needs a bit
	# more work, mark this as broken for now
	depends on BROKEN
	select INTEL_IFS_DEVICE
	help
	  Enable support for the In Field Scan capability in select
	  CPUs. The capability allows for running low level tests via
	  a scan image distributed by Intel via Github to validate CPU
	  operation beyond baseline RAS capabilities. To compile this
	  support as a module, choose M here. The module will be called
	  intel_ifs.

	  If unsure, say N.
```

## drivers/platform/x86/intel/int1092/Kconfig
```kconfig
config INTEL_SAR_INT1092
	tristate "Intel Specific Absorption Rate Driver"
	depends on ACPI
	help
	  This driver helps to limit the exposure of human body to RF frequency by
	  providing information to userspace application that will inform the Intel
	  M.2 modem to regulate the RF power based on SAR data obtained from the
	  sensors captured in the BIOS. ACPI interface exposes this data from the BIOS
	  to SAR driver. The front end application in userspace will interact with SAR
	  driver to obtain information like the device mode, Antenna index, baseband index,
	  SAR table index and use available communication like MBIM interface to enable
	  data communication to modem for RF power regulation. Enable this config when
	  given platform needs to support "Dynamic SAR" configuration for a modem available
	  on the platform.
```

## drivers/platform/x86/intel/int33fe/Kconfig
```kconfig
# SPDX-License-Identifier: GPL-2.0-only
config INTEL_CHT_INT33FE
	tristate "Intel Cherry Trail ACPI INT33FE Driver"
	depends on X86 && ACPI && I2C && REGULATOR
	depends on CHARGER_BQ24190=y || (CHARGER_BQ24190=m && m)
	depends on USB_ROLES_INTEL_XHCI=y || (USB_ROLES_INTEL_XHCI=m && m)
	depends on TYPEC_MUX_PI3USB30532=y || (TYPEC_MUX_PI3USB30532=m && m)
	help
	  This driver add support for the INT33FE ACPI device found on the
	  GPD win and the GPD pocket.

	  The INT33FE ACPI device on these mini laptops contains I2cSerialBusV2
	  resources for a MAX17042 Fuel Gauge, FUSB302 USB Type-C Controller
	  and PI3USB30532 USB switch.
	  This driver instantiates i2c-clients for these, so that standard
	  i2c drivers for these chips can bind to the them.

	  If you enable this driver it is advised to also select
	  CONFIG_TYPEC_FUSB302=m, CONFIG_TYPEC_MUX_PI3USB30532=m and
	  CONFIG_BATTERY_MAX17042=m.
```

## drivers/platform/x86/intel/int3472/Kconfig
```kconfig
config INTEL_SKL_INT3472
	tristate "Intel SkyLake ACPI INT3472 Driver"
	depends on ACPI
	depends on COMMON_CLK
	depends on I2C
	depends on GPIOLIB
	depends on LEDS_CLASS
	depends on REGULATOR
	select MFD_CORE
	select REGMAP_I2C
	help
	  This driver adds power controller support for the Intel SkyCam
	  devices found on the Intel SkyLake platforms.

	  The INT3472 is a camera power controller, a logical device found on
	  Intel Skylake-based systems that can map to different hardware
	  devices depending on the platform. On machines designed for Chrome OS
	  it maps to a TPS68470 camera PMIC. On machines designed for Windows,
	  it maps to either a TP68470 camera PMIC, a uP6641Q sensor PMIC, or a
	  set of discrete GPIOs and power gates.

	  If your device was designed for Chrome OS, this driver will provide
	  an ACPI OpRegion, which must be available before any of the devices
	  using it are probed. For this reason, you should select Y if your
	  device was designed for ChromeOS. For the same reason the
	  I2C_DESIGNWARE_PLATFORM option must be set to Y too.

	  Say Y or M here if you have a SkyLake device designed for use
	  with Windows or ChromeOS. Say N here if you are not sure.

	  The module will be named "intel-skl-int3472".
```

## drivers/platform/x86/intel/pmc/Kconfig
```kconfig
# SPDX-License-Identifier: GPL-2.0
#
# Intel x86 Platform-Specific Drivers
#

config INTEL_PMC_CORE
	tristate "Intel PMC Core driver"
	depends on PCI
	depends on ACPI
	depends on INTEL_PMT_TELEMETRY
	select INTEL_PMC_SSRAM_TELEMETRY
	select INTEL_PMC_PWRM_TELEMETRY
	help
	  The Intel Platform Controller Hub for Intel Core SoCs provides access
	  to Power Management Controller registers via various interfaces. This
	  driver can utilize debugging capabilities and supported features as
	  exposed by the Power Management Controller. It also may perform some
	  tasks in the PMC in order to enable transition into the SLPS0 state.
	  It should be selected on all Intel platforms supported by the driver.

	  Supported features:
		- SLP_S0_RESIDENCY counter
		- PCH IP Power Gating status
		- LTR Ignore / LTR Show
		- MPHY/PLL gating status (Sunrisepoint PCH only)
		- SLPS0 Debug registers (Cannonlake/Icelake PCH)
		- Low Power Mode registers (Tigerlake and beyond)
		- PMC quirks as needed to enable SLPS0/S0ix

config INTEL_PMC_SSRAM_TELEMETRY
	tristate
	help
	  This driver discovers PMC SSRAM telemetry regions through the PMC's
	  MMIO interface (PCI) or ACPI _DSD properties and registers them with
	  the Intel VSEC framework as Intel PMT telemetry devices.

	  It probes the PMC SSRAM device, extracts DVSEC information from MMIO,
	  reads device IDs and base addresses for multiple PMCs (main, IOE, PCH),
	  and exposes the discovered telemetry through Intel PMT interfaces
	  (including sysfs).

	  This option is selected by INTEL_PMC_CORE.

config INTEL_PMC_PWRM_TELEMETRY
	tristate
	help
	  This driver discovers PMC PWRM telemetry regions described in ACPI
	  _DSD and registers them with the Intel VSEC framework as Intel PMT
	  telemetry devices.

	  It validates the ACPI discovery data and publishes the discovered
	  regions so they can be accessed through the Intel PMT telemetry
	  interfaces (including sysfs).

	  This option is selected by INTEL_PMC_CORE.
```
