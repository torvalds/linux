## drivers/hid/amd-sfh-hid/Kconfig
```kconfig
# SPDX-License-Identifier: GPL-2.0-or-later
menu "AMD SFH HID Support"
	depends on X86_64 || COMPILE_TEST
	depends on PCI

config AMD_SFH_HID
	tristate "AMD Sensor Fusion Hub"
	depends on X86
	help
	  If you say yes to this option, support will be included for the
	  AMD Sensor Fusion Hub.
	  This driver will enable sensors functionality on AMD platforms
	  starting from 17h family of RYZEN parts.

	  This driver can also be built as a module. If so, the module will
	  be called amd-sfh.
	  Say Y or M here if you want to support AMD SFH. If unsure, say N.
endmenu
```

## drivers/hid/bpf/Kconfig
```kconfig
# SPDX-License-Identifier: GPL-2.0-only
menu "HID-BPF support"

config HID_BPF
	bool "HID-BPF support"
	depends on BPF_JIT
	depends on BPF_SYSCALL
	depends on DYNAMIC_FTRACE_WITH_DIRECT_CALLS
	help
	This option allows to support eBPF programs on the HID subsystem.
	eBPF programs can fix HID devices in a lighter way than a full
	kernel patch and allow a lot more flexibility.

	For documentation, see Documentation/hid/hid-bpf.rst

endmenu
```

## drivers/hid/i2c-hid/Kconfig
```kconfig
# SPDX-License-Identifier: GPL-2.0-only
menuconfig I2C_HID
	tristate "I2C HID support"
	default y
	depends on I2C

if I2C_HID

config I2C_HID_ACPI
	tristate "HID over I2C transport layer ACPI driver"
	depends on ACPI
	depends on DRM || !DRM
	select I2C_HID_CORE
	help
	  Say Y here if you use a keyboard, a touchpad, a touchscreen, or any
	  other HID based devices which is connected to your computer via I2C.
	  This driver supports ACPI-based systems.

	  If unsure, say N.

	  This support is also available as a module.  If so, the module
	  will be called i2c-hid-acpi.  It will also build/depend on the
	  module i2c-hid.

config I2C_HID_OF
	tristate "HID over I2C transport layer Open Firmware driver"
	# No "depends on OF" because this can also be used for manually
	# (board-file) instantiated "hid-over-i2c" type i2c-clients.
	depends on DRM || !DRM
	select I2C_HID_CORE
	help
	  Say Y here if you use a keyboard, a touchpad, a touchscreen, or any
	  other HID based devices which is connected to your computer via I2C.
	  This driver supports Open Firmware (Device Tree)-based systems as
	  well as binding to manually (board-file) instantiated i2c-hid-clients.

	  If unsure, say N.

	  This support is also available as a module.  If so, the module
	  will be called i2c-hid-of.  It will also build/depend on the
	  module i2c-hid.

config I2C_HID_OF_ELAN
	tristate "Driver for Elan hid-i2c based devices on OF systems"
	depends on OF
	depends on DRM || !DRM
	select I2C_HID_CORE
	help
	  Say Y here if you want support for Elan i2c devices that use
	  the i2c-hid protocol on Open Firmware (Device Tree)-based
	  systems.

	  If unsure, say N.

	  This support is also available as a module.  If so, the module
	  will be called i2c-hid-of-elan.  It will also build/depend on
	  the module i2c-hid.

config I2C_HID_OF_GOODIX
	tristate "Driver for Goodix hid-i2c based devices on OF systems"
	depends on OF
	depends on DRM || !DRM
	select I2C_HID_CORE
	help
	  Say Y here if you want support for Goodix i2c devices that use
	  the i2c-hid protocol on Open Firmware (Device Tree)-based
	  systems.

	  If unsure, say N.

	  This support is also available as a module.  If so, the module
	  will be called i2c-hid-of-goodix.  It will also build/depend on
	  the module i2c-hid.

config I2C_HID_CORE
	tristate
	# We need to call into panel code so if DRM=m, this can't be 'y'
	depends on DRM || !DRM
endif
```

## drivers/hid/intel-ish-hid/Kconfig
```kconfig
menu "Intel ISH HID support"
	depends on (X86_64 || COMPILE_TEST) && PCI

config INTEL_ISH_HID
	tristate "Intel Integrated Sensor Hub"
	default n
	select HID
	help
	  The Integrated Sensor Hub (ISH) enables the ability to offload
	  sensor polling and algorithm processing to a dedicated low power
	  processor in the chipset. This allows the core processor to go into
	  low power modes more often, resulting in the increased battery life.
	  The current processors that support ISH are: Cherrytrail, Skylake,
	  Broxton and Kaby Lake.

	  Say Y here if you want to support Intel ISH. If unsure, say N.
endmenu
```

## drivers/hid/intel-thc-hid/Kconfig
```kconfig
# SPDX-License-Identifier: GPL-2.0
# Copyright (c) 2024, Intel Corporation.

menu "Intel THC HID Support"
	depends on X86_64 && PCI

config INTEL_THC_HID
	tristate "Intel Touch Host Controller"
	depends on ACPI
	help
	  THC (Touch Host Controller) is the name of the IP block in PCH that
	  interfaces with Touch Devices (ex: touchscreen, touchpad etc.). It
	  is comprised of 3 key functional blocks: A natively half-duplex
	  Quad I/O capable SPI master; a low latency I2C interface to support
	  HIDI2C compliant devices; a hardware sequencer with Read/Write DMA
	  capability to system memory.

	  Say Y/M here if you want to support Intel THC. If unsure, say N.

config INTEL_QUICKSPI
	tristate "Intel QuickSPI driver based on Intel Touch Host Controller"
	depends on INTEL_THC_HID
	help
	  Intel QuickSPI, based on Touch Host Controller (THC), implements
	  HIDSPI (HID over SPI) protocol. It configures THC to work at SPI
	  mode, and controls THC hardware sequencer to accelerate HIDSPI
	  transaction flow.

	  Say Y/M here if you want to support Intel QuickSPI. If unsure, say N.

config INTEL_QUICKI2C
	tristate "Intel QuickI2C driver based on Intel Touch Host Controller"
	depends on INTEL_THC_HID
	help
	  Intel QuickI2C, uses Touch Host Controller (THC) hardware, implements
	  HIDI2C (HID over I2C) protocol. It configures THC to work in I2C
	  mode, and controls THC hardware sequencer to accelerate HIDI2C
	  transaction flow.

	  Say Y/M here if you want to support Intel QuickI2C. If unsure, say N.

endmenu
```

## drivers/hid/surface-hid/Kconfig
```kconfig
# SPDX-License-Identifier: GPL-2.0+
menu "Surface System Aggregator Module HID support"
	depends on SURFACE_AGGREGATOR

config SURFACE_HID
	tristate "HID transport driver for Surface System Aggregator Module"
	depends on SURFACE_AGGREGATOR_REGISTRY
	select SURFACE_HID_CORE
	help
	  Driver to support integrated HID devices on newer Microsoft Surface
	  models.

	  This driver provides support for the HID transport protocol provided
	  by the Surface Aggregator Module (i.e. the embedded controller) on
	  7th-generation Microsoft Surface devices, i.e. Surface Book 3 and
	  Surface Laptop 3. On those models, it is mainly used to connect the
	  integrated touchpad and keyboard.

	  Say M or Y here, if you want support for integrated HID devices, i.e.
	  integrated touchpad and keyboard, on 7th generation Microsoft Surface
	  models.

config SURFACE_KBD
	tristate "HID keyboard transport driver for Surface System Aggregator Module"
	select SURFACE_HID_CORE
	help
	  Driver to support HID keyboards on Surface Laptop 1 and 2 devices.

	  This driver provides support for the HID transport protocol provided
	  by the Surface Aggregator Module (i.e. the embedded controller) on
	  Microsoft Surface Laptops 1 and 2. It is used to connect the
	  integrated keyboard on those devices.

	  Say M or Y here, if you want support for the integrated keyboard on
	  Microsoft Surface Laptops 1 and 2.

endmenu

config SURFACE_HID_CORE
	tristate
```

## drivers/hid/usbhid/Kconfig
```kconfig
# SPDX-License-Identifier: GPL-2.0-only
menu "USB HID support"
	depends on USB

config USB_HID
	tristate "USB HID transport layer"
	default y
	depends on USB && INPUT
	select HID
	help
	  Say Y here if you want to connect USB keyboards,
	  mice, joysticks, graphic tablets, or any other HID based devices
	  to your computer via USB, as well as Uninterruptible Power Supply
	  (UPS) and monitor control devices.

	  You can't use this driver and the HIDBP (Boot Protocol) keyboard
	  and mouse drivers at the same time. More information is available:
	  <file:Documentation/input/input.rst>.

	  If unsure, say Y.

	  To compile this driver as a module, choose M here: the
	  module will be called usbhid.

comment "Input core support is needed for USB HID input layer or HIDBP support"
	depends on USB_HID && INPUT=n

config HID_PID
	bool "PID device support"
	help
	  Say Y here if you have a PID-compliant device and wish to enable force
	  feedback for it. Microsoft Sidewinder Force Feedback 2 is one of such
	  devices.

config USB_HIDDEV
	bool "/dev/hiddev raw HID device support"
	depends on USB_HID
	help
	  Say Y here if you want to support HID devices (from the USB
	  specification standpoint) that aren't strictly user interface
	  devices, like monitor controls and Uninterruptible Power Supplies.

	  This module supports these devices separately using a separate
	  event interface on /dev/usb/hiddevX (char 180:96 to 180:111).

	  If unsure, say Y.

menu "USB HID Boot Protocol drivers"
	depends on USB!=n && USB_HID!=y && EXPERT

config USB_KBD
	tristate "USB HIDBP Keyboard (simple Boot) support"
	depends on USB && INPUT
	help
	  Say Y here only if you are absolutely sure that you don't want
	  to use the generic HID driver for your USB keyboard and prefer
	  to use the keyboard in its limited Boot Protocol mode instead.

	  This is almost certainly not what you want.  This is mostly
	  useful for embedded applications or simple keyboards.

	  To compile this driver as a module, choose M here: the
	  module will be called usbkbd.

	  If even remotely unsure, say N.

config USB_MOUSE
	tristate "USB HIDBP Mouse (simple Boot) support"
	depends on USB && INPUT
	help
	  Say Y here only if you are absolutely sure that you don't want
	  to use the generic HID driver for your USB mouse and prefer
	  to use the mouse in its limited Boot Protocol mode instead.

	  This is almost certainly not what you want.  This is mostly
	  useful for embedded applications or simple mice.

	  To compile this driver as a module, choose M here: the
	  module will be called usbmouse.

	  If even remotely unsure, say N.

endmenu

endmenu
```

## drivers/hsi/Kconfig
```kconfig
#
# HSI driver configuration
#
menuconfig HSI
	tristate "HSI support"
	---help---
	  The "High speed synchronous Serial Interface" is
	  synchronous serial interface used mainly to connect
	  application engines and cellular modems.

if HSI

config HSI_BOARDINFO
	bool
	default y

source "drivers/hsi/controllers/Kconfig"
source "drivers/hsi/clients/Kconfig"

endif # HSI
```

## drivers/hsi/clients/Kconfig
```kconfig
# SPDX-License-Identifier: GPL-2.0-only
#
# HSI clients configuration
#

comment "HSI clients"

config ANALKIA_MODEM
	tristate "Analkia Modem"
	depends on HSI && SSI_PROTOCOL && CMT_SPEECH
	help
	Say Y here if you want to add support for the modem on Analkia
	N900 (Analkia RX-51) hardware.

	If unsure, say N.

config CMT_SPEECH
	tristate "CMT speech"
	depends on HSI && SSI_PROTOCOL
	help
	If you say Y here, you will enable the CMT speech protocol used
	by Analkia modems. If you say M the protocol will be available as
	module named cmt_speech.

	If unsure, say N.

config SSI_PROTOCOL
	tristate "SSI protocol"
	depends on HSI && PHONET && OMAP_SSI
	help
	If you say Y here, you will enable the SSI protocol aka McSAAB.

	If unsure, say N.

config HSI_CHAR
	tristate "HSI/SSI character driver"
	depends on HSI
	help
	  If you say Y here, you will enable the HSI/SSI character driver.
	  This driver provides a simple character device interface for
	  serial communication with the cellular modem over HSI/SSI bus.
```

## drivers/hsi/controllers/Kconfig
```kconfig
# SPDX-License-Identifier: GPL-2.0-only
#
# HSI controllers configuration
#
comment "HSI controllers"

config OMAP_SSI
	tristate "OMAP SSI hardware driver"
	depends on HSI && OF && ARM && COMMON_CLK
	depends on ARCH_OMAP3 || COMPILE_TEST
	help
	  SSI is a legacy version of HSI. It is usually used to connect
	  an application engine with a cellular modem.
	  If you say Y here, you will enable the OMAP SSI hardware driver.

	  If unsure, say N.
```

## drivers/hte/Kconfig
```kconfig
# SPDX-License-Identifier: GPL-2.0-only
menuconfig HTE
	bool "Hardware Timestamping Engine (HTE) Support"
	help
	  Hardware Timestamping Engine (HTE) Support.

	  Some devices provide a hardware timestamping engine which can
	  timestamp certain device lines/signals in realtime. It comes with a
	  benefit for the applications needing accurate timestamping event with
	  less jitter. This framework provides a generic interface to such HTE
	  providers and consumer devices.

	  If unsure, say no.

if HTE

config HTE_TEGRA194
	tristate "NVIDIA Tegra194 HTE Support"
	depends on (ARCH_TEGRA_194_SOC || COMPILE_TEST)
	help
	  Enable this option for integrated hardware timestamping engine also
	  known as generic timestamping engine (GTE) support on NVIDIA Tegra194
	  systems-on-chip. The driver supports 352 LIC IRQs and 39 AON GPIOs
	  lines for timestamping in realtime.

config HTE_TEGRA194_TEST
        tristate "NVIDIA Tegra194 HTE Test"
        depends on (HTE_TEGRA194 || COMPILE_TEST)
        help
	  The NVIDIA Tegra194 GTE test driver demonstrates how to use HTE
	  framework to timestamp GPIO and LIC IRQ lines.

endif
```

## drivers/hv/Kconfig
```kconfig
# SPDX-License-Identifier: GPL-2.0

menu "Microsoft Hyper-V guest support"

config HYPERV
	tristate "Microsoft Hyper-V client drivers"
	depends on (X86 && X86_LOCAL_APIC && HYPERVISOR_GUEST) \
		|| (ACPI && ARM64 && !CPU_BIG_ENDIAN)
	select PARAVIRT
	select X86_HV_CALLBACK_VECTOR if X86
	select OF_EARLY_FLATTREE if OF
	help
	  Select this option to run Linux as a Hyper-V client operating
	  system.

config HYPERV_VTL_MODE
	bool "Enable Linux to boot in VTL context"
	depends on X86_64 && HYPERV
	depends on SMP
	default n
	help
	  Virtual Secure Mode (VSM) is a set of hypervisor capabilities and
	  enlightenments offered to host and guest partitions which enables
	  the creation and management of new security boundaries within
	  operating system software.

	  VSM achieves and maintains isolation through Virtual Trust Levels
	  (VTLs). Virtual Trust Levels are hierarchical, with higher levels
	  being more privileged than lower levels. VTL0 is the least privileged
	  level, and currently only other level supported is VTL2.

	  Select this option to build a Linux kernel to run at a VTL other than
	  the normal VTL0, which currently is only VTL2.  This option
	  initializes the x86 platform for VTL2, and adds the ability to boot
	  secondary CPUs directly into 64-bit context as required for VTLs other
	  than 0.  A kernel built with this option must run at VTL2, and will
	  not run as a normal guest.

	  If unsure, say N

config HYPERV_TIMER
	def_bool HYPERV && X86

config HYPERV_UTILS
	tristate "Microsoft Hyper-V Utilities driver"
	depends on HYPERV && CONNECTOR && NLS
	depends on PTP_1588_CLOCK_OPTIONAL
	help
	  Select this option to enable the Hyper-V Utilities.

config HYPERV_BALLOON
	tristate "Microsoft Hyper-V Balloon driver"
	depends on HYPERV
	select PAGE_REPORTING
	help
	  Select this option to enable Hyper-V Balloon driver.

config MSHV_ROOT
	tristate "Microsoft Hyper-V root partition support"
	depends on HYPERV && (X86_64 || ARM64)
	depends on !HYPERV_VTL_MODE
	# The hypervisor interface operates on 4k pages. Enforcing it here
	# simplifies many assumptions in the root partition code.
	# e.g. When withdrawing memory, the hypervisor gives back 4k pages in
	# no particular order, making it impossible to reassemble larger pages
	depends on PAGE_SIZE_4KB
	select EVENTFD
	default n
	help
	  Select this option to enable support for booting and running as root
	  partition on Microsoft Hyper-V.

	  If unsure, say N.

endmenu
```
