## drivers/headset_observe/Kconfig
```kconfig
# SPDX-License-Identifier: GPL-2.0
#
# Headset device configuration
#

menu "Headset device support"

config RK_HEADSET
	tristate "Rockchips HeadSet support"
	---help---
		Rockchips HeadSet support:
		    support hook interrupt mode.
		    support hook adc mode.

endmenu
```
