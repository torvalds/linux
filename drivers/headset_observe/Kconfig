## drivers/hwtracing/intel_th/Kconfig
```kconfig
# SPDX-License-Identifier: GPL-2.0-only
config INTEL_TH
	tristate "Intel(R) Trace Hub controller"
	depends on HAS_DMA && HAS_IOMEM
	help
	  Intel(R) Trace Hub (TH) is a set of hardware blocks (subdevices) that
	  produce, switch and output trace data from multiple hardware and
	  software sources over several types of trace output ports encoded
	  in System Trace Protocol (MIPI STPv2) and is intended to perform
	  full system debugging.

	  This option enables intel_th bus and common code used by TH
	  subdevices to interact with each other and hardware and for
	  platform glue layers to drive Intel TH devices.

	  Say Y here to enable Intel(R) Trace Hub controller support.

if INTEL_TH

config INTEL_TH_PCI
	tristate "Intel(R) Trace Hub PCI controller"
	depends on PCI
	help
	  Intel(R) Trace Hub may exist as a PCI device. This option enables
	  support glue layer for PCI-based Intel TH.

	  Say Y here to enable PCI Intel TH support.

config INTEL_TH_ACPI
	tristate "Intel(R) Trace Hub ACPI controller"
	depends on ACPI
	help
	  Intel(R) Trace Hub may exist as an ACPI device. This option enables
	  support glue layer for ACPI-based Intel TH. This typically implies
	  'host debugger' mode, that is, the trace configuration and capture
	  is handled by an external debug host and corresponding controls will
	  not be available on the target.

	  Say Y here to enable ACPI Intel TH support.

config INTEL_TH_GTH
	tristate "Intel(R) Trace Hub Global Trace Hub"
	help
	  Global Trace Hub (GTH) is the central component of the
	  Intel TH infrastructure and acts as a switch for source
	  and output devices. This driver is required for other
	  Intel TH subdevices to initialize.

	  Say Y here to enable GTH subdevice of Intel(R) Trace Hub.

config INTEL_TH_STH
	tristate "Intel(R) Trace Hub Software Trace Hub support"
	depends on STM
	help
	  Software Trace Hub (STH) enables trace data from software
	  trace sources to be sent out via Intel(R) Trace Hub. It
	  uses stm class device to interface with its sources.

	  Say Y here to enable STH subdevice of Intel(R) Trace Hub.

config INTEL_TH_MSU
	tristate "Intel(R) Trace Hub Memory Storage Unit"
	depends on MMU
	help
	  Memory Storage Unit (MSU) trace output device enables
	  storing STP traces to system memory. It supports single
	  and multiblock modes of operation and provides read()
	  and mmap() access to the collected data.

	  Say Y here to enable MSU output device for Intel TH.

config INTEL_TH_PTI
	tristate "Intel(R) Trace Hub PTI output"
	help
	  Parallel Trace Interface unit (PTI) is a trace output device
	  of Intel TH architecture that facilitates STP trace output via
	  a PTI port.

	  Say Y to enable PTI output of Intel TH data.

config INTEL_TH_DEBUG
	bool "Intel(R) Trace Hub debugging"
	depends on DEBUG_FS
	help
	  Say Y here to enable debugging.

endif
```

## drivers/hwtracing/ptt/Kconfig
```kconfig
# SPDX-License-Identifier: GPL-2.0-only
config HISI_PTT
	tristate "HiSilicon PCIe Tune and Trace Device"
	depends on ARM64 || (COMPILE_TEST && 64BIT)
	depends on PCI && HAS_DMA && HAS_IOMEM && PERF_EVENTS
	help
	  HiSilicon PCIe Tune and Trace device exists as a PCIe RCiEP
	  device, and it provides support for PCIe traffic tuning and
	  tracing TLP headers to the memory.

	  This driver can also be built as a module. If so, the module
	  will be called hisi_ptt.
```

## drivers/hwtracing/stm/Kconfig
```kconfig
# SPDX-License-Identifier: GPL-2.0-only
config STM
	tristate "System Trace Module devices"
	select CONFIGFS_FS
	select SRCU
	help
	  A System Trace Module (STM) is a device exporting data in System
	  Trace Protocol (STP) format as defined by MIPI STP standards.
	  Examples of such devices are Intel(R) Trace Hub and Coresight STM.

	  Say Y here to enable System Trace Module device support.

if STM

config STM_PROTO_BASIC
	tristate "Basic STM framing protocol driver"
	default CONFIG_STM
	help
	  This is a simple framing protocol for sending data over STM
	  devices. This was the protocol that the STM framework used
	  exclusively until the MIPI SyS-T support was added. Use this
	  driver for compatibility with your existing STM setup.

	  The receiving side only needs to be able to decode the MIPI
	  STP protocol in order to extract the data.

	  If you want to be able to use the basic protocol or want the
	  backwards compatibility for your existing setup, say Y.

config STM_PROTO_SYS_T
	tristate "MIPI SyS-T STM framing protocol driver"
	default CONFIG_STM
	help
	  This is an implementation of MIPI SyS-T protocol to be used
	  over the STP transport. In addition to the data payload, it
	  also carries additional metadata for time correlation, better
	  means of trace source identification, etc.

	  The receiving side must be able to decode this protocol in
	  addition to the MIPI STP, in order to extract the data.

	  If you don't know what this is, say N.

config STM_DUMMY
	tristate "Dummy STM driver"
	help
	  This is a simple dummy device that pretends to be an stm device
	  and discards your data. Use for stm class testing.

	  If you don't know what this is, say N.

config STM_SOURCE_CONSOLE
	tristate "Kernel console over STM devices"
	help
	  This is a kernel space trace source that sends kernel log
	  messages to trace hosts over STM devices.

	  If you want to send kernel console messages over STM devices,
	  say Y.

config STM_SOURCE_HEARTBEAT
	tristate "Heartbeat over STM devices"
	help
	  This is a kernel space trace source that sends periodic
	  heartbeat messages to trace hosts over STM devices. It is
	  also useful for testing stm class drivers and the stm class
	  framework itself.

	  If you want to send heartbeat messages over STM devices,
	  say Y.

config STM_SOURCE_FTRACE
	tristate "Copy the output from kernel Ftrace to STM engine"
	depends on TRACING
	help
	  This option can be used to copy the output from kernel Ftrace
	  to STM engine. Enabling this option will introduce a slight
	  timing effect.

	  If you want to send kernel Ftrace messages over STM devices,
	  say Y.

endif
```
