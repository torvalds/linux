## drivers/usb/Kconfig
```kconfig
# SPDX-License-Identifier: GPL-2.0
#
# USB device configuration
#

config USB_OHCI_BIG_ENDIAN_DESC
	bool

config USB_OHCI_BIG_ENDIAN_MMIO
	bool

config USB_OHCI_LITTLE_ENDIAN
	bool
	default n if PPC_MPC52xx
	default y

config USB_EHCI_BIG_ENDIAN_MMIO
	bool

config USB_EHCI_BIG_ENDIAN_DESC
	bool

config USB_UHCI_BIG_ENDIAN_MMIO
	bool

config USB_UHCI_BIG_ENDIAN_DESC
	bool

menuconfig USB_SUPPORT
	bool "USB support"
	depends on HAS_IOMEM
	default y
	help
	  This option adds core support for Universal Serial Bus (USB).
	  You will also need drivers from the following menu to make use of it.

if USB_SUPPORT

source "drivers/usb/common/Kconfig"

config USB_ARCH_HAS_HCD
	def_bool y

config USB
	tristate "Support for Host-side USB"
	depends on USB_ARCH_HAS_HCD
	select GENERIC_ALLOCATOR
	select USB_COMMON
	select NLS  # for UTF-8 strings
	help
	  Universal Serial Bus (USB) is a specification for a serial bus
	  subsystem which offers higher speeds and more features than the
	  traditional PC serial port.  The bus supplies power to peripherals
	  and allows for hot swapping.  Up to 127 USB peripherals can be
	  connected to a single USB host in a tree structure.
	  
	  The USB host is the root of the tree, the peripherals are the
	  leaves and the inner nodes are special USB devices called hubs.
	  Most PCs now have USB host ports, used to connect peripherals
	  such as scanners, keyboards, mice, modems, cameras, disks,
	  flash memory, network links, and printers to the PC.

	  Say Y here if your computer has a host-side USB port and you want
	  to use USB devices.  You then need to say Y to at least one of the
	  Host Controller Driver (HCD) options below.  Choose a USB 1.1
	  controller, such as "UHCI HCD support" or "OHCI HCD support",
	  and "EHCI HCD (USB 2.0) support" except for older systems that
	  do not have USB 2.0 support.  It doesn't normally hurt to select
	  them all if you are not certain.

	  If your system has a device-side USB port, used in the peripheral
	  side of the USB protocol, see the "USB Gadget" framework instead.

	  After choosing your HCD, then select drivers for the USB peripherals
	  you'll be using.  You may want to check out the information provided
	  in <file:Documentation/usb/> and especially the links given in
	  <file:Documentation/usb/usb-help.rst>.

	  To compile this driver as a module, choose M here: the
	  module will be called usbcore.

config USB_PCI
	bool "PCI based USB host interface"
	depends on PCI
	default y
	help
	  Many embedded system SOCs (e.g. freescale T2080) have both
	  PCI and USB modules with the USB module directly controlled by
	  registers and having no relationship to the PCI module.

	  If you have such a device you may say N here and PCI related code
	  will not be built in the USB driver.

config USB_PCI_AMD
	bool "AMD PCI USB host support"
	depends on USB_PCI && HAS_IOPORT
	default X86 || MACH_LOONGSON64 || PPC_PASEMI
	help
	  Enable workarounds for USB implementation quirks in SB600/SB700/SB800
	  and later south bridge implementations. These are common on x86 PCs
	  with AMD CPUs but rarely used elsewhere, with the exception of a few
	  powerpc and mips desktop machines.

if USB

source "drivers/usb/core/Kconfig"

source "drivers/usb/mon/Kconfig"

source "drivers/usb/host/Kconfig"

source "drivers/usb/renesas_usbhs/Kconfig"

source "drivers/usb/class/Kconfig"

source "drivers/usb/storage/Kconfig"

source "drivers/usb/image/Kconfig"

source "drivers/usb/usbip/Kconfig"

endif

comment "USB dual-mode controller drivers"

source "drivers/usb/cdns3/Kconfig"

source "drivers/usb/fotg210/Kconfig"

source "drivers/usb/mtu3/Kconfig"

source "drivers/usb/musb/Kconfig"

source "drivers/usb/dwc3/Kconfig"

source "drivers/usb/dwc2/Kconfig"

source "drivers/usb/chipidea/Kconfig"

source "drivers/usb/isp1760/Kconfig"

comment "USB port drivers"

if USB

source "drivers/usb/serial/Kconfig"

source "drivers/usb/misc/Kconfig"

source "drivers/usb/atm/Kconfig"

endif # USB

source "drivers/usb/phy/Kconfig"

source "drivers/usb/gadget/Kconfig"

source "drivers/usb/typec/Kconfig"

source "drivers/usb/roles/Kconfig"

endif # USB_SUPPORT
```

## drivers/usb/atm/Kconfig
```kconfig
#
# USB/ATM DSL configuration
#

menu "USB DSL modem support"
	depends on USB

config USB_ATM
	tristate "USB DSL modem support"
	depends on USB && ATM
	select CRC32
	default n
	help
	  Say Y here if you want to connect a USB Digital Subscriber Line (DSL)
	  modem to your computer's USB port.  You will then need to choose your
	  modem from the list below.

	  To compile this driver as a module, choose M here: the
	  module will be called usbatm.

config USB_SPEEDTOUCH
	tristate "Speedtouch USB support"
	depends on USB_ATM
	select FW_LOADER
	help
	  Say Y here if you have an SpeedTouch USB or SpeedTouch 330
	  modem.  In order to use your modem you will need to install the 
	  two parts of the firmware, extracted by the user space tools; see
	  <http://www.linux-usb.org/SpeedTouch/> for details.

	  To compile this driver as a module, choose M here: the
	  module will be called speedtch.

config USB_CXACRU
	tristate "Conexant AccessRunner USB support"
	depends on USB_ATM
	select FW_LOADER
	help
	  Say Y here if you have an ADSL USB modem based on the Conexant
	  AccessRunner chipset.  In order to use your modem you will need to
	  install the firmware, extracted by the user space tools; see
	  <http://accessrunner.sourceforge.net/> for details.

	  To compile this driver as a module, choose M here: the
	  module will be called cxacru.

config USB_UEAGLEATM
	tristate "ADI 930 and eagle USB DSL modem"
	depends on USB_ATM
	select FW_LOADER
	help
	  Say Y here if you have an ADSL USB modem based on the ADI 930
	  or eagle chipset. In order to use your modem you will need to
	  install firmwares and CMV (Command Management Variables); see
	  <https://gna.org/projects/ueagleatm/> for details.

	  To compile this driver as a module, choose M here: the
	  module will be called ueagle-atm.

config USB_XUSBATM
	tristate "Other USB DSL modem support"
	depends on USB_ATM
	help
	  Say Y here if you have a DSL USB modem not explicitly supported by
	  another USB DSL drivers.  In order to use your modem you will need to
	  pass the vendor ID, product ID, and endpoint numbers for transmission
	  and reception as module parameters.  You may need to initialize the
	  the modem using a user space utility (a firmware loader for example).

	  To compile this driver as a module, choose M here: the
	  module will be called xusbatm.

endmenu
```

## drivers/usb/cdns3/Kconfig
```kconfig
config USB_CDNS_SUPPORT
	tristate "Cadence USB Support"
	depends on USB_SUPPORT && HAS_DMA
	depends on USB || USB_GADGET
	depends on USB if !USB_GADGET
	depends on USB_GADGET if !USB
	select USB_XHCI_PLATFORM if USB_XHCI_HCD
	select USB_ROLE_SWITCH
	help
	  Say Y here if your system has a Cadence USBSS or USBSSP
	  dual-role controller.
	  It supports: dual-role switch, Host-only, and Peripheral-only.

if USB_CDNS_SUPPORT

config USB_CDNS3
	tristate "Cadence USB dual-role controller (USBSS and USBSSP)"
	depends on USB_CDNS_SUPPORT
	help
	  Say Y or M here if your system has an on-chip Cadence USB
	  dual-role controller. This covers both USBSS (USB 3.0) and
	  USBSSP (SuperSpeed Plus) IP; the driver detects the variant at
	  runtime.

	  The core driver (core, DRD, generic platform binding for the
	  "cdns,usb3" device tree compatible, optional host and gadget)
	  builds as one module named cdns.ko when built as a loadable
	  module.

	  It supports: dual-role switch, Host-only, and Peripheral-only.

if USB_CDNS3

config USB_CDNS3_HOST
	bool "Cadence USB host controller (xHCI)"
	depends on USB=y || USB=USB_CDNS3
	help
	  Say Y here to enable host controller functionality for Cadence
	  USBSS and USBSSP dual-role controllers.

	  The host controller is xHCI compliant and uses the standard
	  xHCI driver.

config USB_CDNS3_GADGET
	bool "Cadence USB device controller (USBSS and USBSSP)"
	depends on USB_GADGET=y || USB_GADGET=USB_CDNS3
	help
	  Say Y here to include Cadence USB device (gadget) support for
	  both USBSS (USB 3.0) and USBSSP (SuperSpeed Plus) IP in the
	  cdns.ko module. The implementation is selected at runtime from
	  the detected controller version.

	  USBSS gadget supports FF, HS and SS mode (not LS or SSP).
	  USBSSP gadget supports FF, HS, SS and SSP mode (not LS).

comment "Platform glue driver support"

config USB_CDNS3_PCI_WRAP
	tristate "Cadence USB3 support on PCIe-based platforms"
	depends on USB_PCI && ACPI
	default USB_CDNS3
	help
	  If you're using the USBSS Core IP with a PCIe, please say
	  'Y' or 'M' here.

	  If you choose to build this driver as module it will
	  be dynamically linked and module will be called cdns3-pci.ko

config USB_CDNSP_PCI
	tristate "Cadence USBSSP support on PCIe-based platforms"
	depends on USB_PCI && ACPI
	default USB_CDNS3
	help
	  If you're using the USBSSP Core IP with a PCIe, please say
	  'Y' or 'M' here.

	  If you choose to build this driver as module it will
	  be dynamically linked and module will be called cdnsp-pci.ko

config USB_CDNS3_TI
	tristate "Cadence USB3 support on TI platforms"
	depends on ARCH_K3 || COMPILE_TEST
	default USB_CDNS3
	help
	  Say 'Y' or 'M' here if you are building for Texas Instruments
	  platforms that contain Cadence USB3 controller core.

	  e.g. J721e.

config USB_CDNS3_IMX
	tristate "Cadence USB3 support on NXP i.MX platforms"
	depends on ARCH_MXC || COMPILE_TEST
	default USB_CDNS3
	help
	  Say 'Y' or 'M' here if you are building for NXP i.MX
	  platforms that contain Cadence USB3 controller core.

	  For example, imx8qm and imx8qxp.

config USB_CDNS3_STARFIVE
	tristate "Cadence USB3 support on StarFive SoC platforms"
	depends on ARCH_STARFIVE || COMPILE_TEST
	default USB_CDNS3
	help
	  Say 'Y' or 'M' here if you are building for StarFive SoCs
	  platforms that contain Cadence USB3 controller core.

	  e.g. JH7110.

	  If you choose to build this driver as module it will
	  be dynamically linked and module will be called cdns3-starfive.ko

endif # USB_CDNS3

endif # USB_CDNS_SUPPORT
```

## drivers/usb/chipidea/Kconfig
```kconfig
# SPDX-License-Identifier: GPL-2.0

config USB_CHIPIDEA
	tristate "ChipIdea Highspeed Dual Role Controller"
	depends on ((USB_EHCI_HCD && USB_GADGET) || (USB_EHCI_HCD && !USB_GADGET) || (!USB_EHCI_HCD && USB_GADGET)) && HAS_DMA
	select EXTCON
	select RESET_CONTROLLER
	select USB_ULPI_BUS
	select USB_ROLE_SWITCH
	select USB_TEGRA_PHY if ARCH_TEGRA
	help
	  Say Y here if your system has a dual role high speed USB
	  controller based on ChipIdea silicon IP. It supports:
	  Dual-role switch (ID, OTG FSM, sysfs), Host-only, and
	  Peripheral-only.

	  When compiled dynamically, the module will be called ci_hdrc.ko.

if USB_CHIPIDEA

config USB_CHIPIDEA_UDC
	bool "ChipIdea device controller"
	depends on USB_GADGET
	help
	  Say Y here to enable device controller functionality of the
	  ChipIdea driver.

config USB_CHIPIDEA_HOST
	bool "ChipIdea host controller"
	depends on USB_EHCI_HCD
	select USB_EHCI_ROOT_HUB_TT
	help
	  Say Y here to enable host controller functionality of the
	  ChipIdea driver.

config USB_CHIPIDEA_PCI
	tristate "Enable PCI glue driver" if EXPERT
	depends on USB_PCI
	depends on NOP_USB_XCEIV
	default USB_CHIPIDEA

config USB_CHIPIDEA_MSM
	tristate "Enable MSM hsusb glue driver" if EXPERT
	default USB_CHIPIDEA

config USB_CHIPIDEA_NPCM
	tristate "Enable NPCM hsusb glue driver" if EXPERT
	default USB_CHIPIDEA

config USB_CHIPIDEA_IMX
	tristate "Enable i.MX USB glue driver" if EXPERT
	depends on OF
	default USB_CHIPIDEA

config USB_CHIPIDEA_GENERIC
	tristate "Enable generic USB2 glue driver" if EXPERT
	default USB_CHIPIDEA

config USB_CHIPIDEA_TEGRA
	tristate "Enable Tegra USB glue driver" if EXPERT
	depends on OF
	default USB_CHIPIDEA

endif
```

## drivers/usb/class/Kconfig
```kconfig
# SPDX-License-Identifier: GPL-2.0
#
# USB Class driver configuration
#
comment "USB Device Class drivers"

config USB_ACM
	tristate "USB Modem (CDC ACM) support"
	depends on TTY
	---help---
	  This driver supports USB modems and ISDN adapters which support the
	  Communication Device Class Abstract Control Model interface.
	  Please read <file:Documentation/usb/acm.rst> for details.

	  If your modem only reports "Cls=ff(vend.)" in the descriptors in
	  /sys/kernel/debug/usb/devices, then your modem will not work with this
	  driver.

	  To compile this driver as a module, choose M here: the
	  module will be called cdc-acm.

config USB_PRINTER
	tristate "USB Printer support"
	help
	  Say Y here if you want to connect a USB printer to your computer's
	  USB port.

	  To compile this driver as a module, choose M here: the
	  module will be called usblp.

config USB_WDM
	tristate "USB Wireless Device Management support"
	---help---
	  This driver supports the WMC Device Management functionality
	  of cell phones compliant to the CDC WMC specification. You can use
	  AT commands over this device.

	  To compile this driver as a module, choose M here: the
	  module will be called cdc-wdm.

config USB_TMC
	tristate "USB Test and Measurement Class support"
	help
	  Say Y here if you want to connect a USB device that follows
	  the USB.org specification for USB Test and Measurement devices
	  to your computer's USB port.

	  To compile this driver as a module, choose M here: the
	  module will be called usbtmc.
```

## drivers/usb/common/Kconfig
```kconfig
# SPDX-License-Identifier: GPL-2.0

config USB_COMMON
	tristate


config USB_LED_TRIG
	bool "USB LED Triggers"
	depends on LEDS_CLASS && USB_COMMON && LEDS_TRIGGERS
	help
	  This option adds LED triggers for USB host and/or gadget activity.

	  Say Y here if you are working on a system with led-class supported
	  LEDs and you want to use them as activity indicators for USB host or
	  gadget.

config USB_ULPI_BUS
	tristate "USB ULPI PHY interface support"
	select USB_COMMON
	help
	  UTMI+ Low Pin Interface (ULPI) is specification for a commonly used
	  USB 2.0 PHY interface. The ULPI specification defines a standard set
	  of registers that can be used to detect the vendor and product which
	  allows ULPI to be handled as a bus. This module is the driver for that
	  bus.

	  The ULPI interfaces (the buses) are registered by the drivers for USB
	  controllers which support ULPI register access and have ULPI PHY
	  attached to them. The ULPI PHY drivers themselves are normal PHY
	  drivers.

	  ULPI PHYs provide often functions such as ADP sensing/probing (OTG
	  protocol) and USB charger detection.

	  To compile this driver as a module, choose M here: the module will
	  be called ulpi.

config USB_CONN_GPIO
	tristate "USB GPIO Based Connection Detection Driver"
	depends on GPIOLIB
	select USB_ROLE_SWITCH
	select POWER_SUPPLY
	help
	  The driver supports USB role switch between host and device via GPIO
	  based USB cable detection, used typically if an input GPIO is used
	  to detect USB ID pin, and another input GPIO may be also used to detect
	  Vbus pin at the same time, it also can be used to enable/disable
	  device if an input GPIO is only used to detect Vbus pin.

	  To compile the driver as a module, choose M here: the module will
	  be called usb-conn-gpio.ko
```
