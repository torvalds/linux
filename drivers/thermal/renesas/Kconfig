## drivers/usb/dwc_otg/Kconfig
```kconfig
config USB11_HOST 
	tristate "RockChip USB 1.1 host controller"
	depends on USB
	---help---
	  This driver supports Rockchip USB 1.1 HOST
	  controller.

config USB20_HOST
	tristate "Rockchip USB 2.0 host controller"
	depends on USB
	---help---
	  This driver supports Rockchip USB2.0 host
	  controller.

config USB20_OTG
	tristate "RockChip USB 2.0 OTG controller"
        ---help---
          This driver supports Rockchip USB2.0  DWC_OTG 
	  controller.
choice
	bool "USB2.0 OTG controller mode"
	depends on USB20_OTG
	default DWC_OTG_DEVICE_ONLY
	help
	   RockChip DWC_OTG Controller can only work
	   in one of following mode
	
config DWC_OTG_HOST_ONLY
        boolean "HOST ONLY MODE"
        depends on USB20_OTG && USB 
	help
	   USB2.0 OTG controller worked in host mode 
	   and device can support other gadgets.

config DWC_OTG_DEVICE_ONLY
        boolean "DEVICE ONLY MODE"
        depends on USB20_OTG && USB_GADGET
	help 
	  USB2.0 OTG controller worked in device mode
     	  and device can connect to PC via USB cable.

endchoice

config DWC_CONN_EN
	bool "connect to PC when vbus detect"
	default y
	depends on DWC_OTG_DEVICE_ONLY
	help
	  USB2.0 OTG controller always polling the USB vbus
	  
	  if selected, device will connect to PC automatic

config DWC_OTG_DEBUG
	bool "DWC_OTG debug messages"
	depends on USB11_HOST || USB20_HOST || USB20_OTG

config DWC_OTG
	tristate	
	default y if USB11_HOST || USB20_HOST || USB20_OTG
```
