## drivers/thermal/renesas/Kconfig
```kconfig
# SPDX-License-Identifier: GPL-2.0-only

config RCAR_THERMAL
	tristate "Renesas R-Car thermal driver"
	depends on ARCH_RENESAS || COMPILE_TEST
	depends on HAS_IOMEM
	depends on OF
	help
	  Enable this to plug the R-Car thermal sensor driver into the Linux
	  thermal framework.

config RCAR_GEN3_THERMAL
	tristate "Renesas R-Car Gen3/Gen4 and RZ/G2 thermal driver"
	depends on ARCH_RENESAS || COMPILE_TEST
	depends on HAS_IOMEM
	depends on OF
	help
	  Enable this to plug the R-Car Gen3/Gen4 or RZ/G2 thermal sensor
	  driver into the Linux thermal framework.

config RZG2L_THERMAL
	tristate "Renesas RZ/G2L thermal driver"
	depends on ARCH_RENESAS || COMPILE_TEST
	depends on HAS_IOMEM
	depends on OF
	help
	  Enable this to plug the RZ/G2L thermal sensor driver into the Linux
	  thermal framework.

config RZG3E_THERMAL
	tristate "Renesas RZ/G3E thermal driver"
	depends on ARCH_RENESAS || COMPILE_TEST
	help
	  Enable this to plug the RZ/G3E thermal sensor driver into the Linux
	  thermal framework.

config RZG3S_THERMAL
	tristate "Renesas RZ/G3S thermal driver"
	depends on ARCH_R9A08G045 || COMPILE_TEST
	depends on OF && IIO && RZG2L_ADC
	help
	  Enable this to plug the RZ/G3S thermal sensor driver into the Linux
	  thermal framework.
```

## drivers/thermal/spacemit/Kconfig
```kconfig
# SPDX-License-Identifier: GPL-2.0-only
menu "SpacemiT thermal drivers"
depends on ARCH_SPACEMIT || COMPILE_TEST

config SPACEMIT_K1_TSENSOR
	tristate "SpacemiT K1 thermal sensor driver"
	depends on THERMAL_OF
	help
	  This driver provides support for the thermal sensor
	  integrated in the SpacemiT K1 SoC.

	  The thermal sensor monitors temperatures for five thermal zones:
	  soc, package, gpu, cluster0, and cluster1. It supports reporting
	  temperature values and handling high/low threshold interrupts.

	  Say Y here if you want to enable thermal monitoring on SpacemiT K1.
	  If compiled as a module, it will be called k1_tsensor.

endmenu
```

## drivers/thermal/st/Kconfig
```kconfig
# SPDX-License-Identifier: GPL-2.0-only
#
# STMicroelectronics thermal drivers configuration
#

config ST_THERMAL
	tristate "Thermal sensors on STMicroelectronics STi series of SoCs"
	help
	  Support for thermal sensors on STMicroelectronics STi series of SoCs.

config ST_THERMAL_SYSCFG
	select ST_THERMAL
	tristate "STi series syscfg register access based thermal sensors"

config ST_THERMAL_MEMMAP
	select ST_THERMAL
	tristate "STi series memory mapped access based thermal sensors"

config STM32_THERMAL
	tristate "Thermal framework support on STMicroelectronics STM32 series of SoCs"
	depends on MACH_STM32MP157
	default y
	help
	  Support for thermal framework on STMicroelectronics STM32 series of
	  SoCs. This thermal driver allows to access to general thermal framework
	  functionalities and to acces to SoC sensor functionalities. This
	  configuration is fully dependent of MACH_STM32MP157.
```

## drivers/thermal/tegra/Kconfig
```kconfig
# SPDX-License-Identifier: GPL-2.0-only
menu "NVIDIA Tegra thermal drivers"
depends on ARCH_TEGRA || COMPILE_TEST

config TEGRA_SOCTHERM
	tristate "Tegra SOCTHERM thermal management"
	help
	  Enable this option for integrated thermal management support on NVIDIA
	  Tegra systems-on-chip. The driver supports four thermal zones
	  (CPU, GPU, MEM, PLLX). Cooling devices can be bound to the thermal
	  zones to manage temperatures. This option is also required for the
	  emergency thermal reset (thermtrip) feature to function.

config TEGRA_BPMP_THERMAL
	tristate "Tegra BPMP thermal sensing"
	depends on TEGRA_BPMP || COMPILE_TEST
	help
	  Enable this option for support for sensing system temperature of NVIDIA
	  Tegra systems-on-chip with the BPMP coprocessor (Tegra186).

config TEGRA30_TSENSOR
	tristate "Tegra30 Thermal Sensor"
	depends on ARCH_TEGRA_3x_SOC || COMPILE_TEST
	help
	  Enable this option to support thermal management of NVIDIA Tegra30
	  system-on-chip.

endmenu
```

## drivers/thermal/ti-soc-thermal/Kconfig
```kconfig
config TI_SOC_THERMAL
	tristate "Texas Instruments SoCs temperature sensor driver"
	help
	  If you say yes here you get support for the Texas Instruments
	  OMAP4460+ on die bandgap temperature sensor support. The register
	  set is part of system control module.

	  This includes alert interrupts generation and also the TSHUT
	  support.

config TI_THERMAL
	bool "Texas Instruments SoCs thermal framework support"
	depends on TI_SOC_THERMAL
	depends on CPU_THERMAL
	help
	  If you say yes here you want to get support for generic thermal
	  framework for the Texas Instruments on die bandgap temperature sensor.

	  This includes trip points definitions, extrapolation rules and
	  CPU cooling device bindings.

config OMAP3_THERMAL
	bool "Texas Instruments OMAP3 thermal support"
	depends on TI_SOC_THERMAL
	depends on ARCH_OMAP3 || COMPILE_TEST
	help
	  If you say yes here you get thermal support for the Texas Instruments
	  OMAP3 SoC family. The current chips supported are:
	   - OMAP3430

	  OMAP3 chips normally don't need thermal management, and sensors in
	  this generation are not accurate, nor they are very close to
	  the important hotspots.

	  Say 'N' here.

config OMAP4_THERMAL
	bool "Texas Instruments OMAP4 thermal support"
	depends on TI_SOC_THERMAL
	depends on ARCH_OMAP4 || COMPILE_TEST
	help
	  If you say yes here you get thermal support for the Texas Instruments
	  OMAP4 SoC family. The current chip supported are:
	   - OMAP4430
	   - OMAP4460
	   - OMAP4470

	  This includes alert interrupts generation and also the TSHUT
	  support.

config OMAP5_THERMAL
	bool "Texas Instruments OMAP5 thermal support"
	depends on TI_SOC_THERMAL
	depends on SOC_OMAP5 || COMPILE_TEST
	help
	  If you say yes here you get thermal support for the Texas Instruments
	  OMAP5 SoC family. The current chip supported are:
	   - OMAP5430

	  This includes alert interrupts generation and also the TSHUT
	  support.

config DRA752_THERMAL
	bool "Texas Instruments DRA752 thermal support"
	depends on TI_SOC_THERMAL
	depends on SOC_DRA7XX || COMPILE_TEST
	help
	  If you say yes here you get thermal support for the Texas Instruments
	  DRA752 SoC family. The current chip supported are:
	   - DRA752

	  This includes alert interrupts generation and also the TSHUT
	  support.
```

## drivers/thunderbolt/Kconfig
```kconfig
# SPDX-License-Identifier: GPL-2.0-only
menuconfig USB4
	tristate "Unified support for USB4 and Thunderbolt"
	depends on PCI
	select APPLE_PROPERTIES if EFI_STUB && X86
	select CRC32
	select CRYPTO
	select CRYPTO_HASH
	select NVMEM
	help
	  USB4 and Thunderbolt driver. USB4 is the public specification
	  based on the Thunderbolt 3 protocol. This driver is required if
	  you want to hotplug Thunderbolt and USB4 compliant devices on
	  Apple hardware or on PCs with Intel Falcon Ridge or newer.

	  To compile this driver a module, choose M here. The module will be
	  called thunderbolt.

if USB4

config USB4_DEBUGFS_WRITE
	bool "Enable write by debugfs to configuration spaces (DANGEROUS)"
	help
	  Enables writing to device configuration registers through
	  debugfs interface.

	  Only enable this if you know what you are doing! Never enable
	  this for production systems or distro kernels.

config USB4_DEBUGFS_MARGINING
	bool "Expose receiver lane margining operations under USB4 ports (DANGEROUS)"
	depends on DEBUG_FS
	depends on USB4_DEBUGFS_WRITE
	help
	  Enables hardware and software based receiver lane margining support
	  under each USB4 port. Used for electrical quality and robustness
	  validation during manufacturing. Should not be enabled by distro
	  kernels.

config USB4_KUNIT_TEST
	bool "KUnit tests" if !KUNIT_ALL_TESTS
	depends on USB4 && KUNIT=y
	default KUNIT_ALL_TESTS

config USB4_DMA_TEST
	tristate "DMA traffic test driver"
	depends on DEBUG_FS
	help
	  This allows sending and receiving DMA traffic through loopback
	  connection. Loopback connection can be done by either special
	  dongle that has TX/RX lines crossed, or by simply connecting a
	  cable back to the host. Only enable this if you know what you
	  are doing. Normal users and distro kernels should say N here.

	  To compile this driver a module, choose M here. The module will be
	  called thunderbolt_dma_test.

endif # USB4
```
