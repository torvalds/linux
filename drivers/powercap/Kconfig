## drivers/rapidio/Kconfig
```kconfig
# SPDX-License-Identifier: GPL-2.0-only
#
# RapidIO configuration
#

config HAVE_RAPIDIO
	bool

menuconfig RAPIDIO
	tristate "RapidIO support"
	depends on HAVE_RAPIDIO || PCI
	help
	  If you say Y here, the kernel will include drivers and
	  infrastructure code to support RapidIO interconnect devices.

source "drivers/rapidio/devices/Kconfig"

config RAPIDIO_DISC_TIMEOUT
	int "Discovery timeout duration (seconds)"
	depends on RAPIDIO
	default "30"
	---help---
	  Amount of time a discovery node waits for a host to complete
	  enumeration before giving up.

config RAPIDIO_ENABLE_RX_TX_PORTS
	bool "Enable RapidIO Input/Output Ports"
	depends on RAPIDIO
	---help---
	  The RapidIO specification describes a Output port transmit
	  enable and a Input port receive enable. The recommended state
	  for Input ports and Output ports should be disabled. When
	  this switch is set the RapidIO subsystem will enable all
	  ports for Input/Output direction to allow other traffic
	  than Maintenance transfers.

config RAPIDIO_DMA_ENGINE
	bool "DMA Engine support for RapidIO"
	depends on RAPIDIO
	select DMADEVICES
	select DMA_ENGINE
	help
	  Say Y here if you want to use DMA Engine frameork for RapidIO data
	  transfers to/from target RIO devices. RapidIO uses NREAD and
	  NWRITE (NWRITE_R, SWRITE) requests to transfer data between local
	  memory and memory on remote target device. You need a DMA controller
	  capable to perform data transfers to/from RapidIO.

	  If you are unsure about this, say Y here.

config RAPIDIO_DEBUG
	bool "RapidIO subsystem debug messages"
	depends on RAPIDIO
	help
	  Say Y here if you want the RapidIO subsystem to produce a bunch of
	  debug messages to the system log. Select this if you are having a
	  problem with the RapidIO subsystem and want to see more of what is
	  going on.

	  If you are unsure about this, say N here.

choice
	prompt "Enumeration method"
	depends on RAPIDIO
	default RAPIDIO_ENUM_BASIC
	help
	  There are different enumeration and discovery mechanisms offered
	  for RapidIO subsystem. You may select single built-in method or
	  or any number of methods to be built as modules.
	  Selecting a built-in method disables use of loadable methods.

	  If unsure, select Basic built-in.

config RAPIDIO_ENUM_BASIC
	tristate "Basic"
	help
	  This option includes basic RapidIO fabric enumeration and discovery
	  mechanism similar to one described in RapidIO specification Annex 1.

endchoice

config RAPIDIO_CHMAN
	tristate "RapidIO Channelized Messaging driver"
	depends on RAPIDIO
	help
	  This option includes RapidIO channelized messaging driver which
	  provides socket-like interface to allow sharing of single RapidIO
	  messaging mailbox between multiple user-space applications.
	  See "Documentation/rapidio/rio_cm.txt" for driver description.

config RAPIDIO_MPORT_CDEV
	tristate "RapidIO /dev mport device driver"
	depends on RAPIDIO
	help
	  This option includes generic RapidIO mport device driver which
	  allows to user space applications to perform RapidIO-specific
	  operations through selected RapidIO mport.

menu "RapidIO Switch drivers"
	depends on RAPIDIO

source "drivers/rapidio/switches/Kconfig"

endmenu
```

## drivers/rapidio/devices/Kconfig
```kconfig
# SPDX-License-Identifier: GPL-2.0-only
#
# RapidIO master port configuration
#

config RAPIDIO_TSI721
	tristate "IDT Tsi721 PCI Express SRIO Controller support"
	depends on RAPIDIO && PCIEPORTBUS
	default "n"
	help
	  Include support for IDT Tsi721 PCI Express Serial RapidIO controller.
```

## drivers/rapidio/switches/Kconfig
```kconfig
#
# RapidIO switches configuration
#
config RAPIDIO_TSI57X
	tristate "IDT Tsi57x SRIO switches support"
	---help---
	  Includes support for IDT Tsi57x family of serial RapidIO switches.

config RAPIDIO_CPS_XX
	tristate "IDT CPS-xx SRIO switches support"
	---help---
	  Includes support for IDT CPS-16/12/10/8 serial RapidIO switches.

config RAPIDIO_TSI568
	tristate "Tsi568 SRIO switch support"
	default n
	---help---
	  Includes support for IDT Tsi568 serial RapidIO switch.

config RAPIDIO_CPS_GEN2
	tristate "IDT CPS Gen.2 SRIO switch support"
	default n
	---help---
	  Includes support for ITD CPS Gen.2 serial RapidIO switches.

config RAPIDIO_RXS_GEN3
	tristate "IDT RXS Gen.3 SRIO switch support"
	default n
	---help---
	  Includes support for ITD RXS Gen.3 serial RapidIO switches.
```

## drivers/ras/Kconfig
```kconfig
# SPDX-License-Identifier: GPL-2.0-only
menuconfig RAS
	bool "Reliability, Availability and Serviceability (RAS) features"
	help
	  Reliability, availability and serviceability (RAS) is a computer
	  hardware engineering term. Computers designed with higher levels
	  of RAS have a multitude of features that protect data integrity
	  and help them stay available for long periods of time without
	  failure.

	  Reliability can be defined as the probability that the system will
	  produce correct outputs up to some given time. Reliability is
	  enhanced by features that help to avoid, detect and repair hardware
	  faults.

	  Availability is the probability a system is operational at a given
	  time, i.e. the amount of time a device is actually operating as the
	  percentage of total time it should be operating.

	  Serviceability or maintainability is the simplicity and speed with
	  which a system can be repaired or maintained; if the time to repair
	  a failed system increases, then availability will decrease.

	  Note that Reliability and Availability are distinct concepts:
	  Reliability is a measure of the ability of a system to function
	  correctly, including avoiding data corruption, whereas Availability
	  measures how often it is available for use, even though it may not
	  be functioning correctly. For example, a server may run forever and
	  so have ideal availability, but may be unreliable, with frequent
	  data corruption.

if RAS

config RAS_CEC
	bool "Correctable Errors Collector"
	depends on X86_MCE && MEMORY_FAILURE && DEBUG_FS
	help
	  This is a small cache which collects correctable memory errors per 4K
	  page PFN and counts their repeated occurrence. Once the counter for a
	  PFN overflows, we try to soft-offline that page as we take it to mean
	  that it has reached a relatively high error count and would probably
	  be best if we don't use it anymore.

	  Bear in mind that this is absolutely useless if your platform doesn't
	  have ECC DIMMs and doesn't have DRAM ECC checking enabled in the BIOS.

config RAS_CEC_DEBUG
	bool "CEC debugging machinery"
	default n
	depends on RAS_CEC
	help
	  Add extra files to (debugfs)/ras/cec to test the correctable error
	  collector feature. "pfn" is a writable file that allows user to
	  simulate an error in a particular page frame. "array" is a read-only
	  file that dumps out the current state of all pages logged so far.

source "drivers/ras/amd/atl/Kconfig"

config RAS_FMPM
	tristate "FRU Memory Poison Manager"
	default m
	depends on AMD_ATL && ACPI_APEI
	help
	  Support saving and restoring memory error information across reboot
	  using ACPI ERST as persistent storage. Error information is saved with
	  the UEFI CPER "FRU Memory Poison" section format.

	  Memory will be retired during boot time and run time depending on
	  platform-specific policies.

endif
```

## drivers/ras/amd/atl/Kconfig
```kconfig
# SPDX-License-Identifier: GPL-2.0-or-later
#
# AMD Address Translation Library Kconfig
#
# Copyright (c) 2023, Advanced Micro Devices, Inc.
# All Rights Reserved.
#
# Author: Yazen Ghannam <Yazen.Ghannam@amd.com>

config AMD_ATL
	tristate "AMD Address Translation Library"
	depends on AMD_NB && X86_64 && RAS
	depends on MEMORY_FAILURE
	default N
	help
	  This library includes support for implementation-specific
	  address translation procedures needed for various error
	  handling cases.

	  Enable this option if using DRAM ECC on Zen-based systems
	  and OS-based error handling.

config AMD_ATL_PRM
	depends on AMD_ATL && ACPI_PRMT
	def_bool y
```
