## drivers/reset/sti/Kconfig
```kconfig
# SPDX-License-Identifier: GPL-2.0-only
if ARCH_STI || COMPILE_TEST

config STIH407_RESET
	bool "STIH407 Reset Driver" if COMPILE_TEST

endif
```

## drivers/reset/tegra/Kconfig
```kconfig
# SPDX-License-Identifier: GPL-2.0-only
config RESET_TEGRA_BPMP
	bool "Tegra BPMP Reset Driver" if COMPILE_TEST
	default TEGRA_BPMP
```

## drivers/rk_nand/Kconfig
```kconfig
# SPDX-License-Identifier: GPL-2.0
if ARCH_ROCKCHIP
config RK_NAND
	tristate "RK NAND Device Support"
	default n
	depends on BLOCK_RKNAND != y
	help
	  RK NAND Device Support.

endif
```

## drivers/rkflash/Kconfig
```kconfig
# SPDX-License-Identifier: GPL-2.0

if ARCH_ROCKCHIP

menuconfig RK_FLASH
	tristate "Rockchip Flash Devices Support"
	default n
	help
	  This enables support for Rockchip Flash Devices including Nandc Slc
	  Nand, SFC Spi Nand and SFC Spi Nor.

	  They're block interface.

	  Say Y when you have a board with one of them.

if RK_FLASH

comment "Rockchip Flash Devices"

config RK_NANDC_NAND
	tristate "Rockchip NANDC Slc Nand Devices support"
	default n
	depends on RK_NAND != y
	help
	  This enables support for NANDC Slc Nand Devices.

	  It's block interface, 512Kb/sector.

	  Say Y when you have a board with Slc Nand Flash supported by Rockchip
	  Nandc controller.

config RK_SFC_NAND
	tristate "Rockchip SFC Spi Nand Devices support"
	default n
	depends on RK_NAND != y
	help
	  This enables support for Rockchip SFC Spi Nand Devices.

	  It's block interface, 512Kb/sector.

	  Say Y when you have a board with Spi Nand Flash supported by Rockchip
	  Serial Flash Controller(SFC).

config RK_SFC_NAND_MTD
	bool "RK SFC NAND mtd Interface Support"
	default n
	depends on RK_SFC_NAND
	help
	  Enable mtd interface for SFC_NAND device.

	  Say Y when you wanna use mtd interface for SFC_NAND flash.

config RK_SFC_NOR
	tristate "Rockchip SFC Spi Nor Devices Support"
	select CRYPTO_ARC4
	default n
	help
	  This enables support for Rockchip SFC Spi Nor Devices.

	  It's block interface,512Kb/sector.

	  Say Y when you have a board with Spi Nor Flash supported by Rockchip
	  Serial Flash Controller(SFC).

config RK_SFC_NOR_MTD
	bool "RK SFC NOR mtd Interface Support"
	default n
	depends on RK_SFC_NOR
	help
	  Enable mtd interface for SFC_NOR device.

	  Say Y when you wanna use mtd interface for SFC_NOR flash.

endif # RK_FLASH

endif # ARCH_ROCKCHIP
```

## drivers/rknpu/Kconfig
```kconfig
# SPDX-License-Identifier: GPL-2.0
menu "RKNPU"
	depends on ARCH_ROCKCHIP

config ROCKCHIP_RKNPU
	tristate "ROCKCHIP_RKNPU"
	depends on DRM || DMABUF_HEAPS_ROCKCHIP_CMA_HEAP
	help
	  rknpu module.

if ROCKCHIP_RKNPU

config ROCKCHIP_RKNPU_DEBUG_FS
	bool "RKNPU debugfs"
	depends on DEBUG_FS
	default y
	help
	  Enable debugfs to debug RKNPU usage.

config ROCKCHIP_RKNPU_PROC_FS
	bool "RKNPU procfs"
	depends on PROC_FS
	help
	  Enable procfs to debug RKNPU usage.

config ROCKCHIP_RKNPU_FENCE
	bool "RKNPU fence"
	depends on SYNC_FILE
	help
	  Enable fence support for RKNPU.

config ROCKCHIP_RKNPU_SRAM
	bool "RKNPU SRAM"
	depends on NO_GKI
	help
	  Enable RKNPU SRAM support

choice
	prompt "RKNPU memory manager"
	default ROCKCHIP_RKNPU_DRM_GEM
	help
	  Select RKNPU memory manager

config ROCKCHIP_RKNPU_DRM_GEM
	bool "RKNPU DRM GEM"
	depends on DRM
	help
	  Enable RKNPU memory manager by DRM GEM.

config ROCKCHIP_RKNPU_DMA_HEAP
	bool "RKNPU DMA heap"
	depends on DMABUF_HEAPS_ROCKCHIP_CMA_HEAP
	help
	  Enable RKNPU memory manager by DMA Heap.

endchoice

endif

endmenu
```
