## drivers/isdn/i4l/Kconfig
```kconfig
#
# Old ISDN4Linux config
#

config ISDN_PPP
	bool "Support synchronous PPP"
	depends on INET
	help
	  Over digital connections such as ISDN, there is no need to
	  synchronize sender and recipient's clocks with start and stop bits
	  as is done over analog telephone lines. Instead, one can use
	  "synchronous PPP". Saying Y here will include this protocol. This
	  protocol is used by Cisco and Sun for example. So you want to say Y
	  here if the other end of your ISDN connection supports it. You will
	  need a special version of pppd (called ipppd) for using this
	  feature. See <file:Documentation/isdn/README.syncppp> and
	  <file:Documentation/isdn/syncPPP.FAQ> for more information.

config ISDN_PPP_VJ
	bool "Use VJ-compression with synchronous PPP"
	depends on ISDN_PPP
	help
	  This enables Van Jacobson header compression for synchronous PPP.
	  Say Y if the other end of the connection supports it.

config ISDN_MPP
	bool "Support generic MP (RFC 1717)"
	depends on ISDN_PPP
	help
	  With synchronous PPP enabled, it is possible to increase throughput
	  by bundling several ISDN-connections, using this protocol. See
	  <file:Documentation/isdn/README.syncppp> for more information.

config IPPP_FILTER
	bool "Filtering for synchronous PPP"
	depends on ISDN_PPP
	help
	  Say Y here if you want to be able to filter the packets passing over
	  IPPP interfaces.  This allows you to control which packets count as
	  activity (i.e. which packets will reset the idle timer or bring up
	  a demand-dialled link) and which packets are to be dropped entirely.
	  You need to say Y here if you wish to use the pass-filter and
	  active-filter options to ipppd.

config ISDN_PPP_BSDCOMP
	tristate "Support BSD compression"
	depends on ISDN_PPP
	help
	  Support for the BSD-Compress compression method for PPP, which uses
	  the LZW compression method to compress each PPP packet before it is
	  sent over the wire. The machine at the other end of the PPP link
	  (usually your ISP) has to support the BSD-Compress compression
	  method as well for this to be useful. Even if they don't support it,
	  it is safe to say Y here.

config ISDN_AUDIO
	bool "Support audio via ISDN"
	help
	  If you say Y here, the modem-emulator will support a subset of the
	  EIA Class 8 Voice commands. Using a getty with voice-support
	  (mgetty+sendfax by <gert@greenie.muc.de> with an extension, available
	  with the ISDN utility package for example), you will be able to use
	  your Linux box as an ISDN-answering machine. Of course, this must be
	  supported by the lowlevel driver also. Currently, the HiSax driver
	  is the only voice-supporting driver. See
	  <file:Documentation/isdn/README.audio> for more information.

config ISDN_TTY_FAX
	bool "Support AT-Fax Class 1 and 2 commands"
	depends on ISDN_AUDIO
	help
	  If you say Y here, the modem-emulator will support a subset of the
	  Fax Class 1 and 2 commands. Using a getty with fax-support
	  (mgetty+sendfax, hylafax), you will be able to use your Linux box as
	  an ISDN-fax-machine. This must be supported by the lowlevel driver
	  also. See <file:Documentation/isdn/README.fax> for more information.

config ISDN_X25
	bool "X.25 PLP on top of ISDN"
	depends on X25
	help
	  This feature provides the X.25 protocol over ISDN connections.
	  See <file:Documentation/isdn/README.x25> for more information
	  if you are thinking about using this.


menu "ISDN feature submodules"
	depends on ISDN

config ISDN_DRV_LOOP
	tristate "isdnloop support"
	depends on BROKEN_ON_SMP
	help
	  This driver provides a virtual ISDN card. Its primary purpose is
	  testing of linklevel features or configuration without getting
	  charged by your service-provider for lots of phone calls.
	  You need will need the loopctrl utility from the latest isdn4k-utils
	  package to set up this driver.

config ISDN_DIVERSION
	tristate "Support isdn diversion services"
	depends on ISDN && ISDN_I4L
	help
	  This option allows you to use some supplementary diversion
	  services in conjunction with the HiSax driver on an EURO/DSS1
	  line.

	  Supported options are CD (call deflection), CFU (Call forward
	  unconditional), CFB (Call forward when busy) and CFNR (call forward
	  not reachable). Additionally the actual CFU, CFB and CFNR state may
	  be interrogated.

	  The use of CFU, CFB, CFNR and interrogation may be limited to some
	  countries. The keypad protocol is still not implemented. CD should
	  work in all countries if the service has been subscribed to.

	  Please read the file <file:Documentation/isdn/README.diversion>.

endmenu

comment "ISDN4Linux hardware drivers"
	depends on NET && ISDN && ISDN_I4L

source "drivers/isdn/hisax/Kconfig"


menu "Active cards"
	depends on NET && ISDN && ISDN_I4L!=n

source "drivers/isdn/icn/Kconfig"

source "drivers/isdn/pcbit/Kconfig"

source "drivers/isdn/sc/Kconfig"

source "drivers/isdn/act2000/Kconfig"

source "drivers/isdn/hysdn/Kconfig"

endmenu
```

## drivers/isdn/icn/Kconfig
```kconfig
#
# Config.in for ICN ISDN driver
#
config ISDN_DRV_ICN
	tristate "ICN 2B and 4B support"
	depends on ISA
	help
	  This enables support for two kinds of ISDN-cards made by a German
	  company called ICN.  2B is the standard version for a single ISDN
	  line with two B-channels, 4B supports two ISDN lines.  For running
	  this card, additional firmware is necessary, which has to be
	  downloaded into the card using a utility which is distributed
	  separately.  See <file:Documentation/isdn/README> and
	  <file:Documentation/isdn/README.icn> for more
	  information.
```

## drivers/isdn/mISDN/Kconfig
```kconfig
#
# modularer ISDN driver
#

menuconfig MISDN
	tristate "Modular ISDN driver"
	help
	  Enable support for the modular ISDN driver.

if MISDN != n

config MISDN_DSP
	tristate "Digital Audio Processing of transparent data"
	depends on MISDN
	help
	  Enable support for digital audio processing capability.
	  This module may be used for special applications that require
	  cross connecting of bchannels, conferencing, dtmf decoding
	  echo cancelation, tone generation, and Blowfish encryption and
	  decryption.
	  It may use hardware features if available.
	  E.g. it is required for PBX4Linux. Go to http://isdn.eversberg.eu
	  and get more informations about this module and it's usage.
	  If unsure, say 'N'.

config MISDN_L1OIP
	tristate "ISDN over IP tunnel"
	depends on MISDN
	help
	  Enable support for ISDN over IP tunnel.

	  It features:
	    - dynamic IP exchange, if one or both peers have dynamic IPs
	    - BRI (S0) and PRI (S2M) interface
	    - layer 1 control via network keepalive frames
	    - direct tunneling of physical interface via IP

	  NOTE: This protocol is called 'Layer 1 over IP' and is not
	  compatible with ISDNoIP (Agfeo) or TDMoIP. Protocol description is
	  provided in the source code.

source "drivers/isdn/hardware/mISDN/Kconfig"

endif #MISDN
```

## drivers/isdn/sc/Kconfig
```kconfig
config ISDN_DRV_SC
	tristate "Spellcaster support"
	depends on ISA
	help
	  This enables support for the Spellcaster BRI ISDN boards.  This
	  driver currently builds only in a modularized version.
	  To build it, choose M here: the module will be called sc.
	  See <file:Documentation/isdn/README.sc> for more information.
```

## drivers/jtag/Kconfig
```kconfig
menuconfig JTAG
	tristate "JTAG support"
	help
	  This provides basic core functionality support for JTAG class devices.
	  Hardware that is equipped with a JTAG microcontroller can be
	  supported by using this driver's interfaces.
	  This driver exposes a set of IOCTLs to the user space for
	  the following commands:
	    SDR: Performs an IEEE 1149.1 Data Register scan
	    SIR: Performs an IEEE 1149.1 Instruction Register scan.
	    RUNTEST: Forces the IEEE 1149.1 bus to a run state for a specified
	    number of clocks or a specified time period.

	  If you want this support, you should say Y here.

	  To compile this driver as a module, choose M here: the module will
	  be called jtag.
```

## drivers/kvm/Kconfig
```kconfig
#
# KVM configuration
#
menuconfig VIRTUALIZATION
	bool "Virtualization"
	depends on X86
	default y
	---help---
	  Say Y here to get to see options for virtualization guest drivers.
	  This option alone does not add any kernel code.

	  If you say N, all options in this submenu will be skipped and disabled.

if VIRTUALIZATION

config KVM
	tristate "Kernel-based Virtual Machine (KVM) support"
	depends on X86 && EXPERIMENTAL
	select ANON_INODES
	---help---
	  Support hosting fully virtualized guest machines using hardware
	  virtualization extensions.  You will need a fairly recent
	  processor equipped with virtualization extensions. You will also
	  need to select one or more of the processor modules below.

	  This module provides access to the hardware capabilities through
	  a character device node named /dev/kvm.

	  To compile this as a module, choose M here: the module
	  will be called kvm.

	  If unsure, say N.

config KVM_INTEL
	tristate "KVM for Intel processors support"
	depends on KVM
	---help---
	  Provides support for KVM on Intel processors equipped with the VT
	  extensions.

config KVM_AMD
	tristate "KVM for AMD processors support"
	depends on KVM
	---help---
	  Provides support for KVM on AMD processors equipped with the AMD-V
	  (SVM) extensions.

endif # VIRTUALIZATION
```
