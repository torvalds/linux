## drivers/leds/blink/Kconfig
```kconfig
config LEDS_BCM63138
	tristate "LED Support for Broadcom BCM63138 SoC"
	depends on LEDS_CLASS
	depends on ARCH_BCMBCA || ARCH_BCM_5301X || BCM63XX || COMPILE_TEST
	depends on HAS_IOMEM
	depends on OF
	default ARCH_BCMBCA
	help
	  This option enables support for LED controller that is part of
	  BCM63138 SoC. The same hardware block is known to be also used
	  in BCM4908, BCM6848, BCM6858, BCM63148, BCM63381 and BCM68360.

	  If compiled as module it will be called leds-bcm63138.

config LEDS_LGM
       tristate "LED support for LGM SoC series"
       depends on X86 || COMPILE_TEST
       depends on GPIOLIB && LEDS_CLASS && MFD_SYSCON && OF
       help
         This option enables support for LEDs connected to GPIO lines on
         Lightning Mountain (LGM) SoC. Lightning Mountain is a AnyWAN
         gateway-on-a-chip SoC to be shipped on mid and high end home
         gateways and routers.

         These LEDs are driven by a Serial Shift Output (SSO) controller.
         The driver supports hardware blinking and the LEDs can be configured
         to be triggered by software/CPU or by hardware.

         Say 'Y' here if you are working on LGM SoC based platform. Otherwise,
         say 'N'. To compile this driver as a module, choose M here: the module
         will be called leds-lgm-sso.
```

## drivers/leds/flash/Kconfig
```kconfig
# SPDX-License-Identifier: GPL-2.0

if LEDS_CLASS_FLASH

config LEDS_AAT1290
	tristate "LED support for the AAT1290"
	depends on V4L2_FLASH_LED_CLASS || !V4L2_FLASH_LED_CLASS
	depends on GPIOLIB || COMPILE_TEST
	depends on OF
	depends on PINCTRL
	help
	  This option enables support for the LEDs on the AAT1290.

config LEDS_AS3645A
	tristate "AS3645A and LM3555 LED flash controllers support"
	depends on I2C
	depends on V4L2_FLASH_LED_CLASS || !V4L2_FLASH_LED_CLASS
	help
	  Enable LED flash class support for AS3645A LED flash
	  controller. V4L2 flash API is provided as well if
	  CONFIG_V4L2_FLASH_API is enabled.

config LEDS_KTD2692
	tristate "LED support for Kinetic KTD2692 flash LED controller"
	depends on OF
	depends on GPIOLIB
	select LEDS_EXPRESSWIRE
	help
	  This option enables support for Kinetic KTD2692 LED flash connected
	  through ExpressWire interface.

	  Say Y to enable this driver.

config LEDS_LM3601X
	tristate "LED support for LM3601x Chips"
	depends on LEDS_CLASS && I2C
	select REGMAP_I2C
	help
	  This option enables support for the TI LM3601x family
	  of flash, torch and indicator classes.

config LEDS_MAX77693
	tristate "LED support for MAX77693 Flash"
	depends on V4L2_FLASH_LED_CLASS || !V4L2_FLASH_LED_CLASS
	depends on MFD_MAX77693
	depends on OF
	help
	  This option enables support for the flash part of the MAX77693
	  multifunction device. It has build in control for two leds in flash
	  and torch mode.

config LEDS_MT6360
	tristate "LED Support for Mediatek MT6360 PMIC"
	depends on LEDS_CLASS && OF
	depends on LEDS_CLASS_FLASH
	depends on LEDS_CLASS_MULTICOLOR
	depends on V4L2_FLASH_LED_CLASS || !V4L2_FLASH_LED_CLASS
	depends on MFD_MT6360
	help
	  This option enables support for dual Flash LED drivers found on
	  Mediatek MT6360 PMIC.
	  Independent current sources supply for each flash LED support torch
	  and strobe mode.

config LEDS_MT6370_FLASH
	tristate "Flash LED Support for MediaTek MT6370 PMIC"
	depends on LEDS_CLASS
	depends on V4L2_FLASH_LED_CLASS || !V4L2_FLASH_LED_CLASS
	depends on MFD_MT6370
	help
	  Support 2 channels and torch/strobe mode.
	  Say Y here to enable support for
	  MT6370_FLASH_LED device.

	  This driver can also be built as a module. If so, the module
	  will be called "leds-mt6370-flash".

config LEDS_QCOM_FLASH
	tristate "LED support for flash module inside Qualcomm Technologies, Inc. PMIC"
	depends on MFD_SPMI_PMIC || COMPILE_TEST
	depends on LEDS_CLASS && OF
	depends on V4L2_FLASH_LED_CLASS || !V4L2_FLASH_LED_CLASS
	select REGMAP
	help
	  This option enables support for the flash module found in Qualcomm
	  Technologies, Inc. PMICs. The flash module can have 3 or 4 flash LED
	  channels and each channel is programmable to support up to 1.5 A full
	  scale current. It also supports connecting two channels' output together
	  to supply one LED component to achieve current up to 2 A. In such case,
	  the total LED current will be split symmetrically on each channel and
	  they will be enabled/disabled at the same time.

	  This driver can be built as a module, it will be called "leds-qcom-flash".

config LEDS_RT4505
	tristate "LED support for RT4505 flashlight controller"
	depends on I2C && OF
	depends on V4L2_FLASH_LED_CLASS || !V4L2_FLASH_LED_CLASS
	select REGMAP_I2C
	help
	  This option enables support for the RT4505 flash LED controller.
	  RT4505 includes torch and flash functions with programmable current.
	  And it's commonly used to compensate the illuminance for the camera
	  inside the mobile product like as phones or tablets.

config LEDS_RT8515
	tristate "LED support for Richtek RT8515 flash/torch LED"
	depends on GPIOLIB
	depends on V4L2_FLASH_LED_CLASS || !V4L2_FLASH_LED_CLASS
	help
	  This option enables support for the Richtek RT8515 flash
	  and torch LEDs found on some mobile phones.

	  To compile this driver as a module, choose M here: the module
	  will be called leds-rt8515.

config LEDS_SGM3140
	tristate "LED support for the SGM3140"
	depends on V4L2_FLASH_LED_CLASS || !V4L2_FLASH_LED_CLASS
	help
	  This option enables support for the SGM3140 500mA Buck/Boost Charge
	  Pump LED Driver.

config LEDS_SY7802
	tristate "LED support for the Silergy SY7802"
	depends on I2C && OF
	depends on GPIOLIB
	select REGMAP_I2C
	help
	  This option enables support for the SY7802 flash LED controller.
	  SY7802 includes torch and flash functions with programmable current.

	  This driver can be built as a module, it will be called "leds-sy7802".

endif # LEDS_CLASS_FLASH
```

## drivers/leds/rgb/Kconfig
```kconfig
# SPDX-License-Identifier: GPL-2.0

if LEDS_CLASS_MULTICOLOR

config LEDS_GROUP_MULTICOLOR
	tristate "LEDs group multi-color support"
	depends on OF
	help
	  This option enables support for monochrome LEDs that are grouped
	  into multicolor LEDs which is useful in the case where LEDs of
	  different colors are physically grouped in a single multi-color LED
	  and driven by a controller that doesn't have multi-color support.

	  To compile this driver as a module, choose M here: the module
	  will be called leds-group-multicolor.

config LEDS_KTD202X
	tristate "LED support for KTD202x Chips"
	depends on I2C
	depends on OF
	select REGMAP_I2C
	help
	  This option enables support for the Kinetic KTD2026/KTD2027
	  RGB/White LED driver found in different BQ mobile phones.
	  It is a 3 or 4 channel LED driver programmed via an I2C interface.

	  To compile this driver as a module, choose M here: the module
	  will be called leds-ktd202x.

config LEDS_PWM_MULTICOLOR
	tristate "PWM driven multi-color LED Support"
	depends on PWM
	help
	  This option enables support for PWM driven monochrome LEDs that are
	  grouped into multicolor LEDs.

	  To compile this driver as a module, choose M here: the module
	  will be called leds-pwm-multicolor.

config LEDS_QCOM_LPG
	tristate "LED support for Qualcomm LPG"
	depends on OF
	depends on PWM
	depends on SPMI
	help
	  This option enables support for the Light Pulse Generator found in a
	  wide variety of Qualcomm PMICs. The LPG consists of a number of PWM
	  channels and typically a shared pattern lookup table and a current
	  sink, intended to drive RGB LEDs. Each channel can either be used as
	  a LED, grouped to represent a RGB LED or exposed as PWM channels.

	  If compiled as a module, the module will be named leds-qcom-lpg.

config LEDS_MT6370_RGB
	tristate "LED Support for MediaTek MT6370 PMIC"
	depends on MFD_MT6370
	select LINEAR_RANGES
	help
	  Say Y here to enable support for MT6370_RGB LED device.
	  In MT6370, there are four channel current-sink LED drivers that
	  support hardware pattern for constant current, PWM, and breath mode.
	  Isink4 channel can also be used as a CHG_VIN power good indicator.

	  This driver can also be built as a module. If so, the module
	  will be called "leds-mt6370-rgb".

endif # LEDS_CLASS_MULTICOLOR
```

## drivers/leds/simple/Kconfig
```kconfig
# SPDX-License-Identifier: GPL-2.0-only
config LEDS_SIEMENS_SIMATIC_IPC
	tristate "LED driver for Siemens Simatic IPCs"
	depends on LEDS_CLASS
	depends on SIEMENS_SIMATIC_IPC
	help
	  This option enables support for the LEDs of several Industrial PCs
	  from Siemens.

	  To compile this driver as a module, choose M here: the module
	  will be called simatic-ipc-leds.

config LEDS_SIEMENS_SIMATIC_IPC_APOLLOLAKE
	tristate "LED driver for Siemens Simatic IPCs based on Intel Apollo Lake GPIO"
	depends on LEDS_GPIO
	depends on PINCTRL_BROXTON
	depends on SIEMENS_SIMATIC_IPC
	default LEDS_SIEMENS_SIMATIC_IPC
	help
	  This option enables support for the LEDs of several Industrial PCs
	  from Siemens based on Apollo Lake GPIO i.e. IPC127E.

	  To compile this driver as a module, choose M here: the module
	  will be called simatic-ipc-leds-gpio-apollolake.

config LEDS_SIEMENS_SIMATIC_IPC_F7188X
	tristate "LED driver for Siemens Simatic IPCs based on Nuvoton GPIO"
	depends on LEDS_GPIO
	depends on GPIO_F7188X
	depends on SIEMENS_SIMATIC_IPC
	default LEDS_SIEMENS_SIMATIC_IPC
	help
	  This option enables support for the LEDs of several Industrial PCs
	  from Siemens based on Nuvoton GPIO i.e. IPC227G.

	  To compile this driver as a module, choose M here: the module
	  will be called simatic-ipc-leds-gpio-f7188x.
```

## drivers/leds/trigger/Kconfig
```kconfig
menuconfig LEDS_TRIGGERS
	bool "LED Trigger support"
	depends on LEDS_CLASS
	help
	  This option enables trigger support for the leds class.
	  These triggers allow kernel events to drive the LEDs and can
	  be configured via sysfs. If unsure, say Y.

if LEDS_TRIGGERS

config LEDS_TRIGGER_TIMER
	tristate "LED Timer Trigger"
	help
	  This allows LEDs to be controlled by a programmable timer
	  via sysfs. Some LED hardware can be programmed to start
	  blinking the LED without any further software interaction.
	  For more details read Documentation/leds/leds-class.txt.

	  If unsure, say Y.

config LEDS_TRIGGER_ONESHOT
	tristate "LED One-shot Trigger"
	help
	  This allows LEDs to blink in one-shot pulses with parameters
	  controlled via sysfs.  It's useful to notify the user on
	  sporadic events, when there are no clear begin and end trap points,
	  or on dense events, where this blinks the LED at constant rate if
	  rearmed continuously.

	  It also shows how to use the led_blink_set_oneshot() function.

	  If unsure, say Y.

config LEDS_TRIGGER_DISK
	bool "LED Disk Trigger"
	depends on IDE_GD_ATA || ATA
	help
	  This allows LEDs to be controlled by disk activity.
	  If unsure, say Y.

config LEDS_TRIGGER_MTD
	bool "LED MTD (NAND/NOR) Trigger"
	depends on MTD
	help
	  This allows LEDs to be controlled by MTD activity.
	  If unsure, say N.

config LEDS_TRIGGER_HEARTBEAT
	tristate "LED Heartbeat Trigger"
	help
	  This allows LEDs to be controlled by a CPU load average.
	  The flash frequency is a hyperbolic function of the 1-minute
	  load average.
	  If unsure, say Y.

config LEDS_TRIGGER_BACKLIGHT
	tristate "LED backlight Trigger"
	help
	  This allows LEDs to be controlled as a backlight device: they
	  turn off and on when the display is blanked and unblanked.

	  If unsure, say N.

config LEDS_TRIGGER_CPU
	bool "LED CPU Trigger"
	help
	  This allows LEDs to be controlled by active CPUs. This shows
	  the active CPUs across an array of LEDs so you can see which
	  CPUs are active on the system at any given moment.

	  If unsure, say N.

config LEDS_TRIGGER_ACTIVITY
	tristate "LED activity Trigger"
	help
	  This allows LEDs to be controlled by an immediate CPU usage.
	  The flash frequency and duty cycle varies from faint flashes to
	  intense brightness depending on the instant CPU load.
	  If unsure, say N.

config LEDS_TRIGGER_GPIO
	tristate "LED GPIO Trigger"
	depends on GPIOLIB || COMPILE_TEST
	help
	  This allows LEDs to be controlled by gpio events. It's good
	  when using gpios as switches and triggering the needed LEDs
	  from there. One use case is n810's keypad LEDs that could
	  be triggered by this trigger when user slides up to show
	  keypad.

	  If unsure, say N.

config LEDS_TRIGGER_DEFAULT_ON
	tristate "LED Default ON Trigger"
	help
	  This allows LEDs to be initialised in the ON state.
	  If unsure, say Y.

comment "iptables trigger is under Netfilter config (LED target)"
	depends on LEDS_TRIGGERS

config LEDS_TRIGGER_TRANSIENT
	tristate "LED Transient Trigger"
	help
	  This allows one time activation of a transient state on
	  GPIO/PWM based hardware.
	  If unsure, say Y.

config LEDS_TRIGGER_CAMERA
	tristate "LED Camera Flash/Torch Trigger"
	help
	  This allows LEDs to be controlled as a camera flash/torch device.
	  This enables direct flash/torch on/off by the driver, kernel space.
	  If unsure, say Y.

config LEDS_TRIGGER_PANIC
	bool "LED Panic Trigger"
	help
	  This allows LEDs to be configured to blink on a kernel panic.
	  Enabling this option will allow to mark certain LEDs as panic indicators,
	  allowing to blink them on a kernel panic, even if they are set to
	  a different trigger.
	  If unsure, say Y.

config LEDS_TRIGGER_NETDEV
	tristate "LED Netdev Trigger"
	depends on NET
	help
	  This allows LEDs to be controlled by network device activity.
	  If unsure, say Y.

config LEDS_TRIGGER_PATTERN
	tristate "LED Pattern Trigger"
	help
	  This allows LEDs to be controlled by a software or hardware pattern
	  which is a series of tuples, of brightness and duration (ms).
	  If unsure, say N

endif # LEDS_TRIGGERS
```

## drivers/lguest/Kconfig
```kconfig
config LGUEST
	tristate "Linux hypervisor example code"
	depends on X86_32 && EVENTFD && TTY && PCI_DIRECT
	select HVC_DRIVER
	---help---
	  This is a very simple module which allows you to run
	  multiple instances of the same Linux kernel, using the
	  "lguest" command found in the tools/lguest directory.

	  Note that "lguest" is pronounced to rhyme with "fell quest",
	  not "rustyvisor". See tools/lguest/lguest.txt.

	  If unsure, say N.  If curious, say M.  If masochistic, say Y.
```

## drivers/lightnvm/Kconfig
```kconfig
#
# Open-Channel SSD NVM configuration
#

menuconfig NVM
	bool "Open-Channel SSD target support"
	depends on BLOCK && PCI
	select BLK_DEV_NVME
	help
	  Say Y here to get to enable Open-channel SSDs.

	  Open-Channel SSDs implement a set of extension to SSDs, that
	  exposes direct access to the underlying non-volatile memory.

	  If you say N, all options in this submenu will be skipped and disabled
	  only do this if you know what you are doing.

if NVM

config NVM_PBLK
	tristate "Physical Block Device Open-Channel SSD target"
	select CRC32
	help
	  Allows an open-channel SSD to be exposed as a block device to the
	  host. The target assumes the device exposes raw flash and must be
	  explicitly managed by the host.

	  Please note the disk format is considered EXPERIMENTAL for now.

if NVM_PBLK

config NVM_PBLK_DEBUG
	bool "PBlk Debug Support"
	default n
	help
	  Enables debug support for pblk. This includes extra checks, more
	  vocal error messages, and extra tracking fields in the pblk sysfs
	  entries.

endif # NVM_PBLK_DEBUG

endif # NVM
```
