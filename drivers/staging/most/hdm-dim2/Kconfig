## drivers/staging/most/hdm-dim2/Kconfig
```kconfig
#
# MediaLB configuration
#

config HDM_DIM2
	tristate "DIM2 HDM"

	---help---
	  Say Y here if you want to connect via MediaLB to network tranceiver.
	  This device driver is platform dependent and needs an addtional
	  platform driver to be installed. For more information contact
	  maintainer of this driver.

	  To compile this driver as a module, choose M here: the
	  module will be called hdm_dim2.
```

## drivers/staging/most/hdm-i2c/Kconfig
```kconfig
#
# MOST I2C configuration
#

config HDM_I2C
	tristate "I2C HDM"
	depends on I2C
	---help---
	  Say Y here if you want to connect via I2C to network tranceiver.

	  To compile this driver as a module, choose M here: the
	  module will be called hdm_i2c.
```

## drivers/staging/most/hdm-usb/Kconfig
```kconfig
#
# MOST USB configuration
#

config HDM_USB
	tristate "USB HDM"
	depends on USB && NET
	select AIM_NETWORK
	---help---
	  Say Y here if you want to connect via USB to network tranceiver.
	  This device driver depends on the networking AIM.

	  To compile this driver as a module, choose M here: the
	  module will be called hdm_usb.
```

## drivers/staging/most/i2c/Kconfig
```kconfig
#
# MOST I2C configuration
#

config MOST_I2C
	tristate "I2C"
	depends on I2C
	---help---
	  Say Y here if you want to connect via I2C to network tranceiver.

	  To compile this driver as a module, choose M here: the
	  module will be called most_i2c.
```

## drivers/staging/most/mostcore/Kconfig
```kconfig
#
# MOSTCore configuration
#

config MOSTCORE
	tristate "MOST Core"
	depends on HAS_DMA

	---help---
	  Say Y here if you want to enable MOST support.
	  This device driver needs at least an additional AIM and HDM to work.

	  To compile this driver as a module, choose M here: the
	  module will be called mostcore.
```

## drivers/staging/most/net/Kconfig
```kconfig
#
# MOST Networking configuration
#

config MOST_NET
	tristate "Net"
	depends on NET

	---help---
	  Say Y here if you want to commumicate via a networking device.

	  To compile this driver as a module, choose M here: the
	  module will be called most_net.
```

## drivers/staging/most/sound/Kconfig
```kconfig
#
# MOST ALSA configuration
#

config MOST_SOUND
	tristate "Sound"
	depends on SND
	select SND_PCM
	---help---
	  Say Y here if you want to commumicate via ALSA/sound devices.

	  To compile this driver as a module, choose M here: the
	  module will be called most_sound.
```

## drivers/staging/most/usb/Kconfig
```kconfig
# SPDX-License-Identifier: GPL-2.0
#
# MOST USB configuration
#

config MOST_USB
	tristate "USB"
	depends on USB
	help
	  Say Y here if you want to connect via USB to network transceiver.

	  To compile this driver as a module, choose M here: the
	  module will be called most_usb.
```

## drivers/staging/most/video/Kconfig
```kconfig
#
# MOST V4L2 configuration
#

config MOST_VIDEO
	tristate "Video"
	depends on VIDEO_V4L2
	---help---
	  Say Y here if you want to commumicate via Video 4 Linux.

	  To compile this driver as a module, choose M here: the
	  module will be called most_video.
```

## drivers/staging/mrst-touchscreen/Kconfig
```kconfig
config TOUCHSCREEN_INTEL_MID
	tristate "Intel MID platform resistive touchscreen"
	depends on INTEL_SCU_IPC && INPUT_TOUCHSCREEN
	default y
	help
	  Say Y here if you have a Intel MID based touchscreen
	  If unsure, say N.
```

## drivers/staging/msm/Kconfig
```kconfig
config MSM_STAGING
	tristate "MSM Frame Buffer Support"
	depends on FB && ARCH_MSM && !FB_MSM
	select FB_BACKLIGHT if FB_MSM_BACKLIGHT
	select NEW_LEDS
	select LEDS_CLASS
	select FB_CFB_FILLRECT
	select FB_CFB_COPYAREA
	select FB_CFB_IMAGEBLIT
	---help---
	  Support for MSM Framebuffer.

if MSM_STAGING

config FB_MSM_LCDC_HW
	bool
	default n

choice
	prompt "MDP HW version"
	default FB_MSM_MDP31

config FB_MSM_MDP31
	select FB_MSM_LCDC_HW
	bool "MDP HW ver3.1"
	---help---
	  Support for MSM MDP HW revision 3.1
	  Say Y here if this is msm8x50 variant platform.
endchoice

config FB_MSM_LCDC
	bool
	default n

config FB_MSM_TVOUT
	bool
	default n

config FB_MSM_LCDC_PANEL
	bool
	select FB_MSM_LCDC
	default n

config FB_MSM_LCDC_PRISM_WVGA
        bool
	select FB_MSM_LCDC_PANEL
	default n

config FB_MSM_LCDC_ST15_WXGA
        bool
        select FB_MSM_LCDC_PANEL
        default n

choice
	prompt "LCD Panel"
	default FB_MSM_LCDC_ST15_PANEL

config FB_MSM_LCDC_PRISM_WVGA_PANEL
	depends on FB_MSM_LCDC_HW
	bool "LCDC Prism WVGA Panel"
	select FB_MSM_LCDC_PRISM_WVGA
	---help---
	  Support for LCDC Prism WVGA (800x480) panel


config FB_MSM_LCDC_ST15_PANEL
        depends on FB_MSM_LCDC_HW
        bool "LCDC ST1.5 Panel"
        select FB_MSM_LCDC_ST15_WXGA
        ---help---
          Support for ST1.5 WXGA (1366x768) panel

config FB_MSM_PANEL_NONE
	bool "NONE"
	---help---
	  This will disable LCD panel
endchoice

choice
	prompt "Secondary LCD Panel"
	depends on  FB_MSM_MDP31
	default FB_MSM_SECONDARY_PANEL_NONE

config FB_MSM_SECONDARY_PANEL_NONE
	bool "NONE"
	---help---
	  No secondary panel
endchoice

config FB_MSM_TVOUT_NTSC
	bool
	select FB_MSM_TVOUT
	default n

config FB_MSM_TVOUT_PAL
	bool
	select FB_MSM_TVOUT
	default n

choice
	depends on  (FB_MSM_MDP22 || FB_MSM_MDP31)
	prompt "TVOut Region"
	default FB_MSM_TVOUT_NTSC_M

config FB_MSM_TVOUT_NTSC_M
	bool "NTSC M"
	select FB_MSM_TVOUT_NTSC
	---help---
	  Support for NTSC M region (North American and Korea)

config FB_MSM_TVOUT_NONE
	bool "NONE"
	---help---
	  This will disable TV Out functionality.
endchoice

config PMEM_KERNEL_SIZE
        int "PMEM for kernel components (in MB)"
        default 2
        depends on ARCH_QSD8X50
        help
          Configures the amount of PMEM for use by kernel components
          (in MB; minimum 2MB)
endif
```

## drivers/staging/mt29f_spinand/Kconfig
```kconfig
config MTD_SPINAND_MT29F
	tristate "SPINAND Device Support for Micron"
	depends on MTD_NAND && SPI
	help
	  This enables support for accessing Micron SPI NAND flash
	  devices.
	  If you have Micron SPI NAND chip say yes.

	  If unsure, say no here.

config MTD_SPINAND_ONDIEECC
	bool "Use SPINAND internal ECC"
	depends on MTD_SPINAND_MT29F
	help
	  Internal ECC.
	  Enables Hardware ECC support for Micron SPI NAND.
```

## drivers/staging/mt7621-dma/Kconfig
```kconfig
# SPDX-License-Identifier: GPL-2.0
config MTK_HSDMA
	tristate "MTK HSDMA support"
	depends on RALINK && SOC_MT7621
	select DMA_ENGINE
	select DMA_VIRTUAL_CHANNELS
```

## drivers/staging/mt7621-dts/Kconfig
```kconfig
# SPDX-License-Identifier: GPL-2.0
config DTB_GNUBEE1
	bool "GnuBee1 NAS"
	depends on SOC_MT7621 && DTB_RT_NONE
	select BUILTIN_DTB
```

## drivers/staging/mt7621-eth/Documentation/devicetree/bindings/net/mediatek-net-gsw.txt
```
Mediatek Gigabit Switch
=======================

The mediatek gigabit switch can be found on Mediatek SoCs.

Required properties:
- compatible: Should be "mediatek,mt7620-gsw", "mediatek,mt7621-gsw",
  "mediatek,mt7623-gsw"
- reg: Address and length of the register set for the device
- interrupts: Should contain the gigabit switches interrupt


Additional required properties for ARM based SoCs:
- mediatek,reset-pin: phandle describing the reset GPIO
- clocks: the clocks used by the switch
- clock-names: the names of the clocks listed in the clocks property
  these should be "trgpll", "esw", "gp2", "gp1"
- mt7530-supply: the phandle of the regulator used to power the switch
- mediatek,pctl-regmap: phandle to the port control regmap. this is used to
  setup the drive current


Optional properties:
- interrupt-parent: Should be the phandle for the interrupt controller
  that services interrupts for this device

Example:

gsw: switch@1b100000 {
	compatible = "mediatek,mt7623-gsw";
	reg = <0 0x1b110000 0 0x300000>;

	interrupt-parent = <&pio>;
	interrupts = <168 IRQ_TYPE_EDGE_RISING>;

	clocks = <&apmixedsys CLK_APMIXED_TRGPLL>,
		 <&ethsys CLK_ETHSYS_ESW>,
		 <&ethsys CLK_ETHSYS_GP2>,
		 <&ethsys CLK_ETHSYS_GP1>;
	clock-names = "trgpll", "esw", "gp2", "gp1";

	mt7530-supply = <&mt6323_vpa_reg>;

	mediatek,pctl-regmap = <&syscfg_pctl_a>;
	mediatek,reset-pin = <&pio 15 0>;

	status = "okay";
};
```

## drivers/staging/mt7621-eth/Kconfig
```kconfig
config NET_VENDOR_MEDIATEK_STAGING
	bool "MediaTek ethernet driver - staging version"
	depends on RALINK
	---help---
	  If you have an MT7621 Mediatek SoC with ethernet, say Y.

if NET_VENDOR_MEDIATEK_STAGING
choice
	prompt "MAC type"

config NET_MEDIATEK_MT7621
	bool "MT7621"
	depends on MIPS && SOC_MT7621

endchoice

config NET_MEDIATEK_SOC_STAGING
	tristate "MediaTek SoC Gigabit Ethernet support"
	depends on NET_VENDOR_MEDIATEK_STAGING
	select PHYLIB
	---help---
	  This driver supports the gigabit ethernet MACs in the
	  MediaTek SoC family.

config NET_MEDIATEK_MDIO
	def_bool NET_MEDIATEK_SOC_STAGING
	depends on NET_MEDIATEK_MT7621
	select PHYLIB

config NET_MEDIATEK_MDIO_MT7620
	def_bool NET_MEDIATEK_SOC_STAGING
	depends on NET_MEDIATEK_MT7621
	select NET_MEDIATEK_MDIO

config NET_MEDIATEK_GSW_MT7621
	def_tristate NET_MEDIATEK_SOC_STAGING
	depends on NET_MEDIATEK_MT7621

endif #NET_VENDOR_MEDIATEK_STAGING
```

## drivers/staging/mt7621-gpio/Kconfig
```kconfig
config GPIO_MT7621
	bool "Mediatek GPIO Support"
	depends on SOC_MT7620 || SOC_MT7621
	select ARCH_REQUIRE_GPIOLIB
	help
	  Say yes here to support the Mediatek SoC GPIO device
```

## drivers/staging/mt7621-mmc/Kconfig
```kconfig
config MTK_MMC
	tristate "MTK SD/MMC"
	depends on RALINK && MMC

config MTK_AEE_KDUMP
	bool "MTK AEE KDUMP"
	depends on MTK_MMC

config MTK_MMC_CD_POLL
	bool "Card Detect with Polling"
	depends on MTK_MMC

config MTK_MMC_EMMC_8BIT
	bool "eMMC 8-bit support"
	depends on MTK_MMC && RALINK_MT7628
```

## drivers/staging/mt7621-pci-phy/Kconfig
```kconfig
config PCI_MT7621_PHY
	tristate "MediaTek MT7621 PCI PHY Driver"
	depends on RALINK && OF
	select GENERIC_PHY
	help
	  Say 'Y' here to add support for MediaTek MT7621 PCI PHY driver,
```

## drivers/staging/mt7621-pci/Kconfig
```kconfig
config PCI_MT7621
	tristate "MediaTek MT7621 PCI Controller"
	depends on RALINK
	select PCI_DRIVERS_GENERIC
	help
	  This selects a driver for the MediaTek MT7621 PCI Controller.
```

## drivers/staging/mt7621-pinctrl/Kconfig
```kconfig
# SPDX-License-Identifier: GPL-2.0
config PINCTRL_RT2880
	bool "RT2800 pinctrl driver for RALINK/Mediatek SOCs"
	depends on RALINK
	select PINMUX
	select GENERIC_PINCONF
```

## drivers/staging/mt7621-spi/Kconfig
```kconfig
config SPI_MT7621
	tristate "MediaTek MT7621 SPI Controller"
	depends on RALINK
	help
	  This selects a driver for the MediaTek MT7621 SPI Controller.
```

## drivers/staging/net/Kconfig
```kconfig
if NETDEVICES

if WAN

config PC300
	tristate "Cyclades-PC300 support (RS-232/V.35, X.21, T1/E1 boards)"
	depends on HDLC && PCI && BROKEN
	---help---
	  This driver is broken because of struct tty_driver change.

	  Driver for the Cyclades-PC300 synchronous communication boards.

	  These boards provide synchronous serial interfaces to your
	  Linux box (interfaces currently available are RS-232/V.35, X.21 and
	  T1/E1). If you wish to support Multilink PPP, please select the
	  option later and read the file README.mlppp provided by PC300
	  package.

	  To compile this as a module, choose M here: the module
	  will be called pc300.

	  If unsure, say N.

config PC300_MLPPP
	bool "Cyclades-PC300 MLPPP support"
	depends on PC300 && PPP_MULTILINK && PPP_SYNC_TTY && HDLC_PPP
	help
	  Multilink PPP over the PC300 synchronous communication boards.

comment "Cyclades-PC300 MLPPP support is disabled."
	depends on HDLC && PC300 && (PPP=n || !PPP_MULTILINK || PPP_SYNC_TTY=n || !HDLC_PPP)

comment "Refer to the file README.mlppp, provided by PC300 package."
	depends on HDLC && PC300 && (PPP=n || !PPP_MULTILINK || PPP_SYNC_TTY=n || !HDLC_PPP)

endif # WAN

endif # NETDEVICES
```

## drivers/staging/netlogic/Kconfig
```kconfig
# SPDX-License-Identifier: GPL-2.0
config NETLOGIC_XLR_NET
	tristate "Netlogic XLR/XLS network device"
	depends on CPU_XLR
	depends on NETDEVICES
	select PHYLIB
	help
	This driver support Netlogic XLR/XLS on chip gigabit
	Ethernet.
```

## drivers/staging/netwave/Kconfig
```kconfig
config PCMCIA_NETWAVE
	tristate "Xircom Netwave AirSurfer Pcmcia wireless support"
	depends on PCMCIA && WLAN
	select WIRELESS_EXT
	select WEXT_PRIV
	help
	  Say Y here if you intend to attach this type of PCMCIA (PC-card)
	  wireless Ethernet networking card to your computer.

	  To compile this driver as a module, choose M here: the module will be
	  called netwave_cs.  If unsure, say N.
```
