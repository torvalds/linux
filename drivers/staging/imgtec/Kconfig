## drivers/staging/imgtec/Kconfig
```kconfig
# SPDX-License-Identifier: GPL-2.0
config POWERVR_ADF_FBDEV
	tristate "ADF driver for fbdev-only systems"
	depends on ADF
	depends on FB
	help
	  Driver for systems with only fbdev video drivers.

	  Say Y here if your SoC has a pre-existing fbdev driver, but
	  no native ADF driver. This driver will wrap the fbdev driver
	  to provide minimal compatibility with ADF.

source "drivers/staging/imgtec/rogue/Kconfig"

source "drivers/staging/imgtec/apollo/Kconfig"
```

## drivers/staging/imgtec/apollo/Kconfig
```kconfig
config POWERVR_APOLLO
	tristate "PowerVR Apollo test chip support"
	depends on X86
	default n

config POWERVR_ADF_PDP
	tristate "ADF driver for Apollo PDP"
	default y
	depends on ADF
	depends on POWERVR_APOLLO
```

## drivers/staging/imgtec/rogue/Kconfig
```kconfig
config POWERVR_ROGUE_N
	tristate "PowerVR Rogue"
	default n
	depends on DRM
	help
	  Driver for PowerVR Rogue graphics hardware.

	  Say Y here if your SoC contains a PowerVR Rogue GPU. For more
	  information, see <http://www.imgtec.com/powervr/>.

config POWERVR_ROGUE_PDUMP
	bool "Parameter dumping"
	default n
	depends on POWERVR_ROGUE_N

config POWERVR_ROGUE_RESOURCE_INFO
	bool "Resource info"
	default n
	depends on POWERVR_ROGUE_N
	help
	  Annotate device memory allocations with human-readable names.
	  Requires a compatible userspace driver.

config POWERVR_ROGUE_DEVICEMEM_HISTORY
	bool "Device memory history"
	default n
	depends on POWERVR_ROGUE_N
	help
	  Provides a debugfs file containing a list of recent memory
	  allocations for debugging purposes. Requires a compatible
	  userspace driver.
```

## drivers/staging/imx-drm/Kconfig
```kconfig
config DRM_IMX
	tristate "DRM Support for Freescale i.MX"
	select DRM_KMS_HELPER
	select DRM_KMS_FB_HELPER
	select VIDEOMODE_HELPERS
	select DRM_GEM_CMA_HELPER
	select DRM_KMS_CMA_HELPER
	depends on DRM && (ARCH_MXC || ARCH_MULTIPLATFORM)
	help
	  enable i.MX graphics support

config DRM_IMX_FB_HELPER
	tristate "provide legacy framebuffer /dev/fb0"
	select DRM_KMS_CMA_HELPER
	depends on DRM_IMX
	help
	  The DRM framework can provide a legacy /dev/fb0 framebuffer
	  for your device. This is necessary to get a framebuffer console
	  and also for applications using the legacy framebuffer API

config DRM_IMX_PARALLEL_DISPLAY
	tristate "Support for parallel displays"
	depends on DRM_IMX
	select VIDEOMODE_HELPERS

config DRM_IMX_TVE
	tristate "Support for TV and VGA displays"
	depends on DRM_IMX
	select REGMAP_MMIO
	help
	  Choose this to enable the internal Television Encoder (TVe)
	  found on i.MX53 processors.

config DRM_IMX_LDB
	tristate "Support for LVDS displays"
	depends on DRM_IMX && MFD_SYSCON
	help
	  Choose this to enable the internal LVDS Display Bridge (LDB)
	  found on i.MX53 and i.MX6 processors.

config DRM_IMX_IPUV3_CORE
	tristate "IPUv3 core support"
	depends on DRM_IMX
	depends on RESET_CONTROLLER
	help
	  Choose this if you have a i.MX5/6 system and want
	  to use the IPU. This option only enables IPU base
	  support.

config DRM_IMX_IPUV3
	tristate "DRM Support for i.MX IPUv3"
	depends on DRM_IMX
	depends on DRM_IMX_IPUV3_CORE
	help
	  Choose this if you have a i.MX5 or i.MX6 processor.

config DRM_IMX_HDMI
	tristate "Freescale i.MX DRM HDMI"
	depends on DRM_IMX
	help
	  Choose this if you want to use HDMI on i.MX6.
```

## drivers/staging/intel_sst/Kconfig
```kconfig
config SND_INTEL_SST
	tristate "Intel SST (LPE) Driver"
	depends on X86 && INTEL_SCU_IPC
	default n
	help
	  Say Y here to include support for the Intel(R) MID SST DSP driver
	  On other PC platforms if you are unsure answer 'N'

config SND_INTELMID
	tristate "Intel MID sound card driver"
	select SND_PCM
	select SND_SEQUENCER
	select SND_JACK
	depends on SND_INTEL_SST
	default n
	help
	  Say Y here to include support for the Intel(R) MID sound card driver
	  On other PC platforms if you are unsure answer 'N'
```

## drivers/staging/ipack/Kconfig
```kconfig
#
# IPACK configuration.
#

menuconfig IPACK_BUS
	tristate "IndustryPack bus support"
	---help---
	  If you say Y here you get support for the IndustryPack Framework
	  for drivers for many types of boards that support this industrial
	  bus. The IndustryPack Framework is a virtual bus allowing to
	  communicate between carrier and mezzanine cards connected through
	  this bus.

if IPACK_BUS

source "drivers/staging/ipack/bridges/Kconfig"

source "drivers/staging/ipack/devices/Kconfig"

endif # IPACK
```

## drivers/staging/ipack/bridges/Kconfig
```kconfig
config BOARD_TPCI200
	tristate "TEWS TPCI-200 support for IndustryPack bus"
	depends on IPACK_BUS
	depends on PCI
	help
	  This driver supports the TEWS TPCI200 device for the IndustryPack bus.
	default n
```

## drivers/staging/isdn/Kconfig
```kconfig
# SPDX-License-Identifier: GPL-2.0-only
menu "ISDN CAPI drivers"
	depends on ISDN_CAPI

source "drivers/staging/isdn/avm/Kconfig"

source "drivers/staging/isdn/gigaset/Kconfig"

source "drivers/staging/isdn/hysdn/Kconfig"

endmenu
```

## drivers/staging/isdn/avm/Kconfig
```kconfig
# SPDX-License-Identifier: GPL-2.0-only
#
# ISDN AVM drivers
#

menuconfig CAPI_AVM
	bool "Active AVM cards"
	help
	  Enable support for AVM active ISDN cards.

if CAPI_AVM

config ISDN_DRV_AVMB1_B1ISA
	tristate "AVM B1 ISA support"
	depends on ISA
	help
	  Enable support for the ISA version of the AVM B1 card.

config ISDN_DRV_AVMB1_B1PCI
	tristate "AVM B1 PCI support"
	depends on PCI
	help
	  Enable support for the PCI version of the AVM B1 card.

config ISDN_DRV_AVMB1_B1PCIV4
	bool "AVM B1 PCI V4 support"
	depends on ISDN_DRV_AVMB1_B1PCI
	help
	  Enable support for the V4 version of AVM B1 PCI card.

config ISDN_DRV_AVMB1_T1ISA
	tristate "AVM T1/T1-B ISA support"
	depends on ISA
	help
	  Enable support for the AVM T1 T1B card.
	  Note: This is a PRI card and handle 30 B-channels.

config ISDN_DRV_AVMB1_B1PCMCIA
	tristate "AVM B1/M1/M2 PCMCIA support"
	depends on PCMCIA
	help
	  Enable support for the PCMCIA version of the AVM B1 card.

config ISDN_DRV_AVMB1_AVM_CS
	tristate "AVM B1/M1/M2 PCMCIA cs module"
	depends on ISDN_DRV_AVMB1_B1PCMCIA
	help
	  Enable the PCMCIA client driver for the AVM B1/M1/M2
	  PCMCIA cards.

config ISDN_DRV_AVMB1_T1PCI
	tristate "AVM T1/T1-B PCI support"
	depends on PCI
	help
	  Enable support for the AVM T1 T1B card.
	  Note: This is a PRI card and handle 30 B-channels.

config ISDN_DRV_AVMB1_C4
	tristate "AVM C4/C2 support"
	depends on PCI
	help
	  Enable support for the AVM C4/C2 PCI cards.
	  These cards handle 4/2 BRI ISDN lines (8/4 channels).

endif # CAPI_AVM
```

## drivers/staging/isdn/gigaset/Kconfig
```kconfig
# SPDX-License-Identifier: GPL-2.0-only
menuconfig ISDN_DRV_GIGASET
	tristate "Siemens Gigaset support"
	depends on TTY
	select CRC_CCITT
	select BITREVERSE
	help
	  This driver supports the Siemens Gigaset SX205/255 family of
	  ISDN DECT bases, including the predecessors Gigaset 3070/3075
	  and 4170/4175 and their T-Com versions Sinus 45isdn and Sinus
	  721X.
	  If you have one of these devices, say M here and for at least
	  one of the connection specific parts that follow.
	  This will build a module called "gigaset".
	  Note: If you build your ISDN subsystem (ISDN_CAPI or ISDN_I4L)
	  as a module, you have to build this driver as a module too,
	  otherwise the Gigaset device won't show up as an ISDN device.

if ISDN_DRV_GIGASET

config GIGASET_CAPI
	bool "Gigaset CAPI support"
	depends on ISDN_CAPI='y'||(ISDN_CAPI='m'&&ISDN_DRV_GIGASET='m')
	default 'y'
	help
	  Build the Gigaset driver as a CAPI 2.0 driver interfacing with
	  the Kernel CAPI subsystem. To use it with the old ISDN4Linux
	  subsystem you'll have to enable the capidrv glue driver.
	  (select ISDN_CAPI_CAPIDRV.)
	  Say N to build the old native ISDN4Linux variant.
	  If unsure, say Y.

config GIGASET_BASE
	tristate "Gigaset base station support"
	depends on USB
	help
	  Say M here if you want to use the USB interface of the Gigaset
	  base for connection to your system.
	  This will build a module called "bas_gigaset".

config GIGASET_M105
	tristate "Gigaset M105 support"
	depends on USB
	help
	  Say M here if you want to connect to the Gigaset base via DECT
	  using a Gigaset M105 (Sinus 45 Data 2) USB DECT device.
	  This will build a module called "usb_gigaset".

config GIGASET_M101
	tristate "Gigaset M101 support"
	help
	  Say M here if you want to connect to the Gigaset base via DECT
	  using a Gigaset M101 (Sinus 45 Data 1) RS232 DECT device.
	  This will build a module called "ser_gigaset".

config GIGASET_DEBUG
	bool "Gigaset debugging"
	help
	  This enables debugging code in the Gigaset drivers.
	  If in doubt, say yes.

endif # ISDN_DRV_GIGASET
```

## drivers/staging/isdn/hysdn/Kconfig
```kconfig
# SPDX-License-Identifier: GPL-2.0-only
config HYSDN
	tristate "Hypercope HYSDN cards (Champ, Ergo, Metro) support (module only)"
	depends on m && PROC_FS && PCI
	help
	  Say Y here if you have one of Hypercope's active PCI ISDN cards
	  Champ, Ergo and Metro. You will then get a module called hysdn.
	  Please read the file <file:Documentation/isdn/README.hysdn> for more
	  information.

config HYSDN_CAPI
	bool "HYSDN CAPI 2.0 support"
	depends on HYSDN && ISDN_CAPI
	help
	  Say Y here if you like to use Hypercope's CAPI 2.0 interface.
```

## drivers/staging/keucr/Kconfig
```kconfig
config USB_ENESTORAGE
	tristate "USB ENE SM card reader support"
	depends on USB && SCSI && m
	---help---
	  Say Y here if you wish to control a ENE SM Card reader.
	  To use SD/MS card, please build driver/usb/storage/ums-eneub6250.ko

	  This option depends on 'SCSI' support being enabled, but you
	  probably also need 'SCSI device support: SCSI disk support'
	  (BLK_DEV_SD) for most USB storage devices.

	  To compile this driver as a module, choose M here: the
	  module will be called keucr.
```

## drivers/staging/kpc2000/Kconfig
```kconfig
# SPDX-License-Identifier: GPL-2.0

config KPC2000
	bool "Daktronics KPC Device support"
	select MFD_CORE
	depends on PCI
	depends on UIO
	help
	  Select this if you wish to use the Daktronics KPC PCI devices

	  If unsure, say N.

config KPC2000_CORE
	tristate "Daktronics KPC PCI UIO device"
	depends on KPC2000
	help
	  Say Y here if you wish to support the Daktronics KPC PCI
	  device in UIO mode.

	  To compile this driver as a module, choose M here: the module
	  will be called kpc2000

	  If unsure, say N.

config KPC2000_SPI
	tristate "Daktronics KPC SPI device"
	depends on KPC2000 && SPI
	help
	  Say Y here if you wish to support the Daktronics KPC PCI
	  device in SPI mode.

	  To compile this driver as a module, choose M here: the module
	  will be called kpc2000_spi

	  If unsure, say N.

config KPC2000_I2C
	tristate "Daktronics KPC I2C device"
	depends on KPC2000 && I2C
	help
	  Say Y here if you wish to support the Daktronics KPC PCI
	  device in I2C mode.

	  To compile this driver as a module, choose M here: the module
	  will be called kpc2000_i2c

	  If unsure, say N.

config KPC2000_DMA
	tristate "Daktronics KPC DMA controller"
	depends on KPC2000
	help
	  Say Y here if you wish to support the Daktronics DMA controller.

	  To compile this driver as a module, choose M here: the module
	  will be called kpc2000_dma

	  If unsure, say N.
```

## drivers/staging/ks7010/Kconfig
```kconfig
# SPDX-License-Identifier: GPL-2.0
config KS7010
	tristate "KeyStream KS7010 SDIO support"
	depends on MMC && WIRELESS
	select WIRELESS_EXT
	select WEXT_PRIV
	select FW_LOADER
	select CRYPTO
	select CRYPTO_HASH
	select CRYPTO_MICHAEL_MIC
	help
	  This is a driver for KeyStream KS7010 based SDIO WIFI cards. It is
	  found on at least later Spectec SDW-821 (FCC-ID "S2Y-WLAN-11G-K" only,
	  sadly not FCC-ID "S2Y-WLAN-11B-G") and Spectec SDW-823 microSD cards.
```

## drivers/staging/ktap/Kconfig
```kconfig
config KTAP
	tristate "a programable dynamic tracing tool for Linux"
	depends on PERF_EVENTS && EVENT_TRACING
	default n
	help
	  ktap is a new script-based dynamic tracing tool for Linux,
	  it uses a scripting language and lets users trace the
	  Linux kernel dynamically. ktap is designed to give
	  operational insights with interoperability that allow
	  users to tune, troubleshoot and extend kernel and application.
	  It's similar with Linux Systemtap and Solaris Dtrace.

	  ktap have different design principles from Linux mainstream
	  dynamic tracing language in that it's based on bytecode,
	  so it doesn't depend upon GCC, doesn't require compiling
	  kernel module for each script, safe to use in production
	  environment, fulfilling the embedded ecosystem's tracing needs.

	  See ktap tutorial for more information:
	      http://www.ktap.org/doc/tutorial.html
```

## drivers/staging/line6/Kconfig
```kconfig
menuconfig LINE6_USB
	tristate "Line6 USB support"
	depends on USB && SND
	select SND_RAWMIDI
	select SND_PCM
	help
	  This is a driver for the guitar amp, cab, and effects modeller
	  PODxt Pro by Line6 (and similar devices), supporting the
	  following features:
	    * Reading/writing individual parameters
	    * Reading/writing complete channel, effects setup, and amp
	      setup data
	    * Channel switching
	    * Virtual MIDI interface
	    * Tuner access
	    * Playback/capture/mixer device for any ALSA-compatible PCM
	      audio application
	    * Signal routing (record clean/processed guitar signal,
	      re-amping)

	  Preliminary support for the Variax Workbench and TonePort
	  devices is included.

if LINE6_USB

config LINE6_USB_IMPULSE_RESPONSE
	bool "measure impulse response"
	default n
	help
	  Say Y here to add code to measure the impulse response of a Line6
	  device. This is more accurate than user-space methods since it
	  bypasses any PCM data buffering (e.g., by ALSA or jack). This is
	  useful for assessing the performance of new devices, but is not
	  required for normal operation.

	  If unsure, say N.

endif # LINE6_USB
```
