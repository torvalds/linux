## drivers/staging/lirc/Kconfig
```kconfig
#
# LIRC driver(s) configuration
#
menuconfig LIRC_STAGING
	bool "Linux Infrared Remote Control IR receiver/transmitter drivers"
	depends on LIRC
	help
	  Say Y here, and all supported Linux Infrared Remote Control IR and
	  RF receiver and transmitter drivers will be displayed. When paired
	  with a remote control and the lirc daemon, the receiver drivers
	  allow control of your Linux system via remote control.

if LIRC_STAGING

config LIRC_BT829
        tristate "BT829 based hardware"
	depends on LIRC_STAGING && PCI
	help
	  Driver for the IR interface on BT829-based hardware

config LIRC_I2C
	tristate "I2C Based IR Receivers"
	depends on LIRC_STAGING && I2C
	help
	  Driver for I2C-based IR receivers, such as those commonly
	  found onboard Hauppauge PVR-150/250/350 video capture cards

config LIRC_IGORPLUGUSB
	tristate "Igor Cesko's USB IR Receiver"
	depends on LIRC_STAGING && USB
	help
	  Driver for Igor Cesko's USB IR Receiver

config LIRC_IMON
	tristate "Legacy SoundGraph iMON Receiver and Display"
	depends on LIRC_STAGING && USB
	help
	  Driver for the original SoundGraph iMON IR Receiver and Display

	  Current generation iMON devices use the input layer imon driver.

config LIRC_IT87
	tristate "ITE IT87XX CIR Port Receiver"
	depends on LIRC_STAGING && PNP
	help
	  Driver for the ITE IT87xx IR Receiver

config LIRC_ITE8709
	tristate "ITE8709 CIR Port Receiver"
	depends on LIRC_STAGING && PNP
	help
	  Driver for the ITE8709 IR Receiver

config LIRC_PARALLEL
	tristate "Homebrew Parallel Port Receiver"
	depends on LIRC_STAGING && PARPORT && !SMP
	help
	  Driver for Homebrew Parallel Port Receivers

config LIRC_SASEM
	tristate "Sasem USB IR Remote"
	depends on LIRC_STAGING && USB
	help
	  Driver for the Sasem OnAir Remocon-V or Dign HV5 HTPC IR/VFD Module

config LIRC_SERIAL
	tristate "Homebrew Serial Port Receiver"
	depends on LIRC_STAGING
	help
	  Driver for Homebrew Serial Port Receivers

config LIRC_SERIAL_TRANSMITTER
	bool "Serial Port Transmitter"
	default y
	depends on LIRC_SERIAL
	help
	  Serial Port Transmitter support

config LIRC_SIR
	tristate "Built-in SIR IrDA port"
	depends on LIRC_STAGING
	help
	  Driver for the SIR IrDA port

config LIRC_TTUSBIR
	tristate "Technotrend USB IR Receiver"
	depends on LIRC_STAGING && USB
	help
	  Driver for the Technotrend USB IR Receiver

config LIRC_ZILOG
	tristate "Zilog/Hauppauge IR Transmitter"
	depends on LIRC_STAGING && I2C
	help
	  Driver for the Zilog/Hauppauge IR Transmitter, found on
	  PVR-150/500, HVR-1200/1250/1700/1800, HD-PVR and other cards
endif
```

## drivers/staging/lttng/Kconfig
```kconfig
config LTTNG
	tristate "LTTng kernel tracer"
	depends on TRACEPOINTS
	help
	  The LTTng 2.0 Tracer Toolchain allows integrated kernel and
	  user-space tracing from a single user interface: the "lttng"
	  command. See http://lttng.org website for the "lttng-tools"
	  user-space tracer control tools package and the "babeltrace"
	  package for conversion of trace data to a human-readable
	  format.

	  LTTng features:
	  - System-wide tracing across kernel, libraries and
	    applications,
	  - Tracepoints, detailed syscall tracing (fast strace replacement),
	    Function tracer, CPU Performance Monitoring Unit (PMU) counters
	    and kprobes support,
	  - Have the ability to attach "context" information to events in the
	    trace (e.g. any PMU counter, pid, ppid, tid, comm name, etc). All
	    the extra information fields to be collected with events are
	    optional, specified on a per-tracing-session basis (except for
	    timestamp and event id, which are mandatory).
	  - Precise and fast clock sources with near cycle-level
	    timestamps,
	  - Efficient trace data transport:
	    - Compact Binary format with CTF,
	    - Per-core buffers ensures scalability,
	    - Fast-paths in caller context, amortized synchronization,
	    - Zero-copy using splice and mmap system calls, over disk,
	      network or consumed in-place,
	  - Multiple concurrent tracing sessions are supported,
	  - Designed to meet hard real-time constraints,
	  - Supports live streaming of the trace data,
	  - Produces CTF (Common Trace Format) natively (see
	    http://www.efficios.com/ctf).
```

## drivers/staging/lustre/Kconfig
```kconfig
source "drivers/staging/lustre/lnet/Kconfig"

source "drivers/staging/lustre/lustre/Kconfig"
```

## drivers/staging/lustre/lnet/Kconfig
```kconfig
config LNET
	tristate "Lustre networking subsystem (LNet)"
	depends on INET
	help
	  The Lustre network layer, also known as LNet, is a networking abstaction
	  level API that was initially created to allow Lustre Filesystem to utilize
	  very different networks like tcp and ib verbs in a uniform way. In the
	  case of Lustre routers only the LNet layer is required. Lately other
	  projects are also looking into using LNet as their networking API as well.

config LNET_MAX_PAYLOAD
	int "Lustre lnet max transfer payload (default 1MB)"
	depends on LNET
	default "1048576"
	help
	  This option defines the maximum size of payload in bytes that lnet
	  can put into its transport.

	  If unsure, use default.

config LNET_SELFTEST
	tristate "Lustre networking self testing"
	depends on LNET
	help
	  Choose Y here if you want to do lnet self testing. To compile this
	  as a module, choose M here: the module will be called lnet_selftest.

	  To compile this as a kernel modules, choose M here and it will be
	  called lnet_selftest.

	  If unsure, say N.

	  See also http://wiki.lustre.org/

config LNET_XPRT_IB
	tristate "LNET infiniband support"
	depends on LNET && PCI && INFINIBAND && INFINIBAND_ADDR_TRANS
	default LNET && INFINIBAND
	help
	  This option allows the LNET users to use infiniband as an
	  RDMA-enabled transport.

	  To compile this as a kernel module, choose M here and it will be
	  called ko2iblnd.

	  If unsure, say N.
```

## drivers/staging/lustre/lustre/Kconfig
```kconfig
config LUSTRE_FS
	tristate "Lustre file system client support"
	depends on LNET
	select CRYPTO
	select CRYPTO_CRC32
	select CRYPTO_CRC32_PCLMUL if X86
	select CRYPTO_CRC32C
	select CRYPTO_MD5
	select CRYPTO_SHA1
	select CRYPTO_SHA256
	select CRYPTO_SHA512
	depends on MULTIUSER
	help
	  This option enables Lustre file system client support. Choose Y
	  here if you want to access a Lustre file system cluster. To compile
	  this file system support as a module, choose M here: the module will
	  be called lustre.

	  To mount Lustre file systems, you also need to install the user space
	  mount.lustre and other user space commands which can be found in the
	  lustre-client package, available from
	  http://downloads.whamcloud.com/public/lustre/

	  Lustre file system is the most popular cluster file system in high
	  performance computing. Source code of both kernel space and user space
	  Lustre components can also be found at
	  http://git.whamcloud.com/?p=fs/lustre-release.git;a=summary

	  If unsure, say N.

	  See also http://wiki.lustre.org/

config LUSTRE_DEBUG_EXPENSIVE_CHECK
	bool "Enable Lustre DEBUG checks"
	depends on LUSTRE_FS
	help
	  This option is mainly for debug purpose. It enables Lustre code to do
	  expensive checks that may have a performance impact.

	  Use with caution. If unsure, say N.

config LUSTRE_TRANSLATE_ERRNOS
	bool
	depends on LUSTRE_FS && !X86
	default y
```

## drivers/staging/me4000/Kconfig
```kconfig
config ME4000
	tristate "Meilhaus ME-4000 support"
	default n
	depends on PCI
	help
	  This driver supports the Meilhaus ME-4000 family of boards
	  that do data collection and multipurpose I/O.

	  To compile this driver as a module, choose M here: the module
	  will be called me4000.
```

## drivers/staging/media/Kconfig
```kconfig
# SPDX-License-Identifier: GPL-2.0
menuconfig STAGING_MEDIA
	bool "Media staging drivers"
	default n
	help
	  This option allows you to select a number of media drivers that
	  don't have the "normal" Linux kernel quality level.
	  Most of them don't follow properly the V4L, DVB and/or RC API's,
	  so, they won't likely work fine with the existing applications.
	  That also means that, once fixed, their API's will change to match
	  the existing ones.

	  If you wish to work on these drivers, to help improve them, or
	  to report problems you have with them, please use the
	  linux-media@vger.kernel.org mailing list.

	  If in doubt, say N here.


if STAGING_MEDIA && MEDIA_SUPPORT

# Please keep them in alphabetic order
source "drivers/staging/media/atomisp/Kconfig"

source "drivers/staging/media/imx/Kconfig"

source "drivers/staging/media/ipu3/Kconfig"

source "drivers/staging/media/max96712/Kconfig"

source "drivers/staging/media/meson/vdec/Kconfig"

source "drivers/staging/media/omap4iss/Kconfig"

source "drivers/staging/media/rkvdec/Kconfig"

source "drivers/staging/media/sunxi/Kconfig"

source "drivers/staging/media/tegra-video/Kconfig"

menuconfig STAGING_MEDIA_DEPRECATED
	bool "Media staging drivers (DEPRECATED)"
	default n
	help
	  This option enables deprecated media drivers that are
	  scheduled for future removal from the kernel.

	  If you wish to work on these drivers to prevent their removal,
	  then contact the linux-media@vger.kernel.org mailing list.

	  If in doubt, say N here.

if STAGING_MEDIA_DEPRECATED
source "drivers/staging/media/deprecated/atmel/Kconfig"
source "drivers/staging/media/deprecated/cpia2/Kconfig"
source "drivers/staging/media/deprecated/fsl-viu/Kconfig"
source "drivers/staging/media/deprecated/meye/Kconfig"
source "drivers/staging/media/deprecated/saa7146/Kconfig"
source "drivers/staging/media/deprecated/stkwebcam/Kconfig"
source "drivers/staging/media/deprecated/tm6000/Kconfig"
source "drivers/staging/media/deprecated/vpfe_capture/Kconfig"
source "drivers/staging/media/deprecated/zr364xx/Kconfig"
endif

endif
```

## drivers/staging/media/airspy/Kconfig
```kconfig
config USB_AIRSPY
	tristate "AirSpy"
	depends on USB && VIDEO_DEV && VIDEO_V4L2 && I2C
	select VIDEOBUF2_VMALLOC
	default m if !MEDIA_SUBDRV_AUTOSELECT
```

## drivers/staging/media/allegro-dvt/Kconfig
```kconfig
# SPDX-License-Identifier: GPL-2.0
config VIDEO_ALLEGRO_DVT
	tristate "Allegro DVT Video IP Core"
	depends on VIDEO_DEV && VIDEO_V4L2
	depends on ARCH_ZYNQMP || COMPILE_TEST
	select V4L2_MEM2MEM_DEV
	select VIDEOBUF2_DMA_CONTIG
	select REGMAP
	select REGMAP_MMIO
	help
	  Support for the encoder video IP core by Allegro DVT. This core is
	  found for example on the Xilinx ZynqMP SoC in the EV family and is
	  called VCU in the reference manual.

	  To compile this driver as a module, choose M here: the module
	  will be called allegro.
```
