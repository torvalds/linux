## drivers/staging/wfx/Documentation/devicetree/bindings/net/wireless/siliabs,wfx.txt
```
The WFxxx chip series can be connected via SPI or via SDIO.

SPI
---

You have to declare the WFxxx chip in your device tree.

Required properties:
 - compatible: Should be "silabs,wfx-spi"
 - reg: Chip select address of device
 - spi-max-frequency: Maximum SPI clocking speed of device in Hz
 - interrupts-extended: Should contain interrupt line (interrupt-parent +
   interrupt can also been used). Trigger should be `IRQ_TYPE_EDGE_RISING`.

Optional properties:
 - reset-gpios: phandle of gpio that will be used to reset chip during probe.
   Without this property, you may encounter issues with warm boot.

Please consult Documentation/devicetree/bindings/spi/spi-bus.txt for optional
SPI connection related properties,

Example:

&spi1 {
	wfx {
		compatible = "silabs,wfx-spi";
		pinctrl-names = "default";
		pinctrl-0 = <&wfx_irq &wfx_gpios>;
		interrupts-extended = <&gpio 16 IRQ_TYPE_EDGE_RISING>;
		wakeup-gpios = <&gpio 12 GPIO_ACTIVE_HIGH>;
		reset-gpios = <&gpio 13 GPIO_ACTIVE_HIGH>;
		reg = <0>;
		spi-max-frequency = <42000000>;
	};
};


SDIO
----

The driver is able to detect a WFxxx chip on SDIO bus by matching its Vendor ID
and Product ID. However, driver will only provide limited features in this
case. Thus declaring WFxxx chip in device tree is strongly recommended (and may
become mandatory in the future).

Required properties:
 - compatible: Should be "silabs,wfx-sdio"
 - reg: Should be 1

In addition, it is recommended to declare a mmc-pwrseq on SDIO host above WFx.
Without it, you may encounter issues with warm boot. mmc-pwrseq should be
compatible with mmc-pwrseq-simple. Please consult
Documentation/devicetree/bindings/mmc/mmc-pwrseq-simple.txt for more
information.

Example:

/ {
	wfx_pwrseq: wfx_pwrseq {
		compatible = "mmc-pwrseq-simple";
		pinctrl-names = "default";
		pinctrl-0 = <&wfx_reset>;
		reset-gpios = <&gpio 13 GPIO_ACTIVE_LOW>;
	};
};

&mmc1 {
	mmc-pwrseq = <&wfx_pwrseq>;
	#address-size = <1>;
	#size = <0>;

	mmc@1 {
		compatible = "silabs,wfx-sdio";
		reg = <1>;
		pinctrl-names = "default";
		pinctrl-0 = <&wfx_wakeup>;
		wakeup-gpios = <&gpio 12 GPIO_ACTIVE_HIGH>;
	};
};

Note that #address-size and #size shoud already be defined in node mmc1, but it
is rarely the case.

Common properties
-----------------

Some properties are recognized either by SPI and SDIO versions:
 - wakeup-gpios: phandle of gpio that will be used to wake-up chip. Without
   this property, driver will disable most of power saving features.
 - config-file: Use an alternative file as PDS. Default is `wf200.pds`. Only
   necessary for development/debug purpose.
 - slk_key: String representing hexadecimal value of secure link key to use.
   Must contains 64 hexadecimal digits. Not supported in current version.

WFx driver also supports `mac-address` and `local-mac-address` as described in
Documentation/devicetree/binding/net/ethernet.txt
```

## drivers/staging/wfx/Kconfig
```kconfig
config WFX
	tristate "Silicon Labs wireless chips WF200 and further"
	depends on MAC80211
	depends on MMC || !MMC # do not allow WFX=y if MMC=m
	depends on (SPI || MMC)
	help
	  This is a driver for Silicons Labs WFxxx series (WF200 and further)
	  chipsets. This chip can be found on SPI or SDIO buses.
```

## drivers/staging/wilc1000/Kconfig
```kconfig
config WILC1000
	tristate
	help
	  This module only support IEEE 802.11n WiFi.

config WILC1000_SDIO
	tristate "Atmel WILC1000 SDIO (WiFi only)"
	depends on CFG80211 && INET && MMC
	select WILC1000
	help
	  This module adds support for the SDIO interface of adapters using
	  WILC1000 chipset. The Atmel WILC1000 SDIO is a full speed interface.
	  It meets SDIO card specification version 2.0. The interface supports
	  the 1-bit/4-bit SD transfer mode at the clock range of 0-50 MHz.
	  The host can use this interface to read and write from any register
	  within the chip as well as configure the WILC1000 for data DMA.
	  To use this interface, pin9 (SDIO_SPI_CFG) must be grounded. Select
	  this if your platform is using the SDIO bus.

config WILC1000_SPI
	tristate "Atmel WILC1000 SPI (WiFi only)"
	depends on CFG80211 && INET && SPI
	select WILC1000
	help
	  This module adds support for the SPI interface of adapters using
	  WILC1000 chipset. The Atmel WILC1000 has a Serial Peripheral
	  Interface (SPI) that operates as a SPI slave. This SPI interface can
	  be used for control and for serial I/O of 802.11 data. The SPI is a
	  full-duplex slave synchronous serial interface that is available
	  immediately following reset when pin 9 (SDIO_SPI_CFG) is tied to
	  VDDIO. Select this if your platform is using the SPI bus.

config WILC1000_HW_OOB_INTR
	bool "WILC1000 out of band interrupt"
	depends on WILC1000_SDIO
	default n
	help
	  This option enables out-of-band interrupt support for the WILC1000
	  chipset. This OOB interrupt is intended to provide a faster interrupt
	  mechanism for SDIO host controllers that don't support SDIO interrupt.
	  Select this option If the SDIO host controller in your platform
	  doesn't support SDIO time devision interrupt.
```

## drivers/staging/winbond/Kconfig
```kconfig
config W35UND
	tristate "IS89C35 WLAN USB driver"
	depends on MAC80211 && WLAN && USB && EXPERIMENTAL
	default n
	---help---
	  This is highly experimental driver for Winbond WIFI card.

	  Hardware is present in some Kohjinsha subnotebooks, and in some
	  stand-alone USB modules. Chipset name seems to be w89c35d.

	  Check http://code.google.com/p/winbondport/ for new version.
```

## drivers/staging/wlags49_h2/Kconfig
```kconfig
config WLAGS49_H2
	tristate "Agere Systems HERMES II Wireless PC Card Model 0110"
	depends on WLAN && PCMCIA
	select WIRELESS_EXT
	select WEXT_SPY
	select WEXT_PRIV
	---help---
	Driver for wireless cards using Agere's HERMES II chipset
	which are identified with Manufacture ID: 0156,0003
	The software is a modified version of wl_lkm_722_abg.tar.gz
	from the Agere Systems website, addapted for Ubuntu 9.04.
```

## drivers/staging/wlags49_h25/Kconfig
```kconfig
config WLAGS49_H25
	tristate "Linksys HERMES II.5 WCF54G_Wireless-G_CompactFlash_Card"
	depends on WLAN && PCMCIA
	select WIRELESS_EXT
	select WEXT_SPY
	select WEXT_PRIV
	---help---
	Driver for wireless cards using Agere's HERMES II.5 chipset
	which are identified with Manufacture ID: 0156,0004
	The software is a modified version of wl_lkm_722_abg.tar.gz
	from the Agere Systems website, addapted for Ubuntu 9.04.
```

## drivers/staging/wlan-ng/Kconfig
```kconfig
# SPDX-License-Identifier: GPL-2.0
config PRISM2_USB
	tristate "Prism2.5/3 USB driver"
	depends on WLAN && USB && CFG80211
	select WIRELESS_EXT
	select WEXT_PRIV
	help
	  This is the wlan-ng prism 2.5/3 USB driver for a wide range of
	  old USB wireless devices.

	  To compile this driver as a module, choose M here: the module
	  will be called prism2_usb.
```

## drivers/staging/wusbcore/host/Kconfig
```kconfig
# SPDX-License-Identifier: GPL-2.0

config USB_WHCI_HCD
	tristate "Wireless USB Host Controller Interface (WHCI) driver"
	depends on USB_PCI && USB && UWB
	select USB_WUSB
	select UWB_WHCI
	help
	  A driver for PCI-based Wireless USB Host Controllers that are
	  compliant with the WHCI specification.

	  To compile this driver a module, choose M here: the module
	  will be called "whci-hcd".

config USB_HWA_HCD
	tristate "Host Wire Adapter (HWA) driver"
	depends on USB && UWB
	select USB_WUSB
	select UWB_HWA
	help
	  This driver enables you to connect Wireless USB devices to
	  your system using a Host Wire Adaptor USB dongle. This is an
	  UWB Radio Controller and WUSB Host Controller connected to
	  your machine via USB (specified in WUSB1.0).

	  To compile this driver a module, choose M here: the module
	  will be called "hwa-hc".
```
