## drivers/staging/vc04_services/bcm2835-audio/Kconfig
```kconfig
# SPDX-License-Identifier: GPL-2.0
config SND_BCM2835
	tristate "BCM2835 Audio"
	depends on (ARCH_BCM2835 || COMPILE_TEST) && SND
	select SND_PCM
	select BCM2835_VCHIQ if HAS_DMA
	help
	  Say Y or M if you want to support BCM2835 built in audio.
	  This driver handles both 3.5mm and HDMI audio, by leveraging
	  the VCHIQ messaging interface between the kernel and the firmware
	  running on VideoCore.
```

## drivers/staging/vc04_services/bcm2835-camera/Kconfig
```kconfig
# SPDX-License-Identifier: GPL-2.0
config VIDEO_BCM2835
	tristate "BCM2835 Camera"
	depends on MEDIA_SUPPORT
	depends on VIDEO_DEV && (ARCH_BCM2835 || COMPILE_TEST)
	select BCM2835_VCHIQ
	select BCM2835_VCHIQ_MMAL
	select VIDEOBUF2_VMALLOC
	select BTREE
	help
	  Say Y here to enable camera host interface devices for
	  Broadcom BCM2835 SoC. This operates over the VCHIQ interface
	  to a service running on VideoCore.
```

## drivers/staging/vc04_services/vchiq-mmal/Kconfig
```kconfig
config BCM2835_VCHIQ_MMAL
	tristate "BCM2835 MMAL VCHIQ service"
	depends on (ARCH_BCM2835 || COMPILE_TEST)
	help
	  Enables the MMAL API over VCHIQ interface as used for the
	  majority of the multimedia services on VideoCore.
	  Defaults to Y when the Broadcomd BCM2835 camera host is selected.
```

## drivers/staging/vhba/Kconfig
```kconfig
config VHBA
	tristate "Virtual (SCSI) Host Bus Adapter"
	depends on SCSI
	---help---
        This is the in-kernel part of CDEmu, a CD/DVD-ROM device
        emulator.

	This driver can also be built as a module. If so, the module
	will be called vhba.
```

## drivers/staging/vme/Kconfig
```kconfig
#
# VME configuration.
#

menuconfig VME_BUS
	tristate "VME bridge support"
	depends on PCI
	---help---
	  If you say Y here you get support for the VME bridge Framework.

if VME_BUS

source "drivers/staging/vme/bridges/Kconfig"

source "drivers/staging/vme/devices/Kconfig"

endif # VME
```

## drivers/staging/vme/bridges/Kconfig
```kconfig
comment "VME Bridge Drivers"

config VME_CA91CX42
	tristate "Universe II"
	help
	 If you say Y here you get support for the Tundra CA91C142
	 (Universe II) VME bridge chip.

config VME_TSI148
	tristate "Tempe"
	help
	 If you say Y here you get support for the Tundra TSI148 VME bridge
	 chip.
```

## drivers/staging/vme/devices/Kconfig
```kconfig
comment "VME Device Drivers"

config VME_USER
	tristate "VME user space access driver"
	help
	  If you say Y here you want to be able to access a limited number of
	  VME windows in a manner at least semi-compatible with the interface
	  provided with the original driver at http://vmelinux.org/.

config VME_PIO2
	tristate "GE PIO2 VME"
	depends on GPIOLIB
	help
	  Say Y here to include support for the GE PIO2. The PIO2 is a 6U VME
	  slave card, implementing 32 solid-state relay switched IO lines, in
	  4 groups of 8. Each bank of IO lines is built to function as input,
	  output or both depending on the variant of the card.

	  To compile this driver as a module, choose M here. The module will
	  be called vme_pio2. If unsure, say N.
```

## drivers/staging/vme_user/Kconfig
```kconfig
# SPDX-License-Identifier: GPL-2.0
menuconfig VME_BUS
	bool "VME bridge support"
	depends on PCI
	help
	  Enable support for VME (VersaModular Eurocard bus) bridge modules.
	  The bridge allows connecting VME devices to systems with existing
	  interfaces (like USB or PCI) by means of translating VME protocol
	  operations.

	  Note that this only enables the bridge framework. You'll also
	  likely want to enable driver for specific bridge device you have
	  to actually use it. If unsure, say N.

if VME_BUS

comment "VME Bridge Drivers"

config VME_TSI148
	tristate "Tundra TSI148 VME bridge support"
	depends on HAS_DMA
	help
	 If you say Y here you get support for the Tundra TSI148 VME-to-PCI/X
	 bridge chip (and pin-compatible clones).

	 TSI148 is a high-performant, 2eSST and VME64-compliant VME-to-PCI/X
	 interconnect bridge with support for PCI and PCI-X bus interface.
	 It is primarily used in industrial and embedded systems.

	 To compile this driver as a module, say M - the module will be
	 called vme_tsi148. If unsure, say N.

config VME_FAKE
	tristate "Fake"
	help
	 If you say Y here you get support for the fake VME bridge. This
	 provides a virtualised VME Bus for devices with no VME bridge. This
	 is mainly useful for VME development (in the absence of VME
	 hardware).

comment "VME Device Drivers"

config VME_USER
	tristate "VME user space access driver"
	help
	  If you say Y here you want to be able to access a limited number of
	  VME windows in a manner at least semi-compatible with the interface
	  provided with the original driver at <http://www.vmelinux.org/>.

	  To compile this driver as a module, choose M here. The module will
	  be called vme_user. If unsure, say N.

endif
```

## drivers/staging/vt6655/Kconfig
```kconfig
# SPDX-License-Identifier: GPL-2.0
config VT6655
   tristate "VIA Technologies VT6655 support"
   depends on PCI && HAS_IOPORT && MAC80211 && m
   help
     This is a vendor-written driver for VIA VT6655.
```

## drivers/staging/vt6656/Kconfig
```kconfig
# SPDX-License-Identifier: GPL-2.0
config VT6656
	tristate "VIA Technologies VT6656 support"
	depends on MAC80211 && USB && WLAN && m
	select FW_LOADER
	help
	  This is a vendor-written driver for VIA VT6656.
```

## drivers/staging/wavelan/Kconfig
```kconfig
config WAVELAN
	tristate "AT&T/Lucent old WaveLAN & DEC RoamAbout DS ISA support"
	depends on ISA
	select WIRELESS_EXT
	select WEXT_SPY
	select WEXT_PRIV
	---help---
	  The Lucent WaveLAN (formerly NCR and AT&T; or DEC RoamAbout DS) is
	  a Radio LAN (wireless Ethernet-like Local Area Network) using the
	  radio frequencies 900 MHz and 2.4 GHz.

	  If you want to use an ISA WaveLAN card under Linux, say Y and read
	  the Ethernet-HOWTO, available from
	  <http://www.tldp.org/docs.html#howto>. Some more specific
	  information is contained in
	  <file:Documentation/networking/wavelan.txt> and in the source code
	  <file:drivers/net/wireless/wavelan.p.h>.

	  You will also need the wireless tools package available from
	  <http://www.hpl.hp.com/personal/Jean_Tourrilhes/Linux/Tools.html>.
	  Please read the man pages contained therein.

	  To compile this driver as a module, choose M here: the module will be
	  called wavelan.

config PCMCIA_WAVELAN
	tristate "AT&T/Lucent old WaveLAN Pcmcia wireless support"
	depends on PCMCIA
	select WIRELESS_EXT
	select WEXT_SPY
	select WEXT_PRIV
	help
	  Say Y here if you intend to attach an AT&T/Lucent Wavelan PCMCIA
	  (PC-card) wireless Ethernet networking card to your computer.  This
	  driver is for the non-IEEE-802.11 Wavelan cards.

	  To compile this driver as a module, choose M here: the module will be
	  called wavelan_cs.  If unsure, say N.
```

## drivers/staging/westbridge/Kconfig
```kconfig
#
# West Bridge configuration
#

menuconfig WESTBRIDGE
	tristate "West Bridge support"
	depends on WESTBRIDGE_HAL_SELECTED
	help
	  This selects West Bridge Peripheral controller support.

	  If you want West Bridge support, you should say Y here.

menuconfig WESTBRIDGE_ASTORIA
	bool "West Bridge Astoria support"
	depends on WESTBRIDGE != n && WESTBRIDGE_HAL_SELECTED
	help
		This option enables support for West Bridge Astoria

if WESTBRIDGE_ASTORIA
source "drivers/staging/westbridge/astoria/Kconfig"
endif #WESTBRIDGE_ASTORIA

config	WESTBRIDGE_HAL_SELECTED
	boolean

choice
	prompt "West Bridge HAL"
	help
	   West Bridge HAL/processor interface to be used

#
# HAL Layers
#

config MACH_OMAP3_WESTBRIDGE_AST_PNAND_HAL
	bool "WESTBRIDGE OMAP3430 Astoria PNAND HAL"
	depends on ARCH_OMAP3
	select WESTBRIDGE_HAL_SELECTED
	help
	   Include the OMAP3430 HAL for PNAND interface

config MACH_NO_WESTBRIDGE
	bool "no West Bridge HAL selected"
	help
	   Do not include any HAL layer(de-activates West Bridge option)
endchoice

config WESTBRIDGE_DEBUG
	bool "West Bridge debugging"
	depends on WESTBRIDGE != n
	help
	  This is an option for use by developers; most people should
	  say N here.  This enables WESTBRIDGE core and driver debugging.
```

## drivers/staging/westbridge/astoria/Kconfig
```kconfig
#
# West Bridge configuration
#
source "drivers/staging/westbridge/astoria/device/Kconfig"

source "drivers/staging/westbridge/astoria/block/Kconfig"

source "drivers/staging/westbridge/astoria/gadget/Kconfig"
```

## drivers/staging/westbridge/astoria/block/Kconfig
```kconfig
#
# West Bridge block driver configuration
#

config WESTBRIDGE_BLOCK_DRIVER
	tristate "West Bridge Block Driver"
	help
		Include the West Bridge based block driver
```

## drivers/staging/westbridge/astoria/device/Kconfig
```kconfig
#
# West Bridge block driver configuration
#

config WESTBRIDGE_DEVICE_DRIVER
	tristate "West Bridge Device Driver"
	help
		Include the West Bridge based device driver
```

## drivers/staging/westbridge/astoria/gadget/Kconfig
```kconfig
#
# West Bridge gadget driver configuration
#

config WESTBRIDGE_GADGET_DRIVER
	tristate "West Bridge Gadget Driver"
	help
		Include the West Bridge based gadget peripheral controller driver
```

## drivers/staging/wfx/Documentation/devicetree/bindings/net/wireless/silabs,wfx.yaml
```yaml
# SPDX-License-Identifier: (GPL-2.0-only OR BSD-2-Clause)
# Copyright (c) 2020, Silicon Laboratories, Inc.
%YAML 1.2
---

$id: http://devicetree.org/schemas/net/wireless/silabs,wfx.yaml#
$schema: http://devicetree.org/meta-schemas/core.yaml#

title: Silicon Labs WFxxx devicetree bindings

maintainers:
  - Jérôme Pouiller <jerome.pouiller@silabs.com>

description:
  The WFxxx chip series can be connected via SPI or via SDIO.

  For SDIO':'

    The driver is able to detect a WFxxx chip on SDIO bus by matching its Vendor
    ID and Product ID. However, driver will only provide limited features in
    this case. Thus declaring WFxxx chip in device tree is recommended (and may
    become mandatory in the future).

    In addition, it is recommended to declare a mmc-pwrseq on SDIO host above
    WFx. Without it, you may encounter issues with warm boot. The mmc-pwrseq
    should be compatible with mmc-pwrseq-simple. Please consult
    Documentation/devicetree/bindings/mmc/mmc-pwrseq-simple.txt for more
    information.

  For SPI':'

    In add of the properties below, please consult
    Documentation/devicetree/bindings/spi/spi-controller.yaml for optional SPI
    related properties.

  Note that in add of the properties below, the WFx driver also supports
  `mac-address` and `local-mac-address` as described in
  Documentation/devicetree/bindings/net/ethernet.txt

properties:
  compatible:
    const: silabs,wf200
  reg:
    description:
      When used on SDIO bus, <reg> must be set to 1. When used on SPI bus, it is
      the chip select address of the device as defined in the SPI devices
      bindings.
    maxItems: 1
  spi-max-frequency:
    description: (SPI only) Maximum SPI clocking speed of device in Hz.
    maxItems: 1
  interrupts:
    description: The interrupt line. Triggers IRQ_TYPE_LEVEL_HIGH and
      IRQ_TYPE_EDGE_RISING are both supported by the chip and the driver. When
      SPI is used, this property is required. When SDIO is used, the "in-band"
      interrupt provided by the SDIO bus is used unless an interrupt is defined
      in the Device Tree.
    maxItems: 1
  reset-gpios:
    description: (SPI only) Phandle of gpio that will be used to reset chip
      during probe. Without this property, you may encounter issues with warm
      boot. (For legacy purpose, the gpio in inverted when compatible ==
      "silabs,wfx-spi")

      For SDIO, the reset gpio should declared using a mmc-pwrseq.
    maxItems: 1
  wakeup-gpios:
    description: Phandle of gpio that will be used to wake-up chip. Without this
      property, driver will disable most of power saving features.
    maxItems: 1
  config-file:
    description: Use an alternative file as PDS. Default is `wf200.pds`. Only
      necessary for development/debug purpose.
    maxItems: 1

required:
  - compatible
  - reg

examples:
  - |
    #include <dt-bindings/gpio/gpio.h>
    #include <dt-bindings/interrupt-controller/irq.h>

    spi0 {
        #address-cells = <1>;
        #size-cells = <0>;

        wfx@0 {
            compatible = "silabs,wf200";
            pinctrl-names = "default";
            pinctrl-0 = <&wfx_irq &wfx_gpios>;
            reg = <0>;
            interrupts-extended = <&gpio 16 IRQ_TYPE_EDGE_RISING>;
            wakeup-gpios = <&gpio 12 GPIO_ACTIVE_HIGH>;
            reset-gpios = <&gpio 13 GPIO_ACTIVE_LOW>;
            spi-max-frequency = <42000000>;
        };
    };

  - |
    #include <dt-bindings/gpio/gpio.h>
    #include <dt-bindings/interrupt-controller/irq.h>

    wfx_pwrseq: wfx_pwrseq {
        compatible = "mmc-pwrseq-simple";
        pinctrl-names = "default";
        pinctrl-0 = <&wfx_reset>;
        reset-gpios = <&gpio 13 GPIO_ACTIVE_LOW>;
    };

    mmc0 {
        mmc-pwrseq = <&wfx_pwrseq>;
        #address-cells = <1>;
        #size-cells = <0>;

        mmc@1 {
            compatible = "silabs,wf200";
            pinctrl-names = "default";
            pinctrl-0 = <&wfx_wakeup>;
            reg = <1>;
            wakeup-gpios = <&gpio 12 GPIO_ACTIVE_HIGH>;
        };
    };
...
```
