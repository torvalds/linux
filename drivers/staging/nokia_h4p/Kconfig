## drivers/staging/panel/Kconfig
```kconfig
config PANEL
	tristate "Parallel port LCD/Keypad Panel support"
	depends on PARPORT
	---help---
	  Say Y here if you have an HD44780 or KS-0074 LCD connected to your
	  parallel port. This driver also features 4 and 6-key keypads. The LCD
	  is accessible through the /dev/lcd char device (10, 156), and the
	  keypad through /dev/keypad (10, 185). Both require misc device to be
	  enabled. This code can either be compiled as a module, or linked into
	  the kernel and started at boot. If you don't understand what all this
	  is about, say N.

config PANEL_PARPORT
	int "Default parallel port number (0=LPT1)"
	depends on PANEL
	range 0 255
	default "0"
	---help---
	  This is the index of the parallel port the panel is connected to. One
	  driver instance only supports one parallel port, so if your keypad
	  and LCD are connected to two separate ports, you have to start two
	  modules with different arguments. Numbering starts with '0' for LPT1,
	  and so on.

config PANEL_PROFILE
	int "Default panel profile (0-5, 0=custom)"
	depends on PANEL
	range 0 5
	default "5"
	---help---
	  To ease configuration, the driver supports different configuration
	  profiles for past and recent wirings. These profiles can also be
	  used to define an approximative configuration, completed by a few
	  other options. Here are the profiles :

	    0 = custom (see further)
	    1 = 2x16 parallel LCD, old keypad
	    2 = 2x16 serial LCD (KS-0074), new keypad
	    3 = 2x16 parallel LCD (Hantronix), no keypad
	    4 = 2x16 parallel LCD (Nexcom NSA1045) with Nexcom's keypad
	    5 = 2x40 parallel LCD (old one), with old keypad

	  Custom configurations allow you to define how your display is
	  wired to the parallel port, and how it works. This is only intended
	  for experts.

config PANEL_KEYPAD
	depends on PANEL && PANEL_PROFILE="0"
	int "Keypad type (0=none, 1=old 6 keys, 2=new 6 keys, 3=Nexcom 4 keys)"
	range 0 3
	default 0
	---help---
	  This enables and configures a keypad connected to the parallel port.
	  The keys will be read from character device 10,185. Valid values are :

	    0 : do not enable this driver
	    1 : old 6 keys keypad
	    2 : new 6 keys keypad, as used on the server at www.ant-computing.com
	    3 : Nexcom NSA1045's 4 keys keypad

	  New profiles can be described in the driver source. The driver also
	  supports simultaneous keys pressed when the keypad supports them.

config PANEL_LCD
	depends on PANEL && PANEL_PROFILE="0"
	int "LCD type (0=none, 1=custom, 2=old //, 3=ks0074, 4=hantronix, 5=Nexcom)"
	range 0 5
	default 0
	---help---
	   This enables and configures an LCD connected to the parallel port.
	   The driver includes an interpreter for escape codes starting with
	   '\e[L' which are specific to the LCD, and a few ANSI codes. The
	   driver will be registered as character device 10,156, usually
	   under the name '/dev/lcd'. There are a total of 6 supported types :

	     0 : do not enable the driver
	     1 : custom configuration and wiring (see further)
	     2 : 2x16 & 2x40 parallel LCD (old wiring)
	     3 : 2x16 serial LCD (KS-0074 based)
	     4 : 2x16 parallel LCD (Hantronix wiring)
	     5 : 2x16 parallel LCD (Nexcom wiring)

	   When type '1' is specified, other options will appear to configure
	   more precise aspects (wiring, dimensions, protocol, ...). Please note
	   that those values changed from the 2.4 driver for better consistency.

config PANEL_LCD_HEIGHT
	depends on PANEL && PANEL_PROFILE="0" && PANEL_LCD="1"
	int "Number of lines on the LCD (1-2)"
	range 1 2
	default 2
	---help---
	  This is the number of visible character lines on the LCD in custom profile.
	  It can either be 1 or 2.

config PANEL_LCD_WIDTH
	depends on PANEL && PANEL_PROFILE="0" && PANEL_LCD="1"
	int "Number of characters per line on the LCD (1-40)"
	range 1 40
	default 40
	---help---
	  This is the number of characters per line on the LCD in custom profile.
	  Common values are 16,20,24,40.

config PANEL_LCD_BWIDTH
	depends on PANEL && PANEL_PROFILE="0" && PANEL_LCD="1"
	int "Internal LCD line width (1-40, 40 by default)"
	range 1 40
	default 40
	---help---
	  Most LCDs use a standard controller which supports hardware lines of 40
	  characters, although sometimes only 16, 20 or 24 of them are really wired
	  to the terminal. This results in some non-visible but addressable characters,
	  and is the case for most parallel LCDs. Other LCDs, and some serial ones,
	  however, use the same line width internally as what is visible. The KS0074
	  for example, uses 16 characters per line for 16 visible characters per line.

	  This option lets you configure the value used by your LCD in 'custom' profile.
	  If you don't know, put '40' here.

config PANEL_LCD_HWIDTH
	depends on PANEL && PANEL_PROFILE="0" && PANEL_LCD="1"
	int "Hardware LCD line width (1-64, 64 by default)"
	range 1 64
	default 64
	---help---
	  Most LCDs use a single address bit to differentiate line 0 and line 1. Since
	  some of them need to be able to address 40 chars with the lower bits, they
	  often use the immediately superior power of 2, which is 64, to address the
	  next line.

	  If you don't know what your LCD uses, in doubt let 16 here for a 2x16, and
	  64 here for a 2x40.

config PANEL_LCD_CHARSET
	depends on PANEL && PANEL_PROFILE="0" && PANEL_LCD="1"
	int "LCD character set (0=normal, 1=KS0074)"
	range 0 1
	default 0
	---help---
	  Some controllers such as the KS0074 use a somewhat strange character set
	  where many symbols are at unusual places. The driver knows how to map
	  'standard' ASCII characters to the character sets used by these controllers.
	  Valid values are :

	     0 : normal (untranslated) character set
	     1 : KS0074 character set

	  If you don't know, use the normal one (0).

config PANEL_LCD_PROTO
	depends on PANEL && PANEL_PROFILE="0" && PANEL_LCD="1"
	int "LCD communication mode (0=parallel 8 bits, 1=serial)"
	range 0 1
	default 0
	---help---
	  This driver now supports any serial or parallel LCD wired to a parallel
	  port. But before assigning signals, the driver needs to know if it will
	  be driving a serial LCD or a parallel one. Serial LCDs only use 2 wires
	  (SDA/SCL), while parallel ones use 2 or 3 wires for the control signals
	  (E, RS, sometimes RW), and 4 or 8 for the data. Use 0 here for a 8 bits
	  parallel LCD, and 1 for a serial LCD.

config PANEL_LCD_PIN_E
	depends on PANEL && PANEL_PROFILE="0" && PANEL_LCD="1" && PANEL_LCD_PROTO="0"
        int "Parallel port pin number & polarity connected to the LCD E signal (-17...17) "
	range -17 17
	default 14
	---help---
	  This describes the number of the parallel port pin to which the LCD 'E'
	  signal has been connected. It can be :

	          0 : no connection (eg: connected to ground)
	      1..17 : directly connected to any of these pins on the DB25 plug
	    -1..-17 : connected to the same pin through an inverter (eg: transistor).

	  Default for the 'E' pin in custom profile is '14' (AUTOFEED).

config PANEL_LCD_PIN_RS
	depends on PANEL && PANEL_PROFILE="0" && PANEL_LCD="1" && PANEL_LCD_PROTO="0"
        int "Parallel port pin number & polarity connected to the LCD RS signal (-17...17) "
	range -17 17
	default 17
	---help---
	  This describes the number of the parallel port pin to which the LCD 'RS'
	  signal has been connected. It can be :

	          0 : no connection (eg: connected to ground)
	      1..17 : directly connected to any of these pins on the DB25 plug
	    -1..-17 : connected to the same pin through an inverter (eg: transistor).

	  Default for the 'RS' pin in custom profile is '17' (SELECT IN).

config PANEL_LCD_PIN_RW
	depends on PANEL && PANEL_PROFILE="0" && PANEL_LCD="1" && PANEL_LCD_PROTO="0"
        int "Parallel port pin number & polarity connected to the LCD RW signal (-17...17) "
	range -17 17
	default 16
	---help---
	  This describes the number of the parallel port pin to which the LCD 'RW'
	  signal has been connected. It can be :

	          0 : no connection (eg: connected to ground)
	      1..17 : directly connected to any of these pins on the DB25 plug
	    -1..-17 : connected to the same pin through an inverter (eg: transistor).

	  Default for the 'RW' pin in custom profile is '16' (INIT).

config PANEL_LCD_PIN_SCL
	depends on PANEL && PANEL_PROFILE="0" && PANEL_LCD="1" && PANEL_LCD_PROTO!="0"
        int "Parallel port pin number & polarity connected to the LCD SCL signal (-17...17) "
	range -17 17
	default 1
	---help---
	  This describes the number of the parallel port pin to which the serial
	  LCD 'SCL' signal has been connected. It can be :

	          0 : no connection (eg: connected to ground)
	      1..17 : directly connected to any of these pins on the DB25 plug
	    -1..-17 : connected to the same pin through an inverter (eg: transistor).

	  Default for the 'SCL' pin in custom profile is '1' (STROBE).

config PANEL_LCD_PIN_SDA
	depends on PANEL && PANEL_PROFILE="0" && PANEL_LCD="1" && PANEL_LCD_PROTO!="0"
        int "Parallel port pin number & polarity connected to the LCD SDA signal (-17...17) "
	range -17 17
	default 2
	---help---
	  This describes the number of the parallel port pin to which the serial
	  LCD 'SDA' signal has been connected. It can be :

	          0 : no connection (eg: connected to ground)
	      1..17 : directly connected to any of these pins on the DB25 plug
	    -1..-17 : connected to the same pin through an inverter (eg: transistor).

	  Default for the 'SDA' pin in custom profile is '2' (D0).

config PANEL_LCD_PIN_BL
	depends on PANEL && PANEL_PROFILE="0" && PANEL_LCD="1"
        int "Parallel port pin number & polarity connected to the LCD backlight signal (-17...17) "
	range -17 17
	default 0
	---help---
	  This describes the number of the parallel port pin to which the LCD 'BL' signal
          has been connected. It can be :

	          0 : no connection (eg: connected to ground)
	      1..17 : directly connected to any of these pins on the DB25 plug
	    -1..-17 : connected to the same pin through an inverter (eg: transistor).

	  Default for the 'BL' pin in custom profile is '0' (uncontrolled).

config PANEL_CHANGE_MESSAGE
	depends on PANEL
	bool "Change LCD initialization message ?"
	default "n"
	---help---
	  This allows you to replace the boot message indicating the kernel version
	  and the driver version with a custom message. This is useful on appliances
	  where a simple 'Starting system' message can be enough to stop a customer
	  from worrying.

	  If you say 'Y' here, you'll be able to choose a message yourself. Otherwise,
	  say 'N' and keep the default message with the version.

config PANEL_BOOT_MESSAGE
	depends on PANEL && PANEL_CHANGE_MESSAGE="y"
	string "New initialization message"
	default ""
	---help---
	  This allows you to replace the boot message indicating the kernel version
	  and the driver version with a custom message. This is useful on appliances
	  where a simple 'Starting system' message can be enough to stop a customer
	  from worrying.

	  An empty message will only clear the display at driver init time. Any other
	  printf()-formatted message is valid with newline and escape codes.
```

## drivers/staging/pata_rdc/Kconfig
```kconfig
config RDC_17F3101X
	tristate "RDC_17F3101X IDE support"
	depends on PCI && ATA && ATA_SFF
	---help---
	  This is an experimental driver for RDC_17F31011 and
	  RDC_17F31012 IDE driver.
```

## drivers/staging/pcc-acpi/Kconfig
```kconfig
config PCC_ACPI
	tristate "Panasonic ACPI Hotkey support"
	depends on ACPI
	default n
	---help---
	  This driver provides support for Panasonic hotkeys through the
	  ACPI interface.  This works for the Panasonic R1 (N variant),
	  R2, R3, T2, W2, and Y2 laptops.

	  To compile this driver as a module, choose M here. The module
	  will be called pcc-acpi.
```

## drivers/staging/phison/Kconfig
```kconfig
config IDE_PHISON
	tristate "PCIE ATA PS5000 IDE support"
	depends on PCI && ATA && ATA_SFF
	---help---
	  This is an experimental driver for PS5000 IDE driver.
```

## drivers/staging/pi433/Kconfig
```kconfig
# SPDX-License-Identifier: GPL-2.0
config PI433
	tristate "Pi433 - a 433MHz radio module for Raspberry Pi"
	depends on SPI
	help
	  This option allows you to enable support for the radio module Pi433.

	  Pi433 is a shield that fits onto the GPIO header of a Raspberry Pi
	  or compatible. It extends the Raspberry Pi with the option, to
	  send and receive data in the 433MHz ISM band - for example to
	  communicate between two systems without using ethernet or bluetooth
	  or for control or read sockets, actors, sensors, widely available
	  for low price.

	  For details or the option to buy, please visit https://pi433.de/en.html

	  If in doubt, say N here, but saying yes most probably won't hurt
```

## drivers/staging/poch/Kconfig
```kconfig
config POCH
	tristate "Redrapids Pocket Change CardBus support"
	depends on PCI && UIO
	default N
	---help---
	  Enable support for Redrapids Pocket Change CardBus devices.
```

## drivers/staging/pohmelfs/Kconfig
```kconfig
config POHMELFS
	tristate "POHMELFS filesystem support"
	depends on NET
	select CONNECTOR
	select CRYPTO
	select CRYPTO_BLKCIPHER
	select CRYPTO_HMAC
	help
	  POHMELFS stands for Parallel Optimized Host Message Exchange Layered
	  File System.  This is a network filesystem which supports coherent
	  caching of data and metadata on clients.

config POHMELFS_DEBUG
	bool "POHMELFS debugging"
	depends on POHMELFS
	default n
	help
	  Turns on excessive POHMELFS debugging facilities.
	  You usually do not want to slow things down noticeably and get really
	  lots of kernel messages in syslog.
```

## drivers/staging/qlge/Kconfig
```kconfig
# SPDX-License-Identifier: GPL-2.0

config QLGE
	tristate "QLogic QLGE 10Gb Ethernet Driver Support"
	depends on ETHERNET && PCI
	select NET_DEVLINK
	help
	This driver supports QLogic ISP8XXX 10Gb Ethernet cards.

	To compile this driver as a module, choose M here. The module will be
	called qlge.
```

## drivers/staging/quatech_usb2/Kconfig
```kconfig
config USB_SERIAL_QUATECH_USB2
	tristate "USB Quatech xSU2-[14]00 USB Serial Driver"
	depends on USB_SERIAL
	help
	  Say Y here if you want to use a Quatech USB2.0 to serial adaptor. This
	  driver supports the SSU2-100, DSU2-100, DSU2-400, QSU2-100, QSU2-400,
	  ESU2-400 and ESU2-100 USB2.0 to RS232 / 485 / 422 serial adaptors.

	  Some hardware has an incorrect product string and announces itself as
	  ESU-100 (which uses the serqt driver) even though it is an ESU2-100.
	  Check the label on the bottom of your device.

	  To compile this driver as a module, choose M here: the module will be
	  called quatech_usb2 .
```

## drivers/staging/quickstart/Kconfig
```kconfig
config ACPI_QUICKSTART
	tristate "ACPI Quickstart key driver"
	depends on ACPI && INPUT
	help
	  Say Y here if you have a platform that supports the ACPI
	  quickstart key protocol.

	  To compile this driver as a module, choose M here: the module will be
	  called quickstart.
```

## drivers/staging/r8188eu/Kconfig
```kconfig
# SPDX-License-Identifier: GPL-2.0
config R8188EU
	tristate "Realtek RTL8188EU Wireless LAN NIC driver"
	depends on WLAN && USB && CFG80211
	depends on m
	select WIRELESS_EXT
	select WEXT_PRIV
	select LIB80211
	select LIB80211_CRYPT_WEP
	select LIB80211_CRYPT_CCMP
	help
	This option adds support for the Realtek RTL8188EU chipset, used in USB
	devices such as the ASUS USB-N10 Nano. This newer driver is based on GitHub
	sources for version v4.1.4_6773.20130222, and contains modifications for
	newer kernel features. If built as a module, it will be called r8188eu.
```

## drivers/staging/ralink-gdma/Kconfig
```kconfig
# SPDX-License-Identifier: GPL-2.0
config DMA_RALINK
	tristate "RALINK DMA support"
	depends on RALINK && !SOC_RT288X
	depends on DMADEVICES
	select DMA_ENGINE
	select DMA_VIRTUAL_CHANNELS
```
