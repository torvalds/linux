## drivers/staging/ramster/Kconfig
```kconfig
config ZCACHE2
	bool "Dynamic compression of swap pages and clean pagecache pages"
	depends on CRYPTO=y && SWAP=y && CLEANCACHE && FRONTSWAP && !ZCACHE 
	select CRYPTO_LZO
	default n
	help
	  Zcache2 doubles RAM efficiency while providing a significant
	  performance boosts on many workloads.  Zcache2 uses
	  compression and an in-kernel implementation of transcendent
	  memory to store clean page cache pages and swap in RAM,
	  providing a noticeable reduction in disk I/O.  Zcache2
	  is a complete rewrite of the older zcache; it was intended to
	  be a merge but that has been blocked due to political and
	  technical disagreements.  It is intended that they will merge
	  again in the future.  Until then, zcache2 is a single-node
	  version of ramster.

config RAMSTER
	bool "Cross-machine RAM capacity sharing, aka peer-to-peer tmem"
	depends on CONFIGFS_FS=y && SYSFS=y && !HIGHMEM && ZCACHE2=y
	depends on NET
	# must ensure struct page is 8-byte aligned
	select HAVE_ALIGNED_STRUCT_PAGE if !64_BIT
	default n
	help
	  RAMster allows RAM on other machines in a cluster to be utilized
	  dynamically and symmetrically instead of swapping to a local swap
	  disk, thus improving performance on memory-constrained workloads
	  while minimizing total RAM across the cluster.  RAMster, like
	  zcache2, compresses swap pages into local RAM, but then remotifies
	  the compressed pages to another node in the RAMster cluster.
```

## drivers/staging/ramzswap/Kconfig
```kconfig
config RAMZSWAP
	tristate "Compressed in-memory swap device (ramzswap)"
	depends on SWAP
	select LZO_COMPRESS
	select LZO_DECOMPRESS
	default n
	help
	  Creates virtual block devices which can be used (only) as a swap
	  disks. Pages swapped to these disks are compressed and stored in
	  memory itself.

	  See ramzswap.txt for more information.
	  Project home: http://compcache.googlecode.com/

config RAMZSWAP_STATS
	bool "Enable ramzswap stats"
	depends on RAMZSWAP
	default y
	help
	  Enable statistics collection for ramzswap. This adds only a minimal
	  overhead. In unsure, say Y.
```

## drivers/staging/rar_register/Kconfig
```kconfig
#
# RAR device configuration
#

menu "RAR Register Driver"
#
#	Restricted Access Register Manager
#
config RAR_REGISTER
	tristate "Restricted Access Region Register Driver"
	depends on PCI
	default n
	---help---
	  This driver allows other kernel drivers access to the
	  contents of the restricted access region control registers.

	  The restricted access region control registers
	  (rar_registers) are used to pass address and
	  locking information on restricted access regions
	  to other drivers that use restricted access regions.

	  The restricted access regions are regions of memory
	  on the Intel MID Platform that are not accessible to
	  the x86 processor, but are accessible to dedicated
	  processors on board peripheral devices.

	  The purpose of the restricted access regions is to
	  protect sensitive data from compromise by unauthorized
	  programs running on the x86 processor.
endmenu
```
