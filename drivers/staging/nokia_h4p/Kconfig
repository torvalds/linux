## drivers/staging/nokia_h4p/Kconfig
```kconfig
config BT_NOKIA_H4P
	tristate "HCI driver with H4 Nokia extensions"
	depends on BT && ARCH_OMAP
	help
	  Bluetooth HCI driver with H4 extensions.  This driver provides
	  support for H4+ Bluetooth chip with vendor-specific H4 extensions.

	  Say Y here to compile support for h4 extended devices into the kernel
	  or say M to compile it as module (btnokia_h4p).
```

## drivers/staging/nvec/Kconfig
```kconfig
# SPDX-License-Identifier: GPL-2.0
config MFD_NVEC
	tristate "NV Tegra Embedded Controller SMBus Interface"
	depends on I2C && GPIOLIB && ARCH_TEGRA
	select MFD_CORE
	help
	    Say Y here to enable support for a nVidia compliant embedded
	    controller.

	    To compile this driver as a module, say M here: the module will be
	    called mfd-nvec

config KEYBOARD_NVEC
	tristate "Keyboard on nVidia compliant EC"
	depends on MFD_NVEC && INPUT
	help
	  Say Y here to enable support for a keyboard connected to
	  a nVidia compliant embedded controller.

	  To compile this driver as a module, say M here: the module will be
	  called keyboard-nvec

config SERIO_NVEC_PS2
	tristate "PS2 on nVidia EC"
	depends on MFD_NVEC && SERIO
	help
	  Say Y here to enable support for a Touchpad / Mouse connected
	  to a nVidia compliant embedded controller.

	  To compile this driver as a module, say M here: the module will be
	  called serio-nvec-ps2


config NVEC_POWER
	tristate "NVEC charger and battery"
	depends on MFD_NVEC && POWER_SUPPLY
	help
	  Say Y to enable support for battery and charger interface for
	  nVidia compliant embedded controllers.

	  To compile this driver as a module, say M here: the module will be
	  called nvec-power


config NVEC_PAZ00
	tristate "Support for OEM specific functions on Compal PAZ00 based devices"
	depends on MFD_NVEC && LEDS_CLASS
	help
	  Say Y to enable control of the yellow side leds on Compal PAZ00 based
	  devices, e.g. Toshbia AC100 and Dynabooks AZ netbooks.

	  To compile this driver as a module, say M here: the module will be
	  called nvec-paz00
```

## drivers/staging/octeon-usb/Kconfig
```kconfig
config OCTEON_USB
	tristate "Cavium Networks Octeon USB support"
	depends on CAVIUM_OCTEON_SOC && USB
	help
	  This driver supports USB host controller on some Cavium
	  Networks' products in the Octeon family.

	  To compile this driver as a module, choose M here. The module
	  will be called octeon-usb.
```

## drivers/staging/octeon/Kconfig
```kconfig
# SPDX-License-Identifier: GPL-2.0
config OCTEON_ETHERNET
	tristate "Cavium Networks Octeon Ethernet support"
	depends on CAVIUM_OCTEON_SOC && NETDEVICES || COMPILE_TEST
	select PHYLIB
	select MDIO_OCTEON
	help
	  This driver supports the builtin ethernet ports on Cavium
	  Networks' products in the Octeon family. This driver supports the
	  CN3XXX and CN5XXX Octeon processors.

	  To compile this driver as a module, choose M here.  The module
	  will be called octeon-ethernet.
```

## drivers/staging/olpc_dcon/Kconfig
```kconfig
# SPDX-License-Identifier: GPL-2.0
config FB_OLPC_DCON
	tristate "One Laptop Per Child Display CONtroller support"
	depends on OLPC && FB
	depends on I2C
	depends on GPIO_CS5535 && ACPI
	select BACKLIGHT_CLASS_DEVICE
	help
	  In order to support very low power operation, the XO laptop uses a
	  secondary Display CONtroller, or DCON.  This secondary controller
	  is present in the video pipeline between the primary display
	  controller (integrate into the processor or chipset) and the LCD
	  panel.  It allows the main processor/display controller to be
	  completely powered off while still retaining an image on the display.
	  This controller is only available on OLPC platforms.  Unless you have
	  one of these platforms, you will want to say 'N'.
```

## drivers/staging/omap-thermal/Kconfig
```kconfig
config OMAP_BANDGAP
	tristate "Texas Instruments OMAP4+ temperature sensor driver"
	depends on THERMAL
	depends on ARCH_OMAP4 || SOC_OMAP5
	help
	  If you say yes here you get support for the Texas Instruments
	  OMAP4460+ on die bandgap temperature sensor support. The register
	  set is part of system control module.

	  This includes alert interrupts generation and also the TSHUT
	  support.

config OMAP_THERMAL
	bool "Texas Instruments OMAP4+ thermal framework support"
	depends on OMAP_BANDGAP
	depends on CPU_THERMAL
	help
	  If you say yes here you want to get support for generic thermal
	  framework for the Texas Instruments OMAP4460+ on die bandgap
	  temperature sensor.

config OMAP4_THERMAL
	bool "Texas Instruments OMAP4 thermal support"
	depends on OMAP_BANDGAP
	depends on ARCH_OMAP4
	help
	  If you say yes here you get thermal support for the Texas Instruments
	  OMAP4 SoC family. The current chip supported are:
	   - OMAP4430
	   - OMAP4460
	   - OMAP4470

	  This includes alert interrupts generation and also the TSHUT
	  support.

config OMAP5_THERMAL
	bool "Texas Instruments OMAP5 thermal support"
	depends on OMAP_BANDGAP
	depends on SOC_OMAP5
	help
	  If you say yes here you get thermal support for the Texas Instruments
	  OMAP5 SoC family. The current chip supported are:
	   - OMAP5430

	  This includes alert interrupts generation and also the TSHUT
	  support.
```

## drivers/staging/omapdrm/Kconfig
```kconfig
config DRM_OMAP
	tristate "OMAP DRM"
	depends on DRM && !CONFIG_FB_OMAP2
	depends on ARCH_OMAP2PLUS || ARCH_MULTIPLATFORM
	select DRM_KMS_HELPER
	select OMAP2_DSS
	select FB_SYS_FILLRECT
	select FB_SYS_COPYAREA
	select FB_SYS_IMAGEBLIT
	select FB_SYS_FOPS
	default n
	help
	  DRM display driver for OMAP2/3/4 based boards.

config DRM_OMAP_NUM_CRTCS
	int "Number of CRTCs"
	range 1 10
	default 1  if ARCH_OMAP2 || ARCH_OMAP3
	default 2  if ARCH_OMAP4
	depends on DRM_OMAP
	help
	  Select the number of video overlays which can be used as framebuffers.
	  The remaining overlays are reserved for video.
```

## drivers/staging/otus/Kconfig
```kconfig
config OTUS
	tristate "Atheros OTUS 802.11n USB wireless support"
	depends on USB && WLAN && MAC80211
	default N
	---help---
	  Enable support for Atheros 802.11n USB hardware:
	    * UB81 - 2x2 2.4 GHz
	    * UB82 - 2x2 2.4 GHz and 5 GHz
	    * UB83 - 1x2 2.4 GHz

	  This includes the following devices currently on the market:
	  Dlink DWA-160A1, Netgear WNDA3100 and WN111v2, TP-Link
	  TL-WN821N, and AVM FRITZ!WLAN N USB Stick.

	  This driver requires its own supplicant driver for
	  wpa_supplicant 0.4.8. For your convenience you can find the
	  tarball here:

	  http://www.kernel.org/pub/linux/kernel/people/mcgrof/otus/wpa_supplicant-0.4.8_otus.tar.bz2

	  Before compiling wpa_supplicant, ensure your .config has at
	  least the following:
		CONFIG_WIRELESS_EXTENSION=y
		CONFIG_EAP_WSC=y
		CONFIG_WSC_IE=y
		CONFIG_DRIVER_WEXT=y
		CONFIG_DRIVER_OTUS=y

	  After a successful compile, you can use the Atheros device as
	  shown in the example:
	  $ wpa_supplicant -Dotus -i <atheros device from ifconfig> -c /path/to/wpa_supplicant.conf -d
```

## drivers/staging/ozwpan/Kconfig
```kconfig
config USB_WPAN_HCD
	tristate "USB over WiFi Host Controller"
	depends on USB && NET
	help
	  A driver for USB Host Controllers that are compatible with
	  Ozmo Devices USB over WiFi technology.

	  To compile this driver a module, choose M here: the module
	  will be called "ozwpan".
```

## drivers/staging/p9auth/Kconfig
```kconfig
config PLAN9AUTH
	tristate "Plan 9 style capability device implementation"
	default n
	depends on CRYPTO
	help
	  This module implements the Plan 9 style capability device.

	  To compile this driver as a module, choose
	  M here: the module will be called p9auth.
```
