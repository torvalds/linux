## drivers/staging/ti-soc-thermal/Kconfig
```kconfig
config TI_SOC_THERMAL
	tristate "Texas Instruments SoCs temperature sensor driver"
	depends on THERMAL
	depends on ARCH_HAS_BANDGAP
	help
	  If you say yes here you get support for the Texas Instruments
	  OMAP4460+ on die bandgap temperature sensor support. The register
	  set is part of system control module.

	  This includes alert interrupts generation and also the TSHUT
	  support.

config TI_THERMAL
	bool "Texas Instruments SoCs thermal framework support"
	depends on TI_SOC_THERMAL
	depends on CPU_THERMAL
	help
	  If you say yes here you want to get support for generic thermal
	  framework for the Texas Instruments on die bandgap temperature sensor.

	  This includes trip points definitions, extrapolation rules and
	  CPU cooling device bindings.

config OMAP4_THERMAL
	bool "Texas Instruments OMAP4 thermal support"
	depends on TI_SOC_THERMAL
	depends on ARCH_OMAP4
	help
	  If you say yes here you get thermal support for the Texas Instruments
	  OMAP4 SoC family. The current chip supported are:
	   - OMAP4430
	   - OMAP4460
	   - OMAP4470

	  This includes alert interrupts generation and also the TSHUT
	  support.

config OMAP5_THERMAL
	bool "Texas Instruments OMAP5 thermal support"
	depends on TI_SOC_THERMAL
	depends on SOC_OMAP5
	help
	  If you say yes here you get thermal support for the Texas Instruments
	  OMAP5 SoC family. The current chip supported are:
	   - OMAP5430

	  This includes alert interrupts generation and also the TSHUT
	  support.
```

## drivers/staging/ti-st/Kconfig
```kconfig
#
# TI's shared transport line discipline and the protocol
# drivers (BT, FM and GPS)
#
menu "Texas Instruments shared transport line discipline"
config ST_BT
	tristate "BlueZ bluetooth driver for ST"
	depends on BT && RFKILL
	select TI_ST
	help
	  This enables the Bluetooth driver for TI BT/FM/GPS combo devices.
	  This makes use of shared transport line discipline core driver to
	  communicate with the BT core of the combo chip.
endmenu
```

## drivers/staging/tidspbridge/Kconfig
```kconfig
#
# DSP Bridge Driver Support
#

menuconfig TIDSPBRIDGE
	tristate "DSP Bridge driver"
	depends on ARCH_OMAP3 && !ARCH_MULTIPLATFORM && BROKEN
	select MAILBOX
	select OMAP2PLUS_MBOX
	help
	  DSP/BIOS Bridge is designed for platforms that contain a GPP and
	  one or more attached DSPs.  The GPP is considered the master or
	  "host" processor, and the attached DSPs are processing resources
	  that can be utilized by applications and drivers running on the GPP.

	  This driver depends on OMAP Mailbox (OMAP_MBOX_FWK).

config TIDSPBRIDGE_DVFS
	bool "Enable Bridge Dynamic Voltage and Frequency Scaling (DVFS)"
	depends on TIDSPBRIDGE && OMAP_PM_SRF && CPU_FREQ
	help
	  DVFS allows DSP Bridge to initiate the operating point change to
	  scale the chip voltage and frequency in order to match the
	  performance and power consumption to the current processing
	  requirements.

config TIDSPBRIDGE_MEMPOOL_SIZE
	hex "Physical memory pool size (Byte)"
	depends on TIDSPBRIDGE
	default 0x600000
	help
	  Allocate specified size of memory at booting time to avoid allocation
	  failure under heavy memory fragmentation after some use time.

config TIDSPBRIDGE_RECOVERY
	bool "Recovery Support"
	depends on TIDSPBRIDGE
	default y
	help
	  In case of DSP fatal error, BRIDGE driver will try to
	  recover itself.

config TIDSPBRIDGE_CACHE_LINE_CHECK
	bool "Check buffers to be 128 byte aligned"
	depends on TIDSPBRIDGE
	help
	  When the DSP processes data, the DSP cache controller loads 128-Byte
	  chunks (lines) from SDRAM and writes the data back in 128-Byte chunks.
	  If a DMM buffer does not start and end on a 128-Byte boundary, the data
	  preceding the start address (SA) from the 128-Byte boundary to the SA
	  and the data at addresses trailing the end address (EA) from the EA to
	  the next 128-Byte boundary will be loaded and written back as well.
	  This can lead to heap corruption. Say Y, to enforce the check for 128
	  byte alignment, buffers failing this check will be rejected.

config TIDSPBRIDGE_NTFY_PWRERR
	bool "Notify power errors"
	depends on TIDSPBRIDGE
	help
	  Enable notifications to registered clients on the event of power error
	  trying to suspend bridge driver. Say Y, to signal this event as a fatal
	  error, this will require a bridge restart to recover.

config TIDSPBRIDGE_BACKTRACE
	bool "Dump backtraces on fatal errors"
	depends on TIDSPBRIDGE
	help
	  Enable useful information to backtrace fatal errors. Say Y if you
	  want to dump information for testing purposes.
```

## drivers/staging/tm6000/Kconfig
```kconfig
config VIDEO_TM6000
	tristate "TV Master TM5600/6000/6010 driver"
	depends on VIDEO_DEV && I2C && INPUT && USB && EXPERIMENTAL
	select VIDEO_TUNER
	select MEDIA_TUNER_XC2028
	select MEDIA_TUNER_XC5000
	select VIDEOBUF_VMALLOC
	help
	  Support for TM5600/TM6000/TM6010 USB Device

	  Since these cards have no MPEG decoder onboard, they transmit
	  only compressed MPEG data over the usb bus, so you need
	  an external software decoder to watch TV on your computer.

	  Say Y if you own such a device and want to use it.

config VIDEO_TM6000_ALSA
	tristate "TV Master TM5600/6000/6010 audio support"
	depends on VIDEO_TM6000 && SND && EXPERIMENTAL
	select SND_PCM
	---help---
	  This is a video4linux driver for direct (DMA) audio for
	  TM5600/TM6000/TM6010 USB Devices.

	  To compile this driver as a module, choose M here: the
	  module will be called tm6000-alsa.

config VIDEO_TM6000_DVB
	bool "DVB Support for tm6000 based TV cards"
	depends on VIDEO_TM6000 && DVB_CORE && EXPERIMENTAL
	select DVB_ZL10353
	---help---
	  This adds support for DVB cards based on the tm5600/tm6000 chip.
```

## drivers/staging/tty/Kconfig
```kconfig
config STALLION
	tristate "Stallion EasyIO or EC8/32 support"
	depends on STALDRV && (ISA || EISA || PCI)
	help
	  If you have an EasyIO or EasyConnection 8/32 multiport Stallion
	  card, then this is for you; say Y.  Make sure to read
	  <file:Documentation/serial/stallion.txt>.

	  To compile this driver as a module, choose M here: the
	  module will be called stallion.

config ISTALLION
	tristate "Stallion EC8/64, ONboard, Brumby support"
	depends on STALDRV && (ISA || EISA || PCI)
	help
	  If you have an EasyConnection 8/64, ONboard, Brumby or Stallion
	  serial multiport card, say Y here. Make sure to read
	  <file:Documentation/serial/stallion.txt>.

	  To compile this driver as a module, choose M here: the
	  module will be called istallion.

config DIGIEPCA
	tristate "Digiboard Intelligent Async Support"
	depends on SERIAL_NONSTANDARD && (ISA || EISA || PCI)
	---help---
	  This is a driver for Digi International's Xx, Xeve, and Xem series
	  of cards which provide multiple serial ports. You would need
	  something like this to connect more than two modems to your Linux
	  box, for instance in order to become a dial-in server. This driver
	  supports the original PC (ISA) boards as well as PCI, and EISA. If
	  you have a card like this, say Y here and read the file
	  <file:Documentation/serial/digiepca.txt>.

	  To compile this driver as a module, choose M here: the
	  module will be called epca.

config RISCOM8
	tristate "SDL RISCom/8 card support"
	depends on SERIAL_NONSTANDARD
	help
	  This is a driver for the SDL Communications RISCom/8 multiport card,
	  which gives you many serial ports. You would need something like
	  this to connect more than two modems to your Linux box, for instance
	  in order to become a dial-in server. If you have a card like that,
	  say Y here and read the file <file:Documentation/serial/riscom8.txt>.

	  Also it's possible to say M here and compile this driver as kernel
	  loadable module; the module will be called riscom8.

config SPECIALIX
	tristate "Specialix IO8+ card support"
	depends on SERIAL_NONSTANDARD
	help
	  This is a driver for the Specialix IO8+ multiport card (both the
	  ISA and the PCI version) which gives you many serial ports. You
	  would need something like this to connect more than two modems to
	  your Linux box, for instance in order to become a dial-in server.

	  If you have a card like that, say Y here and read the file
	  <file:Documentation/serial/specialix.txt>. Also it's possible to say
	  M here and compile this driver as kernel loadable module which will be
	  called specialix.

config COMPUTONE
	tristate "Computone IntelliPort Plus serial support"
	depends on SERIAL_NONSTANDARD && (ISA || EISA || PCI)
	---help---
	  This driver supports the entire family of Intelliport II/Plus
	  controllers with the exception of the MicroChannel controllers and
	  products previous to the Intelliport II. These are multiport cards,
	  which give you many serial ports. You would need something like this
	  to connect more than two modems to your Linux box, for instance in
	  order to become a dial-in server. If you have a card like that, say
	  Y here and read <file:Documentation/serial/computone.txt>.

	  To compile this driver as module, choose M here: the
	  module will be called ip2.

config SERIAL167
	bool "CD2401 support for MVME166/7 serial ports"
	depends on MVME16x
	help
	  This is the driver for the serial ports on the Motorola MVME166,
	  167, and 172 boards.  Everyone using one of these boards should say
	  Y here.
```

## drivers/staging/typec/Kconfig
```kconfig
menu "USB Power Delivery and Type-C drivers"

if TYPEC_TCPM

config TYPEC_TCPCI
	tristate "Type-C Port Controller Interface driver"
	depends on I2C
	select REGMAP_I2C
	help
	  Type-C Port Controller driver for TCPCI-compliant controller.

config TYPEC_RT1711H
	tristate "Richtek RT1711H Type-C chip driver"
	depends on I2C
	select TYPEC_TCPCI
	help
	  Richtek RT1711H Type-C chip driver that works with
	  Type-C Port Controller Manager to provide USB PD and USB
	  Type-C functionalities.

endif

endmenu
```

## drivers/staging/uc2322/Kconfig
```kconfig
config USB_SERIAL_ATEN2011
	tristate "ATEN 2011 USB to serial device support"
	depends on USB_SERIAL
	default N
	---help---
	  Say Y here if you want to use a ATEN 2011 dual port USB to serial
	  adapter.

	  To compile this driver as a module, choose M here: the module will be
	  called aten2011.
```

## drivers/staging/udlfb/Kconfig
```kconfig
config FB_UDL
	tristate "Displaylink USB Framebuffer support"
	depends on FB && USB
	select FB_MODE_HELPERS
	select FB_SYS_FILLRECT
	select FB_SYS_COPYAREA
	select FB_SYS_IMAGEBLIT
	select FB_SYS_FOPS
	select FB_DEFERRED_IO
	---help---
	  This is a kernel framebuffer driver for DisplayLink USB devices.
	  Supports fbdev clients like xf86-video-fbdev, kdrive, fbi, and
	  mplayer -vo fbdev. Supports all USB 2.0 era DisplayLink devices.
	  To compile as a module, choose M here: the module name is udlfb.
```

## drivers/staging/unisys/Kconfig
```kconfig
# SPDX-License-Identifier: GPL-2.0
#
# Unisys SPAR driver configuration
#
menuconfig UNISYSSPAR
	bool "Unisys SPAR driver support"
	help
	  Support for the Unisys SPAR drivers

if UNISYSSPAR

source "drivers/staging/unisys/visornic/Kconfig"
source "drivers/staging/unisys/visorinput/Kconfig"
source "drivers/staging/unisys/visorhba/Kconfig"

endif # UNISYSSPAR
```

## drivers/staging/unisys/channels/Kconfig
```kconfig
#
# Unisys channels configuration
#

config UNISYS_CHANNELSTUB
	tristate "Unisys channelstub driver"
	depends on UNISYSSPAR && UNISYS_VISORUTIL
	---help---
	If you say Y here, you will enable the Unisys channels driver.
```

## drivers/staging/unisys/uislib/Kconfig
```kconfig
#
# Unisys uislib configuration
#

config UNISYS_UISLIB
	tristate "Unisys uislib driver"
	select UNISYS_VISORCHIPSET
	---help---
	If you say Y here, you will enable the Unisys uislib driver.
```

## drivers/staging/unisys/virthba/Kconfig
```kconfig
#
# Unisys virthba configuration
#

config UNISYS_VIRTHBA
	tristate "Unisys virthba driver"
	depends on SCSI
	select UNISYS_VISORCHIPSET
	select UNISYS_UISLIB
	select UNISYS_VIRTPCI
	---help---
	If you say Y here, you will enable the Unisys virthba driver.
```

## drivers/staging/unisys/virtpci/Kconfig
```kconfig
#
# Unisys virtpci configuration
#

config UNISYS_VIRTPCI
	tristate "Unisys virtpci driver"
	depends on UNISYSSPAR && UNISYS_UISLIB
	---help---
	If you say Y here, you will enable the Unisys virtpci driver.
```

## drivers/staging/unisys/visorbus/Kconfig
```kconfig
#
# Unisys visorbus configuration
#

config UNISYS_VISORBUS
	tristate "Unisys visorbus driver"
	depends on UNISYSSPAR
	---help---
	If you say Y here, you will enable the Unisys visorbus driver.
```

## drivers/staging/unisys/visorchannel/Kconfig
```kconfig
#
# Unisys visorchannel configuration
#

config UNISYS_VISORCHANNEL
	tristate "Unisys visorchannel driver"
	---help---
	If you say Y here, you will enable the Unisys visorchannel driver.
```

## drivers/staging/unisys/visorchipset/Kconfig
```kconfig
#
# Unisys visorchipset configuration
#

config UNISYS_VISORCHIPSET
	tristate "Unisys visorchipset driver"
	select UNISYS_VISORUTIL
	select UNISYS_VISORCHANNEL
	---help---
	If you say Y here, you will enable the Unisys visorchipset driver.
```

## drivers/staging/unisys/visorhba/Kconfig
```kconfig
#
# Unisys visorhba configuration
#

config UNISYS_VISORHBA
	tristate "Unisys visorhba driver"
	depends on UNISYSSPAR && UNISYS_VISORBUS && SCSI
	---help---
	The Unisys visorhba driver provides support for s-Par HBA
	devices exposed on the s-Par visorbus. When a message is sent
	to visorbus to create a HBA device, the probe function of
	visorhba is called to create the scsi device.
	If you say Y here, you will enable the Unisys visorhba driver.
```

## drivers/staging/unisys/visorhid/Kconfig
```kconfig
#
# Unisys visorhid configuration
#

config UNISYS_VISORHID
	tristate "Unisys visorhid driver"
	depends on UNISYSSPAR && UNISYS_VISORBUS && FB
	---help---
	If you say Y here, you will enable the Unisys visorhid driver.
```

## drivers/staging/unisys/visorinput/Kconfig
```kconfig
# SPDX-License-Identifier: GPL-2.0
#
# Unisys visorinput configuration
#

config UNISYS_VISORINPUT
	tristate "Unisys visorinput driver"
	depends on UNISYSSPAR && UNISYS_VISORBUS && INPUT
	help
		The Unisys s-Par visorinput driver provides a virtualized system
		console (keyboard and mouse) that is accessible through the
		s-Par firmware's user interface. s-Par provides video using the EFI
		GOP protocol, so If this driver is not present, the Linux guest should
		still boot with visible output in the partition desktop, but keyboard
		and mouse interaction will not be available.
```

## drivers/staging/unisys/visornic/Kconfig
```kconfig
#
# Unisys visornic configuration
#

config UNISYS_VISORNIC
	tristate "Unisys visornic driver"
	depends on UNISYSSPAR && UNISYS_VISORBUS && NET
	---help---
	The Unisys Visornic driver provides support for s-Par network
	devices exposed on the s-Par visorbus. When a message is sent
	to visorbus to create a network device, the probe function of
	visornic is called to create the netdev device. Networking on
	s-Par switches will not work if this driver is not selected.
	If you say Y here, you will enable the Unisys visornic driver.
```

## drivers/staging/unisys/visorutil/Kconfig
```kconfig
#
# Unisys timskmod configuration
#

config UNISYS_VISORUTIL
	tristate "Unisys visorutil driver"
	---help---
	If you say Y here, you will enable the Unisys visorutil driver.
```
