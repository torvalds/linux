## drivers/staging/usbip/Kconfig
```kconfig
config USBIP_CORE
	tristate "USB/IP support"
	depends on USB && NET
	default N
	---help---
	  This enables pushing USB packets over IP to allow remote
	  machines direct access to USB devices. It provides the
	  USB/IP core that is required by both drivers.

	  For more details, and to get the userspace utility
	  programs, please see http://usbip.sourceforge.net/.

	  To compile this as a module, choose M here: the module will
	  be called usbip-core.

	  If unsure, say N.

config USBIP_VHCI_HCD
	tristate "VHCI hcd"
	depends on USBIP_CORE
	default N
	---help---
	  This enables the USB/IP virtual host controller driver,
	  which is run on the remote machine.

	  To compile this driver as a module, choose M here: the
	  module will be called vhci-hcd.

config USBIP_HOST
	tristate "Host driver"
	depends on USBIP_CORE
	default N
	---help---
	  This enables the USB/IP host driver, which is run on the
	  machine that is sharing the USB devices.

	  To compile this driver as a module, choose M here: the
	  module will be called usbip-host.

config USBIP_DEBUG
	bool "Debug messages for USB/IP"
	depends on USBIP_CORE
	default N
	---help---
	  This enables the debug messages from the USB/IP drivers.
```

## drivers/staging/usbvideo/Kconfig
```kconfig
config VIDEO_USBVIDEO
	tristate

config USB_VICAM
	tristate "USB 3com HomeConnect (aka vicam) support (DEPRECATED)"
	depends on VIDEO_DEV && VIDEO_V4L2_COMMON && USB
	select VIDEO_USBVIDEO
	---help---
	  Say Y here if you have 3com homeconnect camera (vicam).

	  This driver uses the deprecated V4L1 API and will be removed in
	  2.6.39, unless someone converts it to the V4L2 API.

	  To compile this driver as a module, choose M here: the
	  module will be called vicam.
```

## drivers/staging/vboxvideo/Kconfig
```kconfig
config DRM_VBOXVIDEO
	tristate "Virtual Box Graphics Card"
	depends on DRM && X86 && PCI
	select DRM_KMS_HELPER
	help
	  This is a KMS driver for the virtual Graphics Card used in
	  Virtual Box virtual machines.

	  Although it is possible to builtin this module, it is advised
	  to build this driver as a module, so that it can be updated
	  independently of the kernel. Select M to built this driver as a
	  module and add support for these devices via drm/kms interfaces.
```

## drivers/staging/vc04_services/Kconfig
```kconfig
# SPDX-License-Identifier: GPL-2.0
if BCM_VIDEOCORE

source "drivers/staging/vc04_services/bcm2835-audio/Kconfig"

endif
```
