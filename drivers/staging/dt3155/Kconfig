## drivers/staging/fieldbus/Documentation/devicetree/bindings/fieldbus/arcx,anybus-controller.txt
```
* Arcx Anybus-S controller

This chip communicates with the SoC over a parallel bus. It is
expected that its Device Tree node is specified as the child of a node
corresponding to the parallel bus used for communication.

Required properties:
--------------------

  - compatible : The following chip-specific string:
        "arcx,anybus-controller"

  - reg : three areas:
	index 0: bus memory area where the cpld registers are located.
	index 1: bus memory area of the first  host's dual-port ram.
	index 2: bus memory area of the second host's dual-port ram.

  - reset-gpios : the GPIO pin connected to the reset line of the controller.

  - interrupts : two interrupts:
		index 0: interrupt connected to the first  host
		index 1: interrupt connected to the second host
	Generic interrupt client node bindings are described in
	interrupt-controller/interrupts.txt

Optional: use of subnodes
-------------------------

The card connected to a host may need additional properties. These can be
specified in subnodes to the controller node.

The subnodes are identified by the standard 'reg' property. Which information
exactly can be specified depends on the bindings for the function driver
for the subnode.

Required controller node properties when using subnodes:
- #address-cells: should be one.
- #size-cells: should be zero.

Required subnode properties:
- reg: Must contain the host index of the card this subnode describes:
		<0>	for the first  host on the controller
		<1>	for the second host on the controller
	Note that only a single card can be plugged into a host, so the host
	index uniquely describes the card location.

Example of usage:
-----------------

This example places the bridge on top of the i.MX WEIM parallel bus, see:
Documentation/devicetree/bindings/bus/imx-weim.txt

&weim {
	controller@0,0 {
		compatible = "arcx,anybus-controller";
		reg = <0 0 0x100>, <0 0x400000 0x800>, <1 0x400000 0x800>;
		reset-gpios = <&gpio5 2 GPIO_ACTIVE_HIGH>;
		interrupt-parent = <&gpio1>;
		interrupts = <1 IRQ_TYPE_LEVEL_LOW>, <5 IRQ_TYPE_LEVEL_LOW>;
		/* fsl,weim-cs-timing is a i.MX WEIM bus specific property */
		fsl,weim-cs-timing = <0x024400b1 0x00001010 0x20081100
				0x00000000 0xa0000240 0x00000000>;
		/* optional subnode for a card plugged into the first host */
		#address-cells = <1>;
		#size-cells = <0>;
		card@0 {
			reg = <0>;
			/* card specific properties go here */
		};
	};
};
```

## drivers/staging/fieldbus/Kconfig
```kconfig
menuconfig FIELDBUS_DEV
	tristate "Fieldbus Device Support"
	help
	  Support for Fieldbus Device Adapters.

	  Fieldbus device (client) adapters allow data exchange with a PLC aka.
	  "Fieldbus Controller" over a fieldbus (Profinet, FLNet, etc.)

	  They are typically used when a Linux device wants to expose itself
	  as an actuator, motor, console light, switch, etc. over the fieldbus.

	  This framework is designed to provide a generic interface to Fieldbus
	  Devices from both the Linux Kernel and the userspace.

	  If unsure, say no.

source "drivers/staging/fieldbus/anybuss/Kconfig"
```

## drivers/staging/fieldbus/anybuss/Kconfig
```kconfig
# SPDX-License-Identifier: GPL-2.0-only
config HMS_ANYBUSS_BUS
	tristate "HMS Anybus-S Bus Support"
	select REGMAP
	depends on OF && FIELDBUS_DEV
	help
	  Driver for the HMS Industrial Networks Anybus-S bus.
	  You can attach a single Anybus-S compatible card to it, which
	  typically provides fieldbus and industrial ethernet
	  functionality.

if HMS_ANYBUSS_BUS

config ARCX_ANYBUS_CONTROLLER
	tristate "Arcx Anybus-S Controller"
	depends on OF && GPIOLIB && HAS_IOMEM && REGULATOR
	select REGMAP_MMIO
	help
	  Select this to get support for the Arcx Anybus controller.
	  It connects to the SoC via a parallel memory bus, and
	  embeds up to two Anybus-S buses (slots).
	  There is also a CAN power readout, unrelated to the Anybus,
	  modelled as a regulator.

config HMS_PROFINET
	tristate "HMS Profinet IRT Controller (Anybus-S)"
	depends on FIELDBUS_DEV && HMS_ANYBUSS_BUS
	help
	  If you say yes here you get support for the HMS Industrial
	  Networks Profinet IRT Controller.

	  It will be registered with the kernel as a fieldbus_dev,
	  so userspace can interact with it via the fieldbus_dev userspace
	  interface(s).

	  This driver can also be built as a module. If so, the module
	  will be called hms-profinet.

	  If unsure, say N.

endif
```

## drivers/staging/frontier/Kconfig
```kconfig
config TRANZPORT
	tristate "Frontier Tranzport and Alphatrack support"
	depends on USB
	default N
	---help---
	  Enable support for the Frontier Tranzport and Alphatrack devices.
```

## drivers/staging/fsl-dpaa2/Kconfig
```kconfig
#
# Freescale DataPath Acceleration Architecture Gen2 (DPAA2) drivers
#

config FSL_DPAA2
	bool "Freescale DPAA2 devices"
	depends on FSL_MC_BUS
	---help---
	  Build drivers for Freescale DataPath Acceleration
	  Architecture (DPAA2) family of SoCs.

config FSL_DPAA2_ETHSW
	tristate "Freescale DPAA2 Ethernet Switch"
	depends on FSL_DPAA2
	depends on NET_SWITCHDEV
	---help---
	Driver for Freescale DPAA2 Ethernet Switch. Select
	BRIDGE to have support for bridge tools.
```

## drivers/staging/ft1000/Kconfig
```kconfig
config FT1000
	tristate "Drivers for Flarion ft1000 devices"

if FT1000

config FT1000_USB
	tristate "Driver for ft1000 usb devices."
	depends on USB
	depends on NET
	help
	  Say Y if you want to have support for Qleadtek FLASH-OFDM USB Modem [LR7F04],
	  Qleadtek Express Card or Leadtek Multi-band modem HSDPA.

config FT1000_PCMCIA
	tristate "Driver for ft1000 pcmcia device."
	depends on PCMCIA
	depends on NET
	help
	  Say Y if you want to have support for Flarion card also called
	  Multimedia Net Card.

endif
```

## drivers/staging/fwserial/Kconfig
```kconfig
config FIREWIRE_SERIAL
       tristate "TTY over Firewire"
       depends on FIREWIRE && TTY
       help
          This enables TTY over IEEE 1394, providing high-speed serial
	  connectivity to cabled peers. This driver implements a
	  ad-hoc transport protocol and is currently limited to
	  Linux-to-Linux communication.

	  To compile this driver as a module, say M here:  the module will
	  be called firewire-serial.

if FIREWIRE_SERIAL

config FWTTY_MAX_TOTAL_PORTS
       int "Maximum number of serial ports supported"
       default "64"
       help
          Set this to the maximum number of serial ports you want the
	  firewire-serial driver to support.

config FWTTY_MAX_CARD_PORTS
       int "Maximum number of serial ports supported per adapter"
       range 0 FWTTY_MAX_TOTAL_PORTS
       default "32"
       help
          Set this to the maximum number of serial ports each firewire
	  adapter supports. The actual number of serial ports registered
	  is set with the module parameter "ttys".

endif
```

## drivers/staging/gasket/Kconfig
```kconfig
# SPDX-License-Identifier: GPL-2.0
menu "Gasket devices"

config STAGING_GASKET_FRAMEWORK
	tristate "Gasket framework"
	depends on PCI && (X86_64 || ARM64)
	help
	  This framework supports Gasket-compatible devices, such as Apex.
	  It is required for any of the following module(s).

	  To compile this driver as a module, choose M here.  The module
	  will be called "gasket".

config STAGING_APEX_DRIVER
	tristate "Apex Driver"
	depends on STAGING_GASKET_FRAMEWORK
	help
	  This driver supports the Apex Edge TPU device.  See
	  https://cloud.google.com/edge-tpu/ for more information.
	  Say Y if you want to include this driver in the kernel.

	  To compile this driver as a module, choose M here.  The module
	  will be called "apex".

endmenu
```

## drivers/staging/gdm724x/Kconfig
```kconfig
#
# GCT GDM724x LTE driver configuration
#

config LTE_GDM724X
	tristate "GCT GDM724x LTE support"
	depends on NET && USB && TTY && m
	help
	  This driver supports GCT GDM724x LTE chip based USB modem devices.
	  It exposes 4 network devices to be used per PDN and 2 tty devices to be
	  used for AT commands and DM monitoring applications.
	  The modules will be called gdmulte.ko and gdmtty.ko

	  GCT-ATCx can be used for AT Commands
	  GCT-DMx can be used for LTE protocol monitoring
```

## drivers/staging/gdm72xx/Kconfig
```kconfig
#
# GCT GDM72xx WiMAX driver configuration
#

menuconfig WIMAX_GDM72XX
	tristate "GCT GDM72xx WiMAX support"
	depends on NET && (USB || MMC)
	help
	  Support a WiMAX module based on the GCT GDM72xx WiMAX chip.

if WIMAX_GDM72XX

config WIMAX_GDM72XX_QOS
	bool "Enable QoS support"
	default n
	help
	  Enable Quality of Service support based on the data protocol of
	  transmitting packets.

config WIMAX_GDM72XX_K_MODE
	bool "Enable K mode"
	default n
	help
	  Enable support for proprietary functions for KT (Korea Telecom).

config WIMAX_GDM72XX_WIMAX2
	bool "Enable WiMAX2 support"
	default n
	help
	  Enable support for transmitting multiple packets (packet
	  aggregation) from the WiMAX module to the host processor.

choice
	prompt "Select interface"

config WIMAX_GDM72XX_USB
	bool "USB interface"
	depends on (USB = y || USB = WIMAX_GDM72XX)
	help
	  Select this option if the WiMAX module interfaces with the host
	  processor via USB.

config WIMAX_GDM72XX_SDIO
	bool "SDIO interface"
	depends on (MMC = y || MMC = WIMAX_GDM72XX)
	help
	  Select this option if the WiMAX module interfaces with the host
	  processor via SDIO.

endchoice

if WIMAX_GDM72XX_USB

config WIMAX_GDM72XX_USB_PM
	bool "Enable power management support"
	depends on PM
	help
	  Enable USB power management in order to reduce power consumption
	  while the interface is not in use.

endif # WIMAX_GDM72XX_USB

endif # WIMAX_GDM72XX
```

## drivers/staging/generic_serial/Kconfig
```kconfig
config A2232
	tristate "Commodore A2232 serial support (EXPERIMENTAL)"
	depends on EXPERIMENTAL && ZORRO && BROKEN
	---help---
	  This option supports the 2232 7-port serial card shipped with the
	  Amiga 2000 and other Zorro-bus machines, dating from 1989.  At
	  a max of 19,200 bps, the ports are served by a 6551 ACIA UART chip
	  each, plus a 8520 CIA, and a master 6502 CPU and buffer as well. The
	  ports were connected with 8 pin DIN connectors on the card bracket,
	  for which 8 pin to DB25 adapters were supplied. The card also had
	  jumpers internally to toggle various pinning configurations.

	  This driver can be built as a module; but then "generic_serial"
	  will also be built as a module. This has to be loaded before
	  "ser_a2232". If you want to do this, answer M here.

config SX
	tristate "Specialix SX (and SI) card support"
	depends on SERIAL_NONSTANDARD && (PCI || EISA || ISA) && BROKEN
	help
	  This is a driver for the SX and SI multiport serial cards.
	  Please read the file <file:Documentation/serial/sx.txt> for details.

	  This driver can only be built as a module ( = code which can be
	  inserted in and removed from the running kernel whenever you want).
	  The module will be called sx. If you want to do that, say M here.

config RIO
	tristate "Specialix RIO system support"
	depends on SERIAL_NONSTANDARD && BROKEN
	help
	  This is a driver for the Specialix RIO, a smart serial card which
	  drives an outboard box that can support up to 128 ports.  Product
	  information is at <http://www.perle.com/support/documentation.html#multiport>.
	  There are both ISA and PCI versions.

config RIO_OLDPCI
	bool "Support really old RIO/PCI cards"
	depends on RIO
	help
	  Older RIO PCI cards need some initialization-time configuration to
	  determine the IRQ and some control addresses.  If you have a RIO and
	  this doesn't seem to work, try setting this to Y.
```

## drivers/staging/gma500/Kconfig
```kconfig
config DRM_PSB
	tristate "Intel GMA500 KMS Framebuffer"
	depends on DRM && PCI && X86
	select FB_CFB_COPYAREA
        select FB_CFB_FILLRECT
        select FB_CFB_IMAGEBLIT
        select DRM_KMS_HELPER
        select DRM_TTM
	help
	  Say yes for an experimental KMS framebuffer driver for the
	  Intel GMA500 ('Poulsbo') graphics support.
```

## drivers/staging/go7007/Kconfig
```kconfig
config VIDEO_GO7007
	tristate "WIS GO7007 MPEG encoder support"
	depends on VIDEO_DEV && PCI && I2C && INPUT
	depends on SND
	select VIDEOBUF_DMA_SG
	select VIDEO_IR
	select VIDEO_TUNER
	select VIDEO_TVEEPROM
	select SND_PCM
	select CRC32
	default N
	---help---
	  This is a video4linux driver for the WIS GO7007 MPEG
	  encoder chip.

	  To compile this driver as a module, choose M here: the
	  module will be called go7007

config VIDEO_GO7007_USB
	tristate "WIS GO7007 USB support"
	depends on VIDEO_GO7007 && USB
	default N
	---help---
	  This is a video4linux driver for the WIS GO7007 MPEG
	  encoder chip over USB.

	  To compile this driver as a module, choose M here: the
	  module will be called go7007-usb

config VIDEO_GO7007_USB_S2250_BOARD
	tristate "Sensoray 2250/2251 support"
	depends on VIDEO_GO7007_USB && DVB_USB
	default N
	---help---
	  This is a video4linux driver for the Sensoray 2250/2251 device.

	  To compile this driver as a module, choose M here: the
	  module will be called s2250

config VIDEO_GO7007_OV7640
	tristate "OV7640 subdev support"
	depends on VIDEO_GO7007
	default N
	---help---
	  This is a video4linux driver for the OV7640 sub-device.

	  To compile this driver as a module, choose M here: the
	  module will be called wis-ov7640

config VIDEO_GO7007_SAA7113
	tristate "SAA7113 subdev support"
	depends on VIDEO_GO7007
	default N
	---help---
	  This is a video4linux driver for the SAA7113 sub-device.

	  To compile this driver as a module, choose M here: the
	  module will be called wis-saa7113

config VIDEO_GO7007_SAA7115
	tristate "SAA7115 subdev support"
	depends on VIDEO_GO7007
	default N
	---help---
	  This is a video4linux driver for the SAA7115 sub-device.

	  To compile this driver as a module, choose M here: the
	  module will be called wis-saa7115

config VIDEO_GO7007_TW9903
	tristate "TW9903 subdev support"
	depends on VIDEO_GO7007
	default N
	---help---
	  This is a video4linux driver for the TW9903 sub-device.

	  To compile this driver as a module, choose M here: the
	  module will be called wis-tw9903

config VIDEO_GO7007_UDA1342
	tristate "UDA1342 subdev support"
	depends on VIDEO_GO7007
	default N
	---help---
	  This is a video4linux driver for the UDA1342 sub-device.

	  To compile this driver as a module, choose M here: the
	  module will be called wis-uda1342

config VIDEO_GO7007_SONY_TUNER
	tristate "Sony tuner subdev support"
	depends on VIDEO_GO7007
	default N
	---help---
	  This is a video4linux driver for the Sony Tuner sub-device.

	  To compile this driver as a module, choose M here: the
	  module will be called wis-sony-tuner

config VIDEO_GO7007_TW2804
	tristate "TW2804 subdev support"
	depends on VIDEO_GO7007
	default N
	---help---
	  This is a video4linux driver for the TW2804 sub-device.

	  To compile this driver as a module, choose M here: the
	  module will be called wis-tw2804
```

## drivers/staging/goldfish/Kconfig
```kconfig
# SPDX-License-Identifier: GPL-2.0
config GOLDFISH_AUDIO
	tristate "Goldfish AVD Audio Device"
	depends on GOLDFISH
	help
	  Emulated audio channel for the Goldfish Android Virtual Device
```
