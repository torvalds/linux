## drivers/staging/dwc2/Kconfig
```kconfig
config USB_DWC2
	tristate "DesignWare USB2 DRD Core Support"
	depends on USB
	help
	  Say Y or M here if your system has a Dual Role HighSpeed
	  USB controller based on the DesignWare HSOTG IP Core.

	  If you choose to build this driver as dynamically linked
	  modules, the core module will be called dwc2.ko, the
	  PCI bus interface module (if you have a PCI bus system)
	  will be called dwc2_pci.ko and the platform interface module
	  (for controllers directly connected to the CPU) will be called
	  dwc2_platform.ko.

	  NOTE: This driver at present only implements the Host mode
	  of the controller. The existing s3c-hsotg driver supports
	  Peripheral mode, but only for the Samsung S3C platforms.
	  There are plans to merge the s3c-hsotg driver with this
	  driver in the near future to create a dual-role driver.

if USB_DWC2

config USB_DWC2_DEBUG
	bool "Enable Debugging Messages"
	help
	  Say Y here to enable debugging messages in the DWC2 Driver.

config USB_DWC2_VERBOSE
	bool "Enable Verbose Debugging Messages"
	depends on USB_DWC2_DEBUG
	help
	  Say Y here to enable verbose debugging messages in the DWC2 Driver.
	  WARNING: Enabling this will quickly fill your message log.
	  If in doubt, say N.

config USB_DWC2_TRACK_MISSED_SOFS
	bool "Enable Missed SOF Tracking"
	help
	  Say Y here to enable logging of missed SOF events to the dmesg log.
	  WARNING: This feature is still experimental.
	  If in doubt, say N.

config USB_DWC2_DEBUG_PERIODIC
	bool "Enable Debugging Messages For Periodic Transfers"
	depends on USB_DWC2_DEBUG || USB_DWC2_VERBOSE
	default y
	help
	  Say N here to disable (verbose) debugging messages to be
	  logged for periodic transfers. This allows better debugging of
	  non-periodic transfers, but of course the debug logs will be
	  incomplete. Note that this also disables some debug messages
	  for which the transfer type cannot be deduced.
endif
```

## drivers/staging/easycap/Kconfig
```kconfig
config EASYCAP
	tristate "EasyCAP USB ID 05e1:0408 support"
	depends on USB && VIDEO_DEV && (SND || SOUND_OSS_CORE)

	---help---
	  This is an integrated audio/video driver for EasyCAP cards with
	  USB ID 05e1:0408.  It supports two hardware variants:

	  *  EasyCAP USB 2.0 Video Adapter with Audio, Model DC60,
	     having input cables labelled CVBS, S-VIDEO, AUDIO(L), AUDIO(R)

	  *  EasyCAP002 4-Channel USB 2.0 DVR, having input cables labelled
	     1, 2, 3, 4 and an unlabelled input cable for a microphone.

	  To compile this driver as a module, choose M here: the
	  module will be called easycap

choice
        prompt "Sound Interface"
        depends on EASYCAP
        default EASYCAP_SND
	---help---

config EASYCAP_SND
        bool "ALSA"
	depends on SND
	select SND_PCM

        ---help---
          Say 'Y' if you want to use ALSA interface

	  This will disable Open Sound System (OSS) binding.

config EASYCAP_OSS
	bool "OSS (DEPRECATED)"
	depends on SOUND_OSS_CORE

	---help---
	  Say 'Y' if you prefer Open Sound System (OSS) interface

	  This will disable Advanced Linux Sound Architecture (ALSA) binding.

	  Once binding to ALSA interface will be stable this option will be
          removed.
endchoice

config EASYCAP_DEBUG
	bool "Enable EasyCAP driver debugging"
	depends on EASYCAP

	---help---
	  This option enables debug printouts

	  To enable debug, pass the debug level to the debug module
          parameter:

          modprobe easycap debug=[0..9]
```

## drivers/staging/emxx_udc/Kconfig
```kconfig
config USB_EMXX
	bool "EMXX USB Function Device Controller"
 	depends on USB_GADGET && (ARCH_SHMOBILE || (ARM && COMPILE_TEST))
	help
	   The Emma Mobile series of SoCs from Renesas Electronics and
	   former NEC Electronics include USB Function hardware.

	   Say "y" to link the driver statically, or "m" to build a
	   dynamically linked module called "emxx_udc" and force all
	   gadget drivers to also be dynamically linked.
```

## drivers/staging/epl/Kconfig
```kconfig
config EPL
	tristate "openPOWERLINK protocol stack"
	depends on NET && HIGH_RES_TIMERS && X86
	default N
	---help---
	  Enable support for the openPOWERLINK network protocol stack.
```

## drivers/staging/erofs/Kconfig
```kconfig
# SPDX-License-Identifier: GPL-2.0

config EROFS_FS
	tristate "EROFS filesystem support"
	depends on BLOCK
	help
	  EROFS(Enhanced Read-Only File System) is a lightweight
	  read-only file system with modern designs (eg. page-sized
	  blocks, inline xattrs/data, etc.) for scenarios which need
	  high-performance read-only requirements, eg. firmwares in
	  mobile phone or LIVECDs.

	  It also provides VLE compression support, focusing on
	  random read improvements, keeping relatively lower
	  compression ratios, which is useful for high-performance
	  devices with limited memory and ROM space.

	  If unsure, say N.

config EROFS_FS_DEBUG
	bool "EROFS debugging feature"
	depends on EROFS_FS
	help
	  Print EROFS debugging messages and enable more BUG_ONs
	  which check the filesystem consistency aggressively.

	  For daily use, say N.

config EROFS_FS_XATTR
	bool "EROFS extended attributes"
	depends on EROFS_FS
	default y
	help
	  Extended attributes are name:value pairs associated with inodes by
	  the kernel or by users (see the attr(5) manual page, or visit
	  <http://acl.bestbits.at/> for details).

	  If unsure, say N.

config EROFS_FS_POSIX_ACL
	bool "EROFS Access Control Lists"
	depends on EROFS_FS_XATTR
	select FS_POSIX_ACL
	default y
	help
	  Posix Access Control Lists (ACLs) support permissions for users and
	  groups beyond the owner/group/world scheme.

	  To learn more about Access Control Lists, visit the POSIX ACLs for
	  Linux website <http://acl.bestbits.at/>.

	  If you don't know what Access Control Lists are, say N.

config EROFS_FS_SECURITY
	bool "EROFS Security Labels"
	depends on EROFS_FS_XATTR
	help
	  Security labels provide an access control facility to support Linux
	  Security Models (LSMs) accepted by AppArmor, SELinux, Smack and TOMOYO
	  Linux. This option enables an extended attribute handler for file
	  security labels in the erofs filesystem, so that it requires enabling
	  the extended attribute support in advance.

	  If you are not using a security module, say N.

config EROFS_FS_USE_VM_MAP_RAM
	bool "EROFS VM_MAP_RAM Support"
	depends on EROFS_FS
	help
	  use vm_map_ram/vm_unmap_ram instead of vmap/vunmap.

	  If you don't know what these are, say N.

config EROFS_FAULT_INJECTION
	bool "EROFS fault injection facility"
	depends on EROFS_FS
	help
	  Test EROFS to inject faults such as ENOMEM, EIO, and so on.
	  If unsure, say N.

config EROFS_FS_IO_MAX_RETRIES
	int "EROFS IO Maximum Retries"
	depends on EROFS_FS
	default "5"
	help
	  Maximum retry count of IO Errors.

	  If unsure, leave the default value (5 retries, 6 IOs at most).

config EROFS_FS_ZIP
	bool "EROFS Data Compresssion Support"
	depends on EROFS_FS
	select LZ4_DECOMPRESS
	help
	  Currently we support LZ4 VLE Compression only.
	  Play at your own risk.

	  If you don't want to use compression feature, say N.

config EROFS_FS_CLUSTER_PAGE_LIMIT
	int "EROFS Cluster Pages Hard Limit"
	depends on EROFS_FS_ZIP
	range 1 256
	default "1"
	help
	  Indicates VLE compressed pages hard limit of a
	  compressed cluster.

	  For example, if files of a image are compressed
	  into 8k-unit, the hard limit should not be less
	  than 2. Otherwise, the image cannot be mounted
	  correctly on this kernel.

choice
	prompt "EROFS VLE Data Decompression mode"
	depends on EROFS_FS_ZIP
	default EROFS_FS_ZIP_CACHE_BIPOLAR
	help
	  EROFS supports three options for VLE decompression.
	  "In-place Decompression Only" consumes the minimum memory
	  with lowest random read.

	  "Bipolar Cached Decompression" consumes the maximum memory
	  with highest random read.

	  If unsure, select "Bipolar Cached Decompression"

config EROFS_FS_ZIP_NO_CACHE
	bool "In-place Decompression Only"
	help
	  Read compressed data into page cache and do in-place
	  decompression directly.

config EROFS_FS_ZIP_CACHE_UNIPOLAR
	bool "Unipolar Cached Decompression"
	help
	  For each request, it caches the last compressed page
	  for further reading.
	  It still decompresses in place for the rest compressed pages.

config EROFS_FS_ZIP_CACHE_BIPOLAR
	bool "Bipolar Cached Decompression"
	help
	  For each request, it caches the both end compressed pages
	  for further reading.
	  It still decompresses in place for the rest compressed pages.

	  Recommended for performance priority.

endchoice
```

## drivers/staging/et131x/Kconfig
```kconfig
config ET131X
	tristate "Agere ET-1310 Gigabit Ethernet support"
	depends on PCI
	default n
	---help---
	  This driver supports Agere ET-1310 ethernet adapters.

	  To compile this driver as a module, choose M here. The module
	  will be called et131x.
```

## drivers/staging/exfat/Kconfig
```kconfig
# SPDX-License-Identifier: GPL-2.0
config STAGING_EXFAT_FS
	tristate "exFAT fs support"
	depends on BLOCK
	select NLS
	help
	  This adds support for the exFAT file system.

config STAGING_EXFAT_DISCARD
	bool "enable discard support"
	depends on STAGING_EXFAT_FS
	default y

config STAGING_EXFAT_DELAYED_SYNC
	bool "enable delayed sync"
	depends on STAGING_EXFAT_FS
	default n

config STAGING_EXFAT_KERNEL_DEBUG
	bool "enable kernel debug features via ioctl"
	depends on STAGING_EXFAT_FS
	default n

config STAGING_EXFAT_DEBUG_MSG
	bool "print debug messages"
	depends on STAGING_EXFAT_FS
	default n

config STAGING_EXFAT_DEFAULT_CODEPAGE
	int "Default codepage for exFAT"
	default 437
	depends on STAGING_EXFAT_FS
	help
	  This option should be set to the codepage of your exFAT filesystems.

config STAGING_EXFAT_DEFAULT_IOCHARSET
	string "Default iocharset for exFAT"
	default "utf8"
	depends on STAGING_EXFAT_FS
	help
	  Set this to the default input/output character set you'd like exFAT to use.
```

## drivers/staging/fbtft/Kconfig
```kconfig
# SPDX-License-Identifier: GPL-2.0
menuconfig FB_TFT
	tristate "Support for small TFT LCD display modules"
	depends on FB && SPI
	depends on FB_DEVICE
	depends on BACKLIGHT_CLASS_DEVICE
	depends on GPIOLIB || COMPILE_TEST
	select FB_BACKLIGHT
	select FB_SYSMEM_HELPERS_DEFERRED

if FB_TFT

config FB_TFT_AGM1264K_FL
	tristate "FB driver for the AGM1264K-FL LCD display"
	help
	  Framebuffer support for the AGM1264K-FL LCD display (two Samsung KS0108 compatible chips)

config FB_TFT_BD663474
	tristate "FB driver for the BD663474 LCD Controller"
	help
	  Generic Framebuffer support for BD663474

config FB_TFT_HX8340BN
	tristate "FB driver for the HX8340BN LCD Controller"
	help
	  Generic Framebuffer support for HX8340BN

config FB_TFT_HX8347D
	tristate "FB driver for the HX8347D LCD Controller"
	help
	  Generic Framebuffer support for HX8347D

config FB_TFT_HX8353D
	tristate "FB driver for the HX8353D LCD Controller"
	help
	  Generic Framebuffer support for HX8353D

config FB_TFT_HX8357D
	tristate "FB driver for the HX8357D LCD Controller"
	help
	  Generic Framebuffer support for HX8357D

config FB_TFT_ILI9163
	tristate "FB driver for the ILI9163 LCD Controller"
	help
	  Generic Framebuffer support for ILI9163

config FB_TFT_ILI9320
	tristate "FB driver for the ILI9320 LCD Controller"
	help
	  Generic Framebuffer support for ILI9320

config FB_TFT_ILI9325
	tristate "FB driver for the ILI9325 LCD Controller"
	help
	  Generic Framebuffer support for ILI9325

config FB_TFT_ILI9340
	tristate "FB driver for the ILI9340 LCD Controller"
	help
	  Generic Framebuffer support for ILI9340

config FB_TFT_ILI9341
	tristate "FB driver for the ILI9341 LCD Controller"
	help
	  Generic Framebuffer support for ILI9341

config FB_TFT_ILI9481
	tristate "FB driver for the ILI9481 LCD Controller"
	help
	  Generic Framebuffer support for ILI9481

config FB_TFT_ILI9486
	tristate "FB driver for the ILI9486 LCD Controller"
	help
	  Generic Framebuffer support for ILI9486

config FB_TFT_PCD8544
	tristate "FB driver for the PCD8544 LCD Controller"
	help
	  Generic Framebuffer support for PCD8544

config FB_TFT_RA8875
	tristate "FB driver for the RA8875 LCD Controller"
	help
	  Generic Framebuffer support for RA8875

config FB_TFT_S6D02A1
	tristate "FB driver for the S6D02A1 LCD Controller"
	help
	  Generic Framebuffer support for S6D02A1

config FB_TFT_S6D1121
	tristate "FB driver for the S6D1211 LCD Controller"
	help
	  Generic Framebuffer support for S6D1121

config FB_TFT_SEPS525
	tristate "FB driver for the SEPS525 LCD Controller"
	help
	  Generic Framebuffer support for SEPS525
	  Say Y if you have such a display that utilizes this controller.

config FB_TFT_SH1106
	tristate "FB driver for the SH1106 OLED Controller"
	help
	  Framebuffer support for SH1106

config FB_TFT_SSD1289
	tristate "FB driver for the SSD1289 LCD Controller"
	help
	  Framebuffer support for SSD1289

config FB_TFT_SSD1305
	tristate "FB driver for the SSD1305 OLED Controller"
	help
	  Framebuffer support for SSD1305

config FB_TFT_SSD1306
	tristate "FB driver for the SSD1306 OLED Controller"
	help
	  Framebuffer support for SSD1306

config FB_TFT_SSD1331
	tristate "FB driver for the SSD1331 LCD Controller"
	help
	  Framebuffer support for SSD1331

config FB_TFT_SSD1351
	tristate "FB driver for the SSD1351 LCD Controller"
	help
	  Framebuffer support for SSD1351

config FB_TFT_ST7735R
	tristate "FB driver for the ST7735R LCD Controller"
	help
	  Generic Framebuffer support for ST7735R

config FB_TFT_ST7789V
	tristate "FB driver for the ST7789V LCD Controller"
	help
	  This enables generic framebuffer support for the Sitronix ST7789V
	  display controller. The controller is intended for small color
	  displays with a resolution of up to 320x240 pixels.

	  Say Y if you have such a display that utilizes this controller.

config FB_TFT_TINYLCD
	tristate "FB driver for tinylcd.com display"
	help
	  Custom Framebuffer support for tinylcd.com display

config FB_TFT_TLS8204
	tristate "FB driver for the TLS8204 LCD Controller"
	help
	  Generic Framebuffer support for TLS8204

config FB_TFT_UC1611
	tristate "FB driver for the UC1611 LCD controller"
	help
	  Generic Framebuffer support for UC1611

config FB_TFT_UC1701
	tristate "FB driver for the UC1701 LCD Controller"
	help
	  Generic Framebuffer support for UC1701

config FB_TFT_UPD161704
	tristate "FB driver for the uPD161704 LCD Controller"
	help
	  Generic Framebuffer support for uPD161704

endif
```
