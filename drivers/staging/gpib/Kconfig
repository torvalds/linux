## drivers/staging/iio/accel/Kconfig
```kconfig
# SPDX-License-Identifier: GPL-2.0
#
# Accelerometer drivers
#
menu "Accelerometers"

config ADIS16203
	tristate "Analog Devices ADIS16203 Programmable 360 Degrees Inclinometer"
	depends on SPI
	select IIO_ADIS_LIB
	select IIO_ADIS_LIB_BUFFER if IIO_BUFFER
	help
	  Say Y here to build support for Analog Devices adis16203 Programmable
	  360 Degrees Inclinometer.

	  To compile this driver as a module, say M here: the module will be
	  called adis16203.

endmenu
```

## drivers/staging/iio/adc/Kconfig
```kconfig
# SPDX-License-Identifier: GPL-2.0
#
# ADC drivers
#
menu "Analog to digital converters"

config AD7816
	tristate "Analog Devices AD7816/7/8 temperature sensor and ADC driver"
	depends on SPI
	depends on GPIOLIB || COMPILE_TEST
	help
	  Say yes here to build support for Analog Devices AD7816/7/8
	  temperature sensors and ADC.

	  To compile this driver as a module, choose M here: the
	  module will be called ad7816.

endmenu
```

## drivers/staging/iio/addac/Kconfig
```kconfig
#
# ADDAC drivers
#
menu "Analog digital bi-direction converters"

config ADT7316
	tristate "Analog Devices ADT7316/7/8 ADT7516/7/9 temperature sensor, ADC and DAC driver"
	depends on GPIOLIB || COMPILE_TEST
	help
	  Say yes here to build support for Analog Devices ADT7316, ADT7317, ADT7318
	  and ADT7516, ADT7517, ADT7519 temperature sensors, ADC and DAC.

	  To compile this driver as a module, choose M here: the module will
	  be called adt7316.

config ADT7316_SPI
	tristate "support SPI bus connection"
	depends on SPI && ADT7316
	default y
	help
	  Say yes here to build SPI bus support for Analog Devices ADT7316/7/8
	  and ADT7516/7/9.

	  To compile this driver as a module, choose M here: the module will
	  be called adt7316_spi.

config ADT7316_I2C
	tristate "support I2C bus connection"
	depends on I2C && ADT7316
	help
	  Say yes here to build I2C bus support for Analog Devices ADT7316/7/8
	  and ADT7516/7/9.

	  To compile this driver as a module, choose M here: the module will
	  be called adt7316_i2c.

endmenu
```

## drivers/staging/iio/cdc/Kconfig
```kconfig
# SPDX-License-Identifier: GPL-2.0
#
# CDC drivers
#
menu "Capacitance to digital converters"

config AD7746
	tristate "Analog Devices AD7745, AD7746 AD7747 capacitive sensor driver"
	depends on I2C
	help
	  Say yes here to build support for Analog Devices capacitive sensors.
	  (AD7745, AD7746, AD7747) Provides direct access via sysfs.

	  To compile this driver as a module, choose M here: the
	  module will be called ad7746.

endmenu
```

## drivers/staging/iio/dac/Kconfig
```kconfig
#
# DAC drivers
#
menu "Digital to analog converters"

config AD5064
	tristate "Analog Devices AD5064/64-1/65/44/45/24/25, AD5628/48/66/68 DAC driver"
	depends on SPI
	help
	  Say yes here to build support for Analog Devices AD5024, AD5025, AD5044,
	  AD5045, AD5064, AD5064-1, AD5065, AD5628, AD5648, AD5666, AD5668 Digital
	  to Analog Converter.

	  To compile this driver as a module, choose M here: the
	  module will be called ad5064.

config AD5360
	tristate "Analog Devices Analog Devices AD5360/61/62/63/70/71/73 DAC driver"
	depends on SPI
	help
	  Say yes here to build support for Analog Devices AD5360, AD5361,
	  AD5362, AD5363, AD5370, AD5371, AD5373 multi-channel
	  Digital to Analog Converters (DAC).

	  To compile this driver as module choose M here: the module will be called
	  ad5360.

config AD5380
	tristate "Analog Devices AD5380/81/82/83/84/90/91/92 DAC driver"
	depends on (SPI_MASTER || I2C)
	select REGMAP_I2C if I2C
	select REGMAP_SPI if SPI_MASTER
	help
	  Say yes here to build support for Analog Devices AD5380, AD5381,
	  AD5382, AD5383, AD5384, AD5390, AD5391, AD5392 multi-channel
	  Digital to Analog Converters (DAC).

	  To compile this driver as module choose M here: the module will be called
	  ad5380.

config AD5421
	tristate "Analog Devices AD5421 DAC driver"
	depends on SPI
	help
	  Say yes here to build support for Analog Devices AD5421 loop-powered
	  digital-to-analog convertors (DAC).

	  To compile this driver as module choose M here: the module will be called
	  ad5421.

config AD5624R_SPI
	tristate "Analog Devices AD5624/44/64R DAC spi driver"
	depends on SPI
	help
	  Say yes here to build support for Analog Devices AD5624R, AD5644R and
	  AD5664R converters (DAC). This driver uses the common SPI interface.

config AD5446
	tristate "Analog Devices AD5444/6, AD5620/40/60 and AD5542A/12A DAC SPI driver"
	depends on SPI
	help
	  Say yes here to build support for Analog Devices AD5444, AD5446,
	  AD5512A, AD5542A, AD5543, AD5553, AD5601, AD5611, AD5620, AD5621,
	  AD5640, AD5660, AD5662 DACs.

	  To compile this driver as a module, choose M here: the
	  module will be called ad5446.

config AD5504
	tristate "Analog Devices AD5504/AD5501 DAC SPI driver"
	depends on SPI
	help
	  Say yes here to build support for Analog Devices AD5504, AD5501,
	  High Voltage Digital to Analog Converter.

	  To compile this driver as a module, choose M here: the
	  module will be called ad5504.

config AD5764
	tristate "Analog Devices AD5764/64R/44/44R DAC driver"
	depends on SPI_MASTER
	help
	  Say yes here to build support for Analog Devices AD5764, AD5764R, AD5744,
	  AD5744R Digital to Analog Converter.

	  To compile this driver as a module, choose M here: the
	  module will be called ad5764.

config AD5791
	tristate "Analog Devices AD5760/AD5780/AD5781/AD5790/AD5791 DAC SPI driver"
	depends on SPI
	help
	  Say yes here to build support for Analog Devices AD5760, AD5780,
	  AD5781, AD5790, AD5791 High Resolution Voltage Output Digital to
	  Analog Converter.

	  To compile this driver as a module, choose M here: the
	  module will be called ad5791.

config AD5686
	tristate "Analog Devices AD5686R/AD5685R/AD5684R DAC SPI driver"
	depends on SPI
	help
	  Say yes here to build support for Analog Devices AD5686R, AD5685R,
	  AD5684R, AD5791 Voltage Output Digital to
	  Analog Converter.

	  To compile this driver as a module, choose M here: the
	  module will be called ad5686.

config MAX517
	tristate "Maxim MAX517/518/519 DAC driver"
	depends on I2C && EXPERIMENTAL
	help
	  If you say yes here you get support for the Maxim chips MAX517,
	  MAX518 and MAX519 (I2C 8-Bit DACs with rail-to-rail outputs).

	  This driver can also be built as a module.  If so, the module
	  will be called max517.

endmenu
```

## drivers/staging/iio/dds/Kconfig
```kconfig
#
# Direct Digital Synthesis drivers
#
comment "Direct Digital Synthesis"

config AD5930
	tristate "Analog Devices ad5930/5932 driver"
	depends on SPI
	help
	  Say yes here to build support for Analog Devices DDS chip
	  ad5930/ad5932, provides direct access via sysfs.

config AD9832
	tristate "Analog Devices ad9832/5 driver"
	depends on SPI
	help
	  Say yes here to build support for Analog Devices DDS chip
	  AD9832 and AD9835, provides direct access via sysfs.

	  To compile this driver as a module, choose M here: the
	  module will be called ad9832.

config AD9834
	tristate "Analog Devices AD9833/4/7/8 driver"
	depends on SPI
	help
	  Say yes here to build support for Analog Devices DDS chip
	  AD9833, AD9834, AD9837 and AD9838, provides direct access via sysfs.

	  To compile this driver as a module, choose M here: the
	  module will be called ad9834.

config AD9850
	tristate "Analog Devices ad9850/1 driver"
	depends on SPI
	help
	  Say yes here to build support for Analog Devices DDS chip
	  ad9850/1, provides direct access via sysfs.

config AD9852
	tristate "Analog Devices ad9852/4 driver"
	depends on SPI
	help
	  Say yes here to build support for Analog Devices DDS chip
	  ad9852/4, provides direct access via sysfs.

config AD9910
	tristate "Analog Devices ad9910 driver"
	depends on SPI
	help
	  Say yes here to build support for Analog Devices DDS chip
	  ad9910, provides direct access via sysfs.

config AD9951
	tristate "Analog Devices ad9951 driver"
	depends on SPI
	help
	  Say yes here to build support for Analog Devices DDS chip
	  ad9951, provides direct access via sysfs.
```

## drivers/staging/iio/frequency/Kconfig
```kconfig
# SPDX-License-Identifier: GPL-2.0
#
# Direct Digital Synthesis drivers
#
menu "Direct Digital Synthesis"

config AD9832
	tristate "Analog Devices ad9832/5 driver"
	depends on SPI
	help
	  Say yes here to build support for Analog Devices DDS chip
	  AD9832 and AD9835, provides direct access via sysfs.

	  To compile this driver as a module, choose M here: the
	  module will be called ad9832.

config AD9834
	tristate "Analog Devices AD9833/4/7/8 driver"
	depends on SPI
	help
	  Say yes here to build support for Analog Devices DDS chip
	  AD9833, AD9834, AD9837 and AD9838, provides direct access via sysfs.

	  To compile this driver as a module, choose M here: the
	  module will be called ad9834.

endmenu
```

## drivers/staging/iio/gyro/Kconfig
```kconfig
#
# IIO Digital Gyroscope Sensor drivers configuration
#
menu "Digital gyroscope sensors"

config ADIS16060
	tristate "Analog Devices ADIS16060 Yaw Rate Gyroscope with SPI driver"
	depends on SPI
	help
	  Say Y (yes) here to build support for Analog Devices adis16060 wide bandwidth
	  yaw rate gyroscope with SPI.

	  To compile this driver as a module, say M here: the module will be
	  called adis16060. If unsure, say N.

endmenu
```

## drivers/staging/iio/impedance-analyzer/Kconfig
```kconfig
#
# Impedance Converter, Network Analyzer drivers
#
menu "Network Analyzer, Impedance Converters"

config AD5933
	tristate "Analog Devices AD5933, AD5934 driver"
	depends on I2C
	select IIO_BUFFER
	select IIO_KFIFO_BUF
	help
	  Say yes here to build support for Analog Devices Impedance Converter,
	  Network Analyzer, AD5933/4.

	  To compile this driver as a module, choose M here: the
	  module will be called ad5933.

endmenu
```

## drivers/staging/iio/imu/Kconfig
```kconfig
#
# IIO imu drivers configuration
#
menu "Inertial measurement units"

config ADIS16400
	tristate "Analog Devices ADIS16400 and similar IMU SPI driver"
	depends on SPI
	select IIO_SW_RING if IIO_BUFFER
	select IIO_TRIGGER if IIO_BUFFER
	help
	  Say yes here to build support for Analog Devices adis16300, adis16344,
	  adis16350, adis16354, adis16355, adis16360, adis16362, adis16364,
	  adis16365, adis16400 and adis16405 triaxial inertial sensors
	  (adis16400 series also have magnetometers).

endmenu

config IIO_ADIS_LIB
	tristate
	help
	  A set of IO helper functions for the Analog Devices ADIS* device family.

config IIO_ADIS_LIB_BUFFER
	bool
	select IIO_TRIGGER
	select IIO_SW_RING
	help
	  A set of buffer helper functions for the Analog Devices ADIS* device
	  family.
```

## drivers/staging/iio/imu/inv_mpu/Kconfig
```kconfig
# SPDX-License-Identifier: GPL-2.0
#
# inv-mpu-iio driver for Invensense MPU devices and combos
#

config INV_MPU_IIO
	tristate "Invensense MPU devices"
	depends on I2C && SYSFS && IIO && IIO_KFIFO_BUF && IIO_TRIGGER && !INV_MPU
	default n
	help
	  This driver supports the Invensense MPU devices.
	  This includes MPU6050/MPU3050/MPU9150/ITG3500/MPU6500/MPU9250.
	  This driver can be built as a module. The module will be called
	  inv-mpu-iio.

config INV_IIO_MPU3050_ACCEL_SLAVE_BMA250
	bool  "Invensense MPU3050 slave accelerometer device for bma250"
	depends on INV_MPU_IIO
	default n
	help
	  This is slave device enable MPU3050 accelerometer slave device.
	  Right now, it is only bma250. For other acceleromter device,
	  it can be added to this menu if the proper interface is filled.
	  There are some interface function to be defined.

config INV_TESTING
	bool "Invensense IIO testing hooks"
	depends on INV_MPU_IIO || INV_AMI306_IIO || INV_YAS530 || INV_HUB_IIO
	default n
	help
	  This flag enables display of additional testing information from the
	  Invensense IIO drivers
```

## drivers/staging/iio/light/Kconfig
```kconfig
#
# Light sensors
#
menu "Light sensors"

config TSL2772
	tristate "TAOS TSL/TMD2x71 and TSL/TMD2x72 Family of light and proximity sensors"
	depends on I2C
	help
	 Support for: tsl2571, tsl2671, tmd2671, tsl2771, tmd2771, tsl2572, tsl2672,
	 tmd2672, tsl2772, tmd2772 devices.
	 Provides iio_events and direct access via sysfs.

endmenu
```

## drivers/staging/iio/magnetometer/Kconfig
```kconfig
#
# Magnetometer sensors
#
menu "Magnetometer sensors"

config SENSORS_HMC5843
	tristate
	select IIO_BUFFER
	select IIO_TRIGGERED_BUFFER

config SENSORS_HMC5843_I2C
	tristate "Honeywell HMC5843/5883/5883L 3-Axis Magnetometer (I2C)"
	depends on I2C
	select SENSORS_HMC5843
	select REGMAP_I2C
	help
	  Say Y here to add support for the Honeywell HMC5843, HMC5883 and
	  HMC5883L 3-Axis Magnetometer (digital compass).

	  This driver can also be compiled as a set of modules.
	  If so, these modules will be created:
	  - hmc5843_core (core functions)
	  - hmc5843_i2c (support for HMC5843, HMC5883, HMC5883L and HMC5983)

config SENSORS_HMC5843_SPI
	tristate "Honeywell HMC5983 3-Axis Magnetometer (SPI)"
	depends on SPI_MASTER
	select SENSORS_HMC5843
	select REGMAP_SPI
	help
	  Say Y here to add support for the Honeywell HMC5983 3-Axis Magnetometer
	  (digital compass).

	  This driver can also be compiled as a set of modules.
	  If so, these modules will be created:
	  - hmc5843_core (core functions)
	  - hmc5843_spi (support for HMC5983)


endmenu
```

## drivers/staging/iio/meter/Kconfig
```kconfig
# SPDX-License-Identifier: GPL-2.0
#
# IIO meter drivers configuration
#
menu "Active energy metering IC"

config ADE7854
	tristate "Analog Devices ADE7854/58/68/78 Polyphase Multifunction Energy Metering IC Driver"
	depends on SPI || I2C
	help
	  Say yes here to build support for Analog Devices ADE7854/58/68/78 Polyphase
	  Multifunction Energy Metering IC Driver.

	  To compile this driver as a module, choose M here: the
	  module will be called ade7854.

config ADE7854_I2C
	tristate "support I2C bus connection"
	depends on ADE7854 && I2C
	default y
	help
	  Say Y here if you have ADE7854/58/68/78 hooked to an I2C bus.

	  To compile this driver as a module, choose M here: the
	  module will be called ade7854-i2c.

config ADE7854_SPI
	tristate "support SPI bus connection"
	depends on ADE7854 && SPI
	default y
	help
	  Say Y here if you have ADE7854/58/68/78 hooked to a SPI bus.

	  To compile this driver as a module, choose M here: the
	  module will be called ade7854-spi.

endmenu
```

## drivers/staging/iio/resolver/Kconfig
```kconfig
# SPDX-License-Identifier: GPL-2.0
#
# Resolver/Synchro drivers
#
menu "Resolver to digital converters"

config AD2S1210
	tristate "Analog Devices ad2s1210 driver"
	depends on SPI
	depends on GPIOLIB || COMPILE_TEST
	help
	  Say yes here to build support for Analog Devices spi resolver
	  to digital converters, ad2s1210, provides direct access via sysfs.

	  To compile this driver as a module, choose M here: the
	  module will be called ad2s1210.

endmenu
```

## drivers/staging/iio/trigger/Kconfig
```kconfig
  #
# Industrial I/O standalone triggers
#
comment "Triggers - standalone"

if IIO_TRIGGER

config IIO_BFIN_TMR_TRIGGER
	tristate "Blackfin TIMER trigger"
	depends on BLACKFIN
	select BFIN_GPTIMERS
	help
	  Provides support for using a Blackfin timer as IIO triggers.
	  If unsure, say N (but it's safe to say "Y").

	  To compile this driver as a module, choose M here: the
	  module will be called iio-trig-bfin-timer.

endif # IIO_TRIGGER
```
