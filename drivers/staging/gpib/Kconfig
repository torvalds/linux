## drivers/staging/gpib/Kconfig
```kconfig
# SPDX-License-Identifier: GPL-2.0
menuconfig GPIB
	tristate "Linux GPIB drivers"
	help
	  Enable support for GPIB cards and dongles for Linux.  GPIB
	  is the General Purpose Interface Bus which conforms to the
	  IEEE488 standard.

	  This set of drivers can be used with the corresponding user
	  space library that can be found on Sourceforge under linux-gpib.
	  Select the drivers for your hardware from the list.

if GPIB

config GPIB_COMMON
	tristate "GPIB core"
	help

	  Core common driver for all GPIB drivers. It provides the
	  interface for the userland library

	  To compile this driver as a module, choose M here: the module will be
	  called gpib_common

config GPIB_AGILENT_82350B
	tristate "Agilent 8235xx PCI(e) adapters"
	depends on PCI
	select GPIB_COMMON
	select GPIB_TMS9914
	help
	  Enable support for HP/Agilent/Keysight boards
	    82350A
	    82350B
	    82351A

	  To compile this driver as a module, choose M here: the module will be
	  called agilent_82350b.

config GPIB_AGILENT_82357A
	tristate "Agilent 82357a/b USB dongles"
	select GPIB_COMMON
	depends on USB
	help
	  Enable support for Agilent/Keysight 82357x USB dongles.

	  To compile this driver as a module, choose M here: the module will be
	  called agilent_82357a.

config GPIB_CEC_PCI
	tristate "CEC PCI board"
	depends on PCI
	depends on HAS_IOPORT
	select GPIB_COMMON
	select GPIB_NEC7210
	help
	  Enable support for Capital Equipment Corporation PCI-488
	  and Keithly KPCI-488 boards.

	  To compile this driver as a module, choose M here: the module will be
	  called cec_gpib.

config GPIB_NI_PCI_ISA
	tristate "NI PCI/ISA compatible boards"
	depends on ISA_BUS || PCI || PCMCIA
	depends on HAS_IOPORT
	depends on PCMCIA || !PCMCIA
	depends on HAS_IOPORT_MAP
	select GPIB_COMMON
	select GPIB_NEC7210
	help
	  Enable support for National Instruments boards based
	  on TNT4882 chips:
	     AT-GPIB (with NAT4882 chip)
	     AT-GPIB (with NEC7210 chip)
	     AT-GPIB/TNT
	     PCI-GPIB
	     PCIe-GPIB
	     PCI-GPIB+
	     PCM-GPIB
	     PXI-GPIB
	     PCMCIA-GPIB
	     and Capital Equipment Corporation CEC-488 board.

	  To compile this driver as a module, choose M here: the module will be
	  called tnt4882.

config GPIB_CB7210
       tristate "Measurement Computing compatible boards"
	depends on HAS_IOPORT
	depends on ISA_BUS || PCI || PCMCIA
	depends on PCMCIA || !PCMCIA
       select GPIB_COMMON
	select GPIB_NEC7210
       help
       Enable support for Measurement Computing (Computer Boards):
       CPCI_GPIB, ISA-GPIB, ISA-GPIB/LC, PCI-GPIB/1M, PCI-GPIB/300K and
       PCMCIA-GPIB
       Quancom PCIGPIB-1 with MC cb7210 chip

	  To compile this driver as a module, choose M here: the module will be

config GPIB_NI_USB
	tristate "NI USB dongles"
	select GPIB_COMMON
	depends on USB
	help
	  Enable support for National Instruments
	       GPIB-USB-B
	       GPIB-USB-HS
	       GPIB-USB-HS+
	   Keithly
	       KUSB-488
	       KUSB-488A
	   Measurement Computing (Computer Boards)
	       USB-488

	  To compile this driver as a module, choose M here: the module will be
	  called ni_usb.

config GPIB_FLUKE
       tristate "Fluke"
	depends on OF
       select GPIB_COMMON
       select GPIB_NEC7210
       help
         GPIB driver for Fluke based cda devices.

	 To compile this driver as a module, choose M here: the module will be
	 called fluke_gpib

config GPIB_FMH
       tristate "FMH FPGA based devices"
       select GPIB_COMMON
       select GPIB_NEC7210
       depends on !PPC
       depends on OF && PCI
       help
         GPIB driver for fmhess FPGA based devices

	 To compile this driver as a module, choose M here: the module will be
	 called fmh_gpib

config GPIB_GPIO
       tristate "RPi GPIO bitbang"
	depends on ARCH_BCM2835 || COMPILE_TEST
       select GPIB_COMMON
       help
         GPIB bitbang driver Raspberry Pi GPIO adapters

	 To compile this driver as a module, choose M here: the module will be
	 called gpib_bitbang

config GPIB_HP82335
       tristate "HP82335/HP27209"
	depends on ISA_BUS
       select GPIB_COMMON
       select GPIB_TMS9914
       help
         GPIB driver for HP82335 and HP27209 boards

	 To compile this driver as a module, choose M here: the module will be
	 called hp82335


config GPIB_HP82341
       tristate "HP82341x"
       select GPIB_COMMON
       select GPIB_TMS9914
       depends on ISA_BUS || EISA
       help
         GPIB driver for HP82341 A/B/C/D boards

	 To compile this driver as a module, choose M here: the module will be
	 called hp82341

config GPIB_INES
       tristate "INES"
	depends on PCI || ISA_BUS || PCMCIA
	depends on PCMCIA || !PCMCIA
	depends on HAS_IOPORT
       select GPIB_COMMON
       select GPIB_NEC7210
       help
         GPIB driver for Ines compatible boards
	 Ines
	    GPIB-HS-NT
	    GPIB for Compact PCI
	    GPIB for PCI
	    GPIB for PCMCIA
	    GPIB PC/104
	 Hameg
	    HO80-2
	 Quancom
	    PCIGPIB-1 based on Ines iGPIB 72010 chip

	 To compile this driver as a module, choose M here: the module will be
	 called ines_gpib
	  called cb7210.

config GPIB_PCMCIA
       def_bool y
       depends on PCMCIA && (GPIB_NI_PCI_ISA || GPIB_CB7210 || GPIB_INES)
       help
         Enable PCMCIA/CArdbus support for National Instruments,
	 measurement computing boards and Ines boards.

config GPIB_LPVO
       tristate "LPVO DIY USB GPIB"
       select GPIB_COMMON
       depends on USB
       help
         Enable support for LPVO Self-made usb-gpib adapter

	 To compile this driver as a module, choose M here: the module will be
	 called lpvo_usb_gpib

config GPIB_PC2
       tristate "PC2 PC2a"
	depends on ISA_BUS
	depends on HAS_IOPORT
       select GPIB_COMMON
       select GPIB_NEC7210
       help
         Enable support for pc2 and pc2a compatible adapters
	    Capital Equipment Corporation PC-488
	    CONTEC GP-IB(PC)
	    Hameg HO80
	    Iotech GP488B
	    Keithly MBC-488
	    Measurement Computing ISA-GPIB-PCA2
	    National Instruments PCII, PCIIa and PCII/IIa

	 To compile this driver as a module, choose M here: the module will be
	 called pc2_gpib


config GPIB_TMS9914
       tristate
       select GPIB_COMMON
       help
         Enable support for TMS 9914 chip.

	 To compile this driver as a module, choose M here: the module will be
	 called tms9914

config GPIB_NEC7210
       tristate
       select GPIB_COMMON
       help
         Enable support for NEC 7210 compatible chips.

	 To compile this driver as a module, choose M here: the module will be
	 called nec7210

endif # GPIB
```

## drivers/staging/greybus/Kconfig
```kconfig
# SPDX-License-Identifier: GPL-2.0
if GREYBUS

config GREYBUS_AUDIO
	tristate "Greybus Audio Class driver"
	depends on SOUND && SND_SOC
	help
	  Select this option if you have a device that follows the
	  Greybus Audio Class specification.

	  To compile this code as a module, chose M here: the module
	  will be called gb-audio.ko

config GREYBUS_AUDIO_APB_CODEC
	tristate "Greybus APBridge Audio codec driver"
	depends on SND_SOC && GREYBUS_AUDIO
	help
	  Select this option if you have a Toshiba APB device that has I2S
          ports and acts as a Greybus "Dummy codec". This device is a
          bridge from an APB-I2S port to a Unipro network.

	  To compile this code as a module, chose M here: the module
	  will be called gb-audio-codec.ko


config GREYBUS_BOOTROM
	tristate "Greybus Bootrom Class driver"
	help
	  Select this option if you have a device that follows the
	  Greybus Bootrom Class specification.

	  To compile this code as a module, chose M here: the module
	  will be called gb-bootrom.ko

config GREYBUS_CAMERA
	tristate "Greybus Camera Class driver"
	depends on MEDIA_SUPPORT && LEDS_CLASS_FLASH && BROKEN
	help
	  Select this option if you have a device that follows the
	  Greybus Camera Class specification.

	  To compile this code as a module, chose M here: the module
	  will be called gb-camera.ko

config GREYBUS_FIRMWARE
	tristate "Greybus Firmware Download Class driver"
	depends on SPI
	help
	  Select this option if you have a device that follows the
	  Greybus Firmware Download Class specification.

	  To compile this code as a module, chose M here: the module
	  will be called gb-firmware.ko

config GREYBUS_HID
	tristate "Greybus HID Class driver"
	depends on HID && INPUT
	help
	  Select this option if you have a device that follows the
	  Greybus HID Class specification.

	  To compile this code as a module, chose M here: the module
	  will be called gb-hid.ko

config GREYBUS_LIGHT
	tristate "Greybus LED Class driver"
	depends on LEDS_CLASS
	help
	  Select this option if you have a device that follows the
	  Greybus LED Class specification.

	  To compile this code as a module, chose M here: the module
	  will be called gb-light.ko

config GREYBUS_LOG
	tristate "Greybus Debug Log Class driver"
	help
	  Select this option if you have a device that follows the
	  Greybus Debug Log Class specification.

	  To compile this code as a module, chose M here: the module
	  will be called gb-log.ko

config GREYBUS_LOOPBACK
	tristate "Greybus Loopback Class driver"
	help
	  Select this option if you have a device that follows the
	  Greybus Debug Log Class specification.

	  To compile this code as a module, chose M here: the module
	  will be called gb-log.ko

config GREYBUS_POWER
	tristate "Greybus Powersupply Class driver"
	depends on POWER_SUPPLY
	help
	  Select this option if you have a device that follows the
	  Greybus Powersupply Class specification.

	  To compile this code as a module, chose M here: the module
	  will be called gb-power-supply.ko

config GREYBUS_RAW
	tristate "Greybus Raw Class driver"
	help
	  Select this option if you have a device that follows the
	  Greybus Raw Class specification.

	  To compile this code as a module, chose M here: the module
	  will be called gb-raw.ko

config GREYBUS_VIBRATOR
	tristate "Greybus Vibrator Motor Class driver"
	help
	  Select this option if you have a device that follows the
	  Greybus Vibrator Motor Class specification.

	  To compile this code as a module, chose M here: the module
	  will be called gb-vibrator.ko

menuconfig GREYBUS_BRIDGED_PHY
	tristate "Greybus Bridged PHY Class drivers"
	help
	  Select this option to pick from a variety of Greybus Bridged
	  PHY class drivers.  These drivers emulate a number of
	  different "traditional" busses by tunneling them over Greybus.
	  Examples of this include serial, SPI, USB, and others.

	  To compile this code as a module, chose M here: the module
	  will be called gb-phy.ko

if GREYBUS_BRIDGED_PHY

config GREYBUS_GPIO
	tristate "Greybus GPIO Bridged PHY driver"
	depends on GPIOLIB
	select GPIOLIB_IRQCHIP
	help
	  Select this option if you have a device that follows the
	  Greybus GPIO Bridged PHY Class specification.

	  To compile this code as a module, chose M here: the module
	  will be called gb-gpio.ko

config GREYBUS_I2C
	tristate "Greybus I2C Bridged PHY driver"
	depends on I2C
	help
	  Select this option if you have a device that follows the
	  Greybus I2C Bridged PHY Class specification.

	  To compile this code as a module, chose M here: the module
	  will be called gb-i2c.ko

config GREYBUS_PWM
	tristate "Greybus PWM Bridged PHY driver"
	depends on PWM
	help
	  Select this option if you have a device that follows the
	  Greybus PWM Bridged PHY Class specification.

	  To compile this code as a module, chose M here: the module
	  will be called gb-pwm.ko

config GREYBUS_SDIO
	tristate "Greybus SDIO Bridged PHY driver"
	depends on MMC
	help
	  Select this option if you have a device that follows the
	  Greybus SDIO Bridged PHY Class specification.

	  To compile this code as a module, chose M here: the module
	  will be called gb-sdio.ko

config GREYBUS_SPI
	tristate "Greybus SPI Bridged PHY driver"
	depends on SPI
	help
	  Select this option if you have a device that follows the
	  Greybus SPI Bridged PHY Class specification.

	  To compile this code as a module, chose M here: the module
	  will be called gb-spi.ko

config GREYBUS_UART
	tristate "Greybus UART Bridged PHY driver"
	depends on TTY
	help
	  Select this option if you have a device that follows the
	  Greybus UART Bridged PHY Class specification.

	  To compile this code as a module, chose M here: the module
	  will be called gb-uart.ko

config GREYBUS_USB
	tristate "Greybus USB Host Bridged PHY driver"
	depends on USB
	help
	  Select this option if you have a device that follows the
	  Greybus USB Host Bridged PHY Class specification.

	  To compile this code as a module, chose M here: the module
	  will be called gb-usb.ko

endif	# GREYBUS_BRIDGED_PHY

config GREYBUS_ARCHE
	tristate "Greybus Arche Platform driver"
	depends on USB_HSIC_USB3613 || COMPILE_TEST
	help
	  Select this option if you have an Arche device.

	  To compile this code as a module, chose M here: the module
	  will be called gb-arche.ko

endif	# GREYBUS
```

## drivers/staging/gs_fpgaboot/Kconfig
```kconfig
# SPDX-License-Identifier: GPL-2.0
#
# "xilinx FPGA firmware download, fpgaboot"
#
config GS_FPGABOOT
	tristate "Xilinx FPGA firmware download module"
	help
	  Xilinx FPGA firmware download module
```

## drivers/staging/heci/Kconfig
```kconfig
config HECI
	tristate "Intel Management Engine Interface (MEI) Support"
	depends on PCI
	---help---
	  The Intel Management Engine Interface (Intel MEI) driver allows
	  applications to access the Active Management Technology
	  firmware and other Management Engine sub-systems.
```

## drivers/staging/hikey9xx/Kconfig
```kconfig
# SPDX-License-Identifier: GPL-2.0

# to be placed at drivers/mfd
config MFD_HI6421_SPMI
	tristate "HiSilicon Hi6421v600 SPMI PMU/Codec IC"
	depends on HAS_IOMEM
	depends on OF
	depends on SPMI
	select MFD_CORE
	select REGMAP_SPMI
	help
	  Add support for HiSilicon Hi6421v600 SPMI PMIC. Hi6421 includes
	  multi-functions, such as regulators, RTC, codec, Coulomb counter,
	  etc.

	  This driver includes core APIs _only_. You have to select
	  individual components like voltage regulators under corresponding
	  menus in order to enable them.
	  We communicate with the Hi6421v600 via a SPMI bus.
```

## drivers/staging/hv/Kconfig
```kconfig
config HYPERV_STORAGE
	tristate "Microsoft Hyper-V virtual storage driver"
	depends on HYPERV && SCSI
	help
	 Select this option to enable the Hyper-V virtual storage driver.
```

## drivers/staging/i4l/Kconfig
```kconfig
#
# Old ISDN4Linux config
#
menu "Old ISDN4Linux (deprecated)"
	depends on ISDN_I4L

source "drivers/staging/i4l/icn/Kconfig"

source "drivers/staging/i4l/pcbit/Kconfig"

source "drivers/staging/i4l/act2000/Kconfig"

endmenu
```

## drivers/staging/i4l/pcbit/Kconfig
```kconfig
config ISDN_DRV_PCBIT
	tristate "PCBIT-D support"
	depends on ISA && (BROKEN || X86)
	help
	  This enables support for the PCBIT ISDN-card.  This card is
	  manufactured in Portugal by Octal.  For running this card,
	  additional firmware is necessary, which has to be downloaded into
	  the card using a utility which is distributed separately.  See
	  <file:Documentation/isdn/README> and
	  <file:Documentation/isdn/README.pcbit> for more information.
```

## drivers/staging/iio/Kconfig
```kconfig
# SPDX-License-Identifier: GPL-2.0
#
# Industrial I/O subsystem configuration
#
menu "IIO staging drivers"
	depends on IIO

source "drivers/staging/iio/accel/Kconfig"
source "drivers/staging/iio/adc/Kconfig"
source "drivers/staging/iio/addac/Kconfig"
source "drivers/staging/iio/cdc/Kconfig"
source "drivers/staging/iio/frequency/Kconfig"
source "drivers/staging/iio/impedance-analyzer/Kconfig"
source "drivers/staging/iio/meter/Kconfig"
source "drivers/staging/iio/resolver/Kconfig"

endmenu
```
