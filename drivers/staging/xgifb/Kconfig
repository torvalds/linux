## drivers/staging/xgifb/Kconfig
```kconfig
config FB_XGI
	tristate "XGI display support"
	depends on FB && PCI
	select FB_CFB_FILLRECT
	select FB_CFB_COPYAREA
	select FB_CFB_IMAGEBLIT
	help
	  This driver supports notebooks with XGI Z7,Z9,Z11 PCI chips.
	  Say Y if you have such a graphics card.
	  To compile this driver as a module, choose M here: the
	  module will be called xgifb.ko
```

## drivers/staging/zcache/Kconfig
```kconfig
config ZCACHE
	bool "Dynamic compression of swap pages and clean pagecache pages"
	depends on CRYPTO=y && SWAP=y && CLEANCACHE && FRONTSWAP
	select CRYPTO_LZO
	default n
	help
	  Zcache doubles RAM efficiency while providing a significant
	  performance boosts on many workloads.  Zcache uses
	  compression and an in-kernel implementation of transcendent
	  memory to store clean page cache pages and swap in RAM,
	  providing a noticeable reduction in disk I/O.

config RAMSTER
	bool "Cross-machine RAM capacity sharing, aka peer-to-peer tmem"
	depends on CONFIGFS_FS=y && SYSFS=y && !HIGHMEM && ZCACHE=y
	depends on NET
	# must ensure struct page is 8-byte aligned
	select HAVE_ALIGNED_STRUCT_PAGE if !64_BIT
	default n
	help
	  RAMster allows RAM on other machines in a cluster to be utilized
	  dynamically and symmetrically instead of swapping to a local swap
	  disk, thus improving performance on memory-constrained workloads
	  while minimizing total RAM across the cluster.  RAMster, like
	  zcache2, compresses swap pages into local RAM, but then remotifies
	  the compressed pages to another node in the RAMster cluster.

# Depends on not-yet-upstreamed mm patches to export end_swap_bio_write and
# __add_to_swap_cache, and implement __swap_writepage (which is swap_writepage
# without the frontswap call. When these are in-tree, the dependency on
# BROKEN can be removed
config ZCACHE_WRITEBACK
	bool "Allow compressed swap pages to be writtenback to swap disk"
	depends on ZCACHE=y && BROKEN
	default n
	help
	  Zcache caches compressed swap pages (and other data) in RAM which
	  often improves performance by avoiding I/O's due to swapping.
	  In some workloads with very long-lived large processes, it can
	  instead reduce performance.  Writeback decompresses zcache-compressed
	  pages (in LRU order) when under memory pressure and writes them to
	  the backing swap disk to ameliorate this problem.  Policy driving
	  writeback is still under development.
```

## drivers/staging/zram/Kconfig
```kconfig
config ZRAM
	tristate "Compressed RAM block device support"
	depends on BLOCK
	select LZO_COMPRESS
	select LZO_DECOMPRESS
	default n
	help
	  Creates virtual block devices called /dev/zramX (X = 0, 1, ...).
	  Pages written to these disks are compressed and stored in memory
	  itself. These disks allow very fast I/O and compression provides
	  good amounts of memory savings.

	  It has several use cases, for example: /tmp storage, use as swap
	  disks and maybe many more.

	  See zram.txt for more information.
	  Project home: http://compcache.googlecode.com/

config ZRAM_STATS
	bool "Enable statistics for compressed RAM disks"
	depends on ZRAM
	default y
	help
	  Enable statistics collection for compressed RAM devices. Statistics
	  are exported through ioctl interface, so you have to use zramconfig
	  program to get them. This adds only a minimal overhead.

	  If unsure, say Y.
```

## drivers/staging/zsmalloc/Kconfig
```kconfig
config ZSMALLOC
	bool "Memory allocator for compressed pages"
	depends on MMU
	default n
	help
	  zsmalloc is a slab-based memory allocator designed to store
	  compressed RAM pages.  zsmalloc uses virtual memory mapping
	  in order to reduce fragmentation.  However, this results in a
	  non-standard allocator interface where a handle, not a pointer, is
	  returned by an alloc().  This handle must be mapped in order to
	  access the allocated space.

config PGTABLE_MAPPING
	bool "Use page table mapping to access object in zsmalloc"
	depends on ZSMALLOC
	help
	  By default, zsmalloc uses a copy-based object mapping method to
	  access allocations that span two pages. However, if a particular
	  architecture (ex, ARM) performs VM mapping faster than copying,
	  then you should select this. This causes zsmalloc to use page table
	  mapping rather than copying for object mapping.

	  You can check speed with zsmalloc benchmark[1].
	  [1] https://github.com/spartacus06/zsmalloc
```

## drivers/switch/Kconfig
```kconfig
# SPDX-License-Identifier: GPL-2.0
menuconfig SWITCH
	tristate "Switch class support"
	help
	  Say Y here to enable switch class support. This allows
	  monitoring switches by userspace via sysfs and uevent.

if SWITCH

config SWITCH_GPIO
	tristate "GPIO Swith support"
	depends on GPIOLIB
	help
	  Say Y here to enable GPIO based switch support.

endif # SWITCH
```

## drivers/target/Kconfig
```kconfig
menuconfig TARGET_CORE
	tristate "Generic Target Core Mod (TCM) and ConfigFS Infrastructure"
	depends on SCSI && BLOCK
	select CONFIGFS_FS
	select CRC_T10DIF
	select BLK_SCSI_REQUEST # only for scsi_command_size_tbl..
	default n
	help
	Say Y or M here to enable the TCM Storage Engine and ConfigFS enabled
	control path for target_core_mod.  This includes built-in TCM RAMDISK
	subsystem logic for virtual LUN 0 access

if TARGET_CORE

config TCM_IBLOCK
	tristate "TCM/IBLOCK Subsystem Plugin for Linux/BLOCK"
	select BLK_DEV_INTEGRITY
	help
	Say Y here to enable the TCM/IBLOCK subsystem plugin for non-buffered
	access to Linux/Block devices using BIO

config TCM_FILEIO
	tristate "TCM/FILEIO Subsystem Plugin for Linux/VFS"
	help
	Say Y here to enable the TCM/FILEIO subsystem plugin for buffered
	access to Linux/VFS struct file or struct block_device

config TCM_PSCSI
	tristate "TCM/pSCSI Subsystem Plugin for Linux/SCSI"
	help
	Say Y here to enable the TCM/pSCSI subsystem plugin for non-buffered
	passthrough access to Linux/SCSI device

config TCM_USER2
	tristate "TCM/USER Subsystem Plugin for Linux"
	depends on UIO && NET
	help
	Say Y here to enable the TCM/USER subsystem plugin for a userspace
	process to handle requests. This is version 2 of the ABI; version 1
	is obsolete.

source "drivers/target/loopback/Kconfig"
source "drivers/target/tcm_fc/Kconfig"
source "drivers/target/iscsi/Kconfig"
source "drivers/target/sbp/Kconfig"

endif
```

## drivers/target/iscsi/Kconfig
```kconfig
# SPDX-License-Identifier: GPL-2.0-only
config ISCSI_TARGET
	tristate "SCSI Target Mode Stack"
	depends on INET
	select CRC32
	select CRYPTO
	select CRYPTO_HASH
	help
	Say M to enable the SCSI target mode stack. A SCSI target mode stack
	is software that makes local storage available over a storage network
	to a SCSI initiator system. The supported storage network technologies
	include iSCSI, Fibre Channel and the SCSI RDMA Protocol (SRP).
	Configuration of the SCSI target mode stack happens through configfs.

source	"drivers/target/iscsi/cxgbit/Kconfig"
```

## drivers/target/iscsi/cxgbit/Kconfig
```kconfig
# SPDX-License-Identifier: GPL-2.0-only
config ISCSI_TARGET_CXGB4
	tristate "Chelsio iSCSI target offload driver"
	depends on ISCSI_TARGET && CHELSIO_T4 && INET
	select CHELSIO_LIB
	help
	To compile this driver as module, choose M here: the module
	will be called cxgbit.
```

## drivers/target/loopback/Kconfig
```kconfig
# SPDX-License-Identifier: GPL-2.0-only
config LOOPBACK_TARGET
	tristate "TCM Virtual SAS target and GNU/Linux/SCSI LDD fabric loopback module"
	depends on SCSI
	help
	  Say Y here to enable the TCM Virtual SAS target and GNU/Linux/SCSI LLD
	  fabric loopback module.
```

## drivers/target/sbp/Kconfig
```kconfig
config SBP_TARGET
	tristate "FireWire SBP-2 fabric module"
	depends on FIREWIRE
	help
	  Say Y or M here to enable SCSI target functionality over FireWire.
	  This enables you to expose SCSI devices to other nodes on the FireWire
	  bus, for example hard disks. Similar to FireWire Target Disk mode on
	  many Apple computers.

	  To compile this driver as a module, say M here: The module will be
	  called sbp-target.
```

## drivers/target/tcm_fc/Kconfig
```kconfig
# SPDX-License-Identifier: GPL-2.0-only
config TCM_FC
	tristate "TCM_FC fabric Plugin"
	depends on LIBFC
	help
	Say Y here to enable the TCM FC plugin for accessing FC fabrics in TCM
```

## drivers/target/tcm_remote/Kconfig
```kconfig
# SPDX-License-Identifier: GPL-2.0-only
config REMOTE_TARGET
	tristate "TCM Virtual Remote target"
	depends on SCSI
	help
	  Say Y here to enable the TCM Virtual Remote fabric
	  That fabric is a dummy fabric to tell TCM about configuration
	  of TPG/ACL/LUN on peer nodes in a cluster.
```

## drivers/tee/Kconfig
```kconfig
# SPDX-License-Identifier: GPL-2.0-only
# Generic Trusted Execution Environment Configuration
menuconfig TEE
	tristate "Trusted Execution Environment support"
	depends on HAVE_ARM_SMCCC || COMPILE_TEST || CPU_SUP_AMD
	select CRYPTO_LIB_SHA1
	select DMA_SHARED_BUFFER
	select GENERIC_ALLOCATOR
	help
	  This implements a generic interface towards a Trusted Execution
	  Environment (TEE).

if TEE

config TEE_DMABUF_HEAPS
	bool
	depends on HAS_DMA && DMABUF_HEAPS
	default y

source "drivers/tee/optee/Kconfig"
source "drivers/tee/amdtee/Kconfig"
source "drivers/tee/tstee/Kconfig"
source "drivers/tee/qcomtee/Kconfig"

endif
```

## drivers/tee/amdtee/Kconfig
```kconfig
# SPDX-License-Identifier: MIT
# AMD-TEE Trusted Execution Environment Configuration
config AMDTEE
	tristate "AMD-TEE"
	default m
	depends on CRYPTO_DEV_SP_PSP
	help
	  This implements AMD's Trusted Execution Environment (TEE) driver.
```

## drivers/tee/optee/Kconfig
```kconfig
# SPDX-License-Identifier: GPL-2.0-only
# OP-TEE Trusted Execution Environment Configuration
config OPTEE
	tristate "OP-TEE"
	depends on HAVE_ARM_SMCCC
	depends on MMU
	help
	  This implements the OP-TEE Trusted Execution Environment (TEE)
	  driver.

config OPTEE_INSECURE_LOAD_IMAGE
	bool "Load OP-TEE image as firmware"
	default n
	depends on OPTEE && ARM64
	help
	  This loads the BL32 image for OP-TEE as firmware when the driver is
	  probed. This returns -EPROBE_DEFER until the firmware is loadable from
	  the filesystem which is determined by checking the system_state until
	  it is in SYSTEM_RUNNING. This also requires enabling the corresponding
	  option in Trusted Firmware for Arm. The documentation there explains
	  the security threat associated with enabling this as well as
	  mitigations at the firmware and platform level.
	  https://trustedfirmware-a.readthedocs.io/en/latest/threat_model/threat_model.html

	  Additional documentation on kernel security risks are at
	  Documentation/staging/tee.rst.
```

## drivers/tee/qcomtee/Kconfig
```kconfig
# SPDX-License-Identifier: GPL-2.0-only
# Qualcomm Trusted Execution Environment Configuration
config QCOMTEE
	tristate "Qualcomm TEE Support"
	depends on ARCH_QCOM || COMPILE_TEST
	depends on !CPU_BIG_ENDIAN
	select QCOM_SCM
	select QCOM_TZMEM_MODE_SHMBRIDGE
	help
	  This option enables the Qualcomm Trusted Execution Environment (QTEE)
	  driver. It provides an API to access services offered by QTEE and
	  its loaded Trusted Applications (TAs). Additionally, it facilitates
	  the export of userspace services provided by supplicants to QTEE.
```

## drivers/tee/tstee/Kconfig
```kconfig
# SPDX-License-Identifier: GPL-2.0-only
config ARM_TSTEE
	tristate "Arm Trusted Services TEE driver"
	depends on ARM_FFA_TRANSPORT
	default n
	help
	  The Trusted Services project provides a framework for developing and
	  deploying device Root of Trust services in FF-A Secure Partitions.
	  This driver provides an interface to make Trusted Services Secure
	  Partitions accessible for user space clients, since the FF-A driver
	  doesn't implement a user space interface directly.
```

## drivers/telephony/Kconfig
```kconfig
#
# Telephony device configuration
#

menuconfig PHONE
	tristate "Telephony support"
	depends on HAS_IOMEM
	---help---
	  Say Y here if you have a telephony card, which for example allows
	  you to use a regular phone for voice-over-IP applications.

	  Note: this has nothing to do with modems.  You do not need to say Y
	  here in order to be able to use a modem under Linux.

	  To compile this driver as a module, choose M here: the
	  module will be called phonedev.

if PHONE

config PHONE_IXJ
	tristate "QuickNet Internet LineJack/PhoneJack support"
	depends ISA || PCI
	---help---
	  Say M if you have a telephony card manufactured by Quicknet
	  Technologies, Inc.  These include the Internet PhoneJACK and
	  Internet LineJACK Telephony Cards. You will get a module called
	  ixj.

	  For the ISA versions of these products, you can configure the
	  cards using the isapnp tools (pnpdump/isapnp) or you can use the
	  isapnp support.  Please read <file:Documentation/telephony/ixj.txt>.

	  For more information on these cards, see Quicknet's web site at:
	  <http://www.quicknet.net/>.

	  If you do not have any Quicknet telephony cards, you can safely
	  say N here.

config PHONE_IXJ_PCMCIA
	tristate "QuickNet Internet LineJack/PhoneJack PCMCIA support"
	depends on PHONE_IXJ && PCMCIA
	help
	  Say Y here to configure in PCMCIA service support for the Quicknet
	  cards manufactured by Quicknet Technologies, Inc.  This changes the
	  card initialization code to work with the card manager daemon.

endif # PHONE
```

## drivers/testcode/Kconfig
```kconfig
#
# Input misc drivers configuration
#
menuconfig TEST_CODE
	bool "some test code for kernel"
	help
	  Say Y here, and a list of test code will be displayed.
	  
	  If unsure, say N.

if TEST_CODE
	
config USE_GPIO_GENERATE_WAVE
	tristate "use gpio to generate square wave"
	
endif
```
