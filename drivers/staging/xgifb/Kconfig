## drivers/thermal/broadcom/Kconfig
```kconfig
config BCM2835_THERMAL
	tristate "Thermal sensors on bcm2835 SoC"
	depends on ARCH_BCM2835 || COMPILE_TEST
	depends on HAS_IOMEM
	depends on THERMAL_OF
	help
	  Support for thermal sensors on Broadcom bcm2835 SoCs.

config BRCMSTB_THERMAL
	tristate "Broadcom STB AVS TMON thermal driver"
	depends on ARCH_BRCMSTB || COMPILE_TEST
	help
	  Enable this driver if you have a Broadcom STB SoC and would like
	  thermal framework support.

config BCM_NS_THERMAL
	tristate "Northstar thermal driver"
	depends on ARCH_BCM_IPROC || COMPILE_TEST
	default y if ARCH_BCM_IPROC
	help
	  Support for the Northstar and Northstar Plus family of SoCs (e.g.
	  BCM4708, BCM4709, BCM5301x, BCM95852X, etc). It contains DMU (Device
	  Management Unit) block with a thermal sensor that allows checking CPU
	  temperature.

config BCM_SR_THERMAL
	tristate "Stingray thermal driver"
	depends on ARCH_BCM_IPROC || COMPILE_TEST
	default ARCH_BCM_IPROC
	help
	  Support for the Stingray family of SoCs. Its different blocks like
	  iHost, CRMU and NITRO has thermal sensor that allows checking its
	  temperature.
```

## drivers/thermal/intel/Kconfig
```kconfig
# SPDX-License-Identifier: GPL-2.0-only
config INTEL_POWERCLAMP
	tristate "Intel PowerClamp idle injection driver"
	depends on X86
	depends on CPU_SUP_INTEL
	help
	  Enable this to enable Intel PowerClamp idle injection driver. This
	  enforce idle time which results in more package C-state residency. The
	  user interface is exposed via generic thermal framework.

config X86_THERMAL_VECTOR
	def_bool y
	depends on X86 && CPU_SUP_INTEL && X86_LOCAL_APIC

config X86_PKG_TEMP_THERMAL
	tristate "X86 package temperature thermal driver"
	depends on X86_THERMAL_VECTOR
	select THERMAL_GOV_USER_SPACE
	select THERMAL_WRITABLE_TRIPS
	default m
	help
	  Enable this to register CPU digital sensor for package temperature as
	  thermal zone. Each package will have its own thermal zone. There are
	  two trip points which can be set by user to get notifications via thermal
	  notification methods.

config INTEL_SOC_DTS_IOSF_CORE
	tristate
	depends on X86 && PCI
	select IOSF_MBI
	help
	  This is becoming a common feature for Intel SoCs to expose the additional
	  digital temperature sensors (DTSs) using side band interface (IOSF). This
	  implements the common set of helper functions to register, get temperature
	  and get/set thresholds on DTSs.

config INTEL_SOC_DTS_THERMAL
	tristate "Intel SoCs DTS thermal driver"
	depends on X86 && PCI && ACPI
	select INTEL_SOC_DTS_IOSF_CORE
	select THERMAL_WRITABLE_TRIPS
	help
	  Enable this to register Intel SoCs (e.g. Bay Trail) platform digital
	  temperature sensor (DTS). These SoCs have two additional DTSs in
	  addition to DTSs on CPU cores. Each DTS will be registered as a
	  thermal zone. There are two trip points. One of the trip point can
	  be set by user mode programs to get notifications via Linux thermal
	  notification methods.The other trip is a critical trip point, which
	  was set by the driver based on the TJ MAX temperature.

config INTEL_QUARK_DTS_THERMAL
	tristate "Intel Quark DTS thermal driver"
	depends on X86_INTEL_QUARK
	help
	  Enable this to register Intel Quark SoC (e.g. X1000) platform digital
	  temperature sensor (DTS). For X1000 SoC, it has one on-die DTS.
	  The DTS will be registered as a thermal zone. There are two trip points:
	  hot & critical. The critical trip point default value is set by
	  underlying BIOS/Firmware.

menu "ACPI INT340X thermal drivers"
source "drivers/thermal/intel/int340x_thermal/Kconfig"
endmenu

config INTEL_BXT_PMIC_THERMAL
	tristate "Intel Broxton PMIC thermal driver"
	depends on X86 && INTEL_SOC_PMIC_BXTWC && REGMAP
	help
	  Select this driver for Intel Broxton PMIC with ADC channels monitoring
	  system temperature measurements and alerts.
	  This driver is used for monitoring the ADC channels of PMIC and handles
	  the alert trip point interrupts and notifies the thermal framework with
	  the trip point and temperature details of the zone.

config INTEL_PCH_THERMAL
	tristate "Intel PCH Thermal Reporting Driver"
	depends on X86 && PCI
	help
	  Enable this to support thermal reporting on certain intel PCHs.
	  Thermal reporting device will provide temperature reading,
	  programmable trip points and other information.

config INTEL_TCC_COOLING
	tristate "Intel TCC offset cooling Driver"
	depends on X86
	help
	  Enable this to support system cooling by adjusting the effective TCC
	  activation temperature via the TCC Offset register, which is widely
	  supported on modern Intel platforms.
	  Note that, on different platforms, the behavior might be different
	  on how fast the setting takes effect, and how much the CPU frequency
	  is reduced.

config INTEL_MENLOW
	tristate "Thermal Management driver for Intel menlow platform"
	depends on ACPI_THERMAL
	help
	  ACPI thermal management enhancement driver on
	  Intel Menlow platform.

	  If unsure, say N.

config INTEL_HFI_THERMAL
	bool "Intel Hardware Feedback Interface"
	depends on NET
	depends on CPU_SUP_INTEL
	depends on X86_THERMAL_VECTOR
	select THERMAL_NETLINK
	help
	  Select this option to enable the Hardware Feedback Interface. If
	  selected, hardware provides guidance to the operating system on
	  the performance and energy efficiency capabilities of each CPU.
	  These capabilities may change as a result of changes in the operating
	  conditions of the system such power and thermal limits. If selected,
	  the kernel relays updates in CPUs' capabilities to userspace.
```

## drivers/thermal/intel/int340x_thermal/Kconfig
```kconfig
# SPDX-License-Identifier: GPL-2.0-only
#
# ACPI INT340x thermal drivers configuration
#

config INT340X_THERMAL
	tristate "ACPI INT340X thermal drivers"
	depends on X86 && ACPI && PCI
	select THERMAL_GOV_USER_SPACE
	select ACPI_THERMAL_REL
	select ACPI_FAN
	select INTEL_SOC_DTS_IOSF_CORE
	select PROC_THERMAL_MMIO_RAPL if X86_64 && POWERCAP
	help
	  Newer laptops and tablets that use ACPI may have thermal sensors and
	  other devices with thermal control capabilities outside the core
	  CPU/SOC, for thermal safety reasons.
	  They are exposed for the OS to use via the INT3400 ACPI device object
	  as the master, and INT3401~INT340B ACPI device objects as the slaves.
	  Enable this to expose the temperature information and cooling ability
	  from these objects to userspace via the normal thermal framework.
	  This means that a wide range of applications and GUI widgets can show
	  the information to the user or use this information for making
	  decisions. For example, the Intel Thermal Daemon can use this
	  information to allow the user to select his laptop to run without
	  turning on the fans.

config ACPI_THERMAL_REL
	tristate
	depends on ACPI

if INT340X_THERMAL

config INT3406_THERMAL
	tristate "ACPI INT3406 display thermal driver"
	depends on ACPI_VIDEO
	help
	  The display thermal device represents the LED/LCD display panel
	  that may or may not include touch support. The main function of
	  the display thermal device is to allow control of the display
	  brightness in order to address a thermal condition or to reduce
	  power consumed by display device.

config PROC_THERMAL_MMIO_RAPL
	tristate
	select INTEL_RAPL_CORE
endif
```

## drivers/thermal/mediatek/Kconfig
```kconfig
config MTK_THERMAL
	tristate "MediaTek thermal drivers"
	depends on THERMAL_OF
	help
	  This is the option for MediaTek thermal software solutions.
	  Please enable corresponding options to get temperature
	  information from thermal sensors or turn on throttle
	  mechaisms for thermal mitigation.

if MTK_THERMAL

config MTK_SOC_THERMAL
	tristate "AUXADC temperature sensor driver for MediaTek SoCs"
	depends on HAS_IOMEM
	help
	  Enable this option if you want to get SoC temperature
	  information for MediaTek platforms.
	  This driver configures thermal controllers to collect
	  temperature via AUXADC interface.

config MTK_LVTS_THERMAL
        tristate "LVTS Thermal Driver for MediaTek SoCs"
        depends on HAS_IOMEM
        help
          Enable this option if you want to get SoC temperature
          information for supported MediaTek platforms.
          This driver configures LVTS (Low Voltage Thermal Sensor)
          thermal controllers to collect temperatures via ASIF
          (Analog Serial Interface).

config MTK_LVTS_THERMAL_DEBUGFS
       bool "LVTS thermal debugfs"
       depends on MTK_LVTS_THERMAL && DEBUG_FS
       help
         Enable this option to debug the internals of the device driver.

endif
```
