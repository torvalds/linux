## drivers/staging/rdma/Kconfig
```kconfig
menuconfig STAGING_RDMA
        tristate "RDMA staging drivers"
	depends on INFINIBAND
	depends on PCI || BROKEN
	depends on HAS_IOMEM
	depends on NET
	depends on INET
        default n
        ---help---
          This option allows you to select a number of RDMA drivers that
	  fall into one of two categories: deprecated drivers being held
	  here before finally being removed or new drivers that still need
	  some work before being moved to the normal RDMA driver area.

          If you wish to work on these drivers, to help improve them, or
          to report problems you have with them, please use the
	  linux-rdma@vger.kernel.org mailing list.

          If in doubt, say N here.


# Please keep entries in alphabetic order
if STAGING_RDMA

endif
```

## drivers/staging/rdma/hfi1/Kconfig
```kconfig
config INFINIBAND_HFI1
	tristate "Intel OPA Gen1 support"
	depends on X86_64
	default m
	---help---
	This is a low-level driver for Intel OPA Gen1 adapter.
config HFI1_DEBUG_SDMA_ORDER
	bool "HFI1 SDMA Order debug"
	depends on INFINIBAND_HFI1
	default n
	---help---
	This is a debug flag to test for out of order
	sdma completions for unit testing
config HFI1_VERBS_31BIT_PSN
	bool "HFI1 enable 31 bit PSN"
	depends on INFINIBAND_HFI1
	default y
	---help---
	Setting this enables 31 BIT PSN
	For verbs RC/UC
config SDMA_VERBOSITY
	bool "Config SDMA Verbosity"
	depends on INFINIBAND_HFI1
	default n
	---help---
	This is a configuration flag to enable verbose
	SDMA debug
config PRESCAN_RXQ
	bool "Enable prescanning of the RX queue for ECNs"
	depends on INFINIBAND_HFI1
	default n
	---help---
	This option toggles the prescanning of the receive queue for
	Explicit Congestion Notifications. If an ECN is detected, it
	is processed as quickly as possible, the ECN is toggled off.
	After the prescanning step, the receive queue is processed as
	usual.
```

## drivers/staging/rk2818/Kconfig
```kconfig
#
# RK28XX ADC configuration
#
menuconfig RK28
	tristate "RK28 Staging Driver"
	depends on ARCH_RK2818
	
if RK28
config RK28_ADC
	tristate "RK28 ADC Driver"
	default y
	---help---
		RK28 ADC Driver
endif #RK28
```

## drivers/staging/rk2818/rk1000_control/Kconfig
```kconfig
menu "RK1000 control"
config RK1000_CONTROL
	tristate "ROCKCHIP RK1000 CONTROL"
	default n
	help
          rk1000 control module.
endmenu
```

## drivers/staging/rk2818/rk1000_tv/Kconfig
```kconfig
menu "RK1000 TV CONTROL"
config RK1000_TVOUT
    tristate "ROCKCHIP RK1000 TV CONTROL"
    depends on RK1000_CONTROL
	default n
endmenu
```

## drivers/staging/rk2818/rk2818_dsp/Kconfig
```kconfig
menu "DSP"
config RK2818_DSP
	tristate "ROCKCHIP RK2818 DSP"
	default y
	help
          rk28 dsp module.
endmenu
```

## drivers/staging/rk2818/rk2818_power/Kconfig
```kconfig
menu "rk2818 POWER CONTROL"
config RK2818_POWER
	tristate "ROCKCHIP RK2818 POWER CONTROL"
	default y
	help
          rk2818 power operation. Here control chip power reset or power off.
endmenu
```

## drivers/staging/rk29/ipp/Kconfig
```kconfig
# SPDX-License-Identifier: GPL-2.0
menu "IPP"
config RK29_IPP
	tristate "ROCKCHIP RK29 IPP"
	depends on ARCH_RK29 || ARCH_RK30 || ARCH_RK3188
	default m
	help
          rk29 ipp module.	
          
config DEINTERLACE
	bool "Deinterlacing support"
	depends on 	RK29_IPP	
	default y
	help 
					Mobile phone dose not support deinterlacing
	
endmenu
```

## drivers/staging/rk29/vivante/Kconfig
```kconfig
menu "GPU Vivante"
	depends on ARCH_RK29

config VIVANTE
	tristate "ROCKCHIP Vivante GPU"
	default y
	help
          Vivante GPU module.
endmenu
```

## drivers/staging/rspiusb/Kconfig
```kconfig
config USB_RSPI
	tristate "Princeton Instruments USB camera support"
	default n
	depends on USB && BROKEN
	help
	  This driver is for the Princeton Instruments USB camera device.
```

## drivers/staging/rt2860/Kconfig
```kconfig
config RT2860
	tristate "Ralink 2860/3090 wireless support"
	depends on PCI && X86 && WLAN
	select WIRELESS_EXT
	select WEXT_PRIV
	select CRC_CCITT
	select FW_LOADER
	---help---
	  This is an experimental driver for the Ralink 2860 and 3090
	  wireless chips.
```

## drivers/staging/rt2870/Kconfig
```kconfig
config RT2870
	tristate "Ralink 2870/3070 wireless support"
	depends on USB && (X86 || ARM) && WLAN
	select WIRELESS_EXT
	select WEXT_PRIV
	select CRC_CCITT
	select FW_LOADER
	---help---
	  This is an experimental driver for the Ralink xx70 wireless chips.
```

## drivers/staging/rt3070/Kconfig
```kconfig
config RT3070
	tristate "Ralink 3070 wireless support"
	depends on USB && X86 && WLAN_80211
	---help---
	  This is an experimental driver for the Ralink 3070 wireless chip.
```

## drivers/staging/rt3090/Kconfig
```kconfig
config RT3090
	tristate "Ralink 3090 wireless support"
	depends on PCI && X86 && WLAN
	---help---
	  This is an experimental driver for the Ralink 3090 wireless chip.
```

## drivers/staging/rtl8187se/Kconfig
```kconfig
config R8187SE
	tristate "RealTek RTL8187SE Wireless LAN NIC driver"
	depends on PCI && WLAN
	depends on m
	select WIRELESS_EXT
	select WEXT_PRIV
	select EEPROM_93CX6
	select CRYPTO
	default N
	---help---
	  If built as a module, it will be called r8187se.ko.
```

## drivers/staging/rtl8188eu/Kconfig
```kconfig
# SPDX-License-Identifier: GPL-2.0
config R8188EU
	tristate "Realtek RTL8188EU Wireless LAN NIC driver"
	depends on WLAN && USB && CFG80211
	depends on m
	select WIRELESS_EXT
	select WEXT_PRIV
	select LIB80211
	select LIB80211_CRYPT_WEP
	select LIB80211_CRYPT_CCMP
	---help---
	This option adds the Realtek RTL8188EU USB device such as TP-Link TL-WN725N.
	If built as a module, it will be called r8188eu.

if R8188EU

config 88EU_AP_MODE
	bool "Realtek RTL8188EU AP mode"
	default y
	---help---
	This option enables Access Point mode. Unless you know that your system
	will never be used as an AP, or the target system has limited memory,
	"Y" should be selected.

endif
```

## drivers/staging/rtl8192e/Kconfig
```kconfig
# SPDX-License-Identifier: GPL-2.0
config RTLLIB
	tristate "Support for rtllib wireless devices"
	depends on WLAN && m
	select LIB80211
	select CRC32
	help
	  If you have a wireless card that uses rtllib, say
	  Y. Currently the only card is the rtl8192e.

	  If unsure, say N.

	  This driver adds support for rtllib wireless cards.
	  Only the rtl8192e is supported as of now.

if RTLLIB

config RTLLIB_CRYPTO_CCMP
	tristate "Support for rtllib CCMP crypto"
	depends on RTLLIB
	select CRYPTO
	select CRYPTO_AES
	select CRYPTO_CCM
	default y
	help
	  CCMP crypto driver for rtllib.

	  If you enabled RTLLIB, you want this.
	  Adds support for the CCM mode Protocol crypto driver for
	  use in wireless cards (including rtllib cards).

config RTLLIB_CRYPTO_TKIP
	tristate "Support for rtllib TKIP crypto"
	depends on RTLLIB
	select CRYPTO
	select CRYPTO_LIB_ARC4
	select CRYPTO_MICHAEL_MIC
	default y
	help
	  TKIP crypto driver for rtllib.

	  If you enabled RTLLIB, you want this.
	  Adds support for the Temporal Key Integrity Protocol for
	  the IEEE 802.11i standard for use on wireless cards.

config RTLLIB_CRYPTO_WEP
	tristate "Support for rtllib WEP crypto"
	select CRYPTO_LIB_ARC4
	depends on RTLLIB
	default y
	help
	  WEP crypto driver for rtllib.

	  If you enabled RTLLIB, you want this.
	  Adds support for the (now weak) Wired Equivalent Privacy
	  (WEP) crypto protocol for wireless cards.
	  NOTE: This protocol is now considered insecure.

source "drivers/staging/rtl8192e/rtl8192e/Kconfig"

endif
```

## drivers/staging/rtl8192e/rtl8192e/Kconfig
```kconfig
config RTL8192E
	tristate "RealTek RTL8192E Wireless LAN NIC driver"
	depends on PCI && WLAN && RTLLIB
	depends on m
	select WIRELESS_EXT
	select WEXT_PRIV
	select CRYPTO
	select FW_LOADER
```

## drivers/staging/rtl8192ee/Kconfig
```kconfig
config R8192EE
	tristate "Realtek RTL8192EE Wireless Network Adapter"
	depends on PCI && WLAN && MAC80211
	depends on m
	select WIRELESS_EXT
	select WEXT_PRIV
	select EEPROM_93CX6
	select CRYPTO
	select FW_LOADER
	---help---
	This is the driver for Realtek RTL8192EE 802.11 PCIe
	wireless network adapters.

	If you choose to build it as a module, it will be called r8192ee
```

## drivers/staging/rtl8192su/Kconfig
```kconfig
config RTL8192SU
	tristate "RealTek RTL8192SU Wireless LAN NIC driver"
	depends on PCI && WLAN && USB
	select WIRELESS_EXT
	select WEXT_PRIV
	select EEPROM_93CX6
	default N
	---help---
```

## drivers/staging/rtl8192u/Kconfig
```kconfig
# SPDX-License-Identifier: GPL-2.0
config RTL8192U
	tristate "RealTek RTL8192U Wireless LAN NIC driver"
	depends on PCI && WLAN && USB
	depends on m
	select WIRELESS_EXT
	select WEXT_PRIV
	select CRYPTO
	select CRYPTO_AES
	select CRYPTO_CCM
```

## drivers/staging/rtl8712/Kconfig
```kconfig
# SPDX-License-Identifier: GPL-2.0
config R8712U
	tristate "RealTek RTL8712U (RTL8192SU) Wireless LAN NIC driver"
	depends on WLAN && USB && CFG80211
	select WIRELESS_EXT
	select WEXT_PRIV
	select FW_LOADER
	help
	    This option adds the Realtek RTL8712 USB device such as the
	    D-Link DWA-130.

	    If built as a module, it will be called r8712u.

config R8712_TX_AGGR
	bool "Realtek RTL8712U Transmit Aggregation code"
	depends on R8712U && BROKEN
	help
	    This option provides transmit aggregation for the Realtek
	    RTL8712 USB device.
```

## drivers/staging/rtl8723au/Kconfig
```kconfig
config R8723AU
	tristate "Realtek RTL8723AU Wireless LAN NIC driver"
	depends on USB && WLAN && RFKILL
	select WIRELESS_EXT
	select WEXT_PRIV
	select CFG80211
	default n
	---help---
	This option adds the Realtek RTL8723AU USB device such as found in
	the Lenovo Yogi 13 tablet. If built as a module, it will be called r8723au.

if R8723AU

config 8723AU_AP_MODE
	bool "Realtek RTL8723AU AP mode"
	default y
	---help---
	This option enables Access Point mode. Unless you know that your system
	will never be used as an AP, or the target system has limited memory,
	"Y" should be selected.

config 8723AU_BT_COEXIST
	bool "Realtek RTL8723AU BlueTooth Coexistence"
	default y
	---help---
	This option enables icoexistence with BlueTooth communications for the r8723au driver.
	Unless you know that this driver will never by used with BT, or the target system has
	limited memory, "Y" should be selected.

endif
```

## drivers/staging/rtl8723bs/Kconfig
```kconfig
# SPDX-License-Identifier: GPL-2.0
config RTL8723BS
	tristate "Realtek RTL8723BS SDIO Wireless LAN NIC driver"
	depends on WLAN && MMC && CFG80211
	depends on m
	select CFG80211_WEXT
	select CRYPTO_LIB_ARC4
	help
	This option enables support for RTL8723BS SDIO drivers, such as
	the wifi found on the 1st gen Intel Compute Stick, the CHIP
	and many other Intel Atom and ARM based devices.
	If built as a module, it will be called r8723bs.
```

## drivers/staging/rtl8821ae/Kconfig
```kconfig
config R8821AE
	tristate "RealTek RTL8821AE Wireless LAN NIC driver"
	depends on PCI && WLAN && MAC80211
	depends on m
	select WIRELESS_EXT
	select WEXT_PRIV
	select EEPROM_93CX6
	select CRYPTO
	default N
	---help---
	  If built as a module, it will be called r8821ae.ko.
```
