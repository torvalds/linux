## drivers/staging/rtlwifi/Kconfig
```kconfig
config R8822BE
	tristate "Realtek RTL8822BE Wireless Network Adapter"
	depends on PCI && MAC80211 && m
	select FW_LOADER
	help
	This is the staging driver for Realtek RTL8822BE 802.11ac PCIe
	wireless network adapters.

config RTLWIFI_DEBUG_ST
	bool
	depends on R8822BE
	default y
```

## drivers/staging/rts5139/Kconfig
```kconfig
config RTS5139
	tristate "Realtek RTS5139 USB card reader support"
	depends on USB && SCSI
	help
	  Say Y here to include driver code to support the Realtek
	  RTS5139 USB card readers.

	  If this driver is compiled as a module, it will be named rts5139.

config RTS5139_DEBUG
	bool "Realtek RTS5139 Card Reader verbose debug"
	depends on RTS5139
	help
	  Say Y here in order to have the rts5139 code generate
	  verbose debugging messages.
```

## drivers/staging/rts5208/Kconfig
```kconfig
config RTS5208
	tristate "Realtek PCI-E Card Reader RTS5208/5288 support"
	depends on PCI && SCSI
	help
	  Say Y here to include driver code to support the Realtek
	  PCI-E card reader rts5208/rts5288.

	  If this driver is compiled as a module, it will be named rts5208.
```

## drivers/staging/rts_pstor/Kconfig
```kconfig
config RTS_PSTOR
	tristate "RealTek PCI-E Card Reader support"
	depends on PCI && SCSI
	help
	  Say Y here to include driver code to support the Realtek
	  PCI-E card readers.

	  If this driver is compiled as a module, it will be named rts_pstor.

config RTS_PSTOR_DEBUG
	bool "Realtek PCI-E Card Reader verbose debug"
	depends on RTS_PSTOR
	help
	  Say Y here in order to have the rts_pstor code generate
	  verbose debugging messages.
```

## drivers/staging/samsung-laptop/Kconfig
```kconfig
config SAMSUNG_LAPTOP
	tristate "Samsung Laptop driver"
	default n
	depends on RFKILL && BACKLIGHT_CLASS_DEVICE && X86
	help
	  This module implements a driver for the N128 Samsung Laptop
	  providing control over the Wireless LED and the LCD backlight

	  To compile this driver as a module, choose
	  M here: the module will be called samsung-laptop.
```

## drivers/staging/sb105x/Kconfig
```kconfig
config SB105X
	tristate "SystemBase PCI Multiport UART"
	select SERIAL_CORE
	depends on PCI && X86 && TTY && BROKEN
	help
	  A driver for the SystemBase Multi-2/PCI serial card

	  To compile this driver a module, choose M here: the module
	  will be called "sb105x".
```

## drivers/staging/sbe-2t3e3/Kconfig
```kconfig
config SBE_2T3E3
	tristate "SBE wanPMC-2T3E3 support"
	depends on HDLC && PCI
	help
	  Driver for wanPMC-2T3E3 cards by SBE Inc.

	  If you have such a card, say Y here and see
	  <http://www.kernel.org/pub/linux/utils/net/hdlc/>.

	  To compile this as a module, choose M here: the
	  module will be called sbe-2t3e3.

	  If unsure, say N.
```

## drivers/staging/se401/Kconfig
```kconfig
config USB_SE401
	tristate "USB SE401 Camera support (DEPRECATED)"
	depends on VIDEO_DEV && VIDEO_V4L2_COMMON && USB
	---help---
	  Say Y here if you want to connect this type of camera to your
	  computer's USB port. See <file:Documentation/video4linux/se401.txt>
	  for more information and for a list of supported cameras.

	  This driver uses the deprecated V4L1 API and will be removed in
	  2.6.39, unless someone converts it to the V4L2 API.

	  To compile this driver as a module, choose M here: the
	  module will be called se401.
```

## drivers/staging/sep/Kconfig
```kconfig
config DX_SEP
	tristate "Discretix SEP driver"
	depends on PCI
	help
	  Discretix SEP driver; used for the security processor subsystem
	  on board the Intel Mobile Internet Device and adds SEP availability
	  to the kernel crypto infrastructure

	  The driver's name is sep_driver.

	  If unsure, select N.
```

## drivers/staging/serial/Kconfig
```kconfig
config SERIAL_68360_SMC
	bool "68360 SMC uart support"
	depends on M68360
	help
	  This driver supports the SMC serial ports of the Motorola 68360 CPU.

config SERIAL_68360_SCC
	bool "68360 SCC uart support"
	depends on M68360
	help
	  This driver supports the SCC serial ports of the Motorola 68360 CPU.

config SERIAL_68360
	bool
	depends on SERIAL_68360_SMC || SERIAL_68360_SCC
	default y
```

## drivers/staging/serqt_usb2/Kconfig
```kconfig
config USB_SERIAL_QUATECH2
	tristate "USB Quatech ESU-100 8 Port Serial Driver"
	depends on USB_SERIAL
	help
	  Say Y here if you want to use the Quatech ESU-100 8 port usb to
	  serial adapter.

	  To compile this driver as a module, choose M here: the
	  module will be called serqt_usb2.
```

## drivers/staging/silicom/Kconfig
```kconfig
#
# Silicom device configuration
#

config NET_VENDOR_SILICOM
	bool "Silicom devices"
	default y
	depends on PCI && NETDEVICES
	---help---
	  If you have a network card (Ethernet) belonging to this class,
	  say Y.

	  Note that the answer to this question does not directly affect
	  the kernel: saying N will just case the configurator to skip all
	  the questions regarding Silicom chipsets. If you say Y, you will be asked
	  for your specific chipset/driver in the following questions.

if NET_VENDOR_SILICOM

config SBYPASS
	tristate "Silicom BypassCTL library support"
	depends on PCI
	depends on m
	---help---
	  If you have a network (Ethernet) controller of this type, say Y

	  To compile this driver as a module, choose M here. The module
	  will be called bypass.

config BPCTL
	tristate "Silicom BypassCTL net support"
	depends on PCI
	depends on m
	select SBYPASS
	select MII
	---help---
	  If you have a network (Ethernet) controller of this type, say Y
	  or M and read the Ethernet-HOWTO, available from
	  <http://www.tldp.org/docs.html#howto>.

	  To compile this driver as a module, choose M here. The module
	  will be called bpctl_mod.


endif # NET_VENDOR_SILICOM
```

## drivers/staging/skein/Kconfig
```kconfig
config CRYPTO_SKEIN
	tristate "Skein digest algorithm"
	depends on (X86 || UML_X86) && 64BIT && CRYPTO
	select CRYPTO_HASH
	select CRYPTO_ALGAPI
	help
	  Skein secure hash algorithm is one of 5 finalists from the NIST SHA3
	  competition.

	  Skein is optimized for modern, 64bit processors and is highly
	  customizable.  See:

	  http://www.skein-hash.info/sites/default/files/skein1.3.pdf

	  for more information. This module also contains the threefish block
	  cipher algorithm.
```

## drivers/staging/slicoss/Kconfig
```kconfig
config SLICOSS
	tristate "Alacritech Gigabit IS-NIC support"
	depends on PCI && X86 && NET
	default n
	help
	  This driver supports Alacritech's IS-NIC gigabit ethernet cards.

	  This includes the following devices:
	    Mojave cards (single port PCI Gigabit) both copper and fiber
	    Oasis cards (single and dual port PCI-x Gigabit) copper and fiber
	    Kalahari cards (dual and quad port PCI-e Gigabit) copper and fiber

	  To compile this driver as a module, choose M here: the module
	  will be called slicoss.
```

## drivers/staging/sm750fb/Kconfig
```kconfig
# SPDX-License-Identifier: GPL-2.0
config FB_SM750
	tristate "Silicon Motion SM750 framebuffer support"
	depends on FB && PCI
	select FB_MODE_HELPERS
	select FB_CFB_FILLRECT
	select FB_CFB_COPYAREA
	select FB_CFB_IMAGEBLIT
	select VIDEO_NOMODESET
	help
	  Frame buffer driver for the Silicon Motion SM750 chip
	  with 2D acceleration and dual head support.

	  This driver is also available as a module. The module will be
	  called sm750fb. If you want to compile it as a module, say M
	  here and read <file:Documentation/kbuild/modules.rst>.
```

## drivers/staging/sm7xx/Kconfig
```kconfig
config FB_SM7XX
	tristate "Silicon Motion SM7XX Frame Buffer Support"
	depends on FB
	select FB_CFB_FILLRECT
	select FB_CFB_COPYAREA
	select FB_CFB_IMAGEBLIT
	help
	  Frame Buffer driver for the Silicon Motion SM7XX serial graphic card.
```

## drivers/staging/sm7xxfb/Kconfig
```kconfig
config FB_SM7XX
	tristate "Silicon Motion SM7XX framebuffer support"
	depends on FB && PCI
	select FB_CFB_FILLRECT
	select FB_CFB_COPYAREA
	select FB_CFB_IMAGEBLIT
	help
	  Frame buffer driver for the Silicon Motion SM710, SM712, SM721
	  and SM722 chips.

	  This driver is also available as a module. The module will be
	  called sm7xxfb. If you want to compile it as a module, say M
	  here and read <file:Documentation/kbuild/modules.txt>.
```

## drivers/staging/solo6x10/Kconfig
```kconfig
config SOLO6X10
	tristate "Softlogic 6x10 MPEG codec cards"
	depends on PCI && VIDEO_DEV && SND && I2C
	select VIDEOBUF_DMA_SG
	select SND_PCM
	---help---
	  This driver supports the Softlogic based MPEG-4 and h.264 codec
	  codec cards.
```

## drivers/staging/speakup/Kconfig
```kconfig
menu "Speakup console speech"

config SPEAKUP
	depends on VT
	tristate "Speakup core"
	---help---
		This is the Speakup screen reader.  Think of it as a
		video console for blind people.  If built in to the
		kernel, it can speak everything on the text console from
		boot up to shutdown.  For more information on Speakup,
		point your browser at <http://www.linux-speakup.org/>.
		There is also a mailing list at the above url that you
		can subscribe to.
		
		Supported synthesizers are accent sa, accent pc,
		appollo II., Auddapter, Braille 'n Speak, Dectalk
		external (old), Dectalk PC (full length isa board),
		Dectalk express, Doubletalk, Doubletalk LT or
		Litetalk, Keynote Gold internal PC, software
		synthesizers, Speakout, transport, and a dummy module
		that can be used with a plain text terminal.
		
		Speakup can either be built in or compiled as a module
		by answering y or m.  If you answer y here, then you
		must answer either y or m to at least one of the
		synthesizer drivers below.  If you answer m here, then
		the synthesizer drivers below can only be built as
		modules.
		
		These drivers are not standalone drivers, but must be
		used in conjunction with Speakup.  Think of them as
		video cards for blind people.
		
		
		The Dectalk pc driver can only be built as a module, and
		requires software to be pre-loaded on to the card before
		the module can be loaded.  See the decpc choice below
		for more details.
		
		If you are not a blind person, or don't have access to
		one of the listed synthesizers, you should say n.

if SPEAKUP
config SPEAKUP_SYNTH_ACNTSA
	tristate "Accent SA synthesizer support"
	---help---
		This is the Speakup driver for the Accent SA
		synthesizer.  You can say y to build it into the kernel,
		or m to build it as a module.  See the configuration
		help on the Speakup choice above for more info.

config SPEAKUP_SYNTH_ACNTPC
	tristate "Accent PC synthesizer support"
	---help---
		This is the Speakup driver for the accent pc
		synthesizer.  You can say y to build it into the kernel,
		or m to build it as a module.  See the configuration
		help on the Speakup choice above for more info.

config SPEAKUP_SYNTH_APOLLO
	tristate "Apollo II synthesizer support"
	---help---
		This is the Speakup driver for the Apollo II
		synthesizer.  You can say y to build it into the kernel,
		or m to build it as a module.  See the configuration
		help on the Speakup choice above for more info.

config SPEAKUP_SYNTH_AUDPTR
	tristate "Audapter synthesizer support"
	---help---
		This is the Speakup driver for the Audapter synthesizer.
		 You can say y to build it into the kernel, or m to
		build it as a module.  See the configuration help on the
		Speakup choice above for more info.

config SPEAKUP_SYNTH_BNS
	tristate "Braille 'n' Speak synthesizer support"
	---help---
		This is the Speakup driver for the Braille 'n' Speak
		synthesizer.  You can say y to build it into the kernel,
		or m to build it as a module.  See the configuration
		help on the Speakup choice above for more info.

config SPEAKUP_SYNTH_DECTLK
	tristate "DECtalk Express synthesizer support"
	---help---
		
		This is the Speakup driver for the DecTalk Express
		synthesizer.  You can say y to build it into the kernel,
		or m to build it as a module.  See the configuration
		help on the Speakup choice above for more info.

config SPEAKUP_SYNTH_DECEXT
	tristate "DECtalk External (old) synthesizer support"
	---help---
		
		This is the Speakup driver for the DecTalk External
		(old) synthesizer.  You can say y to build it into the
		kernel, or m to build it as a module.  See the
		configuration help on the Speakup choice above for more
		info.

config SPEAKUP_SYNTH_DECPC
	depends on m
	tristate "DECtalk PC (big ISA card) synthesizer support"
	---help---
		
		This is the Speakup driver for the DecTalk PC (full
		length ISA) synthesizer.  You can say m to build it as
		a module.  See the configuration help on the Speakup
		choice above for more info.
		
		In order to use the DecTalk PC driver, you must download
		the dec_pc.tgz file from linux-speakup.org.  It is in
		the pub/linux/goodies directory.  The dec_pc.tgz file
		contains the software which must be pre-loaded on to the
		DecTalk PC board in order to use it with this driver.
		This driver must be built as a module, and can not be
		loaded until the file system is mounted and the DecTalk
		PC software has been pre-loaded on to the board.
		
		See the README file in the dec_pc.tgz file for more
		details.

config SPEAKUP_SYNTH_DTLK
	tristate "DoubleTalk PC synthesizer support"
	---help---
		
		This is the Speakup driver for the internal DoubleTalk
		PC synthesizer.  You can say y to build it into the
		kernel, or m to build it as a module.  See the
		configuration help on the Speakup choice above for more
		info.

config SPEAKUP_SYNTH_KEYPC
	tristate "Keynote Gold PC synthesizer support"
	---help---
		
		This is the Speakup driver for the Keynote Gold
		PC synthesizer.  You can say y to build it into the
		kernel, or m to build it as a module.  See the
		configuration help on the Speakup choice above for more
		info.

config SPEAKUP_SYNTH_LTLK
	tristate "DoubleTalk LT/LiteTalk synthesizer support"
---help---

		This is the Speakup driver for the LiteTalk/DoubleTalk
		LT synthesizer.  You can say y to build it into the
		kernel, or m to build it as a module.  See the
		configuration help on the Speakup choice above for more
		info.

config SPEAKUP_SYNTH_SOFT
	tristate "Userspace software synthesizer support"
	---help---

		This is the software synthesizer device node.  It will
		register a device /dev/softsynth which midware programs
		and speech daemons may open and read to provide kernel
		output to software synths such as espeak, festival,
		flite and so forth.  You can select 'y' or 'm' to have
		it built-in to the kernel or loaded as a module.

config SPEAKUP_SYNTH_SPKOUT
	tristate "Speak Out synthesizer support"
	---help---
		
		This is the Speakup driver for the Speakout synthesizer.
		 You can say y to build it into the kernel, or m to
		build it as a module.  See the configuration help on the
		Speakup choice above for more info.

config SPEAKUP_SYNTH_TXPRT
	tristate "Transport synthesizer support"
	---help---
		
		This is the Speakup driver for the Transport
		synthesizer.  You can say y to build it into the kernel,
		or m to build it as a module.  See the configuration
		help on the Speakup choice above for more info.

config SPEAKUP_SYNTH_DUMMY
	tristate "Dummy synthesizer driver (for testing)"
	---help---
		
		This is a dummy Speakup driver for plugging a mere serial
		terminal.  This is handy if you want to test speakup but
		don't have the hardware.  You can say y to build it into
		the kernel, or m to build it as a module.  See the
		configuration help on the Speakup choice above for more info.

endif	# SPEAKUP
endmenu
```
