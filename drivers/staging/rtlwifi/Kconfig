## drivers/staging/spectra/Kconfig
```kconfig
menuconfig SPECTRA
	tristate "Denali Spectra Flash Translation Layer"
	depends on BLOCK
	depends on X86_MRST
	default n
	---help---
	  Enable the FTL pseudo-filesystem used with the NAND Flash
	  controller on Intel Moorestown Platform to pretend to be a disk

choice
	prompt "Compile for"
	depends on SPECTRA
	default SPECTRA_MRST_HW

config SPECTRA_MRST_HW
	bool "Moorestown hardware mode"
	help
	  Driver communicates with the Moorestown hardware's register interface.
	  in DMA mode.

config SPECTRA_MTD
	bool "Linux MTD mode"
	depends on MTD
	help
	  Driver communicates with the kernel MTD subsystem instead of its own
	  built-in hardware driver.

config SPECTRA_EMU
	bool "RAM emulator testing"
	help
	  Driver emulates Flash on a RAM buffer and / or disk file.  Useful to test the behavior of FTL layer.

endchoice

config SPECTRA_MRST_HW_DMA
       bool
       default n
       depends on SPECTRA_MRST_HW
       help
         Use DMA for native hardware interface.
```

## drivers/staging/ste_rmi4/Kconfig
```kconfig
config TOUCHSCREEN_SYNAPTICS_I2C_RMI4
	tristate "Synaptics i2c rmi4 touchscreen"
	depends on I2C && INPUT
	help
	  Say Y here if you have a Synaptics RMI4 and
	  want to enable support for the built-in touchscreen.

	  To compile this driver as a module, choose M here: the
	  module will be called synaptics_rmi4_ts.
```

## drivers/staging/stlc45xx/Kconfig
```kconfig
config STLC45XX
	tristate "stlc4550/4560 support"
	depends on MAC80211 && WLAN_80211 && SPI_MASTER && GENERIC_HARDIRQS
	---help---
	  This is a driver for stlc4550 and stlc4560 chipsets.

	  To compile this driver as a module, choose M here: the module will be
	  called stlc45xx.  If unsure, say N.
```

## drivers/staging/stradis/Kconfig
```kconfig
config VIDEO_STRADIS
        tristate "Stradis 4:2:2 MPEG-2 video driver (DEPRECATED)"
        depends on EXPERIMENTAL && PCI && VIDEO_V4L1 && VIRT_TO_BUS && BKL
        help
          Say Y here to enable support for the Stradis 4:2:2 MPEG-2 video
          driver for PCI.  There is a product page at
          <http://www.stradis.com/>.
```

## drivers/staging/strip/Kconfig
```kconfig
config STRIP
	tristate "STRIP (Metricom starmode radio IP)"
	depends on INET
	select WIRELESS_EXT
	---help---
	  Say Y if you have a Metricom radio and intend to use Starmode Radio
	  IP. STRIP is a radio protocol developed for the MosquitoNet project
	  to send Internet traffic using Metricom radios.  Metricom radios are
	  small, battery powered, 100kbit/sec packet radio transceivers, about
	  the size and weight of a cellular telephone. (You may also have heard
	  them called "Metricom modems" but we avoid the term "modem" because
	  it misleads many people into thinking that you can plug a Metricom
	  modem into a phone line and use it as a modem.)

	  You can use STRIP on any Linux machine with a serial port, although
	  it is obviously most useful for people with laptop computers. If you
	  think you might get a Metricom radio in the future, there is no harm
	  in saying Y to STRIP now, except that it makes the kernel a bit
	  bigger.

	  To compile this as a module, choose M here: the module will be
	  called strip.
```

## drivers/staging/sxg/Kconfig
```kconfig
config SXG
	tristate "Alacritech SLIC Technology Non-Accelerated 10Gbe support"
	depends on PCI && NETDEV_10000
	default n
	help
	  This driver supports the Alacritech SLIC Technology Non-Accelerated
	  10Gbe network cards.

	  To compile this driver as a module, choose
	  M here: the module will be called sxg.
```
