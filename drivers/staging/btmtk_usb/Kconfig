## drivers/staging/btmtk_usb/Kconfig
```kconfig
config USB_BTMTK
	tristate "Mediatek Bluetooth support"
	depends on USB && BT && m
	---help---
	  Say Y here if you wish to control a MTK USB Bluetooth.

	  This option depends on 'USB' support being enabled

	  To compile this driver as a module, choose M here: the
	  module will be called btmtk_usb.
```

## drivers/staging/ccg/Kconfig
```kconfig
if USB_GADGET

config USB_G_CCG
	tristate "Configurable Composite Gadget (STAGING)"
	depends on STAGING && BLOCK && !USB_ZERO && !USB_ZERO_HNPTEST && !USB_AUDIO && !GADGET_UAC1 && !USB_ETH && !USB_ETH_RNDIS && !USB_ETH_EEM && !USB_G_NCM && !USB_GADGETFS && !USB_FUNCTIONFS && !USB_FUNCTIONFS_ETH && !USB_FUNCTIONFS_RNDIS && !USB_FUNCTIONFS_GENERIC && !USB_FILE_STORAGE && !USB_FILE_STORAGE_TEST && !USB_MASS_STORAGE && !USB_G_SERIAL && !USB_MIDI_GADGET && !USB_G_PRINTER && !USB_CDC_COMPOSITE && !USB_G_NOKIA && !USB_G_ACM_MS && !USB_G_MULTI && !USB_G_MULTI_RNDIS && !USB_G_MULTI_CDC && !USB_G_HID && !USB_G_DBGP && !USB_G_WEBCAM
	help
	  The Configurable Composite Gadget supports multiple USB
	  functions: acm, mass storage, rndis and FunctionFS.
	  Each function can be configured and enabled/disabled
	  dynamically from userspace through a sysfs interface.

	  In order to compile this (either as a module or built-in),
	  "USB Gadget Drivers" and anything under it must not be
	  selected compiled-in in
	  Device Drivers->USB Support->USB Gadget Support.
	  However, you can say "M" there, if you do, the
	  Configurable Composite Gadget can be compiled "M" only
	  or not at all.

	  BIG FAT NOTE: DON'T RELY ON THIS USERINTERFACE HERE! AS PART
	  OF THE REWORK DONE HERE WILL BE A NEW USER INTERFACE WITHOUT ANY
	  COMPATIBILITY TO THIS SYSFS INTERFACE HERE. BE AWARE OF THIS
	  BEFORE SELECTING THIS.

endif # USB_GADGET
```

## drivers/staging/ccree/Documentation/devicetree/bindings/crypto/arm-cryptocell.txt
```
Arm TrustZone CryptoCell cryptographic accelerators

Required properties:
- compatible: must be "arm,cryptocell-712-ree".
- reg: shall contain base register location and length.
	Typically length is 0x10000.
- interrupts: shall contain the interrupt for the device.

Optional properties:
- interrupt-parent: can designate the interrupt controller the
	device interrupt is connected to, if needed.
- clocks: may contain the clock handling the device, if needed.
- power-domains: may contain a reference to the PM domain, if applicable.


Examples:

Zynq FPGA device
----------------

       arm_cc7x: arm_cc7x@80000000 {
               compatible = "arm,cryptocell-712-ree";
               interrupt-parent = <&intc>;
               interrupts = < 0 30 4 >;
               reg = < 0x80000000 0x10000 >;
       };
```

## drivers/staging/ccree/Kconfig
```kconfig
# SPDX-License-Identifier: GPL-2.0

config CRYPTO_DEV_CCREE
	tristate "Support for ARM TrustZone CryptoCell C7XX family of Crypto accelerators"
	depends on CRYPTO && CRYPTO_HW && OF && HAS_DMA
	default n
	select CRYPTO_HASH
	select CRYPTO_BLKCIPHER
	select CRYPTO_DES
	select CRYPTO_AEAD
	select CRYPTO_AUTHENC
	select CRYPTO_SHA1
	select CRYPTO_MD5
	select CRYPTO_SHA256
	select CRYPTO_SHA512
	select CRYPTO_HMAC
	select CRYPTO_AES
	select CRYPTO_CBC
	select CRYPTO_ECB
	select CRYPTO_CTR
	select CRYPTO_XTS
	help
	  Say 'Y' to enable a driver for the Arm TrustZone CryptoCell
	  C7xx. Currently only the CryptoCell 712 REE is supported.
	  Choose this if you wish to use hardware acceleration of
	  cryptographic operations on the system REE.
	  If unsure say Y.
```

## drivers/staging/ced1401/Kconfig
```kconfig
config CED1401
	tristate "Cambridge Electronic Design 1401 USB support"
	depends on USB
	help
	  This driver supports the Cambridge Electronic Design 1401 USB device
	  (whatever that is.)
```

## drivers/staging/clocking-wizard/Kconfig
```kconfig
# SPDX-License-Identifier: GPL-2.0
#
# Xilinx Clocking Wizard Driver
#

config COMMON_CLK_XLNX_CLKWZRD
	tristate "Xilinx Clocking Wizard"
	depends on COMMON_CLK && OF && HAS_IOMEM
	help
	  Support for the Xilinx Clocking Wizard IP core clock generator.
```

## drivers/staging/cowloop/Kconfig
```kconfig
config COWLOOP
	tristate "copy-on-write pseudo Block Driver"
	depends on BLOCK
	default n
	---help---
	  Cowloop is a "copy-on-write" pseudo block driver. It can be
	  stacked on top of a "real" block driver, and catches all write
	  operations on their way from the file systems layer above to
	  the real driver below, effectively shielding the lower driver
	  from those write accesses. The requests are then diverted to
	  an ordinary file, located somewhere else (configurable). Later
	  read requests are checked to see whether they can be serviced
	  by the "real" block driver below, or must be pulled in from
	  the diverted location. More information and userspace tools to
	  use the driver are on the project's website
	  http://www.ATComputing.nl/cowloop/
```

## drivers/staging/cpia/Kconfig
```kconfig
config VIDEO_CPIA
	tristate "CPiA Video For Linux (DEPRECATED)"
	depends on VIDEO_V4L1
	default n
	---help---
	  This driver is DEPRECATED please use the gspca cpia1 module
	  instead. Note that you need atleast version 0.6.4 of libv4l for
	  the cpia1 gspca module.

	  This is the video4linux driver for cameras based on Vision's CPiA
	  (Colour Processor Interface ASIC), such as the Creative Labs Video
	  Blaster Webcam II. If you have one of these cameras, say Y here
	  and select parallel port and/or USB lowlevel support below,
	  otherwise say N. This will not work with the Creative Webcam III.

	  Please read <file:Documentation/video4linux/README.cpia> for more
	  information.

	  This driver is also available as a module (cpia).

config VIDEO_CPIA_PP
	tristate "CPiA Parallel Port Lowlevel Support"
	depends on PARPORT_1284 && VIDEO_CPIA && PARPORT
	help
	  This is the lowlevel parallel port support for cameras based on
	  Vision's CPiA (Colour Processor Interface ASIC), such as the
	  Creative Webcam II. If you have the parallel port version of one
	  of these cameras, say Y here, otherwise say N. It is also available
	  as a module (cpia_pp).

config VIDEO_CPIA_USB
	tristate "CPiA USB Lowlevel Support"
	depends on VIDEO_CPIA && USB
	help
	  This is the lowlevel USB support for cameras based on Vision's CPiA
	  (Colour Processor Interface ASIC), such as the Creative Webcam II.
	  If you have the USB version of one of these cameras, say Y here,
	  otherwise say N. This will not work with the Creative Webcam III.
	  It is also available as a module (cpia_usb).
```

## drivers/staging/cptm1217/Kconfig
```kconfig
config TOUCHSCREEN_CLEARPAD_TM1217
	tristate "Synaptics Clearpad TM1217"
	depends on I2C
	depends on GPIOLIB
	depends on INPUT
	help
	  Say Y here if you have a Synaptics Clearpad TM1217 Controller

	  If unsure, say N.

	  To compile this driver as a module, choose M here: the
	  module will be called clearpad_tm1217.
```

## drivers/staging/cpupower/Kconfig
```kconfig
config CPUPOWER
	tristate "cpupower driver"
	depends on SCHED_MC && ARM_CPU_TOPOLOGY
	help
	  Say Y here if you have dual cortex-A9
```

## drivers/staging/crystalhd/Kconfig
```kconfig
config CRYSTALHD
	tristate "Broadcom Crystal HD video decoder support"
	depends on PCI
	default n
	help
	  Support for the Broadcom Crystal HD video decoder chipset
```

## drivers/staging/cs5535_gpio/Kconfig
```kconfig
config CS5535_GPIO
	tristate "AMD CS5535/CS5536 GPIO (Geode Companion Device)"
	depends on X86_32
	help
	  Note: this driver is DEPRECATED.  Please use the cs5535-gpio module
	  in the GPIO section instead (CONFIG_GPIO_CS5535).

	  Give userspace access to the GPIO pins on the AMD CS5535 and
	  CS5536 Geode companion devices.

	  If compiled as a module, it will be called cs5535_gpio.
```

## drivers/staging/csr/Kconfig
```kconfig
config CSR_WIFI
	tristate "CSR wireless driver"
	depends on MMC && CFG80211_WEXT
	select WIRELESS_EXT
	select WEXT_PRIV
	help
	  Driver for the CSR wireless SDIO device.

	  If unsure, select N.
```

## drivers/staging/cxd2099/Kconfig
```kconfig
config DVB_CXD2099
	tristate "CXD2099AR Common Interface driver"
	depends on DVB_CORE && PCI && I2C
	---help---
	  Support for the CI module found on cards based on
	  - Micronas ngene PCIe bridge: cineS2 etc.
	  - Digital Devices PCIe bridge: Octopus series

	  For now, data is passed through '/dev/dvb/adapterX/sec0':
	    - Encrypted data must be written to 'sec0'.
	    - Decrypted data can be read from 'sec0'.
	    - Setup the CAM using device 'ca0'.
```

## drivers/staging/cxt1e1/Kconfig
```kconfig
config CXT1E1
	tristate "SBE wanPMC-C[421]E1T1 hardware support"
	depends on HDLC && PCI
	---help---
      This driver supports the SBE wanPMC-CxT1E1 1, 2 and 4 port T3
      channelized stream WAN adapter card which contains a HDLC/Transparent
      mode controller.

      If you want to compile this driver as a module
      say M here and read <file:Documentation/modules.txt>.
      The module will be called 'cxt1e1'.

      If unsure, say N.

config SBE_PMCC4_NCOMM
	bool "SBE PMCC4 NCOMM support"
	depends on CXT1E1
	---help---
      SBE supplies optional support for NCOMM products.

      If you have purchased this optional support you must say Y or M
      here to allow the driver to operate with the NCOMM product.
```

## drivers/staging/dabusb/Kconfig
```kconfig
config USB_DABUSB
	tristate "DABUSB driver"
	depends on USB
	---help---
	  A Digital Audio Broadcasting (DAB) Receiver for USB and Linux
	  brought to you by the DAB-Team
	  <http://wwwbode.cs.tum.edu/Par/arch/dab/>.  This driver can be taken
	  as an example for URB-based bulk, control, and isochronous
	  transactions. URB's are explained in
	  <Documentation/usb/URB.txt>.

	  To compile this driver as a module, choose M here: the
	  module will be called dabusb.
```

## drivers/staging/dgap/Kconfig
```kconfig
config DGAP
       tristate "Digi EPCA PCI products"
       default n
       depends on TTY && HAS_IOMEM
       ---help---
       Driver for the Digi International EPCA PCI based product line
```

## drivers/staging/dgnc/Kconfig
```kconfig
config DGNC
	tristate "Digi Neo and Classic PCI Products"
	default n
	depends on TTY && PCI
	help
	  Say Y here to enable support for the Digi International Neo and
	  Classic PCI based product line.

	  To compile this driver as a module, say M here: the module will be
	  called dgnc
```

## drivers/staging/dgrp/Kconfig
```kconfig
config DGRP
       tristate "Digi Realport driver"
       default n
       depends on SYSFS
       ---help---
       Support for Digi Realport devices.  These devices allow you to
       access remote serial ports as if they are local tty devices.  This
       will build the kernel driver, you will still need the userspace
       component to make your Realport device work.
```

## drivers/staging/dream/Kconfig
```kconfig
config DREAM
	tristate "HTC Dream support"
	depends on MACH_TROUT

if DREAM

source "drivers/staging/dream/camera/Kconfig"

config INPUT_GPIO
	tristate "GPIO driver support"
	help
	  Say Y here if you want to support gpio based keys, wheels etc...
endif
```

## drivers/staging/dream/camera/Kconfig
```kconfig
comment "Qualcomm MSM Camera And Video"

menuconfig MSM_CAMERA
	bool "Qualcomm MSM camera and video capture support"
	depends on ARCH_MSM && VIDEO_V4L2_COMMON
	help
	  Say Y here to enable selecting the video adapters for
	  Qualcomm msm camera and video encoding

config MSM_CAMERA_DEBUG
	bool "Qualcomm MSM camera debugging with printk"
	depends on MSM_CAMERA
	help
	  Enable printk() debug for msm camera

config MSM_CAMERA_FLASH
	bool "Qualcomm MSM camera flash support"
	depends on MSM_CAMERA
	---help---
	  Enable support for LED flash for msm camera


comment "Camera Sensor Selection"
config MT9T013
	bool "Sensor mt9t013 (BAYER 3M)"
	depends on MSM_CAMERA
	---help---
	  MICRON 3M Bayer Sensor with AutoFocus

config MT9D112
	bool "Sensor mt9d112 (YUV 2M)"
	depends on MSM_CAMERA
	---help---
	  MICRON 2M YUV Sensor

config MT9P012
	bool "Sensor mt9p012 (BAYER 5M)"
	depends on MSM_CAMERA
	---help---
	  MICRON 5M Bayer Sensor with Autofocus

config S5K3E2FX
	bool "Sensor s5k3e2fx (Samsung 5M)"
	depends on MSM_CAMERA
	---help---
	  Samsung 5M with Autofocus
```

## drivers/staging/dream/smd/Kconfig
```kconfig
config MSM_SMD
	depends on ARCH_MSM
	default y
	bool "MSM Shared Memory Driver (SMD)"
	help
	  Support for the shared memory interface between the apps
	  processor and the baseband processor.  Provides access to
	  the "shared heap", as well as virtual serial channels
	  used to communicate with various services on the baseband
	  processor.

config MSM_ONCRPCROUTER
	depends on MSM_SMD
	default y
	bool "MSM ONCRPC router support"
	help
	  Support for the MSM ONCRPC router for communication between
	  the ARM9 and ARM11

config MSM_RPCSERVERS
	depends on MSM_ONCRPCROUTER
	default y
	bool "Kernel side RPC server bundle"
	help
	  none
```
