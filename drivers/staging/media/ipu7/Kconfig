## drivers/staging/media/rockchip/vpu/Kconfig
```kconfig
# SPDX-License-Identifier: GPL-2.0
config VIDEO_ROCKCHIP_VPU
	tristate "Rockchip VPU driver"
	depends on ARCH_ROCKCHIP || COMPILE_TEST
	depends on VIDEO_DEV && VIDEO_V4L2 && MEDIA_CONTROLLER
	select VIDEOBUF2_DMA_CONTIG
	select VIDEOBUF2_VMALLOC
	select V4L2_MEM2MEM_DEV
	help
	  Support for the Video Processing Unit present on Rockchip SoC,
	  which accelerates video and image encoding and decoding.
	  To compile this driver as a module, choose M here: the module
	  will be called rockchip-vpu.
```

## drivers/staging/media/rtl2832u_sdr/Kconfig
```kconfig
config DVB_RTL2832_SDR
	tristate "Realtek RTL2832 SDR"
	depends on USB && DVB_CORE && I2C && VIDEO_V4L2 && DVB_USB_RTL28XXU
	select DVB_RTL2832
	select VIDEOBUF2_VMALLOC
	default m if !MEDIA_SUBDRV_AUTOSELECT
```

## drivers/staging/media/s5p-cec/Kconfig
```kconfig
config VIDEO_SAMSUNG_S5P_CEC
       tristate "Samsung S5P CEC driver"
       depends on VIDEO_DEV && MEDIA_CEC_SUPPORT && (ARCH_EXYNOS || COMPILE_TEST)
       ---help---
         This is a driver for Samsung S5P HDMI CEC interface. It uses the
         generic CEC framework interface.
         CEC bus is present in the HDMI connector and enables communication
         between compatible devices.
```

## drivers/staging/media/sn9c102/Kconfig
```kconfig
config USB_SN9C102
	tristate "USB SN9C1xx PC Camera Controller support (DEPRECATED)"
	depends on VIDEO_V4L2 && MEDIA_USB_SUPPORT && USB
	---help---
	  This driver is DEPRECATED, please use the gspca sonixb and
	  sonixj modules instead.

	  Say Y here if you want support for cameras based on SONiX SN9C101,
	  SN9C102, SN9C103, SN9C105 and SN9C120 PC Camera Controllers.

	  See <file:drivers/staging/media/sn9c102/sn9c102.txt> for more info.

	  If you have webcams that are only supported by this driver and not by
	  the gspca driver, then contact the linux-media mailinglist.

	  To compile this driver as a module, choose M here: the
	  module will be called sn9c102.
```

## drivers/staging/media/soc_camera/Kconfig
```kconfig
# SPDX-License-Identifier: GPL-2.0
config SOC_CAMERA
	tristate "SoC camera support"
	depends on VIDEO_V4L2 && HAS_DMA && I2C && BROKEN
	select VIDEOBUF2_CORE
	help
	  SoC Camera is a common API to several cameras, not connecting
	  over a bus like PCI or USB. For example some i2c camera connected
	  directly to the data bus of an SoC.

comment "soc_camera sensor drivers"

config SOC_CAMERA_MT9M111
	tristate "legacy soc_camera mt9m111, mt9m112 and mt9m131 support"
	depends on SOC_CAMERA && I2C
	select VIDEO_MT9M111
	help
	  This driver supports MT9M111, MT9M112 and MT9M131 cameras from
	  Micron/Aptina.
	  This is the legacy configuration which shouldn't be used anymore,
	  while VIDEO_MT9M111 should be used instead.

config SOC_CAMERA_MT9V022
	tristate "mt9v022 and mt9v024 support"
	depends on SOC_CAMERA && I2C
	help
	  This driver supports MT9V022 cameras from Micron

config SOC_CAMERA_OV5642
	tristate "ov5642 camera support"
	depends on SOC_CAMERA && I2C
	help
	  This is a V4L2 camera driver for the OmniVision OV5642 sensor

config SOC_CAMERA_OV9740
	tristate "ov9740 camera support"
	depends on SOC_CAMERA && I2C
	help
	  This is a ov9740 camera driver

config SOC_CAMERA_IMX074
	tristate "imx074 support (DEPRECATED)"
	depends on SOC_CAMERA && I2C
	help
	  This driver supports IMX074 cameras from Sony

config SOC_CAMERA_MT9T031
	tristate "mt9t031 support (DEPRECATED)"
	depends on SOC_CAMERA && I2C
	help
	  This driver supports MT9T031 cameras from Micron.
```

## drivers/staging/media/solo6x10/Kconfig
```kconfig
config SOLO6X10
	tristate "Softlogic 6x10 MPEG codec cards"
	depends on PCI && VIDEO_DEV && SND && I2C
	select FONT_SUPPORT
	select FONT_8x16
	select VIDEOBUF2_DMA_SG
	select VIDEOBUF2_DMA_CONTIG
	select SND_PCM
	---help---
	  This driver supports the Softlogic based MPEG-4 and h.264 codec
	  cards.
```
