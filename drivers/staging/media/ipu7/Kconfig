## drivers/staging/media/ipu7/Kconfig
```kconfig
config VIDEO_INTEL_IPU7
	tristate "Intel IPU7 driver"
	depends on ACPI || COMPILE_TEST
	depends on VIDEO_DEV
	depends on X86 && HAS_DMA
	depends on IPU_BRIDGE || !IPU_BRIDGE
	depends on PCI
	select AUXILIARY_BUS
	select IOMMU_IOVA
	select VIDEO_V4L2_SUBDEV_API
	select MEDIA_CONTROLLER
	select VIDEOBUF2_DMA_SG
	select V4L2_FWNODE
	help
	  This is the 7th Gen Intel Image Processing Unit, found in Intel SoCs
	  and used for capturing images and video from camera sensors.

	  To compile this driver, say Y here! It contains 2 modules -
	  intel_ipu7 and intel_ipu7_isys.
```

## drivers/staging/media/lirc/Kconfig
```kconfig
#
# LIRC driver(s) configuration
#
menuconfig LIRC_STAGING
	bool "Linux Infrared Remote Control IR receiver/transmitter drivers"
	depends on LIRC
	help
	  Say Y here, and all supported Linux Infrared Remote Control IR and
	  RF receiver and transmitter drivers will be displayed. When paired
	  with a remote control and the lirc daemon, the receiver drivers
	  allow control of your Linux system via remote control.

if LIRC_STAGING

config LIRC_ZILOG
	tristate "Zilog/Hauppauge IR Transmitter"
	depends on LIRC && I2C
	help
	  Driver for the Zilog/Hauppauge IR Transmitter, found on
	  PVR-150/500, HVR-1200/1250/1700/1800, HD-PVR and other cards
endif
```

## drivers/staging/media/max96712/Kconfig
```kconfig
# SPDX-License-Identifier: GPL-2.0
config VIDEO_MAX96712
	tristate "Maxim MAX96712 Quad GMSL2 Deserializer support"
	depends on I2C
	depends on OF_GPIO
	depends on VIDEO_DEV
	select V4L2_FWNODE
	select VIDEO_V4L2_SUBDEV_API
	select MEDIA_CONTROLLER
	help
	  This driver supports the Maxim MAX96712 Quad GMSL2 Deserializer.

	  To compile this driver as a module, choose M here: the
	  module will be called max96712.
```

## drivers/staging/media/meson/vdec/Kconfig
```kconfig
# SPDX-License-Identifier: GPL-2.0

config VIDEO_MESON_VDEC
	tristate "Amlogic video decoder driver"
	depends on VIDEO_DEV && VIDEO_V4L2 && HAS_DMA
	depends on ARCH_MESON || COMPILE_TEST
	select VIDEOBUF2_DMA_CONTIG
	select V4L2_MEM2MEM_DEV
	select MESON_CANVAS
	help
	Support for the video decoder found in gxbb/gxl/gxm chips.
```

## drivers/staging/media/mn88472/Kconfig
```kconfig
config DVB_MN88472
	tristate "Panasonic MN88472"
	depends on DVB_CORE && I2C
	select REGMAP_I2C
	default m if !MEDIA_SUBDRV_AUTOSELECT
	help
	  Say Y when you want to support this frontend.
```

## drivers/staging/media/mn88473/Kconfig
```kconfig
config DVB_MN88473
	tristate "Panasonic MN88473"
	depends on DVB_CORE && I2C
	select REGMAP_I2C
	default m if !MEDIA_SUBDRV_AUTOSELECT
	help
	  Say Y when you want to support this frontend.
```

## drivers/staging/media/msi3101/Kconfig
```kconfig
config USB_MSI3101
	tristate "Mirics MSi3101 SDR Dongle"
	depends on USB && VIDEO_DEV && VIDEO_V4L2
	select VIDEOBUF2_CORE
	select VIDEOBUF2_VMALLOC
```

## drivers/staging/media/mt9t031/Kconfig
```kconfig
config SOC_CAMERA_MT9T031
	tristate "mt9t031 support (DEPRECATED)"
	depends on SOC_CAMERA && I2C
	help
	  This driver supports MT9T031 cameras from Micron.
```

## drivers/staging/media/mx2/Kconfig
```kconfig
config VIDEO_MX2
	tristate "i.MX27 Camera Sensor Interface driver"
	depends on VIDEO_DEV && SOC_CAMERA
	depends on SOC_IMX27 || COMPILE_TEST
	depends on HAS_DMA
	select VIDEOBUF2_DMA_CONTIG
	---help---
	  This is a v4l2 driver for the i.MX27 Camera Sensor Interface

	  This driver is deprecated: it should become a stand-alone driver
	  instead of using the soc-camera framework.

	  Unless someone is willing to take this on (unlikely with such
	  ancient hardware) it is going to be removed from the kernel
	  soon.
```

## drivers/staging/media/mx3/Kconfig
```kconfig
config VIDEO_MX3
	tristate "i.MX3x Camera Sensor Interface driver"
	depends on VIDEO_DEV && MX3_IPU && SOC_CAMERA
	depends on MX3_IPU || COMPILE_TEST
	depends on HAS_DMA
	select VIDEOBUF2_DMA_CONTIG
	---help---
	  This is a v4l2 driver for the i.MX3x Camera Sensor Interface

	  This driver is deprecated: it should become a stand-alone driver
	  instead of using the soc-camera framework.

	  Unless someone is willing to take this on (unlikely with such
	  ancient hardware) it is going to be removed from the kernel
	  soon.
```

## drivers/staging/media/omap1/Kconfig
```kconfig
config VIDEO_OMAP1
	tristate "OMAP1 Camera Interface driver"
	depends on VIDEO_DEV && SOC_CAMERA
	depends on ARCH_OMAP1
	depends on HAS_DMA
	select VIDEOBUF_DMA_CONTIG
	select VIDEOBUF_DMA_SG
	---help---
	  This is a v4l2 driver for the TI OMAP1 camera interface

	  This driver is deprecated and will be removed soon unless someone
	  will start the work to convert this driver to the vb2 framework
	  and remove the soc-camera dependency.
```

## drivers/staging/media/omap24xx/Kconfig
```kconfig
config VIDEO_V4L2_INT_DEVICE
       tristate

config VIDEO_OMAP2
	tristate "OMAP2 Camera Capture Interface driver (DEPRECATED)"
	depends on VIDEO_DEV && ARCH_OMAP2
	select VIDEOBUF_DMA_SG
	select VIDEO_V4L2_INT_DEVICE
	---help---
	  This is a v4l2 driver for the TI OMAP2 camera capture interface

	  It uses the deprecated int-device API. Since this driver is no
	  longer actively maintained and nobody is interested in converting
	  it to the subdev API, this driver will be removed soon.

	  If you do want to keep this driver in the kernel, and are willing
	  to convert it to the subdev API, then please contact the linux-media
	  mailinglist.

config VIDEO_TCM825X
	tristate "TCM825x camera sensor support (DEPRECATED)"
	depends on I2C && VIDEO_V4L2
	depends on MEDIA_CAMERA_SUPPORT
	select VIDEO_V4L2_INT_DEVICE
	---help---
	  This is a driver for the Toshiba TCM825x VGA camera sensor.
	  It is used for example in Nokia N800.

	  It uses the deprecated int-device API. Since this driver is no
	  longer actively maintained and nobody is interested in converting
	  it to the subdev API, this driver will be removed soon.

	  If you do want to keep this driver in the kernel, and are willing
	  to convert it to the subdev API, then please contact the linux-media
	  mailinglist.
```

## drivers/staging/media/omap4iss/Kconfig
```kconfig
# SPDX-License-Identifier: GPL-2.0

config VIDEO_OMAP4
	tristate "OMAP 4 Camera support"
	depends on VIDEO_DEV  && I2C
	depends on ARCH_OMAP4 || COMPILE_TEST
	select MEDIA_CONTROLLER
	select VIDEO_V4L2_SUBDEV_API
	select MFD_SYSCON
	select VIDEOBUF2_DMA_CONTIG
	help
	  Driver for an OMAP 4 ISS controller.
```

## drivers/staging/media/parport/Kconfig
```kconfig
menuconfig MEDIA_PARPORT_SUPPORT
	bool "ISA and parallel port devices"
	depends on (ISA || PARPORT) && MEDIA_CAMERA_SUPPORT
	help
	  Enables drivers for ISA and parallel port bus. If you
	  need media drivers using those legacy buses, say Y.

if MEDIA_PARPORT_SUPPORT
config VIDEO_BWQCAM
	tristate "Quickcam BW Video For Linux (Deprecated)"
	depends on PARPORT && VIDEO_V4L2
	select VIDEOBUF2_VMALLOC
	help
	  Say Y have if you the black and white version of the QuickCam
	  camera. See the next option for the color version.

	  This driver is deprecated and will be removed soon. If you have
	  hardware for this and you want to work on this driver, then contact
	  the linux-media mailinglist.

	  To compile this driver as a module, choose M here: the
	  module will be called bw-qcam.

config VIDEO_CQCAM
	tristate "QuickCam Colour Video For Linux (Deprecated)"
	depends on PARPORT && VIDEO_V4L2
	help
	  This is the video4linux driver for the colour version of the
	  Connectix QuickCam.  If you have one of these cameras, say Y here,
	  otherwise say N.  This driver does not work with the original
	  monochrome QuickCam, QuickCam VC or QuickClip.  It is also available
	  as a module (c-qcam).
	  Read <file:Documentation/video4linux/CQcam.txt> for more information.

	  This driver is deprecated and will be removed soon. If you have
	  hardware for this and you want to work on this driver, then contact
	  the linux-media mailinglist.

config VIDEO_PMS
	tristate "Mediavision Pro Movie Studio Video For Linux (Deprecated)"
	depends on ISA && VIDEO_V4L2
	help
	  Say Y if you have the ISA Mediavision Pro Movie Studio
	  capture card.

	  This driver is deprecated and will be removed soon. If you have
	  hardware for this and you want to work on this driver, then contact
	  the linux-media mailinglist.

	  To compile this driver as a module, choose M here: the
	  module will be called pms.

config VIDEO_W9966
	tristate "W9966CF Webcam (FlyCam Supra and others) Video For Linux (Deprecated)"
	depends on PARPORT_1284 && PARPORT && VIDEO_V4L2
	help
	  Video4linux driver for Winbond's w9966 based Webcams.
	  Currently tested with the LifeView FlyCam Supra.
	  If you have one of these cameras, say Y here
	  otherwise say N.
	  This driver is also available as a module (w9966).

	  Check out <file:Documentation/video4linux/w9966.txt> for more
	  information.

	  This driver is deprecated and will be removed soon. If you have
	  hardware for this and you want to work on this driver, then contact
	  the linux-media mailinglist.
endif
```

## drivers/staging/media/phy-rockchip-dphy-rx0/Kconfig
```kconfig
# SPDX-License-Identifier: GPL-2.0-only

config PHY_ROCKCHIP_DPHY_RX0
	tristate "Rockchip MIPI Synopsys DPHY RX0 driver"
	depends on ARCH_ROCKCHIP || COMPILE_TEST
	select GENERIC_PHY_MIPI_DPHY
	select GENERIC_PHY
	help
	  Enable this to support the Rockchip MIPI Synopsys DPHY RX0
	  associated to the Rockchip ISP module present in RK3399 SoCs.

	  To compile this driver as a module, choose M here: the module
	  will be called phy-rockchip-dphy-rx0.
```

## drivers/staging/media/platform/bcm2835/Kconfig
```kconfig
config VIDEO_BCM2835
	tristate "Broadcom BCM2835 camera driver"
	depends on VIDEO_V4L2 && (ARCH_BCM2835 || COMPILE_TEST)
	depends on BCM2835_VCHIQ
	depends on ARM
	select VIDEOBUF2_VMALLOC
	help
	  Say Y here to enable camera host interface devices for
	  Broadcom BCM2835 SoC. This operates over the VCHIQ interface
	  to a service running on VideoCore.
```

## drivers/staging/media/rkisp1/Documentation/devicetree/bindings/media/rockchip-isp1.yaml
```yaml
# SPDX-License-Identifier: (GPL-2.0+ OR MIT)
%YAML 1.2
---
$id: http://devicetree.org/schemas/media/rockchip-isp1.yaml#
$schema: http://devicetree.org/meta-schemas/core.yaml#

title: Rockchip SoC Image Signal Processing unit v1

maintainers:
  - Helen Koike <helen.koike@collabora.com>

description: |
  Rockchip ISP1 is the Camera interface for the Rockchip series of SoCs
  which contains image processing, scaling, and compression functions.

properties:
  compatible:
    const: rockchip,rk3399-cif-isp

  reg:
    maxItems: 1

  interrupts:
    maxItems: 1

  iommus:
    maxItems: 1

  power-domains:
    maxItems: 1

  phys:
    maxItems: 1
    description: phandle for the PHY port

  phy-names:
    const: dphy

  clocks:
    items:
      - description: ISP clock
      - description: ISP AXI clock clock
      - description: ISP AXI clock  wrapper clock
      - description: ISP AHB clock clock
      - description: ISP AHB wrapper clock

  clock-names:
    items:
      - const: clk_isp
      - const: aclk_isp
      - const: aclk_isp_wrap
      - const: hclk_isp
      - const: hclk_isp_wrap

  # See ./video-interfaces.txt for details
  ports:
    type: object
    additionalProperties: false

    properties:
      "#address-cells":
        const: 1

      "#size-cells":
        const: 0

      port@0:
        type: object
        description: connection point for sensors at MIPI-DPHY RX0
        additionalProperties: false

        properties:
          "#address-cells":
            const: 1

          "#size-cells":
            const: 0

          reg:
            const: 0

        patternProperties:
          endpoint:
            type: object
            additionalProperties: false

            properties:
              reg:
                maxItems: 1

              data-lanes:
                minItems: 1
                maxItems: 4

              remote-endpoint: true

    required:
      - port@0

required:
  - compatible
  - interrupts
  - clocks
  - clock-names
  - power-domains
  - iommus
  - phys
  - phy-names
  - ports

additionalProperties: false

examples:
  - |

    #include <dt-bindings/clock/rk3399-cru.h>
    #include <dt-bindings/interrupt-controller/arm-gic.h>
    #include <dt-bindings/power/rk3399-power.h>

    parent0: parent@0 {
        #address-cells = <2>;
        #size-cells = <2>;

        isp0: isp0@ff910000 {
            compatible = "rockchip,rk3399-cif-isp";
            reg = <0x0 0xff910000 0x0 0x4000>;
            interrupts = <GIC_SPI 43 IRQ_TYPE_LEVEL_HIGH 0>;
            clocks = <&cru SCLK_ISP0>,
                     <&cru ACLK_ISP0>, <&cru ACLK_ISP0_WRAPPER>,
                     <&cru HCLK_ISP0>, <&cru HCLK_ISP0_WRAPPER>;
            clock-names = "clk_isp",
                          "aclk_isp", "aclk_isp_wrap",
                          "hclk_isp", "hclk_isp_wrap";
            power-domains = <&power RK3399_PD_ISP0>;
            iommus = <&isp0_mmu>;
            phys = <&dphy>;
            phy-names = "dphy";

            ports {
                #address-cells = <1>;
                #size-cells = <0>;

                port@0 {
                    #address-cells = <1>;
                    #size-cells = <0>;
                    reg = <0>;

                    mipi_in_wcam: endpoint@0 {
                        reg = <0>;
                        remote-endpoint = <&wcam_out>;
                        data-lanes = <1 2>;
                    };

                    mipi_in_ucam: endpoint@1 {
                        reg = <1>;
                        remote-endpoint = <&ucam_out>;
                        data-lanes = <1>;
                    };
                };
            };
        };

        i2c7: i2c@ff160000 {
            clock-frequency = <400000>;
            #address-cells = <1>;
            #size-cells = <0>;

            wcam: camera@36 {
                compatible = "ovti,ov5695";
                reg = <0x36>;

                port {
                    wcam_out: endpoint {
                        remote-endpoint = <&mipi_in_wcam>;
                        data-lanes = <1 2>;
                    };
                };
            };

            ucam: camera@3c {
                compatible = "ovti,ov2685";
                reg = <0x3c>;

                  port {
                      ucam_out: endpoint {
                          remote-endpoint = <&mipi_in_ucam>;
                          data-lanes = <1>;
                      };
                  };
            };
        };
    };
```

## drivers/staging/media/rkisp1/Kconfig
```kconfig
# SPDX-License-Identifier: GPL-2.0-only

config VIDEO_ROCKCHIP_ISP1
	tristate "Rockchip Image Signal Processing v1 Unit driver"
	depends on VIDEO_V4L2 && VIDEO_V4L2_SUBDEV_API
	depends on ARCH_ROCKCHIP || COMPILE_TEST
	select VIDEOBUF2_DMA_CONTIG
	select VIDEOBUF2_VMALLOC
	select V4L2_FWNODE
	select PHY_ROCKCHIP_DPHY_RX0
	default n
	help
	  Enable this to support the Image Signal Processing (ISP) module
	  present in RK3399 SoCs.

	  To compile this driver as a module, choose M here: the module
	  will be called rockchip-isp1.
```

## drivers/staging/media/rkvdec/Kconfig
```kconfig
# SPDX-License-Identifier: GPL-2.0
config VIDEO_ROCKCHIP_VDEC
	tristate "Rockchip Video Decoder driver"
	depends on ARCH_ROCKCHIP || COMPILE_TEST
	depends on VIDEO_DEV
	select MEDIA_CONTROLLER
	select MEDIA_CONTROLLER_REQUEST_API
	select VIDEOBUF2_DMA_CONTIG
	select VIDEOBUF2_VMALLOC
	select V4L2_MEM2MEM_DEV
	select V4L2_H264
	select V4L2_VP9
	help
	  Support for the Rockchip Video Decoder IP present on Rockchip SoCs,
	  which accelerates video decoding.
	  To compile this driver as a module, choose M here: the module
	  will be called rockchip-vdec.
```
