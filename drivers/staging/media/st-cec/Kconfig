## drivers/staging/most/Kconfig
```kconfig
# SPDX-License-Identifier: GPL-2.0
menuconfig MOST_COMPONENTS
	tristate "MOST support"
	depends on HAS_DMA && CONFIGFS_FS && MOST
	default n
	help
	  Say Y here if you want to enable MOST support.
	  This driver needs at least one additional component to enable the
	  desired access from userspace (e.g. character devices) and one that
	  matches the network controller's hardware interface (e.g. USB).

	  To compile this driver as a module, choose M here: the
	  module will be called most_core.

	  If in doubt, say N here.



if MOST_COMPONENTS

source "drivers/staging/most/net/Kconfig"

source "drivers/staging/most/sound/Kconfig"

source "drivers/staging/most/video/Kconfig"

source "drivers/staging/most/dim2/Kconfig"

source "drivers/staging/most/i2c/Kconfig"

endif
```

## drivers/staging/most/aim-cdev/Kconfig
```kconfig
#
# MOST Cdev configuration
#

config AIM_CDEV
	tristate "Cdev AIM"

	---help---
	  Say Y here if you want to commumicate via character devices.

	  To compile this driver as a module, choose M here: the
	  module will be called aim_cdev.
```

## drivers/staging/most/aim-network/Kconfig
```kconfig
#
# MOST Networking configuration
#

config AIM_NETWORK
	tristate "Networking AIM"
	depends on NET

	---help---
	  Say Y here if you want to commumicate via a networking device.

	  To compile this driver as a module, choose M here: the
	  module will be called aim_network.
```

## drivers/staging/most/aim-sound/Kconfig
```kconfig
#
# MOST ALSA configuration
#

config AIM_SOUND
	tristate "ALSA AIM"
	depends on SND
	select SND_PCM
	---help---
	  Say Y here if you want to commumicate via ALSA/sound devices.

	  To compile this driver as a module, choose M here: the
	  module will be called aim_sound.
```

## drivers/staging/most/aim-v4l2/Kconfig
```kconfig
#
# MOST V4L2 configuration
#

config AIM_V4L2
	tristate "V4L2 AIM"
	depends on VIDEO_V4L2
	---help---
	  Say Y here if you want to commumicate via Video 4 Linux.

	  To compile this driver as a module, choose M here: the
	  module will be called aim_v4l2.
```

## drivers/staging/most/cdev/Kconfig
```kconfig
#
# MOST Cdev configuration
#

config MOST_CDEV
	tristate "Cdev"

	---help---
	  Say Y here if you want to commumicate via character devices.

	  To compile this driver as a module, choose M here: the
	  module will be called most_cdev.
```

## drivers/staging/most/dim2/Kconfig
```kconfig
#
# MediaLB configuration
#

config MOST_DIM2
	tristate "DIM2"
	depends on HAS_IOMEM

	---help---
	  Say Y here if you want to connect via MediaLB to network transceiver.
	  This device driver is platform dependent and needs an additional
	  platform driver to be installed. For more information contact
	  maintainer of this driver.

	  To compile this driver as a module, choose M here: the
	  module will be called most_dim2.
```
