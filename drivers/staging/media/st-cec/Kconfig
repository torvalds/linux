## drivers/staging/media/st-cec/Kconfig
```kconfig
config VIDEO_STI_HDMI_CEC
       tristate "STMicroelectronics STiH4xx HDMI CEC driver"
       depends on VIDEO_DEV && MEDIA_CEC_SUPPORT && (ARCH_STI || COMPILE_TEST)
       ---help---
         This is a driver for STIH4xx HDMI CEC interface. It uses the
         generic CEC framework interface.
         CEC bus is present in the HDMI connector and enables communication
         between compatible devices.
```

## drivers/staging/media/starfive/Kconfig
```kconfig
# SPDX-License-Identifier: GPL-2.0-only

comment "StarFive media platform drivers"

source "drivers/staging/media/starfive/camss/Kconfig"
```

## drivers/staging/media/starfive/camss/Kconfig
```kconfig
# SPDX-License-Identifier: GPL-2.0-only
config VIDEO_STARFIVE_CAMSS
	tristate "Starfive Camera Subsystem driver"
	depends on V4L_PLATFORM_DRIVERS
	depends on VIDEO_DEV && OF
	depends on HAS_DMA
	depends on PM
	depends on ARCH_STARFIVE || COMPILE_TEST
	select MEDIA_CONTROLLER
	select VIDEO_V4L2_SUBDEV_API
	select VIDEOBUF2_DMA_CONTIG
	select V4L2_FWNODE
	help
	   Enable this to support for the Starfive Camera subsystem
	   found on Starfive JH7110 SoC.

	   To compile this driver as a module, choose M here: the
	   module will be called starfive-camss.
```

## drivers/staging/media/sunxi/Kconfig
```kconfig
# SPDX-License-Identifier: GPL-2.0
config VIDEO_SUNXI
	bool "Allwinner sunXi family Video Devices"
	depends on ARCH_SUNXI || COMPILE_TEST
	help
	  If you have an Allwinner SoC based on the sunXi family, say Y.

	  Note that this option doesn't include new drivers in the
	  kernel: saying N will just cause Kconfig to skip all the
	  questions about Allwinner media devices.

if VIDEO_SUNXI

source "drivers/staging/media/sunxi/cedrus/Kconfig"

endif
```

## drivers/staging/media/sunxi/cedrus/Kconfig
```kconfig
# SPDX-License-Identifier: GPL-2.0
config VIDEO_SUNXI_CEDRUS
	tristate "Allwinner Cedrus VPU driver"
	depends on VIDEO_DEV
	depends on HAS_DMA
	depends on OF
	select MEDIA_CONTROLLER
	select MEDIA_CONTROLLER_REQUEST_API
	select SUNXI_SRAM
	select VIDEOBUF2_DMA_CONTIG
	select V4L2_MEM2MEM_DEV
	help
	  Support for the VPU found in Allwinner SoCs, also known as the Cedar
	  video engine.

	  To compile this driver as a module, choose M here: the module
	  will be called sunxi-cedrus.
```

## drivers/staging/media/sunxi/sun6i-isp/Kconfig
```kconfig
# SPDX-License-Identifier: GPL-2.0-only
config VIDEO_SUN6I_ISP
	tristate "Allwinner A31 Image Signal Processor (ISP) Driver"
	depends on V4L_PLATFORM_DRIVERS && VIDEO_DEV
	depends on ARCH_SUNXI || COMPILE_TEST
	depends on PM && COMMON_CLK && HAS_DMA
	select MEDIA_CONTROLLER
	select VIDEO_V4L2_SUBDEV_API
	select VIDEOBUF2_DMA_CONTIG
	select VIDEOBUF2_VMALLOC
	select V4L2_FWNODE
	select REGMAP_MMIO
	help
	   Support for the Allwinner A31 Image Signal Processor (ISP), also
	   found on other platforms such as the A80, A83T or V3/V3s.
```

## drivers/staging/media/tegra-vde/Kconfig
```kconfig
# SPDX-License-Identifier: GPL-2.0
config TEGRA_VDE
	tristate "NVIDIA Tegra Video Decoder Engine driver"
	depends on ARCH_TEGRA || COMPILE_TEST
	select DMA_SHARED_BUFFER
	select IOMMU_IOVA
	select SRAM
	help
	    Say Y here to enable support for the NVIDIA Tegra video decoder
	    driver.
```

## drivers/staging/media/tegra-video/Kconfig
```kconfig
# SPDX-License-Identifier: GPL-2.0-only
config VIDEO_TEGRA
	tristate "NVIDIA Tegra VI driver"
	depends on TEGRA_HOST1X
	depends on VIDEO_DEV
	select MEDIA_CONTROLLER
	select VIDEOBUF2_DMA_CONTIG
	select V4L2_FWNODE
	help
	  Choose this option if you have an NVIDIA Tegra SoC.

	  To compile this driver as a module, choose M here: the module
	  will be called tegra-video.

config VIDEO_TEGRA_TPG
	bool "NVIDIA Tegra VI driver TPG mode"
	depends on VIDEO_TEGRA
	depends on ARCH_TEGRA_210_SOC
	help
	  Say yes here to enable Tegra internal TPG mode
```

## drivers/staging/media/timb/Kconfig
```kconfig
config VIDEO_TIMBERDALE
	tristate "Support for timberdale Video In/LogiWIN"
	depends on VIDEO_V4L2 && I2C && VIDEO_V4L2_SUBDEV_API && HAS_DMA
	depends on (MFD_TIMBERDALE && TIMB_DMA) || COMPILE_TEST
	select VIDEO_ADV7180
	select VIDEOBUF_DMA_CONTIG
	---help---
	  Add support for the Video In peripherial of the timberdale FPGA.

	  This driver is deprecated and will be removed soon unless someone
	  will start the work to convert this driver to the vb2 framework.
```

## drivers/staging/media/tlg2300/Kconfig
```kconfig
config VIDEO_TLG2300
	tristate "Telegent TLG2300 USB video capture support (Deprecated)"
	depends on VIDEO_DEV && I2C && SND && DVB_CORE
	select VIDEO_TUNER
	select VIDEO_TVEEPROM
	depends on RC_CORE
	select VIDEOBUF_VMALLOC
	select SND_PCM
	select VIDEOBUF_DVB

	---help---
	  This is a video4linux driver for Telegent tlg2300 based TV cards.
	  The driver supports V4L2, DVB-T and radio.

	  This driver is deprecated and will be removed soon. If you have
	  hardware for this and you want to work on this driver, then contact
	  the linux-media mailinglist.

	  To compile this driver as a module, choose M here: the
	  module will be called poseidon
```

## drivers/staging/media/tw686x-kh/Kconfig
```kconfig
config VIDEO_TW686X_KH
	tristate "Intersil/Techwell TW686x Video For Linux"
	depends on VIDEO_DEV && PCI && VIDEO_V4L2
	depends on !(VIDEO_TW686X=y || VIDEO_TW686X=m) || COMPILE_TEST
	select VIDEOBUF2_DMA_SG
	help
	  Support for Intersil/Techwell TW686x-based frame grabber cards.

	  Currently supported chips:
	  - TW6864 (4 video channels),
	  - TW6865 (4 video channels, not tested, second generation chip),
	  - TW6868 (8 video channels but only 4 first channels using
	    built-in video decoder are supported, not tested),
	  - TW6869 (8 video channels, second generation chip).

	  To compile this driver as a module, choose M here: the module
	  will be named tw686x-kh.
```

## drivers/staging/media/usbvision/Kconfig
```kconfig
# SPDX-License-Identifier: GPL-2.0-only
config VIDEO_USBVISION
	tristate "USB video devices based on Nogatech NT1003/1004/1005 (Deprecated)"
	depends on MEDIA_USB_SUPPORT && I2C && VIDEO_V4L2
	select VIDEO_TUNER
	select VIDEO_SAA711X if MEDIA_SUBDRV_AUTOSELECT
	help
	  There are more than 50 different USB video devices based on
	  NT1003/1004/1005 USB Bridges. This driver enables using those
	  devices.

	  This driver is deprecated and scheduled for removal by the
	  end of 2020. See the TODO file in drivers/staging/media/usbvision
	  for a list of actions that have to be done in order to prevent
	  removal of this driver.

	  To compile this driver as a module, choose M here: the
	  module will be called usbvision.
```

## drivers/staging/media/vino/Kconfig
```kconfig
config VIDEO_VINO
	tristate "SGI Vino Video For Linux (Deprecated)"
	depends on I2C && SGI_IP22 && VIDEO_V4L2
	select VIDEO_SAA7191 if MEDIA_SUBDRV_AUTOSELECT
	help
	  Say Y here to build in support for the Vino video input system found
	  on SGI Indy machines.

	  This driver is deprecated and will be removed soon. If you have
	  hardware for this and you want to work on this driver, then contact
	  the linux-media mailinglist.

config VIDEO_SAA7191
	tristate "Philips SAA7191 video decoder (Deprecated)"
	depends on VIDEO_V4L2 && I2C
	---help---
	  Support for the Philips SAA7191 video decoder.

	  This driver is deprecated and will be removed soon. If you have
	  hardware for this and you want to work on this driver, then contact
	  the linux-media mailinglist.

	  To compile this driver as a module, choose M here: the
	  module will be called saa7191.
```

## drivers/staging/media/zoran/Kconfig
```kconfig
config VIDEO_ZORAN
	tristate "Zoran ZR36057/36067 Video For Linux (Deprecated)"
	depends on PCI && I2C_ALGOBIT && VIDEO_V4L2 && VIRT_TO_BUS
	depends on !ALPHA
	select VIDEOBUF2_DMA_CONTIG
	help
	  Say Y for support for MJPEG capture cards based on the Zoran
	  36057/36067 PCI controller chipset. This includes the Iomega
	  Buz, Pinnacle DC10+ and the Linux Media Labs LML33. There is
	  a driver homepage at <http://mjpeg.sf.net/driver-zoran/>. For
	  more information, check <file:Documentation/media/v4l-drivers/zoran.rst>.

	  To compile this driver as a module, choose M here: the
	  module will be called zr36067.

config VIDEO_ZORAN_DC30
	tristate "Pinnacle/Miro DC30(+) support"
	depends on VIDEO_ZORAN
	select VIDEO_ADV7175 if MEDIA_SUBDRV_AUTOSELECT
	select VIDEO_VPX3220 if MEDIA_SUBDRV_AUTOSELECT
	help
	  Support for the Pinnacle/Miro DC30(+) MJPEG capture/playback
	  card. This also supports really old DC10 cards based on the
	  zr36050 MJPEG codec and zr36016 VFE.

config VIDEO_ZORAN_ZR36060
	tristate "Zoran ZR36060"
	depends on VIDEO_ZORAN
	help
	  Say Y to support Zoran boards based on 36060 chips.
	  This includes Iomega Buz, Pinnacle DC10, Linux media Labs 33
	  and 33 R10 and AverMedia 6 boards.

config VIDEO_ZORAN_BUZ
	tristate "Iomega Buz support"
	depends on VIDEO_ZORAN_ZR36060
	select VIDEO_SAA711X if MEDIA_SUBDRV_AUTOSELECT
	select VIDEO_SAA7185 if MEDIA_SUBDRV_AUTOSELECT
	help
	  Support for the Iomega Buz MJPEG capture/playback card.

config VIDEO_ZORAN_DC10
	tristate "Pinnacle/Miro DC10(+) support"
	depends on VIDEO_ZORAN_ZR36060
	select VIDEO_SAA7110 if MEDIA_SUBDRV_AUTOSELECT
	select VIDEO_ADV7175 if MEDIA_SUBDRV_AUTOSELECT
	help
	  Support for the Pinnacle/Miro DC10(+) MJPEG capture/playback
	  card.

config VIDEO_ZORAN_LML33
	tristate "Linux Media Labs LML33 support"
	depends on VIDEO_ZORAN_ZR36060
	select VIDEO_BT819 if MEDIA_SUBDRV_AUTOSELECT
	select VIDEO_BT856 if MEDIA_SUBDRV_AUTOSELECT
	help
	  Support for the Linux Media Labs LML33 MJPEG capture/playback
	  card.

config VIDEO_ZORAN_LML33R10
	tristate "Linux Media Labs LML33R10 support"
	depends on VIDEO_ZORAN_ZR36060
	select VIDEO_SAA711X if MEDIA_SUBDRV_AUTOSELECT
	select VIDEO_ADV7170 if MEDIA_SUBDRV_AUTOSELECT
	help
	  support for the Linux Media Labs LML33R10 MJPEG capture/playback
	  card.

config VIDEO_ZORAN_AVS6EYES
	tristate "AverMedia 6 Eyes support"
	depends on VIDEO_ZORAN_ZR36060
	select VIDEO_BT856 if MEDIA_SUBDRV_AUTOSELECT
	select VIDEO_BT866 if MEDIA_SUBDRV_AUTOSELECT
	select VIDEO_KS0127 if MEDIA_SUBDRV_AUTOSELECT
	help
	  Support for the AverMedia 6 Eyes video surveillance card.
```

## drivers/staging/mei/Kconfig
```kconfig
config INTEL_MEI
	tristate "Intel Management Engine Interface (Intel MEI)"
	depends on X86 && PCI && EXPERIMENTAL
	help
	  The Intel Management Engine (Intel ME) provides Manageability,
	  Security and Media services for system containing Intel chipsets.
	  if selected /dev/mei misc device will be created.

	  Supported Chipsets are:
	  7 Series Chipset Family
	  6 Series Chipset Family
	  5 Series Chipset Family
	  4 Series Chipset Family
	  Mobile 4 Series Chipset Family
	  ICH9
	  82946GZ/GL
	  82G35 Express
	  82Q963/Q965
	  82P965/G965
	  Mobile PM965/GM965
	  Mobile GME965/GLE960
	  82Q35 Express
	  82G33/G31/P35/P31 Express
	  82Q33 Express
	  82X38/X48 Express

	  For more information see
	  <http://software.intel.com/en-us/manageability/>
```

## drivers/staging/meilhaus/Kconfig
```kconfig
#
# Meilhaus configuration
#

menuconfig MEILHAUS
	tristate "Meilhaus support"
	---help---
	  If you have a Meilhaus card, say Y (or M) here.

	  You need both this driver, and the driver for the particular
	  data collection card.

	  To compile this driver as a module, choose M here. The module will
	  be called memain.

if MEILHAUS

config ME0600
	tristate "Meilhaus ME-600 support"
	default n
	depends on PCI
	help
	  This driver supports the Meilhaus ME-600 family of boards
	  that do data collection and multipurpose I/O.

	  To compile this driver as a module, choose M here: the module
	  will be called me0600.

config ME0900
	tristate "Meilhaus ME-900 support"
	default n
	depends on PCI
	help
	  This driver supports the Meilhaus ME-900 family of boards
	  that do data collection and multipurpose I/O.

	  To compile this driver as a module, choose M here: the module
	  will be called me0900.

config ME1000
	tristate "Meilhaus ME-1000 support"
	default n
	depends on PCI
	help
	  This driver supports the Meilhaus ME-1000 family of boards
	  that do data collection and multipurpose I/O.

	  To compile this driver as a module, choose M here: the module
	  will be called me1000.

config ME1400
	tristate "Meilhaus ME-1400 support"
	default n
	depends on PCI
	help
	  This driver supports the Meilhaus ME-1400 family of boards
	  that do data collection and multipurpose I/O.

	  To compile this driver as a module, choose M here: the module
	  will be called me1400.

config ME1600
	tristate "Meilhaus ME-1600 support"
	default n
	depends on PCI
	help
	  This driver supports the Meilhaus ME-1600 family of boards
	  that do data collection and multipurpose I/O.

	  To compile this driver as a module, choose M here: the module
	  will be called me1600.

config ME4600
	tristate "Meilhaus ME-4600 support"
	default n
	depends on PCI
	help
	  This driver supports the Meilhaus ME-4600 family of boards
	  that do data collection and multipurpose I/O.

	  To compile this driver as a module, choose M here: the module
	  will be called me4600.

config ME6000
	tristate "Meilhaus ME-6000 support"
	default n
	depends on PCI
	help
	  This driver supports the Meilhaus ME-6000 family of boards
	  that do data collection and multipurpose I/O.

	  To compile this driver as a module, choose M here: the module
	  will be called me6000.

config ME8100
	tristate "Meilhaus ME-8100 support"
	default n
	depends on PCI
	help
	  This driver supports the Meilhaus ME-8100 family of boards
	  that do data collection and multipurpose I/O.

	  To compile this driver as a module, choose M here: the module
	  will be called me8100.

config ME8200
	tristate "Meilhaus ME-8200 support"
	default n
	depends on PCI
	help
	  This driver supports the Meilhaus ME-8200 family of boards
	  that do data collection and multipurpose I/O.

	  To compile this driver as a module, choose M here: the module
	  will be called me8200.

config MEDUMMY
	tristate "Meilhaus dummy driver"
	default n
	depends on PCI
	help
	  This provides a dummy driver for the Meilhaus driver package

	  To compile this driver as a module, choose M here: the module
	  will be called medummy.

endif # MEILHAUS
```

## drivers/staging/memrar/Kconfig
```kconfig
config MRST_RAR_HANDLER
	tristate "RAR handler driver for Intel Moorestown platform"
	depends on RAR_REGISTER
	---help---
	  This driver provides a memory management interface to
	  restricted access regions (RAR) available on the Intel
	  Moorestown platform.

	  Once locked down, restricted access regions are only
	  accessible by specific hardware on the platform.  The x86
	  CPU is typically not one of those platforms.  As such this
	  driver does not access RAR, and only provides a buffer
	  allocation/bookkeeping mechanism.

	  If unsure, say N.
```

## drivers/staging/mimio/Kconfig
```kconfig
config INPUT_MIMIO
	tristate "Mimio Xi interactive whiteboard support"
	depends on USB
	default N
	help
	  Say Y here if you want to use a Mimio Xi interactive
	  whiteboard device.

	  To compile this driver as a module, choose M here: the
	  module will be called mimio.
```
