## drivers/staging/media/deprecated/stkwebcam/Kconfig
```kconfig
# SPDX-License-Identifier: GPL-2.0-only
config VIDEO_STKWEBCAM
	tristate "USB Syntek DC1125 Camera support (DEPRECATED)"
	depends on VIDEO_DEV
	depends on MEDIA_USB_SUPPORT && MEDIA_CAMERA_SUPPORT
	help
	  Say Y here if you want to use this type of camera.
	  Supported devices are typically found in some Asus laptops,
	  with USB id 174f:a311 and 05e1:0501. Other Syntek cameras
	  may be supported by the stk11xx driver, from which this is
	  derived, see <http://sourceforge.net/projects/syntekdriver/>

	  This driver is deprecated and is scheduled for removal by
	  the end of 2022. See the TODO file for more information.

	  To compile this driver as a module, choose M here: the
	  module will be called stkwebcam.
```

## drivers/staging/media/deprecated/vpfe_capture/Kconfig
```kconfig
# SPDX-License-Identifier: GPL-2.0-only
config VIDEO_DM6446_CCDC
	tristate "TI DM6446 CCDC video capture driver"
	depends on V4L_PLATFORM_DRIVERS
	depends on VIDEO_DEV
	depends on ARCH_DAVINCI || COMPILE_TEST
	depends on I2C
	select VIDEOBUF_DMA_CONTIG
	help
	  Enables DaVinci CCD hw module. DaVinci CCDC hw interfaces
	  with decoder modules such as TVP5146 over BT656 or
	  sensor module such as MT9T001 over a raw interface. This
	  module configures the interface and CCDC/ISIF to do
	  video frame capture from slave decoders.

	  This driver is deprecated and is scheduled for removal by
	  the beginning of 2023. See the TODO file for more information.

	  To compile this driver as a module, choose M here. There will
	  be two modules called vpfe_capture.ko and dm644x_ccdc.ko

config VIDEO_DM355_CCDC
	tristate "TI DM355 CCDC video capture driver"
	depends on V4L_PLATFORM_DRIVERS
	depends on VIDEO_DEV
	depends on ARCH_DAVINCI || COMPILE_TEST
	depends on I2C
	select VIDEOBUF_DMA_CONTIG
	help
	  Enables DM355 CCD hw module. DM355 CCDC hw interfaces
	  with decoder modules such as TVP5146 over BT656 or
	  sensor module such as MT9T001 over a raw interface. This
	  module configures the interface and CCDC/ISIF to do
	  video frame capture from a slave decoders

	  This driver is deprecated and is scheduled for removal by
	  the beginning of 2023. See the TODO file for more information.

	  To compile this driver as a module, choose M here. There will
	  be two modules called vpfe_capture.ko and dm355_ccdc.ko

config VIDEO_DM365_ISIF
	tristate "TI DM365 ISIF video capture driver"
	depends on V4L_PLATFORM_DRIVERS
	depends on VIDEO_DEV
	depends on ARCH_DAVINCI || COMPILE_TEST
	depends on I2C
	select VIDEOBUF_DMA_CONTIG
	help
	  Enables ISIF hw module. This is the hardware module for
	  configuring ISIF in VPFE to capture Raw Bayer RGB data from
	  a image sensor or YUV data from a YUV source.

	  This driver is deprecated and is scheduled for removal by
	  the beginning of 2023. See the TODO file for more information.

	  To compile this driver as a module, choose M here. There will
	  be two modules called vpfe_capture.ko and isif.ko
```

## drivers/staging/media/deprecated/zr364xx/Kconfig
```kconfig
# SPDX-License-Identifier: GPL-2.0-only
config USB_ZR364XX
	tristate "USB ZR364XX Camera support (DEPRECATED)"
	depends on USB && VIDEO_DEV
	select VIDEOBUF_GEN
	select VIDEOBUF_VMALLOC
	help
	  Say Y here if you want to connect this type of camera to your
	  computer's USB port.
	  See <file:Documentation/admin-guide/media/zr364xx.rst> for more info
	  and list of supported cameras.

	  This driver is deprecated and is scheduled for removal by
	  the beginning of 2023. See the TODO file for more information.

	  To compile this driver as a module, choose M here: the
	  module will be called zr364xx.
```

## drivers/staging/media/dt3155v4l/Kconfig
```kconfig
config VIDEO_DT3155
	tristate "DT3155 frame grabber, Video4Linux interface"
	depends on PCI && VIDEO_DEV && VIDEO_V4L2
	select VIDEOBUF2_DMA_CONTIG
	default n
	---help---
	  Enables dt3155 device driver for the DataTranslation DT3155 frame grabber.
	  Say Y here if you have this hardware.
	  In doubt, say N.

	  To compile this driver as a module, choose M here: the
	  module will be called dt3155v4l.

config DT3155_CCIR
	bool "Selects CCIR/50Hz vertical refresh"
	depends on VIDEO_DT3155
	default y
	---help---
	  Select it for CCIR/50Hz (European region),
	  or leave it unselected for RS-170/60Hz (North America).

config DT3155_STREAMING
	bool "Selects streaming capture method"
	depends on VIDEO_DT3155
	default y
	---help---
	  Select it if you want to use streaming of memory mapped buffers
	  or leave it unselected if you want to use read method (one copy more).
```

## drivers/staging/media/easycap/Kconfig
```kconfig
config EASYCAP
	tristate "EasyCAP USB ID 05e1:0408 support"
	depends on USB && VIDEO_DEV && SND
	select SND_PCM

	---help---
	  This is an integrated audio/video driver for EasyCAP cards with
	  USB ID 05e1:0408.  It supports two hardware variants:

	  *  EasyCAP USB 2.0 Video Adapter with Audio, Model DC60,
	     having input cables labelled CVBS, S-VIDEO, AUDIO(L), AUDIO(R)

	  *  EasyCAP002 4-Channel USB 2.0 DVR, having input cables labelled
	     1, 2, 3, 4 and an unlabelled input cable for a microphone.

	  To compile this driver as a module, choose M here: the
	  module will be called easycap

config EASYCAP_DEBUG
	bool "Enable EasyCAP driver debugging"
	depends on EASYCAP

	---help---
	  This option enables debug printouts

	  To enable debug, pass the debug level to the debug module
          parameter:

          modprobe easycap debug=[0..9]
```

## drivers/staging/media/go7007/Kconfig
```kconfig
config VIDEO_GO7007
	tristate "WIS GO7007 MPEG encoder support"
	depends on VIDEO_DEV && I2C
	depends on SND && USB
	select VIDEOBUF2_VMALLOC
	select VIDEO_TUNER
	select CYPRESS_FIRMWARE
	select SND_PCM
	select VIDEO_SONY_BTF_MPX if MEDIA_SUBDRV_AUTOSELECT
	select VIDEO_SAA711X if MEDIA_SUBDRV_AUTOSELECT
	select VIDEO_TW2804 if MEDIA_SUBDRV_AUTOSELECT
	select VIDEO_TW9903 if MEDIA_SUBDRV_AUTOSELECT
	select VIDEO_TW9906 if MEDIA_SUBDRV_AUTOSELECT
	select VIDEO_OV7640 if MEDIA_SUBDRV_AUTOSELECT
	select VIDEO_UDA1342 if MEDIA_SUBDRV_AUTOSELECT
	default N
	---help---
	  This is a video4linux driver for the WIS GO7007 MPEG
	  encoder chip.

	  To compile this driver as a module, choose M here: the
	  module will be called go7007.

config VIDEO_GO7007_USB
	tristate "WIS GO7007 USB support"
	depends on VIDEO_GO7007 && USB
	default N
	---help---
	  This is a video4linux driver for the WIS GO7007 MPEG
	  encoder chip over USB.

	  To compile this driver as a module, choose M here: the
	  module will be called go7007-usb.

config VIDEO_GO7007_LOADER
	tristate "WIS GO7007 Loader support"
	depends on VIDEO_GO7007
	default y
	---help---
	  This is a go7007 firmware loader driver for the WIS GO7007
	  MPEG encoder chip over USB.

	  To compile this driver as a module, choose M here: the
	  module will be called go7007-loader.

config VIDEO_GO7007_USB_S2250_BOARD
	tristate "Sensoray 2250/2251 support"
	depends on VIDEO_GO7007_USB && USB
	default N
	---help---
	  This is a video4linux driver for the Sensoray 2250/2251 device.

	  To compile this driver as a module, choose M here: the
	  module will be called s2250.
```

## drivers/staging/media/hantro/Kconfig
```kconfig
# SPDX-License-Identifier: GPL-2.0
config VIDEO_HANTRO
	tristate "Hantro VPU driver"
	depends on ARCH_MXC || ARCH_ROCKCHIP || ARCH_AT91 || ARCH_SUNXI || COMPILE_TEST
	depends on VIDEO_DEV
	select MEDIA_CONTROLLER
	select MEDIA_CONTROLLER_REQUEST_API
	select VIDEOBUF2_DMA_CONTIG
	select VIDEOBUF2_VMALLOC
	select V4L2_MEM2MEM_DEV
	select V4L2_H264
	select V4L2_VP9
	help
	  Support for the Hantro IP based Video Processing Units present on
	  Rockchip and NXP i.MX8M SoCs, which accelerate video and image
	  encoding and decoding.
	  To compile this driver as a module, choose M here: the module
	  will be called hantro-vpu.

config VIDEO_HANTRO_IMX8M
	bool "Hantro VPU i.MX8M support"
	depends on VIDEO_HANTRO
	depends on ARCH_MXC || COMPILE_TEST
	default y
	help
	  Enable support for i.MX8M SoCs.

config VIDEO_HANTRO_SAMA5D4
	bool "Hantro VDEC SAMA5D4 support"
	depends on VIDEO_HANTRO
	depends on ARCH_AT91 || COMPILE_TEST
	default y
	help
	  Enable support for Microchip SAMA5D4 SoCs.

config VIDEO_HANTRO_ROCKCHIP
	bool "Hantro VPU Rockchip support"
	depends on VIDEO_HANTRO
	depends on ARCH_ROCKCHIP || COMPILE_TEST
	default y
	help
	  Enable support for RK3288, RK3328, and RK3399 SoCs.

config VIDEO_HANTRO_SUNXI
	bool "Hantro VPU Allwinner support"
	depends on VIDEO_HANTRO
	depends on ARCH_SUNXI || COMPILE_TEST
	default y
	help
	  Enable support for H6 SoC.
```

## drivers/staging/media/imx/Kconfig
```kconfig
# SPDX-License-Identifier: GPL-2.0
config VIDEO_IMX_MEDIA
	tristate "i.MX5/6 V4L2 media drivers"
	depends on ARCH_MXC || COMPILE_TEST
	depends on HAS_DMA
	depends on VIDEO_DEV
	depends on VIDEO_DEV
	depends on IMX_IPUV3_CORE
	select MEDIA_CONTROLLER
	select V4L2_FWNODE
	select V4L2_MEM2MEM_DEV
	select VIDEOBUF2_DMA_CONTIG
	select VIDEO_V4L2_SUBDEV_API
	help
	  Say yes here to enable support for video4linux media controller
	  drivers for the i.MX5/6 SOC.
```

## drivers/staging/media/imx074/Kconfig
```kconfig
config SOC_CAMERA_IMX074
	tristate "imx074 support (DEPRECATED)"
	depends on SOC_CAMERA && I2C
	help
	  This driver supports IMX074 cameras from Sony
```

## drivers/staging/media/ipu3/Kconfig
```kconfig
# SPDX-License-Identifier: GPL-2.0
config VIDEO_IPU3_IMGU
	tristate "Intel ipu3-imgu driver"
	depends on PCI && VIDEO_DEV
	depends on X86
	select MEDIA_CONTROLLER
	select VIDEO_V4L2_SUBDEV_API
	select IOMMU_IOVA
	select VIDEOBUF2_DMA_SG
	help
	  This is the Video4Linux2 driver for Intel IPU3 image processing unit,
	  found in Intel Skylake and Kaby Lake SoCs and used for processing
	  images and video.

	  Say Y or M here if you have a Skylake/Kaby Lake SoC with a MIPI
	  camera. The module will be called ipu3-imgu.
```
