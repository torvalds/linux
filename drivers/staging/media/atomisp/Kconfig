## drivers/staging/media/atomisp/Kconfig
```kconfig
# SPDX-License-Identifier: GPL-2.0
menuconfig INTEL_ATOMISP
	bool "Enable support to Intel Atom ISP camera drivers"
	depends on X86 && EFI && PCI && ACPI
	depends on COMMON_CLK
	select IOSF_MBI
	select MEDIA_CONTROLLER
	help
	  Enable support for the Intel ISP2 camera interfaces and MIPI
	  sensor drivers.

config VIDEO_ATOMISP
	tristate "Intel Atom Image Signal Processor Driver"
	depends on VIDEO_DEV && INTEL_ATOMISP
	depends on IPU_BRIDGE
	depends on MEDIA_PCI_SUPPORT
	depends on PMIC_OPREGION
	depends on I2C
	select V4L2_FWNODE
	select IOSF_MBI
	select VIDEOBUF2_VMALLOC
	select VIDEO_V4L2_SUBDEV_API
	help
	  Say Y here if your platform supports Intel Atom SoC
	  camera imaging subsystem.
	  To compile this driver as a module, choose M here: the
	  module will be called atomisp

if VIDEO_ATOMISP
source "drivers/staging/media/atomisp/i2c/Kconfig"
endif
```

## drivers/staging/media/atomisp/i2c/Kconfig
```kconfig
# SPDX-License-Identifier: GPL-2.0
#
# Kconfig for sensor drivers
#

config VIDEO_ATOMISP_OV2722
	tristate "OVT ov2722 sensor support"
	depends on ACPI
	depends on I2C && VIDEO_DEV
	help
	  This is a Video4Linux2 sensor-level driver for the OVT
	  OV2722 raw camera.

	  OVT is a 2M raw sensor.

	  It currently only works with the atomisp driver.

config VIDEO_ATOMISP_GC2235
	tristate "Galaxy gc2235 sensor support"
	depends on ACPI
	depends on I2C && VIDEO_DEV
	help
	  This is a Video4Linux2 sensor-level driver for the OVT
	  GC2235 raw camera.

	  GC2235 is a 2M raw sensor.

	  It currently only works with the atomisp driver.
```

## drivers/staging/media/atomisp/i2c/imx/Kconfig
```kconfig
config VIDEO_IMX
	tristate "sony imx sensor support"
	depends on I2C && VIDEO_V4L2 && VIDEO_MSRLIST_HELPER && m
	---help---
	  This is a Video4Linux2 sensor-level driver for the Sony
	  IMX RAW sensor.

	  It currently depends on internal V4L2 extensions defined in
	  atomisp driver.
```

## drivers/staging/media/atomisp/i2c/ov5693/Kconfig
```kconfig
config VIDEO_ATOMISP_OV5693
       tristate "Omnivision ov5693 sensor support"
	depends on ACPI
       depends on I2C && VIDEO_V4L2
       ---help---
	 This is a Video4Linux2 sensor-level driver for the Micron
	 ov5693 5 Mpixel camera.

	 ov5693 is video camera sensor.

	 It currently only works with the atomisp driver.
```

## drivers/staging/media/atomisp/pci/Kconfig
```kconfig
#
# Kconfig for ISP driver
#

config VIDEO_ATOMISP
	tristate "Intel Atom Image Signal Processor Driver"
	depends on VIDEO_V4L2 && VIDEO_V4L2_SUBDEV_API
	select IOSF_MBI
	select VIDEOBUF_VMALLOC
	---help---
	  Say Y here if your platform supports Intel Atom SoC
	  camera imaging subsystem.
	  To compile this driver as a module, choose M here: the
	  module will be called atomisp
```

## drivers/staging/media/av7110/Kconfig
```kconfig
# SPDX-License-Identifier: GPL-2.0-only
config DVB_AV7110_IR
	bool
	depends on RC_CORE=y || RC_CORE = DVB_AV7110
	default DVB_AV7110

config DVB_AV7110
	tristate "AV7110 cards"
	depends on DVB_CORE && PCI && I2C
	select TTPCI_EEPROM
	select VIDEO_SAA7146_VV
	depends on VIDEO_DEV	# dependencies of VIDEO_SAA7146_VV
	select DVB_VES1820 if MEDIA_SUBDRV_AUTOSELECT
	select DVB_VES1X93 if MEDIA_SUBDRV_AUTOSELECT
	select DVB_STV0299 if MEDIA_SUBDRV_AUTOSELECT
	select DVB_TDA8083 if MEDIA_SUBDRV_AUTOSELECT
	select DVB_SP8870 if MEDIA_SUBDRV_AUTOSELECT
	select DVB_STV0297 if MEDIA_SUBDRV_AUTOSELECT
	select DVB_L64781 if MEDIA_SUBDRV_AUTOSELECT
	select DVB_LNBP21 if MEDIA_SUBDRV_AUTOSELECT
	help
	  Support for SAA7146 and AV7110 based DVB cards as produced
	  by Fujitsu-Siemens, Technotrend, Hauppauge and others.

	  This driver only supports the fullfeatured cards with
	  onboard MPEG2 decoder.

	  This driver needs an external firmware. Please use the script
	  "<kerneldir>/scripts/get_dvb_firmware av7110" to
	  download/extract it, and then copy it to /usr/lib/hotplug/firmware
	  or /lib/firmware (depending on configuration of firmware hotplug).

	  Alternatively, you can download the file and use the kernel's
	  EXTRA_FIRMWARE configuration option to build it into your
	  kernel image by adding the filename to the EXTRA_FIRMWARE
	  configuration option string.

	  Say Y if you own such a card and want to use it.

config DVB_AV7110_OSD
	bool "AV7110 OSD support"
	depends on DVB_AV7110
	default y if DVB_AV7110=y || DVB_AV7110=m
	help
	  The AV7110 firmware provides some code to generate an OnScreenDisplay
	  on the video output. This is kind of nonstandard and not guaranteed to
	  be maintained.

	  Anyway, some popular DVB software like VDR uses this OSD to render
	  its menus, so say Y if you want to use this software.

	  All other people say N.

if DVB_AV7110

# Frontend driver that it is used only by AV7110 driver
# While technically independent, it doesn't make sense to keep
# it if we drop support for AV7110, as no other driver will use it.

config DVB_SP8870
	tristate "Spase sp8870 based"
	depends on DVB_CORE && I2C
	default m if !MEDIA_SUBDRV_AUTOSELECT
	help
	  A DVB-T tuner module. Say Y when you want to support this frontend.

	  This driver needs external firmware. Please use the command
	  "<kerneldir>/scripts/get_dvb_firmware sp8870" to
	  download/extract it, and then copy it to /usr/lib/hotplug/firmware
	  or /lib/firmware (depending on configuration of firmware hotplug).

endif
```

## drivers/staging/media/bcm2048/Kconfig
```kconfig
# SPDX-License-Identifier: GPL-2.0
#
# Multimedia Video device configuration
#

config I2C_BCM2048
	tristate "Broadcom BCM2048 FM Radio Receiver support"
	depends on I2C && VIDEO_V4L2 && RADIO_ADAPTERS
	---help---
	  Say Y here if you want support to BCM2048 FM Radio Receiver.
	  This device driver supports only i2c bus.

	  To compile this driver as a module, choose M here: the
	  module will be called radio-bcm2048.
```

## drivers/staging/media/cec/Kconfig
```kconfig
config MEDIA_CEC
	bool "CEC API (EXPERIMENTAL)"
	depends on MEDIA_SUPPORT
	select MEDIA_CEC_EDID
	---help---
	  Enable the CEC API.

config MEDIA_CEC_DEBUG
	bool "CEC debugfs interface (EXPERIMENTAL)"
	depends on MEDIA_CEC && DEBUG_FS
	---help---
	  Turns on the DebugFS interface for CEC devices.
```

## drivers/staging/media/davinci_vpfe/Kconfig
```kconfig
config VIDEO_DM365_VPFE
	tristate "DM365 VPFE Media Controller Capture Driver"
	depends on VIDEO_V4L2 && ARCH_DAVINCI_DM365 && !VIDEO_DM365_ISIF
	depends on HAS_DMA
	depends on VIDEO_V4L2_SUBDEV_API
	depends on VIDEO_DAVINCI_VPBE_DISPLAY
	select VIDEOBUF2_DMA_CONTIG
	help
	  Support for DM365 VPFE based Media Controller Capture driver.

	  To compile this driver as a module, choose M here: the
	  module will be called vpfe-mc-capture.
```

## drivers/staging/media/deprecated/atmel/Kconfig
```kconfig
# SPDX-License-Identifier: GPL-2.0-only

comment "Atmel media platform drivers"

config VIDEO_ATMEL_ISC
	tristate "ATMEL Image Sensor Controller (ISC) support (DEPRECATED)"
	depends on V4L_PLATFORM_DRIVERS
	depends on VIDEO_DEV && COMMON_CLK
	depends on ARCH_AT91 || COMPILE_TEST
	depends on !VIDEO_MICROCHIP_ISC_BASE || COMPILE_TEST
	select MEDIA_CONTROLLER
	select VIDEO_V4L2_SUBDEV_API
	select VIDEOBUF2_DMA_CONTIG
	select REGMAP_MMIO
	select V4L2_FWNODE
	select VIDEO_ATMEL_ISC_BASE
	help
	   This module makes the ATMEL Image Sensor Controller available
	   as a v4l2 device.

	   This driver is deprecated and is scheduled for removal by
	   the beginning of 2026. See the TODO file for more information.

config VIDEO_ATMEL_XISC
	tristate "ATMEL eXtended Image Sensor Controller (XISC) support (DEPRECATED)"
	depends on V4L_PLATFORM_DRIVERS
	depends on VIDEO_DEV && COMMON_CLK
	depends on ARCH_AT91 || COMPILE_TEST
	depends on !VIDEO_MICROCHIP_ISC_BASE || COMPILE_TEST
	select VIDEOBUF2_DMA_CONTIG
	select REGMAP_MMIO
	select V4L2_FWNODE
	select VIDEO_ATMEL_ISC_BASE
	select MEDIA_CONTROLLER
	select VIDEO_V4L2_SUBDEV_API
	help
	   This module makes the ATMEL eXtended Image Sensor Controller
	   available as a v4l2 device.

	   This driver is deprecated and is scheduled for removal by
	   the beginning of 2026. See the TODO file for more information.

config VIDEO_ATMEL_ISC_BASE
	tristate
	default n
	help
	  ATMEL ISC and XISC common code base.
```

## drivers/staging/media/deprecated/cpia2/Kconfig
```kconfig
# SPDX-License-Identifier: GPL-2.0-only
config VIDEO_CPIA2
	tristate "CPiA2 Video For Linux (DEPRECATED)"
	depends on USB && VIDEO_DEV
	help
	  This is the video4linux driver for cameras based on Vision's CPiA2
	  (Colour Processor Interface ASIC), such as the Digital Blue QX5
	  Microscope. If you have one of these cameras, say Y here

	  This driver is deprecated and is scheduled for removal by
	  the beginning of 2023. See the TODO file for more information.

	  This driver is also available as a module (cpia2).
```

## drivers/staging/media/deprecated/fsl-viu/Kconfig
```kconfig
# SPDX-License-Identifier: GPL-2.0-only
config VIDEO_VIU
	tristate "NXP VIU Video Driver (DEPRECATED)"
	depends on V4L_PLATFORM_DRIVERS
	depends on VIDEO_DEV && (PPC_MPC512x || COMPILE_TEST) && I2C
	select VIDEOBUF_DMA_CONTIG
	help
	  Support for Freescale VIU video driver. This device captures
	  video data, or overlays video on DIU frame buffer.

	  This driver is deprecated and is scheduled for removal by
	  the beginning of 2023. See the TODO file for more information.

	  Say Y here if you want to enable VIU device on MPC5121e Rev2+.
	  In doubt, say N.
```

## drivers/staging/media/deprecated/saa7146/Kconfig
```kconfig
# SPDX-License-Identifier: GPL-2.0
source "drivers/staging/media/deprecated/saa7146/common/Kconfig"
source "drivers/staging/media/deprecated/saa7146/av7110/Kconfig"
source "drivers/staging/media/deprecated/saa7146/saa7146/Kconfig"
source "drivers/staging/media/deprecated/saa7146/ttpci/Kconfig"
```

## drivers/staging/media/deprecated/saa7146/av7110/Kconfig
```kconfig
# SPDX-License-Identifier: GPL-2.0-only
config DVB_AV7110_IR
	bool
	depends on RC_CORE=y || RC_CORE = DVB_AV7110
	default DVB_AV7110

config DVB_AV7110
	tristate "AV7110 cards (DEPRECATED)"
	depends on DVB_CORE && PCI && I2C
	select TTPCI_EEPROM
	select VIDEO_SAA7146_VV
	depends on VIDEO_DEV	# dependencies of VIDEO_SAA7146_VV
	select DVB_VES1820 if MEDIA_SUBDRV_AUTOSELECT
	select DVB_VES1X93 if MEDIA_SUBDRV_AUTOSELECT
	select DVB_STV0299 if MEDIA_SUBDRV_AUTOSELECT
	select DVB_TDA8083 if MEDIA_SUBDRV_AUTOSELECT
	select DVB_SP8870 if MEDIA_SUBDRV_AUTOSELECT
	select DVB_STV0297 if MEDIA_SUBDRV_AUTOSELECT
	select DVB_L64781 if MEDIA_SUBDRV_AUTOSELECT
	select DVB_LNBP21 if MEDIA_SUBDRV_AUTOSELECT
	help
	  Support for SAA7146 and AV7110 based DVB cards as produced
	  by Fujitsu-Siemens, Technotrend, Hauppauge and others.

	  This driver only supports the fullfeatured cards with
	  onboard MPEG2 decoder.

	  This driver needs an external firmware. Please use the script
	  "<kerneldir>/scripts/get_dvb_firmware av7110" to
	  download/extract it, and then copy it to /usr/lib/hotplug/firmware
	  or /lib/firmware (depending on configuration of firmware hotplug).

	  Alternatively, you can download the file and use the kernel's
	  EXTRA_FIRMWARE configuration option to build it into your
	  kernel image by adding the filename to the EXTRA_FIRMWARE
	  configuration option string.

	  This driver is deprecated and is scheduled for removal by
	  the beginning of 2023. See the TODO file for more information.

	  Say Y if you own such a card and want to use it.

config DVB_AV7110_OSD
	bool "AV7110 OSD support (DEPRECATED)"
	depends on DVB_AV7110
	default y if DVB_AV7110=y || DVB_AV7110=m
	help
	  The AV7110 firmware provides some code to generate an OnScreenDisplay
	  on the video output. This is kind of nonstandard and not guaranteed to
	  be maintained.

	  Anyway, some popular DVB software like VDR uses this OSD to render
	  its menus, so say Y if you want to use this software.

	  This driver is deprecated and is scheduled for removal by
	  the beginning of 2023. See the TODO file for more information.

	  All other people say N.

config DVB_BUDGET_PATCH
	tristate "AV7110 cards with Budget Patch (DEPRECATED)"
	depends on DVB_BUDGET_CORE && I2C
	depends on DVB_AV7110
	select DVB_STV0299 if MEDIA_SUBDRV_AUTOSELECT
	select DVB_VES1X93 if MEDIA_SUBDRV_AUTOSELECT
	select DVB_TDA8083 if MEDIA_SUBDRV_AUTOSELECT
	help
	  Support for Budget Patch (full TS) modification on
	  SAA7146+AV7110 based cards (DVB-S cards). This
	  driver doesn't use onboard MPEG2 decoder. The
	  card is driven in Budget-only mode. Card is
	  required to have loaded firmware to tune properly.
	  Firmware can be loaded by insertion and removal of
	  standard AV7110 driver prior to loading this
	  driver.

	  This driver is deprecated and is scheduled for removal by
	  the beginning of 2023. See the TODO file for more information.

	  Say Y if you own such a card and want to use it.

	  To compile this driver as a module, choose M here: the
	  module will be called budget-patch.

if DVB_AV7110

# Frontend driver that it is used only by AV7110 driver
# While technically independent, it doesn't make sense to keep
# it if we drop support for AV7110, as no other driver will use it.

config DVB_SP8870
	tristate "Spase sp8870 based (DEPRECATED)"
	depends on DVB_CORE && I2C
	default m if !MEDIA_SUBDRV_AUTOSELECT
	help
	  A DVB-T tuner module. Say Y when you want to support this frontend.

	  This driver needs external firmware. Please use the command
	  "<kerneldir>/scripts/get_dvb_firmware sp8870" to
	  download/extract it, and then copy it to /usr/lib/hotplug/firmware
	  or /lib/firmware (depending on configuration of firmware hotplug).

	  This driver is deprecated and is scheduled for removal by
	  the beginning of 2023. See the TODO file for more information.

endif
```

## drivers/staging/media/deprecated/saa7146/saa7146/Kconfig
```kconfig
# SPDX-License-Identifier: GPL-2.0-only
config VIDEO_HEXIUM_GEMINI
	tristate "Hexium Gemini frame grabber (DEPRECATED)"
	depends on PCI && VIDEO_DEV && I2C
	select VIDEO_SAA7146_VV
	help
	  This is a video4linux driver for the Hexium Gemini frame
	  grabber card by Hexium. Please note that the Gemini Dual
	  card is *not* fully supported.

	  This driver is deprecated and is scheduled for removal by
	  the beginning of 2023. See the TODO file for more information.

	  To compile this driver as a module, choose M here: the
	  module will be called hexium_gemini.

config VIDEO_HEXIUM_ORION
	tristate "Hexium HV-PCI6 and Orion frame grabber (DEPRECATED)"
	depends on PCI && VIDEO_DEV && I2C
	select VIDEO_SAA7146_VV
	help
	  This is a video4linux driver for the Hexium HV-PCI6 and
	  Orion frame grabber cards by Hexium.

	  This driver is deprecated and is scheduled for removal by
	  the beginning of 2023. See the TODO file for more information.

	  To compile this driver as a module, choose M here: the
	  module will be called hexium_orion.

config VIDEO_MXB
	tristate "Siemens-Nixdorf 'Multimedia eXtension Board' (DEPRECATED)"
	depends on PCI && VIDEO_DEV && I2C
	select VIDEO_SAA7146_VV
	select VIDEO_TUNER
	select VIDEO_SAA711X if MEDIA_SUBDRV_AUTOSELECT
	select VIDEO_TDA9840 if MEDIA_SUBDRV_AUTOSELECT
	select VIDEO_TEA6415C if MEDIA_SUBDRV_AUTOSELECT
	select VIDEO_TEA6420 if MEDIA_SUBDRV_AUTOSELECT
	help
	  This is a video4linux driver for the 'Multimedia eXtension Board'
	  TV card by Siemens-Nixdorf.

	  This driver is deprecated and is scheduled for removal by
	  the beginning of 2023. See the TODO file for more information.

	  To compile this driver as a module, choose M here: the
	  module will be called mxb.
```
