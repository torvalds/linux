// SPDX-License-Identifier: GPL-2.0
/dts-v1/;
/plugin/;

#include "clk-fixed-rate_test.h"

&{/} {
	fixed_50MHz: kunit-clock {
		compatible = "fixed-clock";
		#clock-cells = <0>;
		clock-frequency = <TEST_FIXED_FREQUENCY>;
		clock-accuracy = <TEST_FIXED_ACCURACY>;
	};

	kunit-clock-consumer {
		compatible = "test,single-clk-consumer";
		clocks = <&fixed_50MHz>;
	};
};
