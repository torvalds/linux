// SPDX-License-Identifier: GPL-2.0
/dts-v1/;
/plugin/;

&{/} {
	clk: kunit-clock {
		compatible = "test,clk-assigned-rates";
		#clock-cells = <0>;
		assigned-clocks = <&clk>;
		assigned-clock-rates = <0>;
	};
};
