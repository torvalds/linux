// SPDX-License-Identifier: GPL-2.0
/dts-v1/;
/plugin/;

#include "kunit_clk_assigned_rates.h"

&{/} {
	clk: kunit-clock {
		compatible = "test,clk-assigned-rates";
		#clock-cells = <0>;
		assigned-clocks = <0>;
		assigned-clock-rates = <ASSIGNED_RATES_0_RATE>;
	};
};
