## drivers/clk/sunxi-ng/Kconfig
```kconfig
# SPDX-License-Identifier: GPL-2.0-only
config SUNXI_CCU
	tristate "Clock support for Allwinner SoCs"
	depends on ARCH_SUNXI || COMPILE_TEST
	select RESET_CONTROLLER
	default ARCH_SUNXI

if SUNXI_CCU

config SUNIV_F1C100S_CCU
	tristate "Support for the Allwinner newer F1C100s CCU"
	default ARCH_SUNXI
	depends on MACH_SUNIV || COMPILE_TEST

config SUN20I_D1_CCU
	tristate "Support for the Allwinner D1/R528/T113 CCU"
	default ARCH_SUNXI
	depends on MACH_SUN8I || RISCV || COMPILE_TEST

config SUN20I_D1_R_CCU
	tristate "Support for the Allwinner D1/R528/T113 PRCM CCU"
	default ARCH_SUNXI
	depends on MACH_SUN8I || RISCV || COMPILE_TEST

config SUN50I_A64_CCU
	tristate "Support for the Allwinner A64 CCU"
	default ARCH_SUNXI
	depends on ARM64 || COMPILE_TEST

config SUN50I_A100_CCU
	tristate "Support for the Allwinner A100 CCU"
	default ARCH_SUNXI
	depends on ARM64 || COMPILE_TEST

config SUN50I_A100_R_CCU
	tristate "Support for the Allwinner A100 PRCM CCU"
	default ARCH_SUNXI
	depends on ARM64 || COMPILE_TEST

config SUN50I_H6_CCU
	tristate "Support for the Allwinner H6 CCU"
	default ARCH_SUNXI
	depends on ARM64 || COMPILE_TEST

config SUN50I_H616_CCU
	tristate "Support for the Allwinner H616 CCU"
	default ARCH_SUNXI
	depends on ARM64 || COMPILE_TEST

config SUN50I_H6_R_CCU
	tristate "Support for the Allwinner H6 and H616 PRCM CCU"
	default ARCH_SUNXI
	depends on ARM64 || COMPILE_TEST

config SUN55I_A523_CCU
	tristate "Support for the Allwinner A523/T527 CCU"
	default ARCH_SUNXI
	depends on ARM64 || COMPILE_TEST

config SUN55I_A523_MCU_CCU
	tristate "Support for the Allwinner A523/T527 MCU CCU"
	default ARCH_SUNXI
	depends on ARM64 || COMPILE_TEST

config SUN55I_A523_R_CCU
	tristate "Support for the Allwinner A523/T527 PRCM CCU"
	default ARCH_SUNXI
	depends on ARM64 || COMPILE_TEST

config SUN4I_A10_CCU
	tristate "Support for the Allwinner A10/A20 CCU"
	default ARCH_SUNXI
	depends on MACH_SUN4I || MACH_SUN7I || COMPILE_TEST

config SUN5I_CCU
	bool "Support for the Allwinner sun5i family CCM"
	default ARCH_SUNXI
	depends on MACH_SUN5I || COMPILE_TEST
	depends on SUNXI_CCU=y

config SUN6I_A31_CCU
	tristate "Support for the Allwinner A31/A31s CCU"
	default ARCH_SUNXI
	depends on MACH_SUN6I || COMPILE_TEST

config SUN6I_RTC_CCU
	tristate "Support for the Allwinner H616/R329 RTC CCU"
	default ARCH_SUNXI
	depends on MACH_SUN8I || ARM64 || RISCV || COMPILE_TEST

config SUN8I_A23_CCU
	tristate "Support for the Allwinner A23 CCU"
	default ARCH_SUNXI
	depends on MACH_SUN8I || COMPILE_TEST

config SUN8I_A33_CCU
	tristate "Support for the Allwinner A33 CCU"
	default ARCH_SUNXI
	depends on MACH_SUN8I || COMPILE_TEST

config SUN8I_A83T_CCU
	tristate "Support for the Allwinner A83T CCU"
	default ARCH_SUNXI
	depends on MACH_SUN8I || COMPILE_TEST

config SUN8I_H3_CCU
	tristate "Support for the Allwinner H3 CCU"
	default ARCH_SUNXI
	depends on MACH_SUN8I || ARM64 || COMPILE_TEST

config SUN8I_V3S_CCU
	tristate "Support for the Allwinner V3s CCU"
	default ARCH_SUNXI
	depends on MACH_SUN8I || COMPILE_TEST

config SUN8I_DE2_CCU
	tristate "Support for the Allwinner SoCs DE2 CCU"
	default ARCH_SUNXI
	depends on MACH_SUN8I || ARM64 || RISCV || COMPILE_TEST

config SUN8I_R40_CCU
	tristate "Support for the Allwinner R40 CCU"
	default ARCH_SUNXI
	depends on MACH_SUN8I || COMPILE_TEST

config SUN9I_A80_CCU
	tristate "Support for the Allwinner A80 CCU"
	default ARCH_SUNXI
	depends on MACH_SUN9I || COMPILE_TEST

config SUN8I_R_CCU
	tristate "Support for Allwinner SoCs' PRCM CCUs"
	default ARCH_SUNXI
	depends on MACH_SUN8I || ARM64 || COMPILE_TEST

endif
```

## drivers/clk/sunxi/Kconfig
```kconfig
# SPDX-License-Identifier: GPL-2.0-only
menuconfig CLK_SUNXI
	bool "Legacy clock support for Allwinner SoCs"
	depends on (ARM && ARCH_SUNXI) || COMPILE_TEST
	default (ARM && ARCH_SUNXI)

if CLK_SUNXI

config CLK_SUNXI_CLOCKS
	bool "Legacy clock drivers"
	default ARCH_SUNXI
	help
	  Legacy clock drivers being used on older (A10, A13, A20,
	  A23, A31, A80) SoCs. These drivers are kept around for
	  Device Tree backward compatibility issues, in case one would
	  still use a Device Tree with one clock provider by
	  node. Newer Device Trees and newer SoCs use the drivers
	  controlled by CONFIG_SUNXI_CCU.

config CLK_SUNXI_PRCM_SUN6I
	bool "Legacy A31 PRCM driver"
	default ARCH_SUNXI
	help
	  Legacy clock driver for the A31 PRCM clocks. Those are
	  usually needed for the PMIC communication, mostly.

config CLK_SUNXI_PRCM_SUN8I
	bool "Legacy sun8i PRCM driver"
	default ARCH_SUNXI
	help
	  Legacy clock driver for the sun8i family PRCM clocks.
	  Those are usually needed for the PMIC communication,
	  mostly.

config CLK_SUNXI_PRCM_SUN9I
	bool "Legacy A80 PRCM driver"
	default ARCH_SUNXI
	help
	  Legacy clock driver for the A80 PRCM clocks. Those are
	  usually needed for the PMIC communication, mostly.

endif
```

## drivers/clk/tegra/Kconfig
```kconfig
config TEGRA_CLK_EMC
	def_bool y
	depends on TEGRA124_EMC

config CLK_TEGRA_BPMP
	def_bool y
	depends on TEGRA_BPMP

config TEGRA_CLK_DFLL
	depends on ARCH_TEGRA_124_SOC || ARCH_TEGRA_210_SOC
	select PM_OPP
	def_bool y
```

## drivers/clk/thead/Kconfig
```kconfig
#SPDX-License-Identifier: GPL-2.0

config CLK_THEAD_TH1520_AP
	bool "T-HEAD TH1520 AP clock support"
	depends on ARCH_THEAD || COMPILE_TEST
	default ARCH_THEAD
	select REGMAP_MMIO
	help
	  Say yes here to support the AP sub system clock controller
	  on the T-HEAD TH1520 SoC. This includes configuration of
	  both CPU PLLs, both DPU PLLs as well as the GMAC, VIDEO,
	  and TEE PLLs.
```

## drivers/clk/ti/Kconfig
```kconfig
# SPDX-License-Identifier: GPL-2.0-only
config COMMON_CLK_TI_ADPLL
	tristate "Clock driver for dm814x ADPLL"
	depends on ARCH_OMAP2PLUS || COMPILE_TEST
	default y if SOC_TI81XX
	---help---
	  ADPLL clock driver for the dm814x SoC using common clock framework.
```

## drivers/clk/uniphier/Kconfig
```kconfig
# SPDX-License-Identifier: GPL-2.0-only
config CLK_UNIPHIER
	bool "Clock driver for UniPhier SoCs"
	depends on ARCH_UNIPHIER || COMPILE_TEST
	depends on OF && MFD_SYSCON
	default ARCH_UNIPHIER
	help
	  Support for clock controllers on UniPhier SoCs.
	  Say Y if you want to control clocks provided by System Control
	  block, Media I/O block, Peripheral Block.
```

## drivers/clk/versatile/Kconfig
```kconfig
# SPDX-License-Identifier: GPL-2.0-only

menu "Clock driver for ARM Reference designs"

config ICST
	bool "Clock driver for ARM Reference designs ICST"
	select REGMAP_MMIO
	help
	  Supports clocking on ARM Reference designs:
	  - Integrator/AP and Integrator/CP
	  - RealView PB1176, EB, PB11MP and PBX

config CLK_SP810
	bool "Clock driver for ARM SP810 System Controller"
	default y if (ARCH_VEXPRESS && ARM)
	help
	  Supports clock muxing (REFCLK/TIMCLK to TIMERCLKEN0-3) capabilities
	  of the ARM SP810 System Controller cell.

config CLK_VEXPRESS_OSC
	tristate "Clock driver for Versatile Express OSC clock generators"
	depends on VEXPRESS_CONFIG
	select REGMAP_MMIO
	default y if ARCH_VEXPRESS
	help
	  Simple regmap-based driver driving clock generators on Versatile
	  Express platforms hidden behind its configuration infrastructure,
	  commonly known as OSCs.

endmenu
```

## drivers/clk/visconti/Kconfig
```kconfig
# SPDX-License-Identifier: GPL-2.0-only

config COMMON_CLK_VISCONTI
	bool "Support for Toshiba Visconti5 ARM SoC clock controllers"
	depends on ARCH_VISCONTI || COMPILE_TEST
	default ARCH_VISCONTI
	help
	  Support for the Toshiba Visconti5 ARM SoC clock controller.
	  Say Y if you want to include clock support.
```

## drivers/clk/x86/Kconfig
```kconfig
# SPDX-License-Identifier: GPL-2.0-only
config CLK_LGM_CGU
	depends on OF && HAS_IOMEM && (X86 || COMPILE_TEST)
	select MFD_SYSCON
	select OF_EARLY_FLATTREE
	bool "Clock driver for Lightning Mountain(LGM) platform"
	help
	  Clock Generation Unit(CGU) driver for MaxLinear's x86 based
	  Lightning Mountain(LGM) network processor SoC.
```

## drivers/clk/xilinx/Kconfig
```kconfig
# SPDX-License-Identifier: GPL-2.0

config XILINX_VCU
	tristate "Xilinx VCU logicoreIP Init"
	depends on HAS_IOMEM
	select REGMAP_MMIO
	help
	  Provides the driver to enable and disable the isolation between the
	  processing system and programmable logic part by using the logicoreIP
	  register set. This driver also configures the frequency based on the
	  clock information from the logicoreIP register set.

	  If you say yes here you get support for the logicoreIP.

	  If unsure, say N.

	  To compile this driver as a module, choose M here: the
	  module will be called xlnx_vcu.

config COMMON_CLK_XLNX_CLKWZRD
	tristate "Xilinx Clocking Wizard"
	depends on OF
	depends on HAS_IOMEM
	help
	  Support for the Xilinx Clocking Wizard IP core clock generator.
	  Adds support for clocking wizard and compatible.
	  This driver supports the Xilinx clocking wizard programmable clock
	  synthesizer. The number of output is configurable in the design.

	  If unsure, say N.
```

## drivers/clk/zynqmp/Kconfig
```kconfig
# SPDX-License-Identifier: GPL-2.0

config COMMON_CLK_ZYNQMP
	bool "Support for Xilinx ZynqMP Ultrascale+ clock controllers"
	depends on ZYNQMP_FIRMWARE || COMPILE_TEST
	default ZYNQMP_FIRMWARE
	help
	  Support for the Zynqmp Ultrascale clock controller.
	  It has a dependency on the PMU firmware.
	  Say Y if you want to include clock support.
```
