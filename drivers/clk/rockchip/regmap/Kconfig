## drivers/clk/rockchip/regmap/Kconfig
```kconfig
# SPDX-License-Identifier: GPL-2.0

config COMMON_CLK_ROCKCHIP_REGMAP
	tristate

config CLK_RK618
	tristate "Clock driver for Rockchip RK618"
	depends on MFD_RK618
	default MFD_RK618
	select COMMON_CLK_ROCKCHIP_REGMAP

config CLK_RK628
	tristate "Clock driver for Rockchip RK628"
	depends on MFD_RK628
	default MFD_RK628
	select COMMON_CLK_ROCKCHIP_REGMAP
```

## drivers/clk/samsung/Kconfig
```kconfig
# SPDX-License-Identifier: GPL-2.0-only
# Recent Exynos platforms should just select COMMON_CLK_SAMSUNG:
config COMMON_CLK_SAMSUNG
	bool "Samsung Exynos clock controller support" if COMPILE_TEST
	select S3C64XX_COMMON_CLK if ARM && ARCH_S3C64XX
	select S5PV210_COMMON_CLK if ARM && ARCH_S5PV210
	select EXYNOS_3250_COMMON_CLK if ARM && SOC_EXYNOS3250
	select EXYNOS_4_COMMON_CLK if ARM && ARCH_EXYNOS4
	select EXYNOS_5250_COMMON_CLK if ARM && SOC_EXYNOS5250
	select EXYNOS_5260_COMMON_CLK if ARM && SOC_EXYNOS5260
	select EXYNOS_5410_COMMON_CLK if ARM && SOC_EXYNOS5410
	select EXYNOS_5420_COMMON_CLK if ARM && SOC_EXYNOS5420
	select EXYNOS_ARM64_COMMON_CLK if ARM64 && ARCH_EXYNOS
	select TESLA_FSD_COMMON_CLK if ARM64 && ARCH_TESLA_FSD

config S3C64XX_COMMON_CLK
	bool "Samsung S3C64xx clock controller support" if COMPILE_TEST
	depends on COMMON_CLK_SAMSUNG
	help
	  Support for the clock controller present on the Samsung S3C64xx SoCs.
	  Choose Y here only if you build for this SoC.

config S5PV210_COMMON_CLK
	bool "Samsung S5Pv210 clock controller support" if COMPILE_TEST
	depends on COMMON_CLK_SAMSUNG
	help
	  Support for the clock controller present on the Samsung S5Pv210 SoCs.
	  Choose Y here only if you build for this SoC.

config EXYNOS_3250_COMMON_CLK
	bool "Samsung Exynos3250 clock controller support" if COMPILE_TEST
	depends on COMMON_CLK_SAMSUNG
	help
	  Support for the clock controller present on the Samsung
	  Exynos3250 SoCs. Choose Y here only if you build for this SoC.

config EXYNOS_4_COMMON_CLK
	bool "Samsung Exynos4 clock controller support" if COMPILE_TEST
	depends on COMMON_CLK_SAMSUNG
	help
	  Support for the clock controller present on the Samsung
	  Exynos4212 and Exynos4412 SoCs. Choose Y here only if you build for
	  this SoC.

config EXYNOS_5250_COMMON_CLK
	bool "Samsung Exynos5250 clock controller support" if COMPILE_TEST
	depends on COMMON_CLK_SAMSUNG
	help
	  Support for the clock controller present on the Samsung
	  Exynos5250 SoCs. Choose Y here only if you build for this SoC.

config EXYNOS_5260_COMMON_CLK
	bool "Samsung Exynos5260 clock controller support" if COMPILE_TEST
	depends on COMMON_CLK_SAMSUNG
	help
	  Support for the clock controller present on the Samsung
	  Exynos5260 SoCs. Choose Y here only if you build for this SoC.

config EXYNOS_5410_COMMON_CLK
	bool "Samsung Exynos5410 clock controller support" if COMPILE_TEST
	depends on COMMON_CLK_SAMSUNG
	help
	  Support for the clock controller present on the Samsung
	  Exynos5410 SoCs. Choose Y here only if you build for this SoC.

config EXYNOS_5420_COMMON_CLK
	bool "Samsung Exynos5420 clock controller support" if COMPILE_TEST
	depends on COMMON_CLK_SAMSUNG
	help
	  Support for the clock controller present on the Samsung
	  Exynos5420/Exynos5422/Exynos5800 SoCs. Choose Y here only if you
	  build for this SoC.

config EXYNOS_ARM64_COMMON_CLK
	bool "Samsung Exynos ARMv8-family clock controller support" if COMPILE_TEST
	depends on COMMON_CLK_SAMSUNG

config EXYNOS_AUDSS_CLK_CON
	tristate "Samsung Exynos AUDSS clock controller support"
	depends on COMMON_CLK_SAMSUNG
	default y if ARCH_EXYNOS
	help
	  Support for the Audio Subsystem CLKCON clock controller present
	  on some Samsung Exynos SoC variants. Choose M or Y here if you want
	  to use audio devices such as I2S, PCM, etc.

config EXYNOS_CLKOUT
	tristate "Samsung Exynos clock output driver"
	depends on COMMON_CLK_SAMSUNG
	default y if ARCH_EXYNOS
	help
	  Support for the clock output (XCLKOUT) present on some of Samsung
	  Exynos SoC variants. Usually the XCLKOUT is used to monitor the
	  status of the certains clocks from SoC, but it could also be tied to
	  other devices as an input clock.

# For S3C24XX platforms, select following symbols:
config S3C2410_COMMON_CLK
	bool "Samsung S3C2410 clock controller support" if COMPILE_TEST
	select COMMON_CLK_SAMSUNG
	help
	  Support for the clock controller present on the Samsung
	  S3C2410/S3C2440/S3C2442 SoCs. Choose Y here only if you build for
	  this SoC.

config S3C2410_COMMON_DCLK
	bool
	select COMMON_CLK_SAMSUNG
	select REGMAP_MMIO
	help
	  Support for the dclk clock controller present on the Samsung
	  S3C2410/S3C2412/S3C2440/S3C2443 SoCs. Choose Y here only if you build
	  for this SoC.

config S3C2412_COMMON_CLK
	bool "Samsung S3C2412 clock controller support" if COMPILE_TEST
	select COMMON_CLK_SAMSUNG
	help
	  Support for the clock controller present on the Samsung S3C2412 SoCs.
	  Choose Y here only if you build for this SoC.

config S3C2443_COMMON_CLK
	bool "Samsung S3C2443 clock controller support" if COMPILE_TEST
	select COMMON_CLK_SAMSUNG
	help
	  Support for the clock controller present on the Samsung
	  S3C2416/S3C2443 SoCs. Choose Y here only if you build for this SoC.

config TESLA_FSD_COMMON_CLK
	bool "Tesla FSD clock controller support" if COMPILE_TEST
	depends on COMMON_CLK_SAMSUNG
	depends on EXYNOS_ARM64_COMMON_CLK
	help
	  Support for the clock controller present on the Tesla FSD SoC.
	  Choose Y here only if you build for this SoC.
```

## drivers/clk/sifive/Kconfig
```kconfig
# SPDX-License-Identifier: GPL-2.0

menuconfig CLK_SIFIVE
	bool "SiFive SoC driver support"
	depends on ARCH_SIFIVE || COMPILE_TEST
	default ARCH_SIFIVE
	help
	  SoC drivers for SiFive Linux-capable SoCs.

if CLK_SIFIVE

config CLK_SIFIVE_PRCI
	tristate "PRCI driver for SiFive SoCs"
	default ARCH_SIFIVE
	select RESET_CONTROLLER
	select RESET_SIMPLE
	select CLK_ANALOGBITS_WRPLL_CLN28HPC
	help
	  Supports the Power Reset Clock interface (PRCI) IP block found in
	  FU540/FU740 SoCs. If this kernel is meant to run on a SiFive FU540/
	  FU740 SoCs, enable this driver.

endif
```

## drivers/clk/socfpga/Kconfig
```kconfig
# SPDX-License-Identifier: GPL-2.0
config CLK_INTEL_SOCFPGA
	bool "Intel SoCFPGA family clock support" if COMPILE_TEST && !ARCH_INTEL_SOCFPGA
	default ARCH_INTEL_SOCFPGA
	help
	  Support for the clock controllers present on Intel SoCFPGA and eASIC
	  devices like Aria, Cyclone, Stratix 10, Agilex and N5X eASIC.

if CLK_INTEL_SOCFPGA

config CLK_INTEL_SOCFPGA32
	bool "Intel Aria / Cyclone clock controller support" if COMPILE_TEST && (!ARM || !ARCH_INTEL_SOCFPGA)
	default ARM && ARCH_INTEL_SOCFPGA

config CLK_INTEL_SOCFPGA64
	bool "Intel Stratix / Agilex / N5X clock controller support" if COMPILE_TEST && (!ARM64 || !ARCH_INTEL_SOCFPGA)
	default ARM64 && ARCH_INTEL_SOCFPGA

endif # CLK_INTEL_SOCFPGA
```

## drivers/clk/sophgo/Kconfig
```kconfig
# SPDX-License-Identifier: GPL-2.0
# common clock support for SOPHGO SoC family.

config CLK_SOPHGO_CV1800
	tristate "Support for the Sophgo CV1800 series SoCs clock controller"
	depends on ARCH_SOPHGO || COMPILE_TEST
	help
	  This driver supports clock controller of Sophgo CV18XX series SoC.
	  The driver require a 25MHz Oscillator to function generate clock.
	  It includes PLLs, common clock function and some vendor clock for
	  IPs of CV18XX series SoC

config CLK_SOPHGO_SG2042_PLL
	tristate "Sophgo SG2042 PLL clock support"
	depends on ARCH_SOPHGO || COMPILE_TEST
	help
	  This driver supports the PLL clock controller on the
	  Sophgo SG2042 SoC. This clock IP uses three oscillators with
	  frequency of 25 MHz as input, which are used for Main/Fixed
	  PLL, DDR PLL 0 and DDR PLL 1 respectively.

config CLK_SOPHGO_SG2042_CLKGEN
	tristate "Sophgo SG2042 Clock Generator support"
	depends on CLK_SOPHGO_SG2042_PLL
	help
	  This driver supports the Clock Generator on the
	  Sophgo SG2042 SoC. This clock IP depends on SG2042 PLL clock
	  because it uses PLL clocks as input.
	  This driver provides clock function such as DIV/Mux/Gate.

config CLK_SOPHGO_SG2042_RPGATE
	tristate "Sophgo SG2042 RP subsystem clock controller support"
	depends on CLK_SOPHGO_SG2042_CLKGEN
	help
	  This driver supports the RP((Riscv Processors)) subsystem clock
	  controller on the Sophgo SG2042 SoC.
	  This clock IP depends on SG2042 Clock Generator because it uses
	  clock from Clock Generator IP as input.
	  This driver provides Gate function for RP.

config CLK_SOPHGO_SG2044
	tristate "Sophgo SG2044 clock controller support"
	depends on ARCH_SOPHGO || COMPILE_TEST
	help
	  This driver supports the clock controller on the Sophgo SG2044
	  SoC. This controller requires mulitple PLL clock as input.
	  This clock control provides PLL clocks and common clock function
	  for various IPs on the SoC.

config CLK_SOPHGO_SG2044_PLL
	tristate "Sophgo SG2044 PLL clock controller support"
	depends on ARCH_SOPHGO || COMPILE_TEST
	select MFD_SYSCON
	select REGMAP_MMIO
	help
	  This driver supports the PLL clock controller on the Sophgo
	  SG2044 SoC. This controller requires 25M oscillator as input.
	  This clock control provides PLL clocks on the SoC.
```

## drivers/clk/spacemit/Kconfig
```kconfig
# SPDX-License-Identifier: GPL-2.0-only

menu "Clock support for SpacemiT platforms"
	depends on ARCH_SPACEMIT || COMPILE_TEST

config SPACEMIT_CCU
	tristate
	select AUXILIARY_BUS
	select MFD_SYSCON

config SPACEMIT_K1_CCU
	tristate "Support for SpacemiT K1 SoC"
	select SPACEMIT_CCU
	help
	  Support for clock controller unit in SpacemiT K1 SoC.

config SPACEMIT_K3_CCU
	tristate "Support for SpacemiT K3 SoC"
	select SPACEMIT_CCU
	help
	  Support for clock controller unit in SpacemiT K3 SoC.

endmenu
```

## drivers/clk/sprd/Kconfig
```kconfig
# SPDX-License-Identifier: GPL-2.0-only
config SPRD_COMMON_CLK
	tristate "Clock support for Spreadtrum SoCs"
	depends on ARCH_SPRD || COMPILE_TEST
	default ARCH_SPRD
	select REGMAP_MMIO

if SPRD_COMMON_CLK

# SoC Drivers

config SPRD_SC9860_CLK
	tristate "Support for the Spreadtrum SC9860 clocks"
	depends on (ARM64 && ARCH_SPRD) || COMPILE_TEST
	default ARM64 && ARCH_SPRD

config SPRD_SC9863A_CLK
	tristate "Support for the Spreadtrum SC9863A clocks"
	depends on (ARM64 && ARCH_SPRD) || COMPILE_TEST
	default ARM64 && ARCH_SPRD
	help
	  Support for the global clock controller on sc9863a devices.
	  Say Y if you want to use peripheral devices on sc9863a SoC.
endif
```

## drivers/clk/starfive/Kconfig
```kconfig
# SPDX-License-Identifier: GPL-2.0

config CLK_STARFIVE_JH71X0
	bool

config CLK_STARFIVE_JH7100
	bool "StarFive JH7100 clock support"
	depends on ARCH_STARFIVE || COMPILE_TEST
	select CLK_STARFIVE_JH71X0
	default ARCH_STARFIVE
	help
	  Say yes here to support the clock controller on the StarFive JH7100
	  SoC.

config CLK_STARFIVE_JH7100_AUDIO
	tristate "StarFive JH7100 audio clock support"
	depends on CLK_STARFIVE_JH7100
	select CLK_STARFIVE_JH71X0
	default m if ARCH_STARFIVE
	help
	  Say Y or M here to support the audio clocks on the StarFive JH7100
	  SoC.

config CLK_STARFIVE_JH7110_PLL
	bool "StarFive JH7110 PLL clock support"
	depends on ARCH_STARFIVE || COMPILE_TEST
	default ARCH_STARFIVE
	help
	  Say yes here to support the PLL clock controller on the
	  StarFive JH7110 SoC.

config CLK_STARFIVE_JH7110_SYS
	bool "StarFive JH7110 system clock support"
	depends on ARCH_STARFIVE || COMPILE_TEST
	select AUXILIARY_BUS
	select CLK_STARFIVE_JH71X0
	select RESET_STARFIVE_JH7110 if RESET_CONTROLLER
	select CLK_STARFIVE_JH7110_PLL
	default ARCH_STARFIVE
	help
	  Say yes here to support the system clock controller on the
	  StarFive JH7110 SoC.

config CLK_STARFIVE_JH7110_AON
	tristate "StarFive JH7110 always-on clock support"
	depends on CLK_STARFIVE_JH7110_SYS
	default m if ARCH_STARFIVE
	help
	  Say yes here to support the always-on clock controller on the
	  StarFive JH7110 SoC.

config CLK_STARFIVE_JH7110_STG
	tristate "StarFive JH7110 System-Top-Group clock support"
	depends on CLK_STARFIVE_JH7110_SYS
	default m if ARCH_STARFIVE
	help
	  Say yes here to support the System-Top-Group clock controller
	  on the StarFive JH7110 SoC.

config CLK_STARFIVE_JH7110_ISP
	tristate "StarFive JH7110 Image-Signal-Process clock support"
	depends on CLK_STARFIVE_JH7110_SYS && JH71XX_PMU
	default m if ARCH_STARFIVE
	help
	  Say yes here to support the Image-Signal-Process clock controller
	  on the StarFive JH7110 SoC.

config CLK_STARFIVE_JH7110_VOUT
	tristate "StarFive JH7110 Video-Output clock support"
	depends on CLK_STARFIVE_JH7110_SYS && JH71XX_PMU
	default m if ARCH_STARFIVE
	help
	  Say yes here to support the Video-Output clock controller
	  on the StarFive JH7110 SoC.
```

## drivers/clk/stm32/Kconfig
```kconfig
# SPDX-License-Identifier: GPL-2.0-only
# common clock support for STMicroelectronics SoC family.

menuconfig COMMON_CLK_STM32MP
	bool "Clock support for common STM32MP clocks"
	depends on ARCH_STM32 || COMPILE_TEST
	default y
	select RESET_CONTROLLER
	help
	  Support for STM32MP SoC family clocks.

if COMMON_CLK_STM32MP

config COMMON_CLK_STM32MP135
	bool "Clock driver for stm32mp13x clocks"
	depends on ARM || COMPILE_TEST
	default y
	help
	  Support for stm32mp13x SoC family clocks.

config COMMON_CLK_STM32MP157
	bool "Clock driver for stm32mp15x clocks"
	depends on ARM || COMPILE_TEST
	default y
	help
	  Support for stm32mp15x SoC family clocks.

config COMMON_CLK_STM32MP257
	bool "Clock driver for stm32mp25x clocks"
	depends on ARM64 || COMPILE_TEST
	default y
	help
	  Support for stm32mp25x SoC family clocks.

endif
```
