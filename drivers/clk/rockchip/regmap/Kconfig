## drivers/cmmb/Kconfig
```kconfig
# SPDX-License-Identifier: GPL-2.0

 menu "CMMB"
 config CMMB
-tristate "ROCKCHIP CMMB"
 >---default y
 >---help
          rk28 cmmb module.
 ----------
 
 source "drivers/cmmb/siano/Kconfig"
 endmenu
```

## drivers/cmmb/siano/Kconfig
```kconfig
#
# Siano Mobile Silicon Digital TV device configuration
#

config SMS_SIANO_MDTV
	tristate "Siano SMS1xxx based MDTV receiver"
	default M
	---help---
	Choose Y or M here if you have MDTV receiver with a Siano chipset.

	To compile this driver as a module, choose M here
	(The modules will be called smsmdtv).

	Note: All dependents, if selected, will be part of this module.

	Further documentation on this driver can be found on the WWW at http://www.siano-ms.com/

if SMS_SIANO_MDTV
menu "Siano module components"

# Kernel sub systems support

config SMS_DVB3_SUBSYS
	bool "DVB v.3 Subsystem support"
	default n
	---help---
	Choose if you would like to have DVB v.3 kernel sub-system support.

config SMS_DVB5_S2API_SUBSYS
	bool "DVB v.5 (S2 API) Subsystem support"
	default n
	---help---
	Choose if you would like to have DVB v.5 (S2 API) kernel sub-system support.

config SMS_HOSTLIB_SUBSYS
	bool "Host Library Subsystem support"
	default y
	---help---
	Choose if you would like to have Siano's host library kernel sub-system support.

if SMS_HOSTLIB_SUBSYS

config SMS_NET_SUBSYS
	bool "Siano Network Adapter"
	default n
	---help---
	Choose if you would like to have Siano's network adapter support.

endif # SMS_HOSTLIB_SUBSYS

# Hardware interfaces support

config SMS_USB_DRV
	tristate "USB interface support"
	default n
	---help---
	Choose if you would like to have Siano's support for USB interface

config SMS_SDIO_DRV
	tristate "SDIO interface support"
	default n
	---help---
	Choose if you would like to have Siano's support for SDIO interface

config SMS_SPI_ROCKCHIP
	bool "Rockchip SPI interface support"
	default y
	---help---
	Choose if you would like to have Siano's support for Rockchip SPI interface

endmenu
endif # SMS_SIANO_MDTV
```

## drivers/connector/Kconfig
```kconfig
# SPDX-License-Identifier: GPL-2.0-only

menuconfig CONNECTOR
	tristate "Connector - unified userspace <-> kernelspace linker"
	depends on NET
	---help---
	  This is unified userspace <-> kernelspace connector working on top
	  of the netlink socket protocol.

	  Connector support can also be built as a module.  If so, the module
	  will be called cn.

if CONNECTOR

config PROC_EVENTS
	bool "Report process events to userspace"
	depends on CONNECTOR=y
	default y
	---help---
	  Provide a connector that reports process events to userspace. Send
	  events such as fork, exec, id change (uid, gid, suid, etc), and exit.

endif # CONNECTOR
```

## drivers/coresight/Kconfig
```kconfig
#
# Coresight configuration
#
menuconfig CORESIGHT
	bool "CoreSight Tracing Support"
	select ARM_AMBA
	help
	  This framework provides a kernel interface for the CoreSight debug
	  and trace drivers to register themselves with. It's intended to build
	  a topological view of the CoreSight components based on a DT
	  specification and configure the right serie of components when a
	  trace source gets enabled.

if CORESIGHT
config CORESIGHT_LINKS_AND_SINKS
	bool "CoreSight Link and Sink drivers"
	help
	  This enables support for CoreSight link and sink drivers that are
	  responsible for transporting and collecting the trace data
	  respectively.  Link and sinks are dynamically aggregated with a trace
	  entity at run time to form a complete trace path.

config CORESIGHT_LINK_AND_SINK_TMC
	bool "Coresight generic TMC driver"
	depends on CORESIGHT_LINKS_AND_SINKS
	help
	  This enables support for the Trace Memory Controller driver.
	  Depending on its configuration the device can act as a link (embedded
	  trace router - ETR) or sink (embedded trace FIFO).  The driver
	  complies with the generic implementation of the component without
	  special enhancement or added features.

config CORESIGHT_SINK_TPIU
	bool "Coresight generic TPIU driver"
	depends on CORESIGHT_LINKS_AND_SINKS
	help
	  This enables support for the Trace Port Interface Unit driver,
	  responsible for bridging the gap between the on-chip coresight
	  components and a trace for bridging the gap between the on-chip
	  coresight components and a trace port collection engine, typically
	  connected to an external host for use case capturing more traces than
	  the on-board coresight memory can handle.

config CORESIGHT_SINK_ETBV10
	bool "Coresight ETBv1.0 driver"
	depends on CORESIGHT_LINKS_AND_SINKS
	help
	  This enables support for the Embedded Trace Buffer version 1.0 driver
	  that complies with the generic implementation of the component without
	  special enhancement or added features.

config CORESIGHT_SOURCE_ETM3X
	bool "CoreSight Embedded Trace Macrocell 3.x driver"
	depends on !ARM64
	select CORESIGHT_LINKS_AND_SINKS
	help
	  This driver provides support for processor ETM3.x and PTM1.x modules,
	  which allows tracing the instructions that a processor is executing
	  This is primarily useful for instruction level tracing.  Depending
	  the ETM version data tracing may also be available.
endif
```
