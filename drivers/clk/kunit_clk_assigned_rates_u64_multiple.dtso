// SPDX-License-Identifier: GPL-2.0
/dts-v1/;
/plugin/;

#include "kunit_clk_assigned_rates.h"

&{/} {
	clk: kunit-clock {
		compatible = "test,clk-assigned-rates";
		#clock-cells = <1>;
		assigned-clocks = <&clk 0>,
				  <&clk 1>;
		assigned-clock-rates-u64 = /bits/ 64 <ASSIGNED_RATES_0_RATE>,
					   /bits/ 64 <ASSIGNED_RATES_1_RATE>;
		assigned-clock-sscs = <ASSIGNED_SSCS_0_MODFREQ
				       ASSIGNED_SSCS_0_SPREAD
				       ASSIGNED_SSCS_0_METHOD>,
				      <ASSIGNED_SSCS_1_MODFREQ
				       ASSIGNED_SSCS_1_SPREAD
				       ASSIGNED_SSCS_1_METHOD>;
	};
};
