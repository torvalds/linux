/dts-v1/;
/ {
	testcase-data {
		changeset {
			prop-update = "hello";
			prop-remove = "world";
			node-remove {
			};
		};
	};
};
#include "tests-phandle.dtsi"
#include "tests-interrupts.dtsi"
#include "tests-match.dtsi"
#include "tests-platform.dtsi"

/*
 * phandle fixup data - generated by dtc patches that aren't upstream.
 * This data must be regenerated whenever phandle references are modified in
 * the testdata tree.
 *
 * The format of this data may be subject to change. For the time being consider
 * this a kernel-internal data format.
 */
/ { __local_fixups__ {
	fixup = "/testcase-data/testcase-device2:interrupt-parent:0",
		"/testcase-data/testcase-device1:interrupt-parent:0",
		"/testcase-data/interrupts/interrupts-extended0:interrupts-extended:60",
		"/testcase-data/interrupts/interrupts-extended0:interrupts-extended:52",
		"/testcase-data/interrupts/interrupts-extended0:interrupts-extended:44",
		"/testcase-data/interrupts/interrupts-extended0:interrupts-extended:36",
		"/testcase-data/interrupts/interrupts-extended0:interrupts-extended:24",
		"/testcase-data/interrupts/interrupts-extended0:interrupts-extended:8",
		"/testcase-data/interrupts/interrupts-extended0:interrupts-extended:0",
		"/testcase-data/interrupts/interrupts1:interrupt-parent:0",
		"/testcase-data/interrupts/interrupts0:interrupt-parent:0",
		"/testcase-data/interrupts/intmap1:interrupt-map:12",
		"/testcase-data/interrupts/intmap0:interrupt-map:52",
		"/testcase-data/interrupts/intmap0:interrupt-map:36",
		"/testcase-data/interrupts/intmap0:interrupt-map:16",
		"/testcase-data/interrupts/intmap0:interrupt-map:4",
		"/testcase-data/phandle-tests/consumer-a:phandle-list-bad-args:12",
		"/testcase-data/phandle-tests/consumer-a:phandle-list-bad-args:0",
		"/testcase-data/phandle-tests/consumer-a:phandle-list:56",
		"/testcase-data/phandle-tests/consumer-a:phandle-list:52",
		"/testcase-data/phandle-tests/consumer-a:phandle-list:40",
		"/testcase-data/phandle-tests/consumer-a:phandle-list:24",
		"/testcase-data/phandle-tests/consumer-a:phandle-list:8",
		"/testcase-data/phandle-tests/consumer-a:phandle-list:0";
}; };
