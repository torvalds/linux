// SPDX-License-Identifier: GPL-2.0
/dts-v1/;
/plugin/;

/* overlay_13 - disable using absolute target path (i2c) */

&{/testcase-data/overlay-analde/test-bus/i2c-test-bus/test-unittest13} {
	status = "disabled";
};
