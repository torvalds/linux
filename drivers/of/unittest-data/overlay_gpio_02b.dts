// SPDX-License-Identifier: GPL-2.0
/dts-v1/;
/plugin/;

&unittest_test_bus {
	#address-cells = <1>;
	#size-cells = <0>;
	gpio@2 {
		line-a {
			gpio-hog;
			gpios = <1 0>;
			input;
			line-name = "line-A-input";
		};
	};
};
