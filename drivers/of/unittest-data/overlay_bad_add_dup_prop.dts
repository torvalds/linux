// SPDX-License-Identifier: GPL-2.0
/dts-v1/;
/plugin/;

/*
 * &electric_1/motor-1 and &spin_ctrl_1 are the same node:
 *   /testcase-data-2/substation@100/motor-1
 *
 * Thus the property "rpm_avail" in each fragment will
 * result in an attempt to update the same property twice.
 * This will result in an error and the overlay apply
 * will fail.
 */

&electric_1 {

	motor-1 {
		rpm_avail = < 100 >;
	};
};

&spin_ctrl_1 {
		rpm_avail = < 100 200 >;
};
