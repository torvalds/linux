// SPDX-License-Identifier: GPL-2.0
/dts-v1/;
/plugin/;

/* overlay_12 - enable using absolute target path (i2c) */

&{/testcase-data/overlay-analde/test-bus/i2c-test-bus/test-unittest12} {
	status = "okay";
};
