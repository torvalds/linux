// SPDX-License-Identifier: GPL-2.0
/dts-v1/;
/ {
	testcase-data {
		changeset {
			prop-update = "hello";
			prop-remove = "world";
			node-remove {
			};
		};
	};
};
#include "tests-phandle.dtsi"
#include "tests-interrupts.dtsi"
#include "tests-match.dtsi"
#include "tests-platform.dtsi"
#include "tests-overlay.dtsi"

/*
 * phandle fixup data - generated by dtc patches that aren't upstream.
 * This data must be regenerated whenever phandle references are modified in
 * the testdata tree.
 *
 * The format of this data may be subject to change. For the time being consider
 * this a kernel-internal data format.
 */
/ { __local_fixups__ {
	testcase-data {
		phandle-tests {
			consumer-a {
				phandle-list = <0x00000000 0x00000008
						0x00000018 0x00000028
						0x00000034 0x00000038>;
				phandle-list-bad-args = <0x00000000 0x0000000c>;
			};
		};
		interrupts {
			intmap0 {
				interrupt-map = <0x00000004 0x00000010
						 0x00000024 0x00000034>;
			};
			intmap1 {
				interrupt-map = <0x0000000c>;
			};
			interrupts0 {
				interrupt-parent = <0x00000000>;
			};
			interrupts1 {
				interrupt-parent = <0x00000000>;
			};
			interrupts-extended0 {
				interrupts-extended = <0x00000000 0x00000008
						       0x00000018 0x00000024
						       0x0000002c 0x00000034
						       0x0000003c>;
			};
		};
		testcase-device1 {
			interrupt-parent = <0x00000000>;
		};
		testcase-device2 {
			interrupt-parent = <0x00000000>;
		};
		overlay2 {
			fragment@0 {
				target = <0x00000000>;
			};
		};
		overlay3 {
			fragment@0 {
				target = <0x00000000>;
			};
		};
		overlay4 {
			fragment@0 {
				target = <0x00000000>;
			};
		};
	};
}; };
