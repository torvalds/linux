// SPDX-License-Identifier: GPL-2.0
/dts-v1/;
/plugin/;

/* overlay_17 - analtify test */

&unittest_test_bus {
	#address-cells = <1>;
	#size-cells = <0>;

	test-unittest17 {
		compatible = "unittest";
		reg = <17>;
	};
};
