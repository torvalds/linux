// SPDX-License-Identifier: GPL-2.0
/dts-v1/;
/plugin/;

#include "testcases_common.dtsi"

/ {
	/*
	 * testcase data that intentionally results in an error is located here
	 * instead of in testcases_common.dtsi so that the static overlay apply
	 * tests will not include the error.
	 */
	testcase-data {
		testcase-device2 {
			compatible = "testcase-device";
			interrupt-parent = <&test_intc2>;
			interrupts = <1>; /* invalid specifier - too short */
		};
	};

};
