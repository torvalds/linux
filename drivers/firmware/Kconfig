## drivers/firmware/imx/Kconfig
```kconfig
# SPDX-License-Identifier: GPL-2.0-only
config IMX_DSP
	tristate "IMX DSP Protocol driver"
	depends on IMX_MBOX
	help
	  This enables DSP IPC protocol between host AP (Linux)
	  and the firmware running on DSP.
	  DSP exists on some i.MX8 processors (e.g i.MX8QM, i.MX8QXP).

	  It acts like a doorbell. Client might use shared memory to
	  exchange information with DSP side.

config IMX_SCU
	bool "IMX SCU Protocol driver"
	depends on IMX_MBOX
	select SOC_BUS
	help
	  The System Controller Firmware (SCFW) is a low-level system function
	  which runs on a dedicated Cortex-M core to provide power, clock, and
	  resource management. It exists on some i.MX8 processors. e.g. i.MX8QM
	  (QM, QP), and i.MX8QX (QXP, DX).

	  This driver manages the IPC interface between host CPU and the
	  SCU firmware running on M4.

config IMX_SCMI_MISC_DRV
	tristate "IMX SCMI MISC Protocol driver"
	default y if ARCH_MXC
	help
	  The System Controller Management Interface firmware (SCMI FW) is
	  a low-level system function which runs on a dedicated Cortex-M
	  core that could provide misc functions such as board control.

	  This driver can also be built as a module.
```

## drivers/firmware/meson/Kconfig
```kconfig
# SPDX-License-Identifier: GPL-2.0-only
#
# Amlogic Secure Monitor driver
#
config MESON_SM
	tristate "Amlogic Secure Monitor driver"
	depends on ARCH_MESON || COMPILE_TEST
	default y
	depends on ARM64_4K_PAGES
	help
	  Say y here to enable the Amlogic secure monitor driver
```

## drivers/firmware/microchip/Kconfig
```kconfig
# SPDX-License-Identifier: GPL-2.0-only

config POLARFIRE_SOC_AUTO_UPDATE
	tristate "Microchip PolarFire SoC AUTO UPDATE"
	depends on POLARFIRE_SOC_SYS_CTRL
	select FW_LOADER
	select FW_UPLOAD
	help
	  Support for reprogramming PolarFire SoC from within Linux, using the
	  Auto Upgrade feature of the system controller.

	  If built as a module, it will be called mpfs-auto-update.
```

## drivers/firmware/psci/Kconfig
```kconfig
config ARM_PSCI_FW
	bool

config ARM_PSCI_CHECKER
	bool "ARM PSCI checker"
	depends on ARM_PSCI_FW && HOTPLUG_CPU && CPU_IDLE && !TORTURE_TEST
	help
	  Run the PSCI checker during startup. This checks that hotplug and
	  suspend operations work correctly when using PSCI.

	  The torture tests may interfere with the PSCI checker by turning CPUs
	  on and off through hotplug, so for now torture tests and PSCI checker
	  are mutually exclusive.
```

## drivers/firmware/qcom/Kconfig
```kconfig
# SPDX-License-Identifier: GPL-2.0-only
#
# For a description of the syntax of this configuration file,
# see Documentation/kbuild/kconfig-language.rst.
#

menu "Qualcomm firmware drivers"

config QCOM_SCM
	select QCOM_TZMEM
	tristate

config QCOM_TZMEM
	tristate
	select GENERIC_ALLOCATOR

choice
	prompt "TrustZone interface memory allocator mode"
	depends on QCOM_TZMEM
	default QCOM_TZMEM_MODE_GENERIC
	help
	  Selects the mode of the memory allocator providing memory buffers of
	  suitable format for sharing with the TrustZone. If in doubt, select
	  'Generic'.

config QCOM_TZMEM_MODE_GENERIC
	bool "Generic"
	help
	  Use the generic allocator mode. The memory is page-aligned, non-cachable
	  and physically contiguous.

config QCOM_TZMEM_MODE_SHMBRIDGE
	bool "SHM Bridge"
	help
	  Use Qualcomm Shared Memory Bridge. The memory has the same alignment as
	  in the 'Generic' allocator but is also explicitly marked as an SHM Bridge
	  buffer.

	  With this selected, all buffers passed to the TrustZone must be allocated
	  using the TZMem allocator or else the TrustZone will refuse to use them.

endchoice

config QCOM_SCM_DOWNLOAD_MODE_DEFAULT
	bool "Qualcomm download mode enabled by default"
	depends on QCOM_SCM
	help
	  A device with "download mode" enabled will upon an unexpected
	  warm-restart enter a special debug mode that allows the user to
	  "download" memory content over USB for offline postmortem analysis.
	  The feature can be enabled/disabled on the kernel command line.

	  Say Y here to enable "download mode" by default.

config QCOM_QSEECOM
	bool "Qualcomm QSEECOM interface driver"
	depends on QCOM_SCM=y
	select AUXILIARY_BUS
	help
	  Various Qualcomm SoCs have a Secure Execution Environment (SEE) running
	  in the Trust Zone. This module provides an interface to that via the
	  QSEECOM mechanism, using SCM calls.

	  The QSEECOM interface allows, among other things, access to applications
	  running in the SEE. An example of such an application is 'uefisecapp',
	  which is required to access UEFI variables on certain systems. If
	  selected, the interface will also attempt to detect and register client
	  devices for supported applications.

	  Select Y here to enable the QSEECOM interface driver.

config QCOM_QSEECOM_UEFISECAPP
	bool "Qualcomm SEE UEFI Secure App client driver"
	depends on QCOM_QSEECOM
	depends on EFI
	help
	  Various Qualcomm SoCs do not allow direct access to EFI variables.
	  Instead, these need to be accessed via the UEFI Secure Application
	  (uefisecapp), residing in the Secure Execution Environment (SEE).

	  This module provides a client driver for uefisecapp, installing efivar
	  operations to allow the kernel accessing EFI variables, and via that also
	  provide user-space with access to EFI variables via efivarfs.

	  Select Y here to provide access to EFI variables on the aforementioned
	  platforms.

endmenu
```

## drivers/firmware/samsung/Kconfig
```kconfig
# SPDX-License-Identifier: GPL-2.0-only

config EXYNOS_ACPM_PROTOCOL
	tristate "Exynos Alive Clock and Power Manager (ACPM) Message Protocol"
	depends on ARCH_EXYNOS || COMPILE_TEST
	depends on MAILBOX
	help
	  Alive Clock and Power Manager (ACPM) Message Protocol is defined for
	  the purpose of communication between the ACPM firmware and masters
	  (AP, AOC, ...). ACPM firmware operates on the Active Power Management
	  (APM) module that handles overall power activities.

	  This protocol driver provides interface for all the client drivers
	  making use of the features offered by the APM.
```

## drivers/firmware/smccc/Kconfig
```kconfig
# SPDX-License-Identifier: GPL-2.0-only
config HAVE_ARM_SMCCC
	bool
	help
	  Include support for the Secure Monitor Call (SMC) and Hypervisor
	  Call (HVC) instructions on Armv7 and above architectures.

config HAVE_ARM_SMCCC_DISCOVERY
	bool
	depends on ARM_PSCI_FW
	default y
	help
	 SMCCC v1.0 lacked discoverability and hence PSCI v1.0 was updated
	 to add SMCCC discovery mechanism though the PSCI firmware
	 implementation of PSCI_FEATURES(SMCCC_VERSION) which returns
	 success on firmware compliant to SMCCC v1.1 and above.

config ARM_SMCCC_SOC_ID
	bool "SoC bus device for the ARM SMCCC SOC_ID"
	depends on HAVE_ARM_SMCCC_DISCOVERY
	default y
	select SOC_BUS
	help
	  Include support for the SoC bus on the ARM SMCCC firmware based
	  platforms providing some sysfs information about the SoC variant.
```

## drivers/firmware/tegra/Kconfig
```kconfig
# SPDX-License-Identifier: GPL-2.0-only
menu "Tegra firmware driver"

config TEGRA_IVC
	bool "Tegra IVC protocol" if COMPILE_TEST
	depends on ARCH_TEGRA
	help
	  IVC (Inter-VM Communication) protocol is part of the IPC
	  (Inter Processor Communication) framework on Tegra. It maintains the
	  data and the different communication channels in SysRAM or RAM and
	  keeps the content is synchronization between host CPU and remote
	  processors.

config TEGRA_BPMP
	bool "Tegra BPMP driver"
	depends on ARCH_TEGRA && TEGRA_HSP_MBOX
	depends on !CPU_BIG_ENDIAN
	select TEGRA_IVC
	help
	  BPMP (Boot and Power Management Processor) is designed to off-loading
	  the PM functions which include clock/DVFS/thermal/power from the CPU.
	  It needs HSP as the HW synchronization and notification module and
	  IVC module as the message communication protocol.

	  This driver manages the IPC interface between host CPU and the
	  firmware running on BPMP.

endmenu
```

## drivers/firmware/xilinx/Kconfig
```kconfig
# SPDX-License-Identifier: GPL-2.0
# Kconfig for Xilinx firmwares

menu "Zynq MPSoC Firmware Drivers"
	depends on ARCH_ZYNQMP

config ZYNQMP_FIRMWARE
	bool "Enable Xilinx Zynq MPSoC firmware interface"
	depends on ARCH_ZYNQMP
	default y if ARCH_ZYNQMP
	select MFD_CORE
	help
	  Firmware interface driver is used by different
	  drivers to communicate with the firmware for
	  various platform management services.
	  Say yes to enable ZynqMP firmware interface driver.
	  If in doubt, say N.

config ZYNQMP_FIRMWARE_DEBUG
	bool "Enable Xilinx Zynq MPSoC firmware debug APIs"
	depends on ZYNQMP_FIRMWARE && DEBUG_FS
	help
	  Say yes to enable ZynqMP firmware interface debug APIs.
	  If in doubt, say N.

endmenu
```

## drivers/fmc/Kconfig
```kconfig
#
# FMC (ANSI-VITA 57.1) bus support
#

menuconfig FMC
	tristate "FMC support"
	help

	  FMC (FPGA Mezzanine Carrier) is a mechanical and electrical
	  standard for mezzanine cards that plug into a carrier board.
	  This kernel subsystem supports the matching between carrier
	  and mezzanine based on identifiers stored in the internal I2C
	  EEPROM, as well as having carrier-independent drivers.

	  The framework was born outside of the kernel and at this time
	  the off-tree code base is more complete.  Code and documentation
	  is at git://ohwr.org/fmc-projects/fmc-bus.git .

if FMC

config FMC_FAKEDEV
	tristate "FMC fake device (software testing)"
	help
	  This is a fake carrier, bringing a default EEPROM content
	  that can be rewritten at run time and usef for matching
	  mezzanines.

config FMC_TRIVIAL
	tristate "FMC trivial mezzanine driver (software testing)"
	help
	  This is a fake mezzanine driver, to show how FMC works and test it.
	  The driver also handles interrupts (we used it with a real carrier
	  before the mezzanines were produced)

config FMC_WRITE_EEPROM
	tristate "FMC mezzanine driver to write I2C EEPROM"
	help
	  This driver matches every mezzanine device and can write the
	  internal EEPROM of the PCB, using the firmware loader to get
	  its binary and the function carrier->reprogram to actually do it.
	  It is useful when the mezzanines are produced.

config FMC_CHARDEV
	tristate "FMC mezzanine driver that registers a char device"
	help
	  This driver matches every mezzanine device and allows user
	  space to read and write registers using a char device. It
	  can be used to write user-space drivers, or just get
	  acquainted with a mezzanine before writing its specific driver.

endif # FMC
```
