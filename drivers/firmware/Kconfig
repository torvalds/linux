## drivers/firmware/arm_scmi/Kconfig
```kconfig
# SPDX-License-Identifier: GPL-2.0-only
menu "ARM System Control and Management Interface Protocol"

config ARM_SCMI_PROTOCOL
	tristate "ARM System Control and Management Interface (SCMI) Message Protocol"
	depends on ARM || ARM64 || COMPILE_TEST
	help
	  ARM System Control and Management Interface (SCMI) protocol is a
	  set of operating system-independent software interfaces that are
	  used in system management. SCMI is extensible and currently provides
	  interfaces for: Discovery and self-description of the interfaces
	  it supports, Power domain management which is the ability to place
	  a given device or domain into the various power-saving states that
	  it supports, Performance management which is the ability to control
	  the performance of a domain that is composed of compute engines
	  such as application processors and other accelerators, Clock
	  management which is the ability to set and inquire rates on platform
	  managed clocks and Sensor management which is the ability to read
	  sensor data, and be notified of sensor value.

	  This protocol library provides interface for all the client drivers
	  making use of the features offered by the SCMI.

if ARM_SCMI_PROTOCOL

config ARM_SCMI_NEED_DEBUGFS
	bool
	help
	  This declares whether at least one SCMI facility is configured
	  which needs debugfs support. When selected causess the creation
	  of a common SCMI debugfs root directory.

config ARM_SCMI_RAW_MODE_SUPPORT
	bool "Enable support for SCMI Raw transmission mode"
	depends on DEBUG_FS
	select ARM_SCMI_NEED_DEBUGFS
	help
	  Enable support for SCMI Raw transmission mode.

	  If enabled allows the direct injection and snooping of SCMI bare
	  messages through a dedicated debugfs interface.
	  It is meant to be used by SCMI compliance/testing suites.

	  When enabled regular SCMI drivers interactions are inhibited in
	  order to avoid unexpected interactions with the SCMI Raw message
	  flow. If unsure say N.

config ARM_SCMI_RAW_MODE_SUPPORT_COEX
	bool "Allow SCMI Raw mode coexistence with normal SCMI stack"
	depends on ARM_SCMI_RAW_MODE_SUPPORT
	help
	  Allow SCMI Raw transmission mode to coexist with normal SCMI stack.

	  This will allow regular SCMI drivers to register with the core and
	  operate normally, thing which could make an SCMI test suite using the
	  SCMI Raw mode support unreliable. If unsure, say N.

config ARM_SCMI_DEBUG_COUNTERS
	bool "Enable SCMI communication debug metrics tracking"
	select ARM_SCMI_NEED_DEBUGFS
	depends on DEBUG_FS
	default n
	help
	  Enables tracking of some key communication metrics for debug
	  purposes. It may track metrics like how many messages were sent
	  or received, were there any failures, what kind of failures, ..etc.

	  Enable this option to create a new debugfs directory which contains
	  such useful debug counters. This can be helpful for debugging and
	  SCMI monitoring.

config ARM_SCMI_QUIRKS
	bool "Enable SCMI Quirks framework"
	depends on JUMP_LABEL || COMPILE_TEST
	default y
	help
	  Enables support for SCMI Quirks framework to workaround SCMI platform
	  firmware bugs on system already deployed in the wild.

	  The framework allows the definition of platform-specific code quirks
	  that will be associated and enabled only on the desired platforms
	  depending on the SCMI firmware advertised versions and/or machine
	  compatibles.

source "drivers/firmware/arm_scmi/transports/Kconfig"
source "drivers/firmware/arm_scmi/vendors/imx/Kconfig"

endif #ARM_SCMI_PROTOCOL

config ARM_SCMI_POWER_CONTROL
	tristate "SCMI system power control driver"
	depends on ARM_SCMI_PROTOCOL || (COMPILE_TEST && OF)
	help
	  This enables System Power control logic which binds system shutdown or
	  reboot actions to SCMI System Power notifications generated by SCP
	  firmware.

	  This driver can also be built as a module.  If so, the module will be
	  called scmi_power_control. Note this may needed early in boot to catch
	  early shutdown/reboot SCMI requests.

endmenu
```

## drivers/firmware/arm_scmi/transports/Kconfig
```kconfig
# SPDX-License-Identifier: GPL-2.0-only
menu "SCMI Transport Drivers"

config ARM_SCMI_HAVE_TRANSPORT
	bool
	help
	  This declares whether at least one SCMI transport has been configured.
	  Used to trigger a build bug when trying to build SCMI without any
	  configured transport.

config ARM_SCMI_HAVE_SHMEM
	bool
	help
	  This declares whether a shared memory based transport for SCMI is
	  available.

config ARM_SCMI_HAVE_MSG
	bool
	help
	  This declares whether a message passing based transport for SCMI is
	  available.

config ARM_SCMI_TRANSPORT_MAILBOX
	tristate "SCMI transport based on Mailbox"
	depends on MAILBOX
	select ARM_SCMI_HAVE_TRANSPORT
	select ARM_SCMI_HAVE_SHMEM
	default y
	help
	  Enable mailbox based transport for SCMI.

	  If you want the ARM SCMI PROTOCOL stack to include support for a
	  transport based on mailboxes, answer Y.
	  This driver can also be built as a module. If so, the module
	  will be called scmi_transport_mailbox.

config ARM_SCMI_TRANSPORT_SMC
	tristate "SCMI transport based on SMC"
	depends on HAVE_ARM_SMCCC_DISCOVERY
	select ARM_SCMI_HAVE_TRANSPORT
	select ARM_SCMI_HAVE_SHMEM
	default y
	help
	  Enable SMC based transport for SCMI.

	  If you want the ARM SCMI PROTOCOL stack to include support for a
	  transport based on SMC, answer Y.
	  This driver can also be built as a module. If so, the module
	  will be called scmi_transport_smc.

config ARM_SCMI_TRANSPORT_SMC_ATOMIC_ENABLE
	bool "Enable atomic mode support for SCMI SMC transport"
	depends on ARM_SCMI_TRANSPORT_SMC
	help
	  Enable support of atomic operation for SCMI SMC based transport.

	  If you want the SCMI SMC based transport to operate in atomic
	  mode, avoiding any kind of sleeping behaviour for selected
	  transactions on the TX path, answer Y.
	  Enabling atomic mode operations allows any SCMI driver using this
	  transport to optionally ask for atomic SCMI transactions and operate
	  in atomic context too, at the price of using a number of busy-waiting
	  primitives all over instead. If unsure say N.

config ARM_SCMI_TRANSPORT_OPTEE
	tristate "SCMI transport based on OP-TEE service"
	depends on OPTEE
	select ARM_SCMI_HAVE_TRANSPORT
	select ARM_SCMI_HAVE_SHMEM
	select ARM_SCMI_HAVE_MSG
	default y
	help
	  This enables the OP-TEE service based transport for SCMI.

	  If you want the ARM SCMI PROTOCOL stack to include support for a
	  transport based on OP-TEE SCMI service, answer Y.
	  This driver can also be built as a module. If so, the module
	  will be called scmi_transport_optee.

config ARM_SCMI_TRANSPORT_VIRTIO
	tristate "SCMI transport based on VirtIO"
	depends on VIRTIO
	select ARM_SCMI_HAVE_TRANSPORT
	select ARM_SCMI_HAVE_MSG
	help
	  This enables the virtio based transport for SCMI.

	  If you want the ARM SCMI PROTOCOL stack to include support for a
	  transport based on VirtIO, answer Y.
	  This driver can also be built as a module. If so, the module
	  will be called scmi_transport_virtio.

config ARM_SCMI_TRANSPORT_VIRTIO_VERSION1_COMPLIANCE
	bool "SCMI VirtIO transport Version 1 compliance"
	depends on ARM_SCMI_TRANSPORT_VIRTIO
	default y
	help
	  This enforces strict compliance with VirtIO Version 1 specification.

	  If you want the ARM SCMI VirtIO transport layer to refuse to work
	  with Legacy VirtIO backends and instead support only VirtIO Version 1
	  devices (or above), answer Y.

	  If you want instead to support also old Legacy VirtIO backends (like
	  the ones implemented by kvmtool) and let the core Kernel VirtIO layer
	  take care of the needed conversions, say N.

config ARM_SCMI_TRANSPORT_VIRTIO_ATOMIC_ENABLE
	bool "Enable atomic mode for SCMI VirtIO transport"
	depends on ARM_SCMI_TRANSPORT_VIRTIO
	help
	  Enable support of atomic operation for SCMI VirtIO based transport.

	  If you want the SCMI VirtIO based transport to operate in atomic
	  mode, avoiding any kind of sleeping behaviour for selected
	  transactions on the TX path, answer Y.

	  Enabling atomic mode operations allows any SCMI driver using this
	  transport to optionally ask for atomic SCMI transactions and operate
	  in atomic context too, at the price of using a number of busy-waiting
	  primitives all over instead. If unsure say N.

endmenu
```

## drivers/firmware/arm_scmi/vendors/imx/Kconfig
```kconfig
# SPDX-License-Identifier: GPL-2.0-only
menu "ARM SCMI NXP i.MX Vendor Protocols"

config IMX_SCMI_BBM_EXT
	tristate "i.MX SCMI BBM EXTENSION"
	depends on ARM_SCMI_PROTOCOL || (COMPILE_TEST && OF)
	default y if ARCH_MXC
	help
	  This enables i.MX System BBM control logic which supports RTC
	  and BUTTON.

	  To compile this driver as a module, choose M here: the
	  module will be called imx-sm-bbm.

config IMX_SCMI_CPU_EXT
	tristate "i.MX SCMI CPU EXTENSION"
	depends on ARM_SCMI_PROTOCOL || (COMPILE_TEST && OF)
	depends on IMX_SCMI_CPU_DRV
	default y if ARCH_MXC
	help
	  This enables i.MX System CPU Protocol to manage cpu
	  start, stop and etc.

	  To compile this driver as a module, choose M here: the
	  module will be called imx-sm-cpu.

config IMX_SCMI_LMM_EXT
	tristate "i.MX SCMI LMM EXTENSION"
	depends on ARM_SCMI_PROTOCOL || (COMPILE_TEST && OF)
	depends on IMX_SCMI_LMM_DRV
	default y if ARCH_MXC
	help
	  This enables i.MX System Logical Machine Protocol to
	  manage Logical Machines boot, shutdown and etc.

	  To compile this driver as a module, choose M here: the
	  module will be called imx-sm-lmm.

config IMX_SCMI_MISC_EXT
	tristate "i.MX SCMI MISC EXTENSION"
	depends on ARM_SCMI_PROTOCOL || (COMPILE_TEST && OF)
	depends on IMX_SCMI_MISC_DRV
	default y if ARCH_MXC
	help
	  This enables i.MX System MISC control logic such as gpio expander
	  wakeup

	  To compile this driver as a module, choose M here: the
	  module will be called imx-sm-misc.
endmenu
```

## drivers/firmware/broadcom/Kconfig
```kconfig
# SPDX-License-Identifier: GPL-2.0-only
config BCM47XX_NVRAM
	bool "Broadcom NVRAM driver"
	depends on BCM47XX || ARCH_BCM_5301X
	help
	  Broadcom home routers contain flash partition called "nvram" with all
	  important hardware configuration as well as some minor user setup.
	  NVRAM partition contains a text-like data representing name=value
	  pairs.
	  This driver provides an easy way to get value of requested parameter.
	  It simply reads content of NVRAM and parses it. It doesn't control any
	  hardware part itself.

config BCM47XX_SPROM
	bool "Broadcom SPROM driver"
	depends on BCM47XX_NVRAM
	select GENERIC_NET_UTILS
	help
	  Broadcom devices store configuration data in SPROM. Accessing it is
	  specific to the bus host type, e.g. PCI(e) devices have it mapped in
	  a PCI BAR.
	  In case of SoC devices SPROM content is stored on a flash used by
	  bootloader firmware CFE. This driver provides method to ssb and bcma
	  drivers to read SPROM on SoC.
```

## drivers/firmware/cirrus/Kconfig
```kconfig
# SPDX-License-Identifier: GPL-2.0-only

config FW_CS_DSP
	tristate
	default n

config FW_CS_DSP_KUNIT_TEST_UTILS
	tristate

config FW_CS_DSP_KUNIT_TEST
	tristate "KUnit tests for Cirrus Logic cs_dsp" if !KUNIT_ALL_TESTS
	depends on KUNIT && REGMAP && FW_CS_DSP
	default KUNIT_ALL_TESTS
	select FW_CS_DSP_KUNIT_TEST_UTILS
	help
	  This builds KUnit tests for cs_dsp.
	  For more information on KUnit and unit tests in general,
	  please refer to the KUnit documentation in
	  Documentation/dev-tools/kunit/.
	  If in doubt, say "N".
```
