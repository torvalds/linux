## drivers/fpga/Kconfig
```kconfig
# SPDX-License-Identifier: GPL-2.0-only
#
# FPGA framework configuration
#

menuconfig FPGA
	tristate "FPGA Configuration Framework"
	help
	  Say Y here if you want support for configuring FPGAs from the
	  kernel.  The FPGA framework adds an FPGA manager class and FPGA
	  manager drivers.

if FPGA

config FPGA_MGR_SOCFPGA
	tristate "Altera SOCFPGA FPGA Manager"
	depends on ARCH_INTEL_SOCFPGA || COMPILE_TEST
	help
	  FPGA manager driver support for Altera SOCFPGA.

config FPGA_MGR_SOCFPGA_A10
	tristate "Altera SoCFPGA Arria10"
	depends on ARCH_INTEL_SOCFPGA || COMPILE_TEST
	select REGMAP_MMIO
	help
	  FPGA manager driver support for Altera Arria10 SoCFPGA.

config ALTERA_PR_IP_CORE
	tristate "Altera Partial Reconfiguration IP Core"
	help
	  Core driver support for Altera Partial Reconfiguration IP component

config ALTERA_PR_IP_CORE_PLAT
	tristate "Platform support of Altera Partial Reconfiguration IP Core"
	depends on ALTERA_PR_IP_CORE && OF && HAS_IOMEM
	help
	  Platform driver support for Altera Partial Reconfiguration IP
	  component

config FPGA_MGR_ALTERA_PS_SPI
	tristate "Altera FPGA Passive Serial over SPI"
	depends on SPI
	select BITREVERSE
	help
	  FPGA manager driver support for Altera Arria/Cyclone/Stratix
	  using the passive serial interface over SPI.

config FPGA_MGR_ALTERA_CVP
	tristate "Altera CvP FPGA Manager"
	depends on PCI
	help
	  FPGA manager driver support for Arria-V, Cyclone-V, Stratix-V,
	  Arria 10 and Stratix10 Altera FPGAs using the CvP interface over PCIe.

config FPGA_MGR_ZYNQ_FPGA
	tristate "Xilinx Zynq FPGA"
	depends on ARCH_ZYNQ || COMPILE_TEST
	help
	  FPGA manager driver support for Xilinx Zynq FPGAs.

config FPGA_MGR_STRATIX10_SOC
	tristate "Intel Stratix10 SoC FPGA Manager"
	depends on (ARCH_INTEL_SOCFPGA && INTEL_STRATIX10_SERVICE)
	help
	  FPGA manager driver support for the Intel Stratix10 SoC.

config FPGA_MGR_XILINX_SPI
	tristate "Xilinx Configuration over Slave Serial (SPI)"
	depends on SPI
	help
	  FPGA manager driver support for Xilinx FPGA configuration
	  over slave serial interface.

config FPGA_MGR_ICE40_SPI
	tristate "Lattice iCE40 SPI"
	depends on OF && SPI
	help
	  FPGA manager driver support for Lattice iCE40 FPGAs over SPI.

config FPGA_MGR_MACHXO2_SPI
	tristate "Lattice MachXO2 SPI"
	depends on SPI
	help
	  FPGA manager driver support for Lattice MachXO2 configuration
	  over slave SPI interface.

config FPGA_MGR_TS73XX
	tristate "Technologic Systems TS-73xx SBC FPGA Manager"
	depends on ARCH_EP93XX && MACH_TS72XX
	help
	  FPGA manager driver support for the Altera Cyclone II FPGA
	  present on the TS-73xx SBC boards.

config FPGA_BRIDGE
	tristate "FPGA Bridge Framework"
	help
	  Say Y here if you want to support bridges connected between host
	  processors and FPGAs or between FPGAs.

config SOCFPGA_FPGA_BRIDGE
	tristate "Altera SoCFPGA FPGA Bridges"
	depends on ARCH_INTEL_SOCFPGA && FPGA_BRIDGE
	help
	  Say Y to enable drivers for FPGA bridges for Altera SOCFPGA
	  devices.

config ALTERA_FREEZE_BRIDGE
	tristate "Altera FPGA Freeze Bridge"
	depends on FPGA_BRIDGE && HAS_IOMEM
	help
	  Say Y to enable drivers for Altera FPGA Freeze bridges.  A
	  freeze bridge is a bridge that exists in the FPGA fabric to
	  isolate one region of the FPGA from the busses while that
	  region is being reprogrammed.

config XILINX_PR_DECOUPLER
	tristate "Xilinx LogiCORE PR Decoupler"
	depends on FPGA_BRIDGE
	depends on HAS_IOMEM
	help
	  Say Y to enable drivers for Xilinx LogiCORE PR Decoupler
	  or Xilinx Dynamic Function eXchange AIX Shutdown Manager.
	  The PR Decoupler exists in the FPGA fabric to isolate one
	  region of the FPGA from the busses while that region is
	  being reprogrammed during partial reconfig.
	  The Dynamic Function eXchange AXI shutdown manager prevents
	  AXI traffic from passing through the bridge. The controller
	  safely handles AXI4MM and AXI4-Lite interfaces on a
	  Reconfigurable Partition when it is undergoing dynamic
	  reconfiguration, preventing the system deadlock that can
	  occur if AXI transactions are interrupted by DFX.

config FPGA_REGION
	tristate "FPGA Region"
	depends on FPGA_BRIDGE
	help
	  FPGA Region common code.  An FPGA Region controls an FPGA Manager
	  and the FPGA Bridges associated with either a reconfigurable
	  region of an FPGA or a whole FPGA.

config OF_FPGA_REGION
	tristate "FPGA Region Device Tree Overlay Support"
	depends on OF && FPGA_REGION
	help
	  Support for loading FPGA images by applying a Device Tree
	  overlay.

config FPGA_DFL
	tristate "FPGA Device Feature List (DFL) support"
	select FPGA_BRIDGE
	select FPGA_REGION
	depends on HAS_IOMEM
	help
	  Device Feature List (DFL) defines a feature list structure that
	  creates a linked list of feature headers within the MMIO space
	  to provide an extensible way of adding features for FPGA.
	  Driver can walk through the feature headers to enumerate feature
	  devices (e.g. FPGA Management Engine, Port and Accelerator
	  Function Unit) and their private features for target FPGA devices.

	  Select this option to enable common support for Field-Programmable
	  Gate Array (FPGA) solutions which implement Device Feature List.
	  It provides enumeration APIs and feature device infrastructure.

config FPGA_DFL_FME
	tristate "FPGA DFL FME Driver"
	depends on FPGA_DFL && HWMON && PERF_EVENTS
	help
	  The FPGA Management Engine (FME) is a feature device implemented
	  under Device Feature List (DFL) framework. Select this option to
	  enable the platform device driver for FME which implements all
	  FPGA platform level management features. There shall be one FME
	  per DFL based FPGA device.

config FPGA_DFL_FME_MGR
	tristate "FPGA DFL FME Manager Driver"
	depends on FPGA_DFL_FME && HAS_IOMEM
	help
	  Say Y to enable FPGA Manager driver for FPGA Management Engine.

config FPGA_DFL_FME_BRIDGE
	tristate "FPGA DFL FME Bridge Driver"
	depends on FPGA_DFL_FME && HAS_IOMEM
	help
	  Say Y to enable FPGA Bridge driver for FPGA Management Engine.

config FPGA_DFL_FME_REGION
	tristate "FPGA DFL FME Region Driver"
	depends on FPGA_DFL_FME && HAS_IOMEM
	help
	  Say Y to enable FPGA Region driver for FPGA Management Engine.

config FPGA_DFL_AFU
	tristate "FPGA DFL AFU Driver"
	depends on FPGA_DFL
	help
	  This is the driver for FPGA Accelerated Function Unit (AFU) which
	  implements AFU and Port management features. A User AFU connects
	  to the FPGA infrastructure via a Port. There may be more than one
	  Port/AFU per DFL based FPGA device.

config FPGA_DFL_NIOS_INTEL_PAC_N3000
	tristate "FPGA DFL NIOS Driver for Intel PAC N3000"
	depends on FPGA_DFL
	select REGMAP
	help
	  This is the driver for the N3000 Nios private feature on Intel
	  PAC (Programmable Acceleration Card) N3000. It communicates
	  with the embedded Nios processor to configure the retimers on
	  the card. It also instantiates the SPI master (spi-altera) for
	  the card's BMC (Board Management Controller).

config FPGA_DFL_PCI
	tristate "FPGA DFL PCIe Device Driver"
	depends on PCI && FPGA_DFL
	help
	  Select this option to enable PCIe driver for PCIe-based
	  Field-Programmable Gate Array (FPGA) solutions which implement
	  the Device Feature List (DFL). This driver provides interfaces
	  for userspace applications to configure, enumerate, open and access
	  FPGA accelerators on the FPGA DFL devices, enables system level
	  management functions such as FPGA partial reconfiguration, power
	  management and virtualization with DFL framework and DFL feature
	  device drivers.

	  To compile this as a module, choose M here.

config FPGA_MGR_ZYNQMP_FPGA
	tristate "Xilinx ZynqMP FPGA"
	depends on ZYNQMP_FIRMWARE || (!ZYNQMP_FIRMWARE && COMPILE_TEST)
	help
	  FPGA manager driver support for Xilinx ZynqMP FPGAs.
	  This driver uses the processor configuration port(PCAP)
	  to configure the programmable logic(PL) through PS
	  on ZynqMP SoC.

config FPGA_MGR_VERSAL_FPGA
	tristate "Xilinx Versal FPGA"
	depends on ARCH_ZYNQMP || COMPILE_TEST
	help
	  Select this option to enable FPGA manager driver support for
	  Xilinx Versal SoC. This driver uses the firmware interface to
	  configure the programmable logic(PL).

	  To compile this as a module, choose M here.

config FPGA_M10_BMC_SEC_UPDATE
	tristate "Intel MAX10 BMC Secure Update driver"
	depends on MFD_INTEL_M10_BMC
	select FW_LOADER
	select FW_UPLOAD
	help
	  Secure update support for the Intel MAX10 board management
	  controller.

	  This is a subdriver of the Intel MAX10 board management controller
	  (BMC) and provides support for secure updates for the BMC image,
	  the FPGA image, the Root Entry Hashes, etc.

config FPGA_MGR_MICROCHIP_SPI
	tristate "Microchip Polarfire SPI FPGA manager"
	depends on SPI
	help
	  FPGA manager driver support for Microchip Polarfire FPGAs
	  programming over slave SPI interface with .dat formatted
	  bitstream image.

endif # FPGA
```

## drivers/fpga/tests/Kconfig
```kconfig
config FPGA_KUNIT_TESTS
	bool "KUnit test for the FPGA subsystem" if !KUNIT_ALL_TESTS
	depends on FPGA=y && FPGA_REGION=y && FPGA_BRIDGE=y && KUNIT=y && MODULES=n
	default KUNIT_ALL_TESTS
        help
          This builds unit tests for the FPGA subsystem

          For more information on KUnit and unit tests in general,
          please refer to the KUnit documentation in Documentation/dev-tools/kunit/.

          If unsure, say N.
```

## drivers/fsi/Kconfig
```kconfig
# SPDX-License-Identifier: GPL-2.0-only
#
# FSI subsystem
#

menuconfig FSI
	tristate "FSI support"
	depends on OF
	select CRC4
	---help---
	  FSI - the FRU Support Interface - is a simple bus for low-level
	  access to POWER-based hardware.

if FSI

config FSI_NEW_DEV_NODE
	bool "Create '/dev/fsi' directory for char devices"
	default n
	---help---
	This option causes char devices created for FSI devices to be
	located under a common /dev/fsi/ directory. Set to N unless your
	userspace has been updated to handle the new location.

	Additionally, it also causes the char device names to be offset
	by one so that chip 0 will have /dev/scom1 and chip1 /dev/scom2
	to match old userspace expectations.

	New userspace will use udev rules to generate predictable access
	symlinks in /dev/fsi/by-path when this option is enabled.

config FSI_MASTER_GPIO
	tristate "GPIO-based FSI master"
	depends on GPIOLIB
	select CRC4
	---help---
	This option enables a FSI master driver using GPIO lines.

config FSI_MASTER_HUB
	tristate "FSI hub master"
	---help---
	This option enables a FSI hub master driver.  Hub is a type of FSI
	master that is connected to the upstream master via a slave.  Hubs
	allow chaining of FSI links to an arbitrary depth.  This allows for
	a high target device fanout.

config FSI_MASTER_AST_CF
	tristate "FSI master based on Aspeed ColdFire coprocessor"
	depends on GPIOLIB
	depends on GPIO_ASPEED
	select GENERIC_ALLOCATOR
	---help---
	This option enables a FSI master using the AST2400 and AST2500 GPIO
	lines driven by the internal ColdFire coprocessor. This requires
	the corresponding machine specific ColdFire firmware to be available.

config FSI_MASTER_ASPEED
	tristate "FSI ASPEED master"
	help
	 This option enables a FSI master that is present behind an OPB bridge
	 in the AST2600.

	 Enable it for your BMC kernel in an OpenPower or IBM Power system.

config FSI_SCOM
	tristate "SCOM FSI client device driver"
	---help---
	This option enables an FSI based SCOM device driver.

config FSI_SBEFIFO
	tristate "SBEFIFO FSI client device driver"
	depends on OF_ADDRESS
	---help---
	This option enables an FSI based SBEFIFO device driver. The SBEFIFO is
	a pipe-like FSI device for communicating with the self boot engine
	(SBE) on POWER processors.

config FSI_OCC
	tristate "OCC SBEFIFO client device driver"
	depends on FSI_SBEFIFO
	---help---
	This option enables an SBEFIFO based On-Chip Controller (OCC) device
	driver. The OCC is a device embedded on a POWER processor that collects
	and aggregates sensor data from the processor and system. The OCC can
	provide the raw sensor data as well as perform thermal and power
	management on the system.

endif
```

## drivers/fwctl/Kconfig
```kconfig
# SPDX-License-Identifier: GPL-2.0-only
menuconfig FWCTL
	tristate "fwctl device firmware access framework"
	help
	  fwctl provides a userspace API for restricted access to communicate
	  with on-device firmware. The communication channel is intended to
	  support a wide range of lockdown compatible device behaviors including
	  manipulating device FLASH, debugging, and other activities that don't
	  fit neatly into an existing subsystem.

if FWCTL
config FWCTL_MLX5
	tristate "mlx5 ConnectX control fwctl driver"
	depends on MLX5_CORE
	help
	  MLX5 provides interface for the user process to access the debug and
	  configuration registers of the ConnectX hardware family
	  (NICs, PCI switches and SmartNIC SoCs).
	  This will allow configuration and debug tools to work out of the box on
	  mainstream kernel.

	  If you don't know what to do here, say N.

config FWCTL_PDS
	tristate "AMD/Pensando pds fwctl driver"
	depends on PDS_CORE
	help
	  The pds_fwctl driver provides an fwctl interface for a user process
	  to access the debug and configuration information of the AMD/Pensando
	  DSC hardware family.

	  If you don't know what to do here, say N.
endif
```

## drivers/gator/Kconfig
```kconfig
config GATOR
	tristate "Gator module for ARM's Streamline Performance Analyzer"
	default m if (ARM || ARM64)
	depends on PROFILING
	depends on HIGH_RES_TIMERS
	depends on LOCAL_TIMERS || !(ARM && SMP)
	depends on PERF_EVENTS
	depends on HW_PERF_EVENTS || !(ARM || ARM64)
	select TRACING
	help
	  Gator module for ARM's Streamline Performance Analyzer

config GATOR_WITH_MALI_SUPPORT
	bool

choice
	prompt "Enable Mali GPU support in Gator"
	depends on GATOR
	optional
	help
	  Enable Mali GPU support in Gator

config GATOR_MALI_4XXMP
	bool "Mali-400MP or Mali-450MP"
	select GATOR_WITH_MALI_SUPPORT

config GATOR_MALI_MIDGARD
	bool "Mali-T60x, Mali-T62x, Mali-T72x or Mali-T76x"
	select GATOR_WITH_MALI_SUPPORT

endchoice

config GATOR_MALI_PATH
	string "Path to Mali driver"
	depends on GATOR_WITH_MALI_SUPPORT
	default "drivers/gpu/arm/mali400mp"
	help
	  The gator code adds this to its include path so it can get the Mali
	  trace headers with: #include "linux/mali_linux_trace.h"
```

## drivers/gator_v5/Kconfig
```kconfig
menuconfig ARM_STREAMLINE_DEBUGGER
	bool "Enable ARM Streamline Debugger"
	depends on	ARM
	default	n
	help
	  Enable ARM Streamline debugger(DS-5).  

if ARM_STREAMLINE_DEBUGGER
config GATOR_MODULE_MAKE
	tristate "Make Gator driver for ARM Streamline debugger"
	default	m
	select	PROFILING
	select	ENABLE_DEFAULT_TRACERS
	select	HIGH_RES_TIMERS
	select  DEBUG_MUTEXES
	select  CPU_FREQ
	select  PERF_EVENTS
	select	LOCAL_TIMERS if SMP
	help
	  Make Gator driver enable for ARM Streamline debugger(DS-5).  

config GATOR_WITH_MALI_SUPPORT
	bool "Debug with Mali support"
	depends on	GATOR_MODULE_MAKE
	default	n
	help
	  Enable Mali Debug support.  

endif
```
