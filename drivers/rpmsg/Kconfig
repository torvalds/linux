## drivers/scsi/aic7xxx/Kconfig.aic7xxx
```kconfig
# SPDX-License-Identifier: GPL-2.0-only
#
# AIC7XXX and AIC79XX 2.5.X Kernel configuration File.
# $Id: //depot/linux-aic79xx-2.5.0/drivers/scsi/aic7xxx/Kconfig.aic7xxx#7 $
#
config SCSI_AIC7XXX
	tristate "Adaptec AIC7xxx Fast -> U160 support"
	depends on (PCI || EISA) && SCSI
	select SCSI_SPI_ATTRS
	help
	This driver supports all of Adaptec's Fast through Ultra 160 PCI
	based SCSI controllers as well as the aic7770 based EISA and VLB
	SCSI controllers (the 274x and 284x series).  For AAA and ARO based
	configurations, only SCSI functionality is provided.

	To compile this driver as a module, choose M here: the
	module will be called aic7xxx.

config AIC7XXX_CMDS_PER_DEVICE
	int "Maximum number of TCQ commands per device"
	depends on SCSI_AIC7XXX
	default "32"
	help
	Specify the number of commands you would like to allocate per SCSI
	device when Tagged Command Queueing (TCQ) is enabled on that device.

	This is an upper bound value for the number of tagged transactions
	to be used for any device.  The aic7xxx driver will automatically
	vary this number based on device behavior.  For devices with a
	fixed maximum, the driver will eventually lock to this maximum
	and display a console message indicating this value.

	Due to resource allocation issues in the Linux SCSI mid-layer, using
	a high number of commands per device may result in memory allocation
	failures when many devices are attached to the system.  For this reason,
	the default is set to 32.  Higher values may result in higher performance
	on some devices.  The upper bound is 253.  0 disables tagged queueing.

	Per device tag depth can be controlled via the kernel command line
	"tag_info" option.  See Documentation/scsi/aic7xxx.rst for details.

config AIC7XXX_RESET_DELAY_MS
	int "Initial bus reset delay in milli-seconds"
	depends on SCSI_AIC7XXX
	default "5000"
	help
	The number of milliseconds to delay after an initial bus reset.
	The bus settle delay following all error recovery actions is
	dictated by the SCSI layer and is not affected by this value.

	Default: 5000 (5 seconds)

config AIC7XXX_BUILD_FIRMWARE
	bool "Build Adapter Firmware with Kernel Build"
	depends on SCSI_AIC7XXX && !PREVENT_FIRMWARE_BUILD
	help
	This option should only be enabled if you are modifying the firmware
	source to the aic7xxx driver and wish to have the generated firmware
	include files updated during a normal kernel build.  The assembler
	for the firmware requires lex and yacc or their equivalents, as well
	as the db v1 library.  You may have to install additional packages
	or modify the assembler Makefile or the files it includes if your
	build environment is different than that of the author.

config AIC7XXX_DEBUG_ENABLE
	bool "Compile in Debugging Code"
	depends on SCSI_AIC7XXX
	default y
	help
	Compile in aic7xxx debugging code that can be useful in diagnosing
	driver errors.

config AIC7XXX_DEBUG_MASK
        int "Debug code enable mask (2047 for all debugging)"
        depends on SCSI_AIC7XXX
        default "0"
        help
	Bit mask of debug options that is only valid if the
	CONFIG_AIC7XXX_DEBUG_ENABLE option is enabled.  The bits in this mask
	are defined in the drivers/scsi/aic7xxx/aic7xxx.h - search for the
	variable ahc_debug in that file to find them.

config AIC7XXX_REG_PRETTY_PRINT
        bool "Decode registers during diagnostics"
        depends on SCSI_AIC7XXX
	default y
        help
	Compile in register value tables for the output of expanded register
	contents in diagnostics.  This make it much easier to understand debug
	output without having to refer to a data book and/or the aic7xxx.reg
	file.
```

## drivers/scsi/aic94xx/Kconfig
```kconfig
# SPDX-License-Identifier: GPL-2.0-only
#
# Kernel configuration file for aic94xx SAS/SATA driver.
#
# Copyright (c) 2005 Adaptec, Inc.  All rights reserved.
# Copyright (c) 2005 Luben Tuikov <luben_tuikov@adaptec.com>
#

config SCSI_AIC94XX
	tristate "Adaptec AIC94xx SAS/SATA support"
	depends on PCI
	select SCSI_SAS_LIBSAS
	select FW_LOADER
	help
		This driver supports Adaptec's SAS/SATA 3Gb/s 64 bit PCI-X
		AIC94xx chip based host adapters.

config AIC94XX_DEBUG
	bool "Compile in debug mode"
	default y
	depends on SCSI_AIC94XX
	help
		Compiles the aic94xx driver in debug mode.  In debug mode,
		the driver prints some messages to the console.
```

## drivers/scsi/arm/Kconfig
```kconfig
#
# SCSI driver configuration for Acorn
#
config SCSI_ACORNSCSI_3
	tristate "Acorn SCSI card (aka30) support"
	depends on ARCH_ACORN && SCSI
	select SCSI_SPI_ATTRS
	help
	  This enables support for the Acorn SCSI card (aka30). If you have an
	  Acorn system with one of these, say Y. If unsure, say N.

config SCSI_ACORNSCSI_TAGGED_QUEUE
	bool "Support SCSI 2 Tagged queueing"
	depends on SCSI_ACORNSCSI_3
	help
	  Say Y here to enable tagged queuing support on the Acorn SCSI card.

	  This is a feature of SCSI-2 which improves performance: the host
	  adapter can send several SCSI commands to a device's queue even if
	  previous commands haven't finished yet. Some SCSI devices don't
	  implement this properly, so the safe answer is N.

config SCSI_ACORNSCSI_SYNC
	bool "Support SCSI 2 Synchronous Transfers"
	depends on SCSI_ACORNSCSI_3
	help
	  Say Y here to enable synchronous transfer negotiation with all
	  targets on the Acorn SCSI card.

	  In general, this improves performance; however some SCSI devices
	  don't implement it properly, so the safe answer is N.

config SCSI_ARXESCSI
	tristate "ARXE SCSI support"
	depends on ARCH_ACORN && SCSI
	help
	  Around 1991, Arxe Systems Limited released a high density floppy
	  disc interface for the Acorn Archimedes range, to allow the use of
	  HD discs from the then new A5000 on earlier models. This interface
	  was either sold on its own or with an integral SCSI controller.
	  Technical details on this NCR53c94-based device are available at
	  <http://www.cryton.demon.co.uk/acornbits/scsi_arxe.html>
	  Say Y here to compile in support for the SCSI controller.

config SCSI_CUMANA_2
	tristate "CumanaSCSI II support"
	depends on ARCH_ACORN && SCSI
	help
	  This enables support for the Cumana SCSI II card. If you have an
	  Acorn system with one of these, say Y. If unsure, say N.

config SCSI_EESOXSCSI
	tristate "EESOX support"
	depends on ARCH_ACORN && SCSI
	help
	  This enables support for the EESOX SCSI card. If you have an Acorn
	  system with one of these, say Y, otherwise say N.

config SCSI_POWERTECSCSI
	tristate "PowerTec support"
	depends on ARCH_ACORN && SCSI
	help
	  This enables support for the Powertec SCSI card on Acorn systems. If
	  you have one of these, say Y. If unsure, say N.

comment "The following drivers are not fully supported"
	depends on ARCH_ACORN

config SCSI_CUMANA_1
	tristate "CumanaSCSI I support"
	depends on ARCH_ACORN && SCSI
	select SCSI_SPI_ATTRS
	help
	  This enables support for the Cumana SCSI I card. If you have an
	  Acorn system with one of these, say Y. If unsure, say N.

config SCSI_OAK1
	tristate "Oak SCSI support"
	depends on ARCH_ACORN && SCSI
	select SCSI_SPI_ATTRS
	help
	  This enables support for the Oak SCSI card. If you have an Acorn
	  system with one of these, say Y. If unsure, say N.
```

## drivers/scsi/be2iscsi/Kconfig
```kconfig
# SPDX-License-Identifier: GPL-2.0-only
config BE2ISCSI
	tristate "Emulex 10Gbps iSCSI - BladeEngine 2"
	depends on PCI && SCSI && NET
	select SCSI_ISCSI_ATTRS
	select ISCSI_BOOT_SYSFS
	select IRQ_POLL

	help
	This driver implements the iSCSI functionality for Emulex
	10Gbps Storage adapter - BladeEngine 2.
```

## drivers/scsi/bnx2fc/Kconfig
```kconfig
# SPDX-License-Identifier: GPL-2.0-only
config SCSI_BNX2X_FCOE
	tristate "QLogic FCoE offload support"
	depends on PCI
	depends on (IPV6 || IPV6=n)
	depends on LIBFC
	depends on LIBFCOE
	depends on MMU
	select NETDEVICES
	select ETHERNET
	select NET_VENDOR_BROADCOM
	select CNIC
	help
	This driver supports FCoE offload for the QLogic devices.
```

## drivers/scsi/bnx2i/Kconfig
```kconfig
config SCSI_BNX2_ISCSI
	tristate "QLogic NetXtreme II iSCSI support"
	depends on NET
	depends on PCI
	depends on (IPV6 || IPV6=n)
	depends on MMU
	select SCSI_ISCSI_ATTRS
	select NETDEVICES
	select ETHERNET
	select NET_VENDOR_BROADCOM
	select CNIC
	---help---
	This driver supports iSCSI offload for the QLogic NetXtreme II
	devices.
```

## drivers/scsi/csiostor/Kconfig
```kconfig
# SPDX-License-Identifier: GPL-2.0-only
config SCSI_CHELSIO_FCOE
	tristate "Chelsio Communications FCoE support"
	depends on PCI && SCSI
	depends on SCSI_FC_ATTRS
	select FW_LOADER
	help
	  This driver supports FCoE Offload functionality over
	  Chelsio T4-based 10Gb Converged Network Adapters.

	  For general information about Chelsio and our products, visit
	  our website at <http://www.chelsio.com>.

	  For customer support, please visit our customer support page at
	  <http://www.chelsio.com/support.html>.

	  Please send feedback to <linux-bugs@chelsio.com>.

	  To compile this driver as a module choose M here; the module
	  will be called csiostor.
```

## drivers/scsi/cxgb3i/Kconfig
```kconfig
config SCSI_CXGB3_ISCSI
	tristate "Chelsio S3xx iSCSI support"
	depends on CHELSIO_T3_DEPENDS
	select CHELSIO_T3
	select SCSI_ISCSI_ATTRS
	---help---
	This driver supports iSCSI offload for the Chelsio S3 series devices.
```

## drivers/scsi/cxgbi/Kconfig
```kconfig
# SPDX-License-Identifier: GPL-2.0-only
source "drivers/scsi/cxgbi/cxgb3i/Kconfig"
source "drivers/scsi/cxgbi/cxgb4i/Kconfig"
```

## drivers/scsi/cxgbi/cxgb3i/Kconfig
```kconfig
# SPDX-License-Identifier: GPL-2.0-only
config SCSI_CXGB3_ISCSI
	tristate "Chelsio T3 iSCSI support"
	depends on PCI && INET && (IPV6 || IPV6=n)
	select NETDEVICES
	select ETHERNET
	select NET_VENDOR_CHELSIO
	select CHELSIO_T3
	select CHELSIO_LIB
	select SCSI_ISCSI_ATTRS
	help
	  This driver supports iSCSI offload for the Chelsio T3 devices.
```

## drivers/scsi/cxgbi/cxgb4i/Kconfig
```kconfig
# SPDX-License-Identifier: GPL-2.0-only
config SCSI_CXGB4_ISCSI
	tristate "Chelsio T4 iSCSI support"
	depends on PCI && INET && (IPV6 || IPV6=n)
	depends on THERMAL || !THERMAL
	depends on ETHERNET
	depends on TLS || TLS=n
	select NET_VENDOR_CHELSIO
	select CHELSIO_T4
	select CHELSIO_LIB
	select SCSI_ISCSI_ATTRS
	help
	  This driver supports iSCSI offload for the Chelsio T4 devices.
```

## drivers/scsi/cxlflash/Kconfig
```kconfig
# SPDX-License-Identifier: GPL-2.0-only
#
# IBM CXL-attached Flash Accelerator SCSI Driver
#

config CXLFLASH
	tristate "Support for IBM CAPI Flash (DEPRECATED)"
	depends on PCI && SCSI && (CXL || OCXL) && EEH
	select IRQ_POLL
	help
	  The cxlflash driver is deprecated and will be removed in a future
	  kernel release.

	  Allows CAPI Accelerated IO to Flash
	  If unsure, say N.
```

## drivers/scsi/device_handler/Kconfig
```kconfig
#
# SCSI Device Handler configuration
#

menuconfig SCSI_DH
	bool "SCSI Device Handlers"
	depends on SCSI
	default n
	help
	  SCSI Device Handlers provide device specific support for
	  devices utilized in multipath configurations. Say Y here to
	  select support for specific hardware.

config SCSI_DH_RDAC
	tristate "LSI RDAC Device Handler"
	depends on SCSI_DH
	help
	If you have a LSI RDAC select y. Otherwise, say N.

config SCSI_DH_HP_SW
	tristate "HP/COMPAQ MSA Device Handler"
	depends on SCSI_DH
	help
	If you have a HP/COMPAQ MSA device that requires START_STOP to
	be sent to start it and cannot upgrade the firmware then select y.
	Otherwise, say N.

config SCSI_DH_EMC
	tristate "EMC CLARiiON Device Handler"
	depends on SCSI_DH
	help
	If you have a EMC CLARiiON select y. Otherwise, say N.

config SCSI_DH_ALUA
	tristate "SPC-3 ALUA Device Handler"
	depends on SCSI_DH
	help
	  SCSI Device handler for generic SPC-3 Asymmetric Logical Unit
	  Access (ALUA).
```

## drivers/scsi/elx/Kconfig
```kconfig
config SCSI_EFCT
	tristate "Emulex Fibre Channel Target"
	depends on PCI && SCSI
	depends on TARGET_CORE
	depends on SCSI_FC_ATTRS
	select CRC_T10DIF
	help
	  The efct driver provides enhanced SCSI Target Mode
	  support for specific SLI-4 adapters.
```

## drivers/scsi/esas2r/Kconfig
```kconfig
config SCSI_ESAS2R
	tristate "ATTO Technology's ExpressSAS RAID adapter driver"
	depends on PCI && SCSI
	---help---
	  This driver supports the ATTO ExpressSAS R6xx SAS/SATA RAID controllers.
```

## drivers/scsi/hisi_sas/Kconfig
```kconfig
# SPDX-License-Identifier: GPL-2.0-only
config SCSI_HISI_SAS
	tristate "HiSilicon SAS"
	depends on HAS_IOMEM
	depends on ARM64 || COMPILE_TEST
	select SCSI_SAS_LIBSAS
	select BLK_DEV_INTEGRITY
	depends on ATA
	select SATA_HOST
	help
		This driver supports HiSilicon's SAS HBA, including support based
		on platform device

config SCSI_HISI_SAS_PCI
	tristate "HiSilicon SAS on PCI bus"
	depends on SCSI_HISI_SAS
	depends on PCI
	depends on ACPI
	help
		This driver supports HiSilicon's SAS HBA based on PCI device

config SCSI_HISI_SAS_DEBUGFS_DEFAULT_ENABLE
	bool "HiSilicon SAS debugging default enable"
	depends on SCSI_HISI_SAS
	help
		Set Y to default enable DEBUGFS for SCSI_HISI_SAS
```
