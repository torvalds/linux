## drivers/vfio/pci/ism/Kconfig
```kconfig
# SPDX-License-Identifier: GPL-2.0
config ISM_VFIO_PCI
	tristate "VFIO support for ISM devices"
	depends on S390
	select VFIO_PCI_CORE
	help
	  This provides user space support for IBM Internal Shared Memory (ISM)
	  Adapter devices using the VFIO framework.

	  If you don't know what to do here, say N.
```

## drivers/vfio/pci/mlx5/Kconfig
```kconfig
# SPDX-License-Identifier: GPL-2.0-only
config MLX5_VFIO_PCI
	tristate "VFIO support for MLX5 PCI devices"
	depends on MLX5_CORE
	select VFIO_PCI_CORE
	select IOMMUFD_DRIVER
	help
	  This provides migration support for MLX5 devices using the VFIO
	  framework.

	  If you don't know what to do here, say N.
```

## drivers/vfio/pci/nvgrace-gpu/Kconfig
```kconfig
# SPDX-License-Identifier: GPL-2.0-only
config NVGRACE_EGM
	tristate "EGM driver for NVIDIA Grace Hopper and Blackwell Superchip"
	depends on ARM64 || (COMPILE_TEST && 64BIT)
	help
	  Extended GPU Memory (EGM) support for the GPU in the NVIDIA Grace
	  based chips required to avail the CPU memory as additional
	  cross-node/cross-socket memory for GPU using KVM/qemu.

	  If you don't know what to do here, say N.

config NVGRACE_GPU_VFIO_PCI
	tristate "VFIO support for the GPU in the NVIDIA Grace Hopper Superchip"
	depends on ARM64 || (COMPILE_TEST && 64BIT)
	select VFIO_PCI_CORE
	select NVGRACE_EGM
	help
	  VFIO support for the GPU in the NVIDIA Grace Hopper Superchip is
	  required to assign the GPU device to userspace using KVM/qemu/etc.

	  If you don't know what to do here, say N.
```

## drivers/vfio/pci/pds/Kconfig
```kconfig
# SPDX-License-Identifier: GPL-2.0
# Copyright (c) 2023 Advanced Micro Devices, Inc.

config PDS_VFIO_PCI
	tristate "VFIO support for PDS PCI devices"
	depends on PDS_CORE && PCI_IOV
	select VFIO_PCI_CORE
	select IOMMUFD_DRIVER
	help
	  This provides generic PCI support for PDS devices using the VFIO
	  framework.

	  More specific information on this driver can be
	  found in
	  <file:Documentation/networking/device_drivers/ethernet/amd/pds_vfio_pci.rst>.

	  To compile this driver as a module, choose M here. The module
	  will be called pds-vfio-pci.

	  If you don't know what to do here, say N.
```

## drivers/vfio/pci/qat/Kconfig
```kconfig
# SPDX-License-Identifier: GPL-2.0-only
config QAT_VFIO_PCI
	tristate "VFIO support for QAT VF PCI devices"
	select VFIO_PCI_CORE
	depends on CRYPTO_DEV_QAT_4XXX
	help
	  This provides migration support for Intel(R) QAT Virtual Function
	  using the VFIO framework.

	  To compile this as a module, choose M here: the module
	  will be called qat_vfio_pci. If you don't know what to do here,
	  say N.
```

## drivers/vfio/pci/virtio/Kconfig
```kconfig
# SPDX-License-Identifier: GPL-2.0-only
config VIRTIO_VFIO_PCI
	tristate "VFIO support for VIRTIO PCI VF devices"
	depends on VIRTIO_PCI
	select VFIO_PCI_CORE
	help
	  This provides migration support for VIRTIO NET and BLOCK PCI VF
	  devices using the VFIO framework. Migration support requires the
	  SR-IOV PF device to support specific VIRTIO extensions,
	  otherwise this driver provides no additional functionality
	  beyond vfio-pci.

	  Migration support in this driver relies on dirty page tracking
	  provided by the IOMMU hardware and exposed through IOMMUFD, any
	  other use cases are dis-recommended.

	  If you don't know what to do here, say N.

config VIRTIO_VFIO_PCI_ADMIN_LEGACY
	bool "Legacy I/O support for VIRTIO NET PCI VF devices"
	depends on VIRTIO_VFIO_PCI && VIRTIO_PCI_ADMIN_LEGACY
	default y
	help
	  This extends the virtio-vfio-pci driver to support legacy I/O
	  access, allowing use of legacy virtio drivers with VIRTIO NET
	  PCI VF devices. Legacy I/O support requires the SR-IOV PF
	  device to support and enable specific VIRTIO extensions,
	  otherwise this driver provides no additional functionality
	  beyond vfio-pci.

	  If you don't know what to do here, say N.
```

## drivers/vfio/pci/xe/Kconfig
```kconfig
# SPDX-License-Identifier: GPL-2.0-only
config XE_VFIO_PCI
	tristate "VFIO support for Intel Graphics"
	depends on DRM_XE && PCI_IOV
	select VFIO_PCI_CORE
	help
	  This option enables device specific VFIO driver variant for Intel Graphics.
	  In addition to generic VFIO PCI functionality, it implements VFIO
	  migration uAPI allowing userspace to enable migration for
	  Intel Graphics SR-IOV Virtual Functions supported by the Xe driver.

	  If you don't know what to do here, say N.
```

## drivers/vfio/platform/Kconfig
```kconfig
# SPDX-License-Identifier: GPL-2.0-only
menu "VFIO support for platform devices"
	depends on ARM || ARM64 || COMPILE_TEST

config VFIO_PLATFORM_BASE
	tristate
	select VFIO_VIRQFD

config VFIO_PLATFORM
	tristate "Generic VFIO support for any platform device"
	select VFIO_PLATFORM_BASE
	help
	  Support for platform devices with VFIO. This is required to make
	  use of platform devices present on the system using the VFIO
	  framework.

	  If you don't know what to do here, say N.

config VFIO_AMBA
	tristate "VFIO support for AMBA devices"
	depends on ARM_AMBA || COMPILE_TEST
	select VFIO_PLATFORM_BASE
	help
	  Support for ARM AMBA devices with VFIO. This is required to make
	  use of ARM AMBA devices present on the system using the VFIO
	  framework.

	  If you don't know what to do here, say N.

menu "VFIO platform reset drivers"
	depends on VFIO_PLATFORM_BASE

source "drivers/vfio/platform/reset/Kconfig"
endmenu
endmenu
```

## drivers/vfio/platform/reset/Kconfig
```kconfig
# SPDX-License-Identifier: GPL-2.0-only
config VFIO_PLATFORM_CALXEDAXGMAC_RESET
	tristate "VFIO support for calxeda xgmac reset"
	help
	  Enables the VFIO platform driver to handle reset for Calxeda xgmac

	  If you don't know what to do here, say N.

config VFIO_PLATFORM_AMDXGBE_RESET
	tristate "VFIO support for AMD XGBE reset"
	help
	  Enables the VFIO platform driver to handle reset for AMD XGBE

	  If you don't know what to do here, say N.

config VFIO_PLATFORM_BCMFLEXRM_RESET
	tristate "VFIO support for Broadcom FlexRM reset"
	depends on ARCH_BCM_IPROC || COMPILE_TEST
	default ARCH_BCM_IPROC
	help
	  Enables the VFIO platform driver to handle reset for Broadcom FlexRM

	  If you don't know what to do here, say N.
```

## drivers/vhost/Kconfig
```kconfig
# SPDX-License-Identifier: GPL-2.0-only
config VHOST_IOTLB
	tristate
	help
	  Generic IOTLB implementation for vhost and vringh.
	  This option is selected by any driver which needs to support
	  an IOMMU in software.

config VHOST_RING
	tristate
	select VHOST_IOTLB
	help
	  This option is selected by any driver which needs to access
	  the host side of a virtio ring.

config VHOST
	tristate
	select VHOST_IOTLB
	help
	  This option is selected by any driver which needs to access
	  the core of vhost.

menuconfig VHOST_MENU
	bool "VHOST drivers"
	default y

if VHOST_MENU

config VHOST_NET
	tristate "Host kernel accelerator for virtio net"
	depends on NET && EVENTFD && (TUN || !TUN) && (TAP || !TAP)
	select VHOST
	help
	  This kernel module can be loaded in host kernel to accelerate
	  guest networking with virtio_net. Not to be confused with virtio_net
	  module itself which needs to be loaded in guest kernel.

	  To compile this driver as a module, choose M here: the module will
	  be called vhost_net.

config VHOST_SCSI
	tristate "VHOST_SCSI TCM fabric driver"
	depends on TARGET_CORE && EVENTFD
	select VHOST
	default n
	help
	Say M here to enable the vhost_scsi TCM fabric module
	for use with virtio-scsi guests

config VHOST_VSOCK
	tristate "vhost virtio-vsock driver"
	depends on VSOCKETS && EVENTFD
	select VHOST
	select VIRTIO_VSOCKETS_COMMON
	default n
	help
	This kernel module can be loaded in the host kernel to provide AF_VSOCK
	sockets for communicating with guests.  The guests must have the
	virtio_transport.ko driver loaded to use the virtio-vsock device.

	To compile this driver as a module, choose M here: the module will be called
	vhost_vsock.

config VHOST_VDPA
	tristate "Vhost driver for vDPA-based backend"
	depends on EVENTFD
	select VHOST
	select IRQ_BYPASS_MANAGER
	depends on VDPA
	help
	  This kernel module can be loaded in host kernel to accelerate
	  guest virtio devices with the vDPA-based backends.

	  To compile this driver as a module, choose M here: the module
	  will be called vhost_vdpa.

config VHOST_CROSS_ENDIAN_LEGACY
	bool "Cross-endian support for vhost"
	default n
	help
	  This option allows vhost to support guests with a different byte
	  ordering from host while using legacy virtio.

	  Userspace programs can control the feature using the
	  VHOST_SET_VRING_ENDIAN and VHOST_GET_VRING_ENDIAN ioctls.

	  This is only useful on a few platforms (ppc64 and arm64). Since it
	  adds some overhead, it is disabled by default.

	  If unsure, say "N".

endif
```

## drivers/vhost/Kconfig.blk
```kconfig
config VHOST_BLK
	tristate "Host kernel accelerator for virtio blk"
	depends on BLOCK && EVENTFD && m
	---help---
	  This kernel module can be loaded in host kernel to accelerate
	  guest block with virtio_blk. Not to be confused with virtio_blk
	  module itself which needs to be loaded in guest kernel.

	  To compile this driver as a module, choose M here: the module will
	  be called vhost_blk.
```

## drivers/vhost/Kconfig.tcm
```kconfig
config TCM_VHOST
	tristate "TCM_VHOST fabric module"
	depends on TARGET_CORE && EVENTFD && m
	default n
	---help---
	Say M here to enable the TCM_VHOST fabric module for use with virtio-scsi guests
```

## drivers/vhost/Kconfig.vringh
```kconfig
# SPDX-License-Identifier: GPL-2.0-only
config VHOST_RING
	tristate
	---help---
	  This option is selected by any driver which needs to access
	  the host side of a virtio ring.
```

## drivers/vhost/Kconfig.vsock
```kconfig
config VHOST_VSOCK
	tristate "vhost virtio-vsock driver"
	depends on VSOCKETS && EVENTFD
	select VIRTIO_VSOCKETS_COMMON
	default n
	---help---
	Say M here to enable the vhost-vsock for virtio-vsock guests
```

## drivers/video/Kconfig
```kconfig
# SPDX-License-Identifier: GPL-2.0-only
#
# Video configuration
#

menu "Graphics support"

config APERTURE_HELPERS
	bool
	help
	  Support tracking and hand-over of aperture ownership. Required
	  by graphics drivers for firmware-provided framebuffers.

config SCREEN_INFO
	bool
	default n

config STI_CORE
	bool
	depends on PARISC
	help
	  STI refers to the HP "Standard Text Interface" which is a set of
	  BIOS routines contained in a ROM chip in HP PA-RISC based machines.

config VIDEO
	bool
	default n

source "drivers/auxdisplay/Kconfig"

if HAS_IOMEM

config HAVE_FB_ATMEL
	bool

source "drivers/char/agp/Kconfig"

source "drivers/gpu/vga/Kconfig"

source "drivers/gpu/host1x/Kconfig"
source "drivers/gpu/ipu-v3/Kconfig"
source "drivers/gpu/nova-core/Kconfig"

source "drivers/gpu/drm/Kconfig"

menu "Frame buffer Devices"
source "drivers/video/fbdev/Kconfig"
endmenu

source "drivers/video/backlight/Kconfig"

config VGASTATE
       tristate
       default n

config VIDEOMODE_HELPERS
	bool

config HDMI
	bool

endif # HAS_IOMEM

config FIRMWARE_EDID
	bool "Enable firmware EDID"
	depends on X86
	help
	  This enables access to the EDID transferred from the firmware.
	  On x86, this is from the VESA BIOS. DRM display drivers will
	  be able to export the information to userspace.

	  Also enable this if DDC/I2C transfers do not work for your driver
	  and if you are using nvidiafb, i810fb or savagefb.

	  In general, choosing Y for this option is safe.  If you
	  experience extremely long delays while booting before you get
	  something on your display, try setting this to N.  Matrox cards in
	  combination with certain motherboards and monitors are known to
	  suffer from this problem.

if VT
	source "drivers/video/console/Kconfig"
endif

if FB_CORE || SGI_NEWPORT_CONSOLE
	source "drivers/video/logo/Kconfig"

endif

source "drivers/gpu/trace/Kconfig"

endmenu
```

## drivers/video/adf/Kconfig
```kconfig
menuconfig ADF
	depends on SYNC
	depends on DMA_SHARED_BUFFER
	tristate "Atomic Display Framework"
```
