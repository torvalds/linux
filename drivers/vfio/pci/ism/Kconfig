## drivers/video/console/Kconfig
```kconfig
# SPDX-License-Identifier: GPL-2.0-only
#
# Video configuration
#

menu "Console display driver support"

config VGA_CONSOLE
	bool "VGA text console" if EXPERT || !X86
	depends on !4xx && !PPC_8xx && !SPARC && !M68K && !PARISC &&  !SUPERH && \
		(!ARM || ARCH_FOOTBRIDGE || ARCH_INTEGRATOR || ARCH_NETWINDER) && \
		!ARM64 && !ARC && !MICROBLAZE && !OPENRISC && !S390 && !UML
	select APERTURE_HELPERS if (DRM || FB || VFIO_PCI_CORE)
	default y
	help
	  Saying Y here will allow you to use Linux in text mode through a
	  display that complies with the generic VGA standard. Virtually
	  everyone wants that.

	  The program SVGATextMode can be used to utilize SVGA video cards to
	  their full potential in text mode. Download it from
	  <ftp://ibiblio.org/pub/Linux/utils/console/>.

	  Say Y.

config MDA_CONSOLE
	depends on !M68K && !PARISC && ISA
	tristate "MDA text console (dual-headed)"
	help
	  Say Y here if you have an old MDA or monochrome Hercules graphics
	  adapter in your system acting as a second head ( = video card). You
	  will then be able to use two monitors with your Linux system. Do not
	  say Y here if your MDA card is the primary card in your system; the
	  normal VGA driver will handle it.

	  To compile this driver as a module, choose M here: the
	  module will be called mdacon.

	  If unsure, say N.

config SGI_NEWPORT_CONSOLE
	tristate "SGI Newport Console support"
	depends on SGI_IP22 && HAS_IOMEM
	select FONT_SUPPORT
	help
	  Say Y here if you want the console on the Newport aka XL graphics
	  card of your Indy.  Most people say Y here.

config DUMMY_CONSOLE
	bool
	default y

config DUMMY_CONSOLE_COLUMNS
	int "Initial number of console screen columns"
	depends on DUMMY_CONSOLE && !ARM
	default 160 if PARISC
	default 80
	help
	  On PA-RISC, the default value is 160, which should fit a 1280x1024
	  monitor.
	  Select 80 if you use a 640x480 resolution by default.

config DUMMY_CONSOLE_ROWS
	int "Initial number of console screen rows"
	depends on DUMMY_CONSOLE && !ARM
	default 64 if PARISC
	default 25
	help
	  On PA-RISC, the default value is 64, which should fit a 1280x1024
	  monitor.
	  Select 25 if you use a 640x480 resolution by default.

config FRAMEBUFFER_CONSOLE
	bool "Framebuffer Console support"
	depends on FB && !UML
	select VT_HW_CONSOLE_BINDING
	select CRC32
	select FONT_SUPPORT
	help
	  Low-level framebuffer-based console driver.

config FRAMEBUFFER_CONSOLE_LEGACY_ACCELERATION
	bool "Enable legacy fbcon hardware acceleration code"
	depends on FRAMEBUFFER_CONSOLE
	default y if PARISC
	default n
	help
	  This option enables the fbcon (framebuffer text-based) hardware
	  acceleration for graphics drivers which were written for the fbdev
	  graphics interface.

	  On modern machines, on mainstream machines (like x86-64) or when
	  using a modern Linux distribution those fbdev drivers usually aren't used.
	  So enabling this option wouldn't have any effect, which is why you want
	  to disable this option on such newer machines.

	  If you compile this kernel for older machines which still require the
	  fbdev drivers, you may want to say Y.

	  If unsure, select n.

config FRAMEBUFFER_CONSOLE_DETECT_PRIMARY
       bool "Map the console to the primary display device"
       depends on FRAMEBUFFER_CONSOLE
       default n
	help
	 If this option is selected, the framebuffer console will
	 automatically select the primary display device (if the architecture
	 supports this feature).  Otherwise, the framebuffer console will
	 always select the first framebuffer driver that is loaded. The latter
	 is the default behavior.

	 You can always override the automatic selection of the primary device
	 by using the fbcon=map: boot option.

	 If unsure, select n.

config FRAMEBUFFER_CONSOLE_ROTATION
       bool "Framebuffer Console Rotation"
       depends on FRAMEBUFFER_CONSOLE
       help
	 Enable display rotation for the framebuffer console.  This is done
	 in software and may be significantly slower than a normally oriented
	 display.  Note that the rotation is done at the console level only
	 such that other users of the framebuffer will remain normally
	 oriented.

config FRAMEBUFFER_CONSOLE_DEFERRED_TAKEOVER
	bool "Framebuffer Console Deferred Takeover"
	depends on FB=y && FRAMEBUFFER_CONSOLE && DUMMY_CONSOLE
	help
	  If enabled this defers the framebuffer console taking over the
	  console from the dummy console until the first text is displayed on
	  the console. This is useful in combination with the "quiet" kernel
	  commandline option to keep the framebuffer contents initially put up
	  by the firmware in place, rather then replacing the contents with a
	  black screen as soon as fbcon loads.

config STI_CONSOLE
	bool "STI text console"
	depends on PARISC && HAS_IOMEM
	select FONT_SUPPORT
	select CRC32
	select STI_CORE
	default y
	help
	  The STI console is the builtin display/keyboard on HP-PARISC
	  machines.  Say Y here to build support for it into your kernel.
	  The alternative is to use your primary serial port as a console.

endmenu
```

## drivers/video/display/Kconfig
```kconfig
#
# Display drivers configuration
#

menu "Display device support"

config DISPLAY_SUPPORT
	tristate "Display panel/monitor support"
	---help---
	  This framework adds support for low-level control of a display.
	  This includes support for power.

	  Enable this to be able to choose the drivers for controlling the
	  physical display panel/monitor on some platforms. This not only
	  covers LCD displays for PDAs but also other types of displays
	  such as CRT, TVout etc.

	  To have support for your specific display panel you will have to
	  select the proper drivers which depend on this option.

comment "Display hardware drivers"
	depends on DISPLAY_SUPPORT

endmenu
```

## drivers/video/display/lcd/Kconfig
```kconfig
config RK610_LCD
	bool "RK610(Jetta) lcd support"
	depends on MFD_RK610
	default y if MFD_RK610
	help
		Support Jetta(RK610) to output LCD1 and LVDS.
```

## drivers/video/display/screen/Kconfig
```kconfig
choice
	depends on FB_RK29  
	prompt  "LCD Panel Select for rk2918 platform"

config LCD_RK29_NULL
	bool "NULL"
config LCD_RK29_LG_LP097X02
	bool "RGB LCD_LG_LP097X02 1024X768"

config LCD_RK29_HSD100PXN
	  bool "RGB Hannstar HSD100PXN(1024X768)"

config LCD_RK29_LS035Y8DX02A
	  bool "RGB LS035Y8DX02A(480X800)"

config LCD_RK29_LS035Y8DX04A
	  bool "RGB LS035Y8DX04A(480X800)"

config LCD_RK29_NT35510
	bool "RGB lcd_nt35510"
	
config DEFAULT_OUT_HDMI
	bool "HDMI for default panel"
	depends on HDMI
	---help---
	if you want set HDMI for default panel, android UI size is HDMI default resolution.

config LCD_RK29_A050VL01
	bool "RGB A050VL01"
	
endchoice
```

## drivers/video/display/transmitter/Kconfig
```kconfig
choice
    depends on DISPLAY_SUPPORT
    prompt  "Display interface transmitter Select"

config NO_TRSM
	bool "no transmitter needed"

config RK610_LVDS
	bool "RK610(Jetta) lvds transmitter support"
	depends on MFD_RK610 
	help
		Support Jetta(RK610) to output LCD1 and LVDS.

config RK616_LVDS
        bool "RK616(Jetta B) lvds,lcd,scaler transmitter support"
        depends on MFD_RK616
        help
           RK616(Jetta B) LVDS,LCD,scaler transmitter support.
		

config DP_ANX6345
	bool "RGB to Display Port transmitter anx6345,anx9804,anx9805 support"

config DP501
	bool"RGB to Display Port transmitter dp501 support"

config TC358768_RGB2MIPI
        bool "toshiba TC358768 RGB to MIPI DSI"
        help
        "a chip that change RGB interface parallel signal into DSI serial signal"

config SSD2828_RGB2MIPI
        bool "solomon SSD2828 RGB to MIPI DSI"
        help
        "a chip that change RGB interface parallel signal into DSI serial signal"
	
endchoice

			
```

## drivers/video/exynos/Kconfig
```kconfig
#
# Exynos Video configuration
#

menuconfig EXYNOS_VIDEO
	bool "Exynos Video driver support"
	help
	  This enables support for EXYNOS Video device.

if EXYNOS_VIDEO

#
# MIPI DSI driver
#

config EXYNOS_MIPI_DSI
	bool "EXYNOS MIPI DSI driver support."
	depends on ARCH_S5PV210 || ARCH_EXYNOS
	select GENERIC_PHY
	help
	  This enables support for MIPI-DSI device.

config EXYNOS_LCD_S6E8AX0
	bool "S6E8AX0 MIPI AMOLED LCD Driver"
	depends on EXYNOS_MIPI_DSI && BACKLIGHT_CLASS_DEVICE
	depends on (LCD_CLASS_DEVICE = y)
	default n
	help
	  If you have an S6E8AX0 MIPI AMOLED LCD Panel, say Y to enable its
	  LCD control driver.

endif # EXYNOS_VIDEO
```

## drivers/video/fbdev/core/Kconfig
```kconfig
# SPDX-License-Identifier: GPL-2.0-only
#
# fbdev core configuration
#

config FB_CORE
	select VIDEO
	tristate

config FB_NOTIFY
	bool

config FIRMWARE_EDID
	bool "Enable firmware EDID"
	depends on FB
	help
	  This enables access to the EDID transferred from the firmware.
	  On the i386, this is from the Video BIOS. Enable this if DDC/I2C
	  transfers do not work for your driver and if you are using
	  nvidiafb, i810fb or savagefb.

	  In general, choosing Y for this option is safe.  If you
	  experience extremely long delays while booting before you get
	  something on your display, try setting this to N.  Matrox cards in
	  combination with certain motherboards and monitors are known to
	  suffer from this problem.

config FB_DEVICE
	bool "Provide legacy /dev/fb* device"
	depends on FB_CORE
	default FB
	help
	  Say Y here if you want the legacy /dev/fb* device file and
	  interfaces within sysfs anc procfs. It is only required if you
	  have userspace programs that depend on fbdev for graphics output.
	  This does not affect the framebuffer console. If unsure, say N.

config FB_DDC
	tristate
	depends on FB
	select I2C_ALGOBIT
	select I2C

config FB_CFB_FILLRECT
	tristate
	depends on FB_CORE
	help
	  Include the cfb_fillrect function for generic software rectangle
	  filling. This is used by drivers that don't provide their own
	  (accelerated) version.

config FB_CFB_COPYAREA
	tristate
	depends on FB_CORE
	help
	  Include the cfb_copyarea function for generic software area copying.
	  This is used by drivers that don't provide their own (accelerated)
	  version.

config FB_CFB_IMAGEBLIT
	tristate
	depends on FB_CORE
	help
	  Include the cfb_imageblit function for generic software image
	  blitting. This is used by drivers that don't provide their own
	  (accelerated) version.

config FB_CFB_REV_PIXELS_IN_BYTE
	bool
	depends on FB_CORE
	help
	  Allow I/O memory frame-buffer functions to work on displays with 1, 2
	  and 4 bits per pixel depths which has opposite order of pixels in
	  byte order to bytes in long order.

config FB_SYS_FILLRECT
	tristate
	depends on FB_CORE
	help
	  Include the sys_fillrect function for generic software rectangle
	  filling. This is used by drivers that don't provide their own
	  (accelerated) version and the framebuffer is in system RAM.

config FB_SYS_COPYAREA
	tristate
	depends on FB_CORE
	help
	  Include the sys_copyarea function for generic software area copying.
	  This is used by drivers that don't provide their own (accelerated)
	  version and the framebuffer is in system RAM.

config FB_SYS_IMAGEBLIT
	tristate
	depends on FB_CORE
	help
	  Include the sys_imageblit function for generic software image
	  blitting. This is used by drivers that don't provide their own
	  (accelerated) version and the framebuffer is in system RAM.

config FB_SYS_REV_PIXELS_IN_BYTE
	bool
	depends on FB_CORE
	help
	  Allow virtual memory frame-buffer functions to work on displays with 1, 2
	  and 4 bits per pixel depths which has opposite order of pixels in
	  byte order to bytes in long order.

config FB_PROVIDE_GET_FB_UNMAPPED_AREA
	bool
	depends on FB
	help
	  Allow generic frame-buffer to provide get_fb_unmapped_area
	  function to provide shareable character device support on nommu.

menuconfig FB_FOREIGN_ENDIAN
	bool "Framebuffer foreign endianness support"
	depends on FB
	help
	  This menu will let you enable support for the framebuffers with
	  non-native endianness (e.g. Little-Endian framebuffer on a
	  Big-Endian machine). Most probably you don't have such hardware,
	  so it's safe to say "n" here.

choice
	prompt "Choice endianness support"
	depends on FB_FOREIGN_ENDIAN

config FB_BOTH_ENDIAN
	bool "Support for Big- and Little-Endian framebuffers"

config FB_BIG_ENDIAN
	bool "Support for Big-Endian framebuffers only"

config FB_LITTLE_ENDIAN
	bool "Support for Little-Endian framebuffers only"

endchoice

config FB_SYSMEM_FOPS
	tristate
	depends on FB_CORE

config FB_DEFERRED_IO
	bool
	depends on FB_CORE

config FB_DMAMEM_HELPERS
	bool
	depends on FB_CORE
	select FB_SYS_COPYAREA
	select FB_SYS_FILLRECT
	select FB_SYS_IMAGEBLIT
	select FB_SYSMEM_FOPS

config FB_DMAMEM_HELPERS_DEFERRED
	bool
	depends on FB_CORE
	select FB_DEFERRED_IO
	select FB_DMAMEM_HELPERS

config FB_IOMEM_FOPS
	tristate
	depends on FB_CORE

config FB_IOMEM_HELPERS
	bool
	depends on FB_CORE
	select FB_CFB_COPYAREA
	select FB_CFB_FILLRECT
	select FB_CFB_IMAGEBLIT
	select FB_IOMEM_FOPS

config FB_IOMEM_HELPERS_DEFERRED
	bool
	depends on FB_CORE
	select FB_DEFERRED_IO
	select FB_IOMEM_HELPERS

config FB_SYSMEM_HELPERS
	bool
	depends on FB_CORE
	select FB_SYS_COPYAREA
	select FB_SYS_FILLRECT
	select FB_SYS_IMAGEBLIT
	select FB_SYSMEM_FOPS

config FB_SYSMEM_HELPERS_DEFERRED
	bool
	depends on FB_CORE
	select FB_DEFERRED_IO
	select FB_SYSMEM_HELPERS

config FB_BACKLIGHT
	bool
	depends on FB

config FB_MODE_HELPERS
	bool "Enable Video Mode Handling Helpers"
	depends on FB
	help
	  This enables functions for handling video modes using the
	  Generalized Timing Formula and the EDID parser. A few drivers rely
	  on this feature such as the radeonfb, rivafb, and the i810fb. If
	  your driver does not take advantage of this feature, choosing Y will
	  just increase the kernel size by about 5K.

config FB_TILEBLITTING
	bool "Enable Tile Blitting Support"
	depends on FB
	help
	  This enables tile blitting.  Tile blitting is a drawing technique
	  where the screen is divided into rectangular sections (tiles), whereas
	  the standard blitting divides the screen into pixels. Because the
	  default drawing element is a tile, drawing functions will be passed
	  parameters in terms of number of tiles instead of number of pixels.
	  For example, to draw a single character, instead of using bitmaps,
	  an index to an array of bitmaps will be used.  To clear or move a
	  rectangular section of a screen, the rectangle will be described in
	  terms of number of tiles in the x- and y-axis.

	  This is particularly important to one driver, matroxfb.  If
	  unsure, say N.
```
