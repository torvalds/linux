## drivers/infiniband/hw/mlx5/Kconfig
```kconfig
# SPDX-License-Identifier: GPL-2.0-only
config MLX5_INFINIBAND
	tristate "Mellanox 5th generation network adapters (ConnectX series) support"
	depends on NETDEVICES && ETHERNET && PCI && MLX5_CORE
	---help---
	  This driver provides low-level InfiniBand support for
	  Mellanox Connect-IB PCI Express host channel adapters (HCAs).
	  This is required to use InfiniBand protocols such as
	  IP-over-IB or SRP with these devices.
```

## drivers/infiniband/hw/mthca/Kconfig
```kconfig
config INFINIBAND_MTHCA
	tristate "Mellanox HCA support"
	depends on PCI
	---help---
	  This is a low-level driver for Mellanox InfiniHost host
	  channel adapters (HCAs), including the MT23108 PCI-X HCA
	  ("Tavor") and the MT25208 PCI Express HCA ("Arbel").

config INFINIBAND_MTHCA_DE
	bool "Verbose deging output" if EXPERT
	depends on INFINIBAND_MTHCA
	default y
	---help---
	  This option causes deging code to be compiled into the
	  mthca driver.  The output can be turned on via the
	  de_level module parameter (which can also be set after
	  the driver is loaded through sysfs).
```

## drivers/infiniband/hw/nes/Kconfig
```kconfig
config INFINIBAND_NES
	tristate "NetEffect RNIC Driver"
	depends on PCI && INET
	select LIBCRC32C
	---help---
	  This is the RDMA Network Interface Card (RNIC) driver for
	  NetEffect Ethernet Cluster Server Adapters.

config INFINIBAND_NES_DE
	bool "Verbose deging output"
	depends on INFINIBAND_NES
	default n
	---help---
	  This option enables de messages from the NetEffect RNIC
	  driver.  Select this if you are diagnosing a problem.
```

## drivers/infiniband/hw/ocrdma/Kconfig
```kconfig
# SPDX-License-Identifier: GPL-2.0-only
config INFINIBAND_OCRDMA
	tristate "Emulex One Connect HCA support"
	depends on ETHERNET && NETDEVICES && PCI && INET && (IPV6 || IPV6=n)
	select NET_VENDOR_EMULEX
	select BE2NET
	---help---
	  This driver provides low-level InfiniBand over Ethernet
	  support for Emulex One Connect host channel adapters (HCAs).
```

## drivers/infiniband/hw/qedr/Kconfig
```kconfig
config INFINIBAND_QEDR
	tristate "QLogic RoCE driver"
	depends on 64BIT && QEDE
	depends on PCI
	select QED_LL2
	select QED_RDMA
	---help---
	  This driver provides low-level InfiniBand over Ethernet
	  support for QLogic QED host channel adapters (HCAs).
```

## drivers/infiniband/hw/qib/Kconfig
```kconfig
config INFINIBAND_QIB
	tristate "Intel PCIe HCA support"
	depends on 64BIT
	---help---
	This is a low-level driver for Intel PCIe QLE InfiniBand host
	channel adapters.  This driver does not support the Intel
	HyperTransport card (model QHT7140).

config INFINIBAND_QIB_DCA
	bool "QIB DCA support"
	depends on INFINIBAND_QIB && DCA && SMP && !(INFINIBAND_QIB=y && DCA=m)
	default y
	---help---
	Setting this enables DCA support on some Intel chip sets
	with the iba7322 HCA.
```

## drivers/infiniband/hw/usnic/Kconfig
```kconfig
config INFINIBAND_USNIC
	tristate "Verbs support for Cisco VIC"
	depends on NETDEVICES && ETHERNET && INET && PCI && INTEL_IOMMU
	depends on INFINIBAND_USER_ACCESS
	select ENIC
	select NET_VENDOR_CISCO
	select PCI_IOV
	---help---
	  This is a low-level driver for Cisco's Virtual Interface
	  Cards (VICs), including the VIC 1240 and 1280 cards.
```

## drivers/infiniband/hw/vmw_pvrdma/Kconfig
```kconfig
# SPDX-License-Identifier: GPL-2.0-only
config INFINIBAND_VMWARE_PVRDMA
	tristate "VMware Paravirtualized RDMA Driver"
	depends on NETDEVICES && ETHERNET && PCI && INET && VMXNET3
	---help---
	  This driver provides low-level support for VMware Paravirtual
	  RDMA adapter. It interacts with the VMXNet3 driver to provide
	  Ethernet capabilities.
```

## drivers/infiniband/sw/rdmavt/Kconfig
```kconfig
# SPDX-License-Identifier: GPL-2.0-only
config INFINIBAND_RDMAVT
	tristate "RDMA verbs transport library"
	depends on INFINIBAND_VIRT_DMA
	depends on X86_64
	depends on PCI
	help
	This is a common software verbs provider for RDMA networks.
```

## drivers/infiniband/sw/rxe/Kconfig
```kconfig
config RDMA_RXE
	tristate "Software RDMA over Ethernet (RoCE) driver"
	depends on INET && PCI && INFINIBAND
	select NET_UDP_TUNNEL
	select CRYPTO_CRC32
	select DMA_VIRT_OPS
	---help---
	This driver implements the InfiniBand RDMA transport over
	the Linux network stack. It enables a system with a
	standard Ethernet adapter to interoperate with a RoCE
	adapter or with another system running the RXE driver.
	Documentation on InfiniBand and RoCE can be downloaded at
	www.infinibandta.org and www.openfabrics.org. (See also
	siw which is a similar software driver for iWARP.)

	The driver is split into two layers, one interfaces with the
	Linux RDMA stack and implements a kernel or user space
	verbs API. The user space verbs API requires a support
	library named librxe which is loaded by the generic user
	space verbs API, libibverbs. The other layer interfaces
	with the Linux network stack at layer 3.

	To configure and work with soft-RoCE driver please use the
	following wiki page under "configure Soft-RoCE (RXE)" section:

	https://github.com/linux-rdma/rdma-core/blob/master/Documentation/rxe.md
```

## drivers/infiniband/sw/siw/Kconfig
```kconfig
config RDMA_SIW
	tristate "Software RDMA over TCP/IP (iWARP) driver"
	depends on INET && INFINIBAND && LIBCRC32C
	depends on INFINIBAND_VIRT_DMA
	select DMA_VIRT_OPS
	help
	This driver implements the iWARP RDMA transport over
	the Linux TCP/IP network stack. It enables a system with a
	standard Ethernet adapter to interoperate with a iWARP
	adapter or with another system running the SIW driver.
	(See also RXE which is a similar software driver for RoCE.)

	The driver interfaces with the Linux RDMA stack and
	implements both a kernel and user space RDMA verbs API.
	The user space verbs API requires a support
	library named libsiw which is loaded by the generic user
	space verbs API, libibverbs. To implement RDMA over
	TCP/IP, the driver further interfaces with the Linux
	in-kernel TCP socket layer.
```

## drivers/infiniband/ulp/ipoib/Kconfig
```kconfig
config INFINIBAND_IPOIB
	tristate "IP-over-InfiniBand"
	depends on NETDEVICES && INET && (IPV6 || IPV6=n)
	select INET_LRO
	---help---
	  Support for the IP-over-InfiniBand protocol (IPoIB). This
	  transports IP packets over InfiniBand so you can use your IB
	  device as a fancy NIC.

	  See Documentation/infiniband/ipoib.txt for more information

config INFINIBAND_IPOIB_CM
	bool "IP-over-InfiniBand Connected Mode support"
	depends on INFINIBAND_IPOIB
	default n
	---help---
	  This option enables support for IPoIB connected mode.  After
	  enabling this option, you need to switch to connected mode
	  through /sys/class/net/ibXXX/mode to actually create
	  connections, and then increase the interface MTU with
	  e.g. ifconfig ib0 mtu 65520.

	  WARNING: Enabling connected mode will trigger some packet
	  drops for multicast and UD mode traffic from this interface,
	  unless you limit mtu for these destinations to 2044.

config INFINIBAND_IPOIB_DEBUG
	bool "IP-over-InfiniBand debugging" if EMBEDDED
	depends on INFINIBAND_IPOIB
	default y
	---help---
	  This option causes debugging code to be compiled into the
	  IPoIB driver.  The output can be turned on via the
	  debug_level and mcast_debug_level module parameters (which
	  can also be set after the driver is loaded through sysfs).

	  This option also creates a directory tree under ipoib/ in
	  debugfs, which contains files that expose debugging
	  information about IB multicast groups used by the IPoIB
	  driver.

config INFINIBAND_IPOIB_DEBUG_DATA
	bool "IP-over-InfiniBand data path debugging"
	depends on INFINIBAND_IPOIB_DEBUG
	---help---
	  This option compiles debugging code into the data path
	  of the IPoIB driver.  The output can be turned on via the
	  data_debug_level module parameter; however, even with output
	  turned off, this debugging code will have some performance
	  impact.
```

## drivers/infiniband/ulp/iser/Kconfig
```kconfig
# SPDX-License-Identifier: GPL-2.0-only
config INFINIBAND_ISER
	tristate "iSCSI Extensions for RDMA (iSER)"
	depends on SCSI && INET && INFINIBAND_ADDR_TRANS
	select SCSI_ISCSI_ATTRS
	help
	  Support for the iSCSI Extensions for RDMA (iSER) Protocol
	  over InfiniBand. This allows you to access storage devices
	  that speak iSCSI over iSER over InfiniBand.

	  The iSER protocol is defined by IETF.
	  See <http://www.ietf.org/rfc/rfc5046.txt>
	  and <http://members.infinibandta.org/kwspub/spec/Annex_iSER.PDF>
```

## drivers/infiniband/ulp/isert/Kconfig
```kconfig
# SPDX-License-Identifier: GPL-2.0-only
config INFINIBAND_ISERT
	tristate "iSCSI Extensions for RDMA (iSER) target support"
	depends on INET && INFINIBAND_ADDR_TRANS && TARGET_CORE && ISCSI_TARGET
	help
	Support for iSCSI Extensions for RDMA (iSER) Target on Infiniband fabrics.
```

## drivers/infiniband/ulp/opa_vnic/Kconfig
```kconfig
# SPDX-License-Identifier: GPL-2.0-only
config INFINIBAND_OPA_VNIC
	tristate "Cornelis OPX VNIC support"
	depends on X86_64 && INFINIBAND
	help
	This is Omni-Path Express (OPX) Virtual Network Interface Controller (VNIC)
	driver for Ethernet over Omni-Path feature. It implements the HW
	independent VNIC functionality. It interfaces with Linux stack for
	data path and IB MAD for the control path.
```

## drivers/infiniband/ulp/rtrs/Kconfig
```kconfig
# SPDX-License-Identifier: GPL-2.0-or-later

config INFINIBAND_RTRS
	tristate
	depends on INFINIBAND_ADDR_TRANS

config INFINIBAND_RTRS_CLIENT
	tristate "RTRS client module"
	depends on INFINIBAND_ADDR_TRANS
	select INFINIBAND_RTRS
	help
	  RDMA transport client module.

	  RDMA Transport (RTRS) client implements a reliable transport layer
	  and also multipathing functionality and that it is intended to be
	  the base layer for a block storage initiator over RDMA.

config INFINIBAND_RTRS_SERVER
	tristate "RTRS server module"
	depends on INFINIBAND_ADDR_TRANS
	select INFINIBAND_RTRS
	help
	  RDMA transport server module.

	  RDMA Transport (RTRS) server module processing connection and IO
	  requests received from the RTRS client module, it will pass the
	  IO requests to its user eg. RNBD_server.
```

## drivers/infiniband/ulp/srp/Kconfig
```kconfig
config INFINIBAND_SRP
	tristate "InfiniBand SCSI RDMA Protocol"
	depends on SCSI && INFINIBAND_ADDR_TRANS
	select SCSI_SRP_ATTRS
	---help---
	  Support for the SCSI RDMA Protocol over InfiniBand.  This
	  allows you to access storage devices that speak SRP over
	  InfiniBand.

	  The SRP protocol is defined by the INCITS T10 technical
	  committee.  See <http://www.t10.org/>.
```

## drivers/infiniband/ulp/srpt/Kconfig
```kconfig
config INFINIBAND_SRPT
	tristate "InfiniBand SCSI RDMA Protocol target support"
	depends on INFINIBAND && INFINIBAND_ADDR_TRANS && TARGET_CORE
	---help---

	  Support for the SCSI RDMA Protocol (SRP) Target driver. The
	  SRP protocol is a protocol that allows an initiator to access
	  a block storage device on another host (target) over a network
	  that supports the RDMA protocol. Currently the RDMA protocol is
	  supported by InfiniBand and by iWarp network hardware. More
	  information about the SRP protocol can be found on the website
	  of the INCITS T10 technical committee (http://www.t10.org/).
```
