## drivers/iio/addac/Kconfig
```kconfig
#
# ADC DAC drivers
#
# When adding new entries keep the list in alphabetical order

menu "Analog to digital and digital to analog converters"

config AD74115
	tristate "Analog Devices AD74115H driver"
	depends on GPIOLIB && SPI
	select CRC8
	select IIO_BUFFER
	select IIO_TRIGGERED_BUFFER
	select REGMAP_SPI
	help
	  Say yes here to build support for Analog Devices AD74115H
	  single-channel software configurable input/output solution.

	  To compile this driver as a module, choose M here: the
	  module will be called ad74115.

config AD74413R
	tristate "Analog Devices AD74412R/AD74413R driver"
	depends on GPIOLIB && SPI
	select REGMAP_SPI
	select CRC8
	select IIO_BUFFER
	select IIO_TRIGGERED_BUFFER
	help
	  Say yes here to build support for Analog Devices AD74412R/AD74413R
	  quad-channel software configurable input/output solution.

	  To compile this driver as a module, choose M here: the
	  module will be called ad74413r.

config STX104
	tristate "Apex Embedded Systems STX104 driver"
	depends on PC104 && X86
	select ISA_BUS_API
	select REGMAP_MMIO
	select GPIOLIB
	select GPIO_REGMAP
	select I8254
	help
	  Say yes here to build support for the Apex Embedded Systems STX104
	  integrated analog PC/104 card.

	  This driver supports the 16 channels of single-ended (8 channels of
	  differential) analog inputs, 2 channels of analog output, 4 digital
	  inputs, and 4 digital outputs provided by the STX104.

	  The base port addresses for the devices may be configured via the base
	  array module parameter.

endmenu
```

## drivers/iio/afe/Kconfig
```kconfig
# SPDX-License-Identifier: GPL-2.0-only
#
# Analog Front End drivers
#
# When adding new entries keep the list in alphabetical order

menu "Analog Front Ends"

config IIO_RESCALE
	tristate "IIO rescale"
	depends on OF || COMPILE_TEST
	help
	  Say yes here to build support for the IIO rescaling
	  that handles voltage dividers, current sense shunts and
	  current sense amplifiers.

	  To compile this driver as a module, choose M here: the
	  module will be called iio-rescale.

endmenu
```

## drivers/iio/amplifiers/Kconfig
```kconfig
# SPDX-License-Identifier: GPL-2.0
#
# Gain Amplifiers, etc.
#
# When adding new entries keep the list in alphabetical order

menu "Amplifiers"

config AD8366
	tristate "Analog Devices AD8366 and similar Gain Amplifiers"
	depends on SPI
	depends on GPIOLIB
	select BITREVERSE
	help
	  Say yes here to build support for Analog Devices AD8366 and similar
	  gain amplifiers. This driver supports the following gain amplifiers
	  from Analog Devices:
	    AD8366 Dual-Digital Variable Gain Amplifier (VGA)
	    ADA4961 BiCMOS RF Digital Gain Amplifier (DGA)
	    ADL5240 Digitally controlled variable gain amplifier (VGA)
	    HMC1119 0.25 dB LSB, 7-Bit, Silicon Digital Attenuator

	  To compile this driver as a module, choose M here: the
	  module will be called ad8366.

config ADA4250
	tristate "Analog Devices ADA4250 Instrumentation Amplifier"
	depends on SPI
	select REGMAP_SPI
	help
	  Say yes here to build support for Analog Devices ADA4250
	  SPI Amplifier's support. The driver provides direct access via
	  sysfs.

	  To compile this driver as a module, choose M here: the
	  module will be called ada4250.

config HMC425
	tristate "Analog Devices HMC425A and similar GPIO Gain Amplifiers"
	depends on GPIOLIB
	help
	  Say yes here to build support for Analog Devices HMC425A and similar
	  gain amplifiers or step attenuators.

	  To compile this driver as a module, choose M here: the
	  module will be called hmc425a.

endmenu
```

## drivers/iio/buffer/Kconfig
```kconfig
# SPDX-License-Identifier: GPL-2.0-only
#
# Industrial I/O generic buffer implementations
#
# When adding new entries keep the list in alphabetical order

config IIO_BUFFER_CB
	tristate "IIO callback buffer used for push in-kernel interfaces"
	help
	  Should be selected by any drivers that do in-kernel push
	  usage.  That is, those where the data is pushed to the consumer.

config IIO_BUFFER_DMA
	tristate "Industrial I/O DMA buffer infrastructure"
	help
	  Provides the generic IIO DMA buffer infrastructure that can be used by
	  drivers for devices with DMA support to implement the IIO buffer.

	  Should be selected by drivers that want to use the generic DMA buffer
	  infrastructure.

config IIO_BUFFER_DMAENGINE
	tristate "Industrial I/O DMA buffer integration with DMAEngine"
	select IIO_BUFFER_DMA
	help
	  Provides a bonding of the generic IIO DMA buffer infrastructure with the
	  DMAEngine framework. This can be used by converter drivers with a DMA port
	  connected to an external DMA controller which is supported by the
	  DMAEngine framework.

	  Should be selected by drivers that want to use this functionality.

config IIO_BUFFER_HW_CONSUMER
	tristate "Industrial I/O HW buffering"
	help
	  Provides a way to bonding when an IIO device has a direct connection
	  to another device in hardware. In this case buffers for data transfers
	  are handled by hardware.

	  Should be selected by drivers that want to use the generic Hw consumer
	  interface.

config IIO_KFIFO_BUF
	tristate "Industrial I/O buffering based on kfifo"
	help
	  A simple fifo based on kfifo.  Note that this currently provides
	  no buffer events so it is up to userspace to work out how
	  often to read from the buffer.

config IIO_TRIGGERED_BUFFER
	tristate
	select IIO_TRIGGER
	select IIO_KFIFO_BUF
	help
	  Provides helper functions for setting up triggered buffers.
```

## drivers/iio/cdc/Kconfig
```kconfig
# SPDX-License-Identifier: GPL-2.0
#
# CDC drivers
#
menu "Capacitance to digital converters"

config AD7150
	tristate "Analog Devices ad7150/1/6 capacitive sensor driver"
	depends on I2C
	help
	  Say yes here to build support for Analog Devices capacitive sensors.
	  (ad7150, ad7151, ad7156) Provides direct access via sysfs.

	  To compile this driver as a module, choose M here: the
	  module will be called ad7150.

endmenu
```

## drivers/iio/chemical/Kconfig
```kconfig
# SPDX-License-Identifier: GPL-2.0-only
#
# Chemical sensors
#

menu "Chemical Sensors"

config AOSONG_AGS02MA
	tristate "Aosong AGS02MA TVOC sensor driver"
	depends on I2C
	select CRC8
	help
	  Say Y here to build support for Aosong AGS02MA TVOC (Total Volatile
	  Organic Compounds) sensor.

	  To compile this driver as module, choose M here: the module will be
	  called ags02ma.

config ATLAS_PH_SENSOR
	tristate "Atlas Scientific OEM SM sensors"
	depends on I2C
	select REGMAP_I2C
	select IIO_BUFFER
	select IIO_TRIGGERED_BUFFER
	select IRQ_WORK
	help
	  Say Y here to build I2C interface support for the following
	  Atlas Scientific OEM SM sensors:
	    * pH SM sensor
	    * EC SM sensor
	    * ORP SM sensor

	  To compile this driver as module, choose M here: the
	  module will be called atlas-ph-sensor.

config ATLAS_EZO_SENSOR
	tristate "Atlas Scientific EZO sensors"
	depends on I2C
	help
	  Say Y here to build I2C interface support for the following
	  Atlas Scientific EZO sensors
	    * CO2 EZO Sensor

	  To compile this driver as module, choose M here: the
	  module will be called atlas-ezo-sensor.

config BME680
	tristate "Bosch Sensortec BME680 sensor driver"
	depends on (I2C || SPI)
	select REGMAP
	select BME680_I2C if I2C
	select BME680_SPI if SPI
	help
	  Say yes here to build support for Bosch Sensortec BME680 sensor with
	  temperature, pressure, humidity and gas sensing capability.

	  This driver can also be built as a module. If so, the module for I2C
	  would be called bme680_i2c and bme680_spi for SPI support.

config BME680_I2C
	tristate
	depends on I2C && BME680
	select REGMAP_I2C

config BME680_SPI
	tristate
	depends on SPI && BME680
	select REGMAP_SPI

config CCS811
	tristate "AMS CCS811 VOC sensor"
	depends on I2C
	select IIO_BUFFER
	select IIO_TRIGGERED_BUFFER
	help
	  Say Y here to build I2C interface support for the AMS
	  CCS811 VOC (Volatile Organic Compounds) sensor

config ENS160
	tristate "ScioSense ENS160 sensor driver"
	depends on (I2C || SPI)
	select REGMAP
	select IIO_BUFFER
	select IIO_TRIGGERED_BUFFER
	select ENS160_I2C if I2C
	select ENS160_SPI if SPI
	help
	  Say yes here to build support for ScioSense ENS160 multi-gas sensor.

	  This driver can also be built as a module. If so, the module for I2C
	  would be called ens160_i2c and ens160_spi for SPI support.

config ENS160_I2C
	tristate
	select REGMAP_I2C

config ENS160_SPI
	tristate
	select REGMAP_SPI

config IAQCORE
	tristate "AMS iAQ-Core VOC sensors"
	depends on I2C
	help
	  Say Y here to build I2C interface support for the AMS
	  iAQ-Core Continuous/Pulsed VOC (Volatile Organic Compounds)
	  sensors

config PMS7003
	tristate "Plantower PMS7003 particulate matter sensor"
	depends on SERIAL_DEV_BUS
	select IIO_BUFFER
	select IIO_TRIGGERED_BUFFER
	help
	  Say Y here to build support for the Plantower PMS7003 particulate
	  matter sensor.

	  To compile this driver as a module, choose M here: the module will
	  be called pms7003.

config SCD30_CORE
	tristate "SCD30 carbon dioxide sensor driver"
	select IIO_BUFFER
	select IIO_TRIGGERED_BUFFER
	help
	  Say Y here to build support for the Sensirion SCD30 sensor with carbon
	  dioxide, relative humidity and temperature sensing capabilities.

	  To compile this driver as a module, choose M here: the module will
	  be called scd30_core.

config SCD30_I2C
	tristate "SCD30 carbon dioxide sensor I2C driver"
	depends on SCD30_CORE && I2C
	select CRC8
	help
	  Say Y here to build support for the Sensirion SCD30 I2C interface
	  driver.

	  To compile this driver as a module, choose M here: the module will
	  be called scd30_i2c.

config SCD30_SERIAL
	tristate "SCD30 carbon dioxide sensor serial driver"
	depends on SCD30_CORE && SERIAL_DEV_BUS
	select CRC16
	help
	  Say Y here to build support for the Sensirion SCD30 serial interface
	  driver.

	  To compile this driver as a module, choose M here: the module will
	  be called scd30_serial.

config SCD4X
	tristate "SCD4X carbon dioxide sensor driver"
	select IIO_BUFFER
	select IIO_TRIGGERED_BUFFER
	depends on I2C
	select CRC8
	help
	  Say Y here to build support for the Sensirion SCD4X sensor with carbon
	  dioxide, relative humidity and temperature sensing capabilities.

	  To compile this driver as a module, choose M here: the module will
	  be called scd4x.

config SENSIRION_SGP30
	tristate "Sensirion SGPxx gas sensors"
	depends on I2C
	select CRC8
	help
	  Say Y here to build I2C interface support for the following
	  Sensirion SGP gas sensors:
	    * SGP30 gas sensor
	    * SGPC3 low power gas sensor

	  To compile this driver as module, choose M here: the
	  module will be called sgp30.

config SENSIRION_SGP40
	tristate "Sensirion SGP40 gas sensor"
	depends on I2C
	select CRC8
	help
	  Say Y here to build I2C interface to support Sensirion SGP40 gas
	  sensor

	  To compile this driver as module, choose M here: the
	  module will be called sgp40.

config SPS30
	tristate
	select IIO_BUFFER
	select IIO_TRIGGERED_BUFFER

config SPS30_I2C
	tristate "SPS30 particulate matter sensor I2C driver"
	depends on I2C
	select SPS30
	select CRC8
	help
	  Say Y here to build support for the Sensirion SPS30 I2C interface
	  driver.

	  To compile this driver as a module, choose M here: the module will
	  be called sps30_i2c.

config SPS30_SERIAL
	tristate "SPS30 particulate matter sensor serial driver"
	depends on SERIAL_DEV_BUS
	select SPS30
	help
	  Say Y here to build support for the Sensirion SPS30 serial interface
	  driver.

	  To compile this driver as a module, choose M here: the module will
	  be called sps30_serial.

config SENSEAIR_SUNRISE_CO2
	tristate "Senseair Sunrise 006-0-0007 CO2 sensor"
	depends on I2C
	select REGMAP_I2C
	help
	  Say yes here to build support for Senseair Sunrise 006-0-0007 CO2
	  sensor.

	  To compile this driver as a module, choose M here: the
	  module will be called sunrise_co2.

config VZ89X
	tristate "SGX Sensortech MiCS VZ89X VOC sensor"
	depends on I2C
	help
	  Say Y here to build I2C interface support for the SGX
	  Sensortech MiCS VZ89X VOC (Volatile Organic Compounds)
	  sensors

endmenu
```

## drivers/iio/common/Kconfig
```kconfig
# SPDX-License-Identifier: GPL-2.0-only
#
# IIO common modules
#

source "drivers/iio/common/cros_ec_sensors/Kconfig"
source "drivers/iio/common/hid-sensors/Kconfig"
source "drivers/iio/common/ms_sensors/Kconfig"
source "drivers/iio/common/ssp_sensors/Kconfig"
source "drivers/iio/common/st_sensors/Kconfig"
```

## drivers/iio/common/cros_ec_sensors/Kconfig
```kconfig
# SPDX-License-Identifier: GPL-2.0-only
#
# Chrome OS Embedded Controller managed sensors library
#
config IIO_CROS_EC_SENSORS_CORE
	tristate "ChromeOS EC Sensors Core"
	depends on SYSFS && CROS_EC_SENSORHUB
	select IIO_BUFFER
	select IIO_TRIGGERED_BUFFER
	help
	  Base module for the ChromeOS EC Sensors module.
	  Contains core functions used by other IIO CrosEC sensor
	  drivers.
	  Define common attributes and sysfs interrupt handler.

config IIO_CROS_EC_SENSORS
	tristate "ChromeOS EC Contiguous Sensors"
	depends on IIO_CROS_EC_SENSORS_CORE
	help
	  Module to handle 3d contiguous sensors like
	  Accelerometers, Gyroscope and Magnetometer that are
	  presented by the ChromeOS EC Sensor hub.
	  Creates an IIO device for each functions.

config IIO_CROS_EC_SENSORS_LID_ANGLE
	tristate "ChromeOS EC Sensor for lid angle"
	depends on IIO_CROS_EC_SENSORS_CORE
	help
	  Module to report the angle between lid and base for some
	  convertible devices.
	  This module is loaded when the EC can calculate the angle between the base
	  and the lid.

config IIO_CROS_EC_ACTIVITY
	tristate "ChromeOS EC Activity Sensors"
	depends on IIO_CROS_EC_SENSORS_CORE
	help
	  Module to handle activity events presented by the ChromeOS EC sensor hub.
	  Activities can be a proximity detector (on body/off body detection)
	  or a significant motion detector.
	  Creates an IIO device to manage all activities.
```

## drivers/iio/common/hid-sensors/Kconfig
```kconfig
# SPDX-License-Identifier: GPL-2.0-only
#
# Hid Sensor common modules
#
menu "Hid Sensor IIO Common"

config HID_SENSOR_IIO_COMMON
	tristate "Common modules for all HID Sensor IIO drivers"
	depends on HID_SENSOR_HUB
	select HID_SENSOR_IIO_TRIGGER if IIO_BUFFER
	help
	  Say yes here to build support for HID sensor to use
	  HID sensor common processing for attributes and IIO triggers.
	  There are many attributes which can be shared among multiple
	  HID sensor drivers, this module contains processing for those
	  attributes.

config HID_SENSOR_IIO_TRIGGER
	tristate "Common module (trigger) for all HID Sensor IIO drivers"
	depends on HID_SENSOR_HUB && HID_SENSOR_IIO_COMMON && IIO_BUFFER
	select IIO_TRIGGER
	help
	  Say yes here to build trigger support for HID sensors.
	  Triggers will be send if all requested attributes were read.

	  If this driver is compiled as a module, it will be named
	  hid-sensor-trigger.

endmenu
```

## drivers/iio/common/inv_sensors/Kconfig
```kconfig
# SPDX-License-Identifier: GPL-2.0-only
#
# TDK-InvenSense sensors common library
#

config IIO_INV_SENSORS_TIMESTAMP
	tristate
```

## drivers/iio/common/ms_sensors/Kconfig
```kconfig
# SPDX-License-Identifier: GPL-2.0-only
#
# Measurements Specialties sensors common library
#

config IIO_MS_SENSORS_I2C
	tristate
```
