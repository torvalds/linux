## drivers/i2c/Kconfig
```kconfig
# SPDX-License-Identifier: GPL-2.0-only
#
# I2C subsystem configuration
#

menu "I2C support"

config I2C
	tristate "I2C support"
	select RT_MUTEXES
	select IRQ_DOMAIN
	help
	  I2C (pronounce: I-squared-C) is a slow serial bus protocol used in
	  many micro controller applications and developed by Philips.  SMBus,
	  or System Management Bus is a subset of the I2C protocol.  More
	  information is contained in the directory <file:Documentation/i2c/>,
	  especially in the file called "summary" there.

	  Both I2C and SMBus are supported here. You will need this for
	  hardware sensors support, and also for Video For Linux support.

	  If you want I2C support, you should say Y here and also to the
	  specific driver for your bus adapter(s) below.

	  This I2C support can also be built as a module.  If so, the module
	  will be called i2c-core.

config ACPI_I2C_OPREGION
	bool "ACPI I2C Operation region support"
	depends on I2C=y && ACPI
	default y
	help
	  Say Y here if you want to enable ACPI I2C operation region support.
	  Operation Regions allow firmware (BIOS) code to access I2C slave devices,
	  such as smart batteries through an I2C host controller driver.

if I2C

config I2C_BOARDINFO
	bool
	default y

config I2C_COMPAT
	bool "Enable compatibility bits for old user-space"
	default y
	help
	  Say Y here if you intend to run lm-sensors 3.1.1 or older, or any
	  other user-space package which expects i2c adapters to be class
	  devices. If you don't know, say Y.

config I2C_CHARDEV
	tristate "I2C device interface"
	help
	  Say Y here to use i2c-* device files, usually found in the /dev
	  directory on your system.  They make it possible to have user-space
	  programs use the I2C bus.  Information on how to do this is
	  contained in the file <file:Documentation/i2c/dev-interface.rst>.

	  This support is also available as a module.  If so, the module 
	  will be called i2c-dev.

config I2C_MUX
	tristate "I2C bus multiplexing support"
	help
	  Say Y here if you want the I2C core to support the ability to
	  handle multiplexed I2C bus topologies, by presenting each
	  multiplexed segment as a I2C adapter.

	  This support is also available as a module.  If so, the module
	  will be called i2c-mux.

source "drivers/i2c/muxes/Kconfig"

config I2C_HELPER_AUTO
	bool "Autoselect pertinent helper modules"
	default y
	help
	  Some I2C bus drivers require so-called "I2C algorithm" modules
	  to work. These are basically software-only abstractions of generic
	  I2C interfaces. This option will autoselect them so that you don't
	  have to care.

	  Unselect this only if you need to enable additional helper
	  modules, for example for use with external I2C bus drivers.

	  In doubt, say Y.

config I2C_SMBUS
	tristate "SMBus-specific protocols" if !I2C_HELPER_AUTO
	help
	  Say Y here if you want support for SMBus extensions to the I2C
	  specification. At the moment, two extensions are supported:
	  the SMBus Alert protocol and the SMBus Host Notify protocol.

	  This support is also available as a module.  If so, the module
	  will be called i2c-smbus.

source "drivers/i2c/algos/Kconfig"
source "drivers/i2c/busses/Kconfig"

config I2C_STUB
	tristate "I2C/SMBus Test Stub"
	depends on m
	help
	  This module may be useful to developers of SMBus client drivers,
	  especially for certain kinds of sensor chips.

	  If you do build this module, be sure to read the notes and warnings
	  in <file:Documentation/i2c/i2c-stub.rst>.

	  If you don't know what to do here, definitely say N.

config I2C_SLAVE
	bool "I2C slave support"
	help
	  This enables Linux to act as an I2C slave device. Note that your I2C
	  bus master driver also needs to support this functionality. Please
	  read Documentation/i2c/slave-interface.rst for further details.

if I2C_SLAVE

config I2C_SLAVE_EEPROM
	tristate "I2C eeprom slave driver"
	help
	  This backend makes Linux behave like an I2C EEPROM. Please read
	  Documentation/i2c/slave-eeprom-backend.rst for further details.

config I2C_SLAVE_TESTUNIT
	tristate "I2C eeprom testunit driver"
	help
	  This backend can be used to trigger test cases for I2C bus masters
	  which require a remote device with certain capabilities, e.g.
	  multi-master, SMBus Host Notify, etc. Please read
	  Documentation/i2c/slave-testunit-backend.rst for further details.

endif

config I2C_DEBUG_CORE
	bool "I2C Core debugging messages"
	help
	  Say Y here if you want the I2C core to produce a bunch of debug
	  messages to the system log.  Select this if you are having a
	  problem with I2C support and want to see more of what is going on.

config I2C_DEBUG_ALGO
	bool "I2C Algorithm debugging messages"
	help
	  Say Y here if you want the I2C algorithm drivers to produce a bunch
	  of debug messages to the system log.  Select this if you are having
	  a problem with I2C support and want to see more of what is going
	  on.

config I2C_DEBUG_BUS
	bool "I2C Bus debugging messages"
	depends on HAS_IOMEM
	help
	  Say Y here if you want the I2C bus drivers to produce a bunch of
	  debug messages to the system log.  Select this if you are having
	  a problem with I2C support and want to see more of what is going
	  on.

endif # I2C

endmenu
```

## drivers/i2c/algos/Kconfig
```kconfig
#
# I2C algorithm drivers configuration
#

menu "I2C Algorithms"
	visible if !I2C_HELPER_AUTO

config I2C_ALGOBIT
	tristate "I2C bit-banging interfaces"

config I2C_ALGOPCF
	tristate "I2C PCF 8584 interfaces"

config I2C_ALGOPCA
	tristate "I2C PCA 9564 interfaces"

endmenu
```

## drivers/i2c/chips/Kconfig
```kconfig
#
# Miscellaneous I2C chip drivers configuration
#
# *** DEPRECATED! Do not add new entries! See Makefile ***
#

menu "Miscellaneous I2C Chip support"

config DS1682
	tristate "Dallas DS1682 Total Elapsed Time Recorder with Alarm"
	depends on EXPERIMENTAL
	help
	  If you say yes here you get support for Dallas Semiconductor
	  DS1682 Total Elapsed Time Recorder.

	  This driver can also be built as a module.  If so, the module
	  will be called ds1682.

config SENSORS_TSL2550
	tristate "Taos TSL2550 ambient light sensor"
	depends on EXPERIMENTAL
	help
	  If you say yes here you get support for the Taos TSL2550
	  ambient light sensor.

	  This driver can also be built as a module.  If so, the module
	  will be called tsl2550.

config SENSORS_PCA963X
	tristate "Philips PCA963X 4-bit I2C-bus LED"
	depends on I2C && EXPERIMENTAL
	help
	 If you say yes here you get support for the Philips PCA963X
	 4-bit I2C-bus LED.

	 This driver can also be built as a module.  If so, the module
	 will be called pca963X.

endmenu
```

## drivers/i2c/muxes/Kconfig
```kconfig
#
# Multiplexer I2C chip drivers configuration
#

menu "Multiplexer I2C Chip support"
	depends on I2C_MUX

config I2C_ARB_GPIO_CHALLENGE
	tristate "GPIO-based I2C arbitration"
	depends on GPIOLIB || COMPILE_TEST
	depends on OF
	help
	  If you say yes to this option, support will be included for an
	  I2C multimaster arbitration scheme using GPIOs and a challenge &
	  response mechanism where masters have to claim the bus by asserting
	  a GPIO.

	  This driver can also be built as a module.  If so, the module
	  will be called i2c-arb-gpio-challenge.

config I2C_MUX_GPIO
	tristate "GPIO-based I2C multiplexer"
	depends on GPIOLIB
	help
	  If you say yes to this option, support will be included for a
	  GPIO based I2C multiplexer. This driver provides access to
	  I2C busses connected through a MUX, which is controlled
	  through GPIO pins.

	  This driver can also be built as a module.  If so, the module
	  will be called i2c-mux-gpio.

config I2C_MUX_GPMUX
	tristate "General Purpose I2C multiplexer"
	select MULTIPLEXER
	depends on OF || COMPILE_TEST
	help
	  If you say yes to this option, support will be included for a
	  general purpose I2C multiplexer. This driver provides access to
	  I2C busses connected through a MUX, which in turn is controlled
	  by a MUX-controller from the MUX subsystem.

	  This driver can also be built as a module.  If so, the module
	  will be called i2c-mux-gpmux.

config I2C_MUX_LTC4306
	tristate "LTC LTC4306/5 I2C multiplexer"
	select GPIOLIB
	select REGMAP_I2C
	help
	  If you say yes here you get support for the Analog Devices
	  LTC4306 or LTC4305 I2C mux/switch devices.

	  This driver can also be built as a module.  If so, the module
	  will be called i2c-mux-ltc4306.

config I2C_MUX_PCA9541
	tristate "NXP PCA9541 I2C Master Selector"
	help
	  If you say yes here you get support for the NXP PCA9541
	  I2C Master Selector.

	  This driver can also be built as a module.  If so, the module
	  will be called i2c-mux-pca9541.

config I2C_MUX_PCA954x
	tristate "Philips PCA954x I2C Mux/switches"
	depends on GPIOLIB || COMPILE_TEST
	help
	  If you say yes here you get support for the Philips PCA954x
	  I2C mux/switch devices.

	  This driver can also be built as a module.  If so, the module
	  will be called i2c-mux-pca954x.

config I2C_MUX_PINCTRL
	tristate "pinctrl-based I2C multiplexer"
	depends on PINCTRL
	help
	  If you say yes to this option, support will be included for an I2C
	  multiplexer that uses the pinctrl subsystem, i.e. pin multiplexing.
	  This is useful for SoCs whose I2C module's signals can be routed to
	  different sets of pins at run-time.

	  This driver can also be built as a module. If so, the module will be
	  called pinctrl-i2cmux.

config I2C_MUX_REG
	tristate "Register-based I2C multiplexer"
	depends on HAS_IOMEM
	help
	  If you say yes to this option, support will be included for a
	  register based I2C multiplexer. This driver provides access to
	  I2C busses connected through a MUX, which is controlled
	  by a single register.

	  This driver can also be built as a module.  If so, the module
	  will be called i2c-mux-reg.

config I2C_DEMUX_PINCTRL
	tristate "pinctrl-based I2C demultiplexer"
	depends on PINCTRL && OF
	select OF_DYNAMIC
	help
	  If you say yes to this option, support will be included for an I2C
	  demultiplexer that uses the pinctrl subsystem. This is useful if you
	  want to change the I2C master at run-time depending on features.

config I2C_MUX_MLXCPLD
        tristate "Mellanox CPLD based I2C multiplexer"
        help
          If you say yes to this option, support will be included for a
          CPLD based I2C multiplexer. This driver provides access to
          I2C busses connected through a MUX, which is controlled
          by a CPLD register.

          This driver can also be built as a module.  If so, the module
          will be called i2c-mux-mlxcpld.

endmenu
```

## drivers/i3c/master/Kconfig
```kconfig
# SPDX-License-Identifier: GPL-2.0-only
config ADI_I3C_MASTER
	tristate "Analog Devices I3C master driver"
	depends on HAS_IOMEM
	help
	  Support for Analog Devices I3C Controller IP, an AXI-interfaced IP
	  core that supports I3C and I2C devices, multiple speed-grades and I3C
	  IBIs.

	  This driver can also be built as a module. If so, the module will be
	  called adi-i3c-master.

config CDNS_I3C_MASTER
	tristate "Cadence I3C master driver"
	depends on HAS_IOMEM
	depends on !(ALPHA || PARISC)
	help
	  Enable this driver if you want to support Cadence I3C master block.

config DW_I3C_MASTER
	tristate "Synospsys DesignWare I3C master driver"
	depends on HAS_IOMEM
	depends on !(ALPHA || PARISC)
	# ALPHA and PARISC needs {read,write}sl()
	help
	  Support for Synopsys DesignWare MIPI I3C Controller.

	  For details please see
	  https://www.synopsys.com/dw/ipdir.php?ds=mipi_i3c

	  This driver can also be built as a module.  If so, the module
	  will be called dw-i3c-master.

config AST2600_I3C_MASTER
	tristate "ASPEED AST2600 I3C master driver"
	depends on DW_I3C_MASTER
	depends on ARCH_ASPEED || COMPILE_TEST
	select MFD_SYSCON
	help
	  Support for ASPEED AST2600 I3C Controller.

	  This hardware is an instance of the DW I3C controller; this
	  driver adds platform- specific support for AST2600 hardware.

	  This driver can also be built as a module.  If so, the module
	  will be called ast2600-i3c-master.

config SVC_I3C_MASTER
	tristate "Silvaco I3C Dual-Role Master driver"
	depends on HAS_IOMEM
	depends on !(ALPHA || PARISC)
	help
	  Support for Silvaco I3C Dual-Role Master Controller.

config MIPI_I3C_HCI
	tristate "MIPI I3C Host Controller Interface driver (EXPERIMENTAL)"
	depends on HAS_IOMEM
	help
	  Support for hardware following the MIPI Aliance's I3C Host Controller
	  Interface specification.

	  For details please see:
	  https://www.mipi.org/specifications/i3c-hci

	  This driver can also be built as a module.  If so, the module will be
	  called mipi-i3c-hci.

config MIPI_I3C_HCI_PCI
	tristate "MIPI I3C Host Controller Interface PCI support"
	depends on MIPI_I3C_HCI
	depends on PCI
	help
	  Support for MIPI I3C Host Controller Interface compatible hardware
	  on the PCI bus.

	  This driver can also be built as a module. If so, the module will be
	  called mipi-i3c-hci-pci.

config RENESAS_I3C
	tristate "Renesas I3C controller driver"
	depends on HAS_IOMEM
	depends on ARCH_RENESAS || COMPILE_TEST
	help
	  Support the Renesas I3C controller as found in some RZ variants.

	  This driver can also be built as a module. If so, the module will be
	  called renesas-i3c.
```

## drivers/i3c/mctp/Kconfig
```kconfig
# SPDX-License-Identifier: GPL-2.0-only
config I3C_MCTP
    tristate "I3C Controller MCTP driver"
    depends on I3C
help
    Say yes here to enable the I3C MCTP driver for I3C HW that is
    configured as an I3C Controller Device on the I3C Bus.

config I3C_TARGET_MCTP
    tristate "I3C Target MCTP driver"
    depends on I3C
help
    Say yes here to enable the I3C MCTP driver for I3C HW that is
    configured as an I3C Target Device on the I3C Bus.
```
