## drivers/amlogic/power/aml_pmu/Kconfig
```kconfig
menuconfig AML_PMU
    bool    "Amlogic PMU drivers"
    depends on AMLOGIC_BOARD_HAS_PMU
    select  I2C
    select  REGULATOR
    default n
    ---help---
        say yes if you want add Amlogic power management unit support
if AML_PMU

config AML1212
    bool "AML1212 driver"
    ---help---
        drivers for AML1212

config AML1216
    bool "AML1216 driver"
    ---help---
        drivers for amlogic pmu AML1216 

config AML1218
    bool "AML1218 driver"
    ---help---
        drivers for amlogic pmu AML1218 

endif #AML_PMU
```

## drivers/amlogic/power/meson_cs_dcdc_regulator/Kconfig
```kconfig
config MESON_CS_DCDC_REGULATOR
	bool "Meson Current Source DCDC Regulator support "
	select REGULATOR
	help
	  meson current source control DCDC regulator.
```

## drivers/amlogic/power/ricoh/Kconfig
```kconfig
menuconfig RICOH_PMU 
    bool    "RICOH PMU drivers"
    depends on AMLOGIC_BOARD_HAS_PMU
    select  I2C
    select  REGULATOR
    default n
    ---help---
        say yes if you want add RICOH power management unit support

if RICOH_PMU
choice 
    prompt "RICOH PMU type"
    default RN5T618 
config RN5T618 
    bool "RN5T618 driver"
    ---help---
        drivers for RN5T618 

endchoice

endif #RICOH_PMU
```

## drivers/amlogic/ppmgr/Kconfig
```kconfig
#
# Post Process Manager device configuration
#

menu "Post Process Manager driver"

config POST_PROCESS_MANAGER
    tristate "Amlogic Post Process Manager driver"
    default n
	help
	  Select to enable Amlogic Post Process Manager driver.
config POST_PROCESS_MANAGER_PPSCALER
    tristate "Amlogic Post Process Manager PPScaler mode"
    depends on  POST_PROCESS_MANAGER
    default n
	help
	  Select to include PPscaler function in Amlogic Post Process Manager driver.
config POST_PROCESS_MANAGER_3D_PROCESS
    tristate "Amlogic Post Process Manager 3D Process"
    depends on  POST_PROCESS_MANAGER
    default n
	help
	  Select to include 3D Process function in Amlogic Post Process Manager driver.
endmenu
```

## drivers/amlogic/pwm/Kconfig
```kconfig
config MESON_PWM
    tristate "Amlogic PWM support"
	help
	  Generic PWM framework driver for AMLOGIC.

	  To compile this driver as a module, choose M here: the module
	  will be called pwm-meson.

config MESON_PWM_CTRL
    tristate "Amlogic PWM Control driver"
    depends on MESON_PWM
	help
	  Generic PWM framework driver for Hardkernel.

	  To compile this driver as a module, choose M here: the module
	  will be called pwm-meson.
```

## drivers/amlogic/regd/Kconfig
```kconfig
#
# Amlogic register debug driver configuration
#
menu "Register Debug Support"

config AML_REG_DEBUG
	bool "Amlogic Register Debug"
	default n
	help
	  Amlogic register debug driver.

endmenu
```

## drivers/amlogic/rtc/Kconfig
```kconfig
# Amlogic RTC


config AML_RTC
    bool "RTC support"
    default y
    select RTC_CLASS
    help
      This is the Amlogic internal RTC driver
      
```

## drivers/amlogic/securitykeys/Kconfig
```kconfig
#
# Amlogic efuse device configuration
#

menu "Security key Support"

config SECURITYKEY
	bool "security key Driver"
	default n
	help
	    security device driver.


endmenu
```

## drivers/amlogic/smartcard/Kconfig
```kconfig
#
# Smart card driver configuration
#

menu "Smartcard support"

config AM_SMARTCARD
	tristate "Amlogic Smartcard driver"
	default n
	help
		Select to enable Smartcard driver.
endmenu
```

## drivers/amlogic/spi/Kconfig
```kconfig
#
# Sensor device configuration
#

menu "AMLOGIC SPI Hardware bus support"


config AMLOGIC_SPICC_MASTER
	tristate "AMLOGIC SPICC MASTER SUPPORT"

  select SPI
	help
		This is amlogic SPICC hardware bus master.
		This driver can also be built as a module.
	  
config AMLOGIC_SPICC_MASTER_DEBUG
    depends on AMLOGIC_SPICC_MASTER

    bool "AMLOGIC SPICC Enable Debug Message"
    default n
    help
        Say "yes" to enable debug messaging.
endmenu
```

## drivers/amlogic/spi_nor/Kconfig
```kconfig
#
# Sensor device configuration
#

menu "SPI NOR Flash  support"


config AMLOGIC_SPI_NOR
	tristate "AMLOGIC SPI NOR FLASH SUPPORT"
  select MTD
  select MTD_DATA_FLASH 
  select MTD_PARTITIONS
  select MTD_BLOCK
  select MTD_CHAR
  select SPI
	help
		This is amlogic spi nor suport
		This driver can also be built as a module.  If so, the module
		will be called apollo_nand.ko
	  
endmenu
```

## drivers/amlogic/thermal/Kconfig
```kconfig
# Amlogic Thermal


config AML_VIRTUAL_THERMAL
    bool "Amlogic virtual thermal interface"
    default y
    help 
        Say Y if you want use amlogic virtual thermal interface

config AMLOGIC_THERMAL
    bool "amlogic thermal support"
    select THERMAL
    select CPU_THERMAL
    select GPU_THERMAL
    select CPUCORE_THERMAL
    select GPUCORE_THERMAL
    select AML_VIRTUAL_THERMAL 
    default n
    help
      This is the Amlogic Thermal interface driver
```

## drivers/amlogic/touch/Kconfig
```kconfig
menu "Amlogic touch algorithm Support"

config AML_TOUCH_ALGORITHM_SUPPORT
    tristate "Amlogic touch algorithm support"
    help
        Say y if your touch device need this algorithm support

endmenu
```

## drivers/amlogic/tvin/Kconfig
```kconfig
#
# Amlogic tvin devices configuration
#

menuconfig TVIN
	tristate "Amlogic TVIN support"
	default n

if TVIN

source "drivers/amlogic/tvin/vdin/Kconfig"
source "drivers/amlogic/tvin/tvafe/Kconfig"
source "drivers/amlogic/tvin/hdmirx/Kconfig"
source "drivers/amlogic/tvin/bt656/Kconfig"
source "drivers/amlogic/tvin/csi/Kconfig"
source "drivers/amlogic/tvin/viu/Kconfig"
source "drivers/amlogic/tvin/it660x/Kconfig"
source "drivers/amlogic/tvin/isp/Kconfig"
source "drivers/amlogic/tvin/vdin_ctrl/Kconfig"
endif
```

## drivers/amlogic/tvin/bt656/Kconfig
```kconfig
#
# BT656 Device Driver Configuration
#


config TVIN_BT656
	tristate "Amlogic BT656 device driver"
	default y
	help
	  BT656 device driver.
```

## drivers/amlogic/tvin/csi/Kconfig
```kconfig
#
# CSI Device Driver Configuration
#


config TVIN_CSI
	tristate "Amlogic CSI device driver"
	default y
	help
	  CSI device driver.
```

## drivers/amlogic/tvin/hdmirx/Kconfig
```kconfig
#
# HDMI Rx Device Driver Configuration
#


config TVIN_HDMI
    tristate "Amlogic HDMI RX device driver"
    default n
    help
      HDMI RX device driver.
```

## drivers/amlogic/tvin/isp/Kconfig
```kconfig
config  TVIN_ISP 
	tristate "Amlogic ISP device driver"
	default n
	help
		ISP device driver.
```

## drivers/amlogic/tvin/it660x/Kconfig
```kconfig
#
#Hdmirx It660xin Device Driver Configuration
#
config  AM_HDMI_REPEATER
	bool 
	default n

config TVIN_IT660X
    tristate "Amlogic IT660XIN device driver" 
    default  n
    select AM_HDMI_REPEATER
    help
         Amlogic IT660XIN device driver.
```

## drivers/amlogic/tvin/tvafe/Kconfig
```kconfig
#
# TVAFE Device Driver Configuration
#


config TVIN_AFE
	tristate "Amlogic AFE device driver"
	default n
	help
	  AFE device driver.
if TVIN_AFE
   config ADC_DOUBLE_SAMPLING_FOR_SD
        bool "Enable double sampling function"
        default n
        help
                Adc double sampling for SD.        
   config TVIN_VBI
    	tristate "Amlogic TVIN VBI device"
    	default n
    	help
        	VBI devices driver.
     
endif 
```

## drivers/amlogic/tvin/vdin/Kconfig
```kconfig
#
# VDIN Device Driver Configuration
#


config TVIN_VDIN
	tristate "Amlogic VDIN device driver"
	default n
	help
	  VDIN device driver.
```

## drivers/amlogic/tvin/vdin_ctrl/Kconfig
```kconfig
#
#VDIN Controler Device Driver Configuration
#
 
config TVIN_VDIN_CTRL
    tristate "Amlogic VDIN driver level controller" 
    default  n
    help
         Amlogic VDIN Controller device driver.
```

## drivers/amlogic/tvin/viu/Kconfig
```kconfig
config  VIUIN 
	tristate "Amlogic VIUIN device driver"
	default n
	help
		VIUIN device driver.
if VIUIN
   config GAMMA_AUTO_TUNE
        bool "Enable gamma auto tune function"
        default n
        help
                Auto tune the gamma.
                
endif 
```

## drivers/amlogic/uart/Kconfig
```kconfig
#
# Amlogic driver configuration
#
	
config AM_UART
    bool "Serial support"
    depends on PLAT_MESON
	select SERIAL_CORE
	default y
    help
	Add support for the Amlogic serial port.

config AM_UART_CONSOLE
	bool "Console on Amlogic Serial port"
	depends on AM_UART
	select SERIAL_CORE_CONSOLE
	default y
	help
		Support for running a console on the Amlogic serial
```

## drivers/amlogic/usb/Kconfig
```kconfig
menu "USB Support"

config AMLOGIC_USB
	tristate "Amlogic USB controller support"
	select USB_DWC_OTG_HCD
	select USB_HOST_ELECT_TEST
	select OF_LM
	depends on USB
	help
	   dwc_otg USB host controller

config USB_DWC_OTG_HCD
	bool "USB Host controller dwc_otg support"
	depends on AMLOGIC_USB
	
config USB_HOST_ELECT_TEST
	bool
	help
	    Enable this config to support USB High speed electric test.

#config DWC_USB_NAK_IN_TIMER
#	bool "Disable DWC OTG USB NAK ISR"
#	depends on USB_DWC_OTG_HCD
#	default n
#	help
#		[y]Enable this config to disable DWC OTG USB NAK interrupt handler.
#			 The handler is moved to timer.
#		[n]Disable this config to let NAK handler in interrupt.
#		Don't change this if you don't know what it is.

endmenu
```
