## drivers/amlogic/display/backlight/Kconfig
```kconfig
menu "Amlogic Backlight Support"

config AMLOGIC_BACKLIGHT
	bool "Amlogic backlight support"
	select BACKLIGHT_CLASS_DEVICE
	default y
	help
		Say Y here if you want to use the Amlogic backlight management.

config AML_BL_LATCH_ON_VSYNC
	bool "Backlight latch on vsync"
	depends on AMLOGIC_BACKLIGHT
	default n
	help
	  Say Y if you want to enable the Amlogic backlight latch on vsync.

config AML_BL_PWM_ATTR
	bool "Backlight sys class attr"
	default n
	help
	  Say Y if you want to enable the Amlogic backlight sys pwm attr.

choice
	prompt "Backlight control mode"
	depends on AMLOGIC_BACKLIGHT
	default AML_BL_CTL_GPIO
	help
	  Backlight control mode, by GPIO or PWM.

config AML_BL_CTL_GPIO
	bool "GPIO"

config AML_BL_CTL_PWM
	bool "PWM"

endchoice

config AML_LCD_BACKLIGHT_SUPPORT
	tristate "AML lcd backlight support"
	default y
	depends on AMLOGIC_BACKLIGHT
	help
		AML lcd backlight support

config AML_LOCAL_DIMMING
	bool "Amlogic Local Dimming"
	default n
	help
	  Amlogic local dimming support.

config IW7023_BACKLIGHT
	bool "iW7023 Backlight"
	default n
	help
	  iW7023 LED Driver for LCD Panel Backlight.

config IW7023_USE_EEPROM
	bool "iW7023 use eeprom to backup data"
	default n
	help
	  Say Y if you use eeprom to backup data of iw7023.

endmenu
```

## drivers/amlogic/display/lcd/Kconfig
```kconfig
#
# Kconfig for Amlogic LCD Devices
#

menu "Amlogic TV LCD Support"

config AML_TV_LCD
	bool "Amlogic TV LCD Driver"
	default n
	help
	  Enable this to choose the drivers for controlling the
	  the LCD panel on TV.

endmenu
```

## drivers/amlogic/display/osd/Kconfig
```kconfig
#
# Frame buffer configuration
#
menu "Amlogic osd module"

config FB_AM
	tristate "Amlogic osd support"
	select FB
	select FB_CFB_FILLRECT
	select FB_CFB_COPYAREA
	select FB_CFB_IMAGEBLIT
	select AM_CANVAS
	help
	  This is the frame buffer device driver.

config FB_OSD2_ENABLE
	bool "osd2 layer enable"
	default y
	depends on  FB_AM
	help  
		if enable osd2 then we will have two OSD op layer

config FB_OSD2_CURSOR
	bool "Android OSD2 cursor support"
	depends on FB_OSD2_ENABLE
	default n
	help
		Enables support for a mouse cursor using OSD2.
config FB_OSD2_DEFAULT_BITS_PER_PIXEL
	depends on FB_OSD2_ENABLE
	int "default OSD2 BPP"
	range 16  32
	default  32
	---help---
	 The default osd2 color depth.
config FB_OSD2_DEFAULT_WIDTH
	depends on FB_OSD2_ENABLE
	int "Default OSD2 width"
	range 1 4096
	default 720
	---help---
	  The default osd2/fb1 width. Does not affect ability to change width using fbset or FBIOPUT ioctl.

config FB_OSD2_DEFAULT_HEIGHT
	depends on FB_OSD2_ENABLE
	int "Default OSD2 height"
	range 1 4096
	default 480
	---help---
	  The default osd2/fb1 height. Does not affect ability to change height using fbset or FBIOPUT ioctl.

config FB_OSD2_DEFAULT_WIDTH_VIRTUAL
	depends on FB_OSD2_ENABLE
	int "Default OSD2 virtual width"
	range FB_OSD2_DEFAULT_WIDTH 4096
	default 720
	---help---
	  The default osd2/fb1 virtual width. Does not affect ability to change width using fbset or FBIOPUT ioctl.

config FB_OSD2_DEFAULT_HEIGHT_VIRTUAL
	depends on FB_OSD2_ENABLE
	int "Default OSD2 virtual height"
	range FB_OSD2_DEFAULT_HEIGHT 4096
	default 480
	---help---
	  The default osd2/fb1 virtual height. Does not affect ability to change height using fbset or FBIOPUT ioctl.
config FB_OSD1_DEFAULT_BITS_PER_PIXEL
	depends on FB_AM
	int "default OSD1 BPP"
	range 16  32
	default  16
	---help---
	 The default osd1 color depth.
config FB_OSD1_DEFAULT_WIDTH
	depends on FB_AM
	int "Default OSD1 width"
	range 1 4096
	default 720
	---help---
	  The default osd1/fb0 width. Does not affect ability to change width using fbset or FBIOPUT ioctl.

config FB_OSD1_DEFAULT_HEIGHT
	depends on FB_AM
	int "Default OSD1 height"
	range 1 4096
	default 480
	---help---
	  The default osd1/fb0 height. Does not affect ability to change height using fbset or FBIOPUT ioctl.

config FB_OSD1_DEFAULT_WIDTH_VIRTUAL
	depends on FB_AM
	int "Default OSD1 virtual width"
	range FB_OSD1_DEFAULT_WIDTH 4096
	default 720
	---help---
	  The default osd1/fb0 virtual width. Does not affect ability to change width using fbset or FBIOPUT ioctl.

config FB_OSD1_DEFAULT_HEIGHT_VIRTUAL
	depends on FB_AM
	int "Default OSD1 virtual height"
	range FB_OSD1_DEFAULT_HEIGHT 4096
	default 480
	---help---
	  The default osd1/fb0 virtual height. Does not affect ability to change height using fbset or FBIOPUT ioctl.

config FB_AMLOGIC_UMP
   bool "amlogic ump"
   default y
   depends on  FB_AM
   help
                enable osd ump when we use mali for x11

endmenu	
```

## drivers/amlogic/display/osd_ext/Kconfig
```kconfig
#
# Frame buffer configuration
#
menu "Amlogic osd_ext module"

config AM_FB_EXT
	tristate "Amlogic osd_ext support"
	default n
	depends on FB && AM_TV_OUTPUT2
	select FB_CFB_FILLRECT
	select FB_CFB_COPYAREA
	select FB_CFB_IMAGEBLIT
	select AM_CANVAS
	help
		This is the frame buffer device driver.
endmenu
```

## drivers/amlogic/display/vout/Kconfig
```kconfig
#
# Video output configuration
#
menu "Amlogic video output module"

config AM_TV_OUTPUT
	tristate "TV output"
	default y
	help  
		tv output module

config AML_VOUT_FRAMERATE_AUTOMATION
	bool "framerate automation"
	default y
	depends on AM_TV_OUTPUT
	help
		framerate adjustment automatically from video source

config AM_LCD_OUTPUT
	tristate "LCD output" 
	default y
	help  
		LCD output module

config AML_GAMMA_DEBUG
	tristate "AML Gamma debug"
	default y
	depends on  AM_LCD_OUTPUT
	help
		AML gamma debug

endmenu
```

## drivers/amlogic/display/vout2/Kconfig
```kconfig
#
# Video output configuration
#
menu "Amlogic video output2 module"

config AM_TV_OUTPUT2
	tristate "TV output2"
	default n
	help  
		tv output2 module

		
endmenu
	
```

## drivers/amlogic/dvb_tv/Kconfig
```kconfig
#
# DVB driver configuration
#

menu "Amlogic DVB driver"

config AM_DVB
	tristate "AMLOGIC DVB driver"
	default n
	select DVB_CORE
	help
		Select to enable AMLogic DVB driver.

menu "AMLOGIC CI Driver"

config AM_CI
	tristate "Amlogic Common Interface driver"
	default n
	depends on AM_DVB
	select AM_PCMCIA
	select AM_IOBUS
	help
		Select to enable Amlogic CI driver.

config AM_PCMCIA
	tristate "Amlogic PCMCIA driver"
	default n
	help
		Select to enable Amlogic PCMCIA driver.

config AM_IOBUS
	tristate "Amlogic IOBUS driver"
	default n
	help
		Select to enable Amlogic IOBUS driver.

endmenu

if !OF

config AMLOGIC_TS0
	bool "Enable TS0"
	default n
	depends on AM_DVB
	help
		Enable TS0.

config AMLOGIC_S_TS0
	bool "Serial TS0"
	default n
	depends on AMLOGIC_TS0
	help
		TS0 in serial mode.

config AMLOGIC_TS0_INVERT_S2P1_FEC_ERROR
	bool "Invert FEC_ERROR TS0"
	default n
	depends on AMLOGIC_S_TS0
	help
		TS0 FEC_ERROR invert

config AMLOGIC_TS0_INVERT_S2P1_FEC_DATA
	bool "Invert FEC_DATA TS0"
	default n
	depends on AMLOGIC_S_TS0
	help
		TS0 FEC_DATA invert

config AMLOGIC_TS0_INVERT_S2P1_FEC_SYNC
	bool "Invert FEC_SYNC TS0"
	default n
	depends on AMLOGIC_S_TS0
	help
		TS0 FEC_SYNC invert

config AMLOGIC_TS0_INVERT_S2P1_FEC_VALID
	bool "Invert FEC_VALID TS0"
	default n
	depends on AMLOGIC_S_TS0
	help
		TS0 FEC_VALID invert

config AMLOGIC_TS0_INVERT_S2P1_FEC_CLK
	bool "Invert FEC_CLK TS0"
	default n
	depends on AMLOGIC_S_TS0
	help
		TS0 FEC_CLK invert

config AMLOGIC_TS1
	bool "Enable TS1"
	default n
	depends on AM_DVB
	help
		Enable TS1.

config AMLOGIC_S_TS1
	bool "Serial TS1"
	default n
	depends on AMLOGIC_TS1
	help
		TS1 in serial mode.

config AMLOGIC_TS1_INVERT_S2P1_FEC_ERROR
	bool "Invert FEC_ERROR TS1"
	default n
	depends on AMLOGIC_S_TS1
	help
		TS1 FEC_ERROR invert

config AMLOGIC_TS1_INVERT_S2P1_FEC_DATA
	bool "Invert FEC_DATA TS1"
	default n
	depends on AMLOGIC_S_TS1
	help
		TS1 FEC_DATA invert

config AMLOGIC_TS1_INVERT_S2P1_FEC_SYNC
	bool "Invert FEC_SYNC TS1"
	default n
	depends on AMLOGIC_S_TS1
	help
		TS1 FEC_SYNC invert

config AMLOGIC_TS1_INVERT_S2P1_FEC_VALID
	bool "Invert FEC_VALID TS1"
	default n
	depends on AMLOGIC_S_TS1
	help
		TS1 FEC_VALID invert

config AMLOGIC_TS1_INVERT_S2P1_FEC_CLK
	bool "Invert FEC_CLK TS1"
	default n
	depends on AMLOGIC_S_TS1
	help
		TS1 FEC_CLK invert

config AMLOGIC_TS2
	bool "Enable TS2"
	default n
	depends on AM_DVB
	help
		Enable TS2.

config AMLOGIC_S_TS2
	bool "Serial TS2"
	default n
	depends on AMLOGIC_TS2
	help
		TS2 in serial mode.

config AMLOGIC_TS2_INVERT_S2P1_FEC_ERROR
	bool "Invert FEC_ERROR TS2"
	default n
	depends on AMLOGIC_S_TS2
	help
		TS2 FEC_ERROR invert

config AMLOGIC_TS2_INVERT_S2P1_FEC_DATA
	bool "Invert FEC_DATA TS2"
	default n
	depends on AMLOGIC_S_TS2
	help
		TS2 FEC_DATA invert

config AMLOGIC_TS2_INVERT_S2P1_FEC_SYNC
	bool "Invert FEC_SYNC TS2"
	default n
	depends on AMLOGIC_S_TS2
	help
		TS2 FEC_SYNC invert

config AMLOGIC_TS2_INVERT_S2P1_FEC_VALID
	bool "Invert FEC_VALID TS2"
	default n
	depends on AMLOGIC_S_TS2
	help
		TS2 FEC_VALID invert

config AMLOGIC_TS2_INVERT_S2P1_FEC_CLK
	bool "Invert FEC_CLK TS2"
	default n
	depends on AMLOGIC_S_TS2
	help
		TS2 FEC_CLK invert

endif

if ARCH_MESON6TV || ARCH_MESON6TVD
config AM_M6_DEMOD
	tristate "M6 demod driver"
	default n
	depends on AM_DVB
	help
		Select to enable M6 demod driver.
endif

# source "drivers/amlogic/dvb/altobeam/drivers/atbm887x/Kconfig"

config AM_SI2177
	tristate "SI2177 tuner"
	default n
	depends on AM_DVB
	help
		select the 2177 tuner.

config AM_AVL6211
	tristate "AVL6211 DVB-S2 demod driver"
	default n
	depends on AM_DVB
	help
		select the AVL6211 DVB-S2 demod.

endmenu
```

## drivers/amlogic/early_init/Kconfig
```kconfig
config EARLY_INIT
	bool "early_init Driver"
	default n
	depends on GPIO_AMLOGIC
	help
	    early_init device driver.
```

## drivers/amlogic/efuse/Kconfig
```kconfig
#
# Amlogic efuse device configuration
#

menu "EFUSE Support"

config EFUSE
	bool "EFUSE Driver"
	default n
	help
	    EFUSE device driver.

config EFUSE_WRITE_VERSION_PERMIT
	depends on EFUSE
	bool "efuse write version permit"
	default n
	help
		efuse version is prohibited writing in kernel default case, if it must be written, enable this config
		if you don't understand efuse version, please don't enable this config


config EFUSE_LAYOUT_VERSION
	depends on EFUSE
	int "default efuse layout version"
	range 0  3
	default  3
	help
		EFUSE layout version

		0 => v0  for m1
		1 => v1  for m3
		2 => v2  for m6
		3 => v3  for m3 and m6, security key save in emmc or nand, hash save in efuse

endmenu
```

## drivers/amlogic/ethernet/Kconfig
```kconfig
#
# Amlogic Ethernet Driver configuration
#
menu "Ethernet Support"

config AM_ETHERNET
	tristate "Amloigc Ethetnet support"
	select  NET
	help
		Depends on NET
source "drivers/amlogic/ethernet/phy/Kconfig"
	
config AM_ETHERNET_DEBUG_LEVEL
	int "Amloigc Ethetnet support"
	default 1
	depends on NET && AM_ETHERNET
	help
		debug level:
		// >0 for basic init and remove debug;
		// >1 further setting debug;
		// >2 for tx
		// >3 for rx

endmenu
```

## drivers/amlogic/ethernet/phy/Kconfig
```kconfig
#
# PHY Layer Configuration
#

menuconfig PHYLIB
	tristate "PHY Device support and infrastructure"
	depends on NETDEVICES
	help
	  Ethernet controllers are usually attached to PHY
	  devices.  This option provides infrastructure for
	  managing PHY devices.

if PHYLIB
comment "MII PHY device drivers"
config AML_PHY
	tristate "Drivers for AMLOGIC PHY"
	---help---
	  Currently has a driver for the AMLOGIC INTERNAL PHY

config AML_LAN8720
	tristate "Drivers for SMSC LAN8720 PHYs"
	---help---
	  Currently supports the LAN83C185, LAN8187 and LAN8700 PHYs

config AML_IP101_PHY
	tristate "Drivers for ICPlus IP101GR PHYs"
	---help---
	  Currently supports the IP175C and IP1001 PHYs.

config AML_KSZ8091
	tristate "Driver for Micrel KSZ8091 PHYs"
	---help---
	  Supports the KSZ9021, VSC8201, KS8001 PHYs.
config AML_RTL8211F
	tristate "Drivers for RTL8211F"
	default n
	---help---
	  Currently supports the RTL8211F

endif # PHYLIB
```

## drivers/amlogic/ext_hdmiin/Kconfig
```kconfig
#
# Amlogic external hdmi-in chips configuration
#

menuconfig AML_EXT_HDMIIN
	bool "External hdmi-in chips support"
	default y

if AML_EXT_HDMIIN
config AML_SII9233
	bool "SiliconImage 9233 support"
	depends on AML_EXT_HDMIIN
	default n

source "drivers/amlogic/ext_hdmiin/sii9293/linux_driver/Kconfig"

endif # AML_EXT_HDMIIN
```

## drivers/amlogic/ext_hdmiin/sii9233/Kconfig
```kconfig
#
#Hdmirx SiI9233A Device Driver Configuration
#

config TVIN_SII9233A
    tristate "Amlogic SII9233A device driver" 
    default  y
    help
         Amlogic SII9233A device driver.
```

## drivers/amlogic/ext_hdmiin/sii9293/linux_driver/Kconfig
```kconfig
#
#Hdmirx SiI9293 Device Driver Configuration
#

menuconfig AML_SII9293
	bool "Amlogic SII9293 device driver" 
    default  n
    help
         Amlogic SII9293 device driver.

if AML_SII9293

config MHAWB_SUPPORT
	bool
	prompt "MHL Media Data Tunneling Support"
	default n
	---help---
	  This option controls whether or not Silicon Image MHL transmitter
	  drivers include support for Media Data Tunneling (MDT).  MDT
	  support enables HID events generated by HID devices attached to
	  an MDT capable MHL sink to be passed over the MHL connection
	  to the system.

config DEBUG_DRIVER
	bool
	prompt "Enable debug messages in kernel"
	default n

config SII5293_RX
	bool 
	prompt "Silicon Image 9293 HDMI to MHL Rx"	
	depends on I2C
	default y

endif
```

## drivers/amlogic/gpio/Kconfig
```kconfig
# Amlogic GPIO


config GPIO_AMLOGIC
    bool "GPIO support"
    select ARCH_REQUIRE_GPIOLIB
    default y
    help
      This is the Amlogic GPIO interface driver
```
