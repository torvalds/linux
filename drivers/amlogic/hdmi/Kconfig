## drivers/amlogic/input/touchscreen/Kconfig
```kconfig
#
# Touchscreen driver configuration
#

menuconfig MESON_INPUT_TOUCHSCREEN
	bool "Touchscreens"
	help
	  Say Y here, and a list of supported touchscreens will be displayed.
	  This option doesn't affect the kernel.

	  If unsure, say Y.

if MESON_INPUT_TOUCHSCREEN

config ADC_TOUCHSCREEN_AM
	tristate "Meson ADC touchscreen"
	depends on SARADC_AM
	help
          Say Y here if you want to use the Meson ADC touchscreen.

config ITK_CAPACITIVE_TOUCHSCREEN
	tristate "ITK capacitive touchscreen"
	default n
	help
	  Say Y here if you want to use the ITK capacitive panel.

config PIXCIR_CAPACITIVE_TOUCHSCREEN
	tristate "PIXCIR I2C capacitive touchscreen"
	depends on I2C
	default n
	help
	  Say Y here if you want to use the PIXCIR capacitive panel.

config PIXCIR_NEW_CAPACITIVE_TOUCHSCREEN
	tristate "PIXCIR I2C new capacitive touchscreen(5 points)"
	depends on I2C
	default n
	help
	  Say Y here if you want to use the PIXCIR new capacitive panel.

config SINTEK_CAPACITIVE_TOUCHSCREEN
	tristate "Sintek capacitive touchscreen"
	default n
	help
	  Say Y here if you want to use the Sintek capacitive panel.

config EETI_CAPACITIVE_TOUCHSCREEN
	tristate "EETI capacitive touchscreen"
	default n
	help
	  Say Y here if you want to use the EETI capacitive panel.

config SIS92XX_CAPACITIVE_TOUCHSCREEN
	tristate "SIS92XX I2C capacitive touchscreen"
	depends on I2C
	default n
	help
	  Say Y here if you want to use the SIS92XX capacitive panel.

config FOCALTECH_CAPACITIVE_TOUCHSCREEN
	tristate "FocalTech I2C capacitive touchscreen"
	depends on I2C
	default n
	help
	  Say Y here if you want to use the FocalTech 5X06 capacitive panel.

config SITRONIX_CAPACITIVE_TOUCHSCREEN
	tristate "SITRONIX I2C capacitive touchscreen"
	depends on I2C
	default n
	help
	  Say Y here if you want to use the SITRONIX ST15XX capacitive panel.

config HX8520_CAPACITIVE_TOUCHSCREEN
	tristate "HX8520 I2C capacitive touchscreen"
	depends on I2C
	default n
	help
	  Say Y here if you want to use the HX8520 capacitive panel.

config RAYDIUM_CAPACITIVE_TOUCHSCREEN
	tristate "Raydium I2C capacitive touchscreen"
	depends on I2C
	default n
	help
	  Say Y here if you want to use the Raydium capacitive panel.

config GOODIX_CAPACITIVE_TOUCHSCREEN
	tristate "Goodix I2C capacitive touchscreen"
	depends on I2C
	default n
	help
	  Say Y here if you want to use the Goodix capacitive panel.

config GOODIX_GT81XX_CAPACITIVE_TOUCHSCREEN
	tristate "Goodix I2C GT81XX capacitive touchscreen"
	depends on I2C
	default n
	help
	  Say Y here if you want to use the Goodix capacitive panel.

config GOODIX_GT82X_CAPACITIVE_TOUCHSCREEN
	tristate "Goodix GT828X capacitive touch panel"
	depends on I2C
	default n
	help
	  Say Y here if you want to use the Goodix GT828X capacitive panel.

	  To compile this driver as a module, choose M here: the
	  module will be called .

config UOR7X5X_RESISTIVE_TOUCHSCREEN
	tristate "UOR7X5X resistive touchscreen"
	default n
	help
	  Say Y here if you want to use the UOR7X5X resistive panel.

config UOR6X5X_RESISTIVE_TOUCHSCREEN
	tristate "UOR6X5X resistive touchscreen"
	default n
	help
	  Say Y here if you want to use the UOR6X5X resistive panel.
	  
config GSLX680_CAPACITIVE_TOUCHSCREEN
	tristate "gslx680 I2C capacitive touchscreen"
		depends on I2C
	default n
	help
	  Say Y here if you want to use the gslx680 capacitive panel.

config GSLX680_COMPATIBLE_CAPACITIVE_TOUCHSCREEN
	tristate "gslx680 I2C compatible chip type A and B capacitive touchscreen"
		depends on I2C
	default n
	help
	  Say Y here if you want to use the gslx680 compatible capacitive panel.


config GSLX680B_CAPACITIVE_TOUCHSCREEN
	tristate "gslx680b I2C capacitive touchscreen"
		depends on I2C
	default n
	help
	  Say Y here if you want to use the gslx680b capacitive panel.	  
	  
config GOODIX_GT9XX_CAPACITIVE_TOUCHSCREEN
	tristate "Goodix I2C GT9XX capacitive touchscreen"
	depends on I2C
	default n
	help
	  Say Y here if you want to use the Goodix capacitive panel.

config FT5X02_CAPACITIVE_TOUCHSCREEN
	tristate "FocalTech I2C FT5X02 capacitive touchscreen"
	depends on I2C
	default n
	help
	  Say Y here if you want to use the Goodix capacitive panel.

config NOVATEK_CAPACITIVE_TOUCHSCREEN
	tristate "novatek I2C NT110x capacitive touchscreen"
	depends on I2C
	default n
	help
	  Say Y here if you want to use the Goodix capacitive panel.

# VTL TouchScreen Driver Config
menu "Ct36x Touch device support"
source "drivers/amlogic/input/touchscreen/ct36x_ts/Kconfig"
endmenu

endif # MESON_INPUT_TOUCHSCREEN
```

## drivers/amlogic/input/touchscreen/ct36x_ts/Kconfig
```kconfig
#
# Touchscreen driver configuration
#


config TOUCHSCREEN_CT36X
	tristate "VTL ct36x based touchscreens"
	depends on I2C
	default n

if TOUCHSCREEN_CT36X
#config TOUCHSCREEN_CT36X_I2C
#	tristate "VTL ct36x based touchscreens"
#	depends on I2C

choice
	prompt "Device driver platform support"
	default TOUCHSCREEN_CT36X_PLATFORM_AMLCHIP

	config TOUCHSCREEN_CT36X_PLATFORM_AMLCHIP
		bool "Amlogic"

	config TOUCHSCREEN_CT36X_PLATFORM_GENERIC
	  bool "Generic"

	config TOUCHSCREEN_CT36X_PLATFORM_ROCKCHIP
	  bool "RockChip"

	config TOUCHSCREEN_CT36X_PLATFORM_ALLWINNER
	  bool "AllWinner"
endchoice

choice
	prompt "Device driver chip support"
	default TOUCHSCREEN_CT36X_CHIP_CT365

	config TOUCHSCREEN_CT36X_CHIP_CT360
	  bool "ct360"

	config TOUCHSCREEN_CT36X_CHIP_CT365
	  bool "ct363/ct365"
endchoice

config TOUCHSCREEN_CT36X_MISC
	bool "Device driver misc support"
	default y

		config TOUCHSCREEN_CT36X_MISC_X_REVERSE
		bool "reverse X axis"
		default n
		depends on TOUCHSCREEN_CT36X_MISC

		config TOUCHSCREEN_CT36X_MISC_Y_REVERSE
		bool "reverse Y axis"
		default n
		depends on TOUCHSCREEN_CT36X_MISC

		config TOUCHSCREEN_CT36X_MISC_XY_SWAP
		bool "swap X, Y"
		default n
		depends on TOUCHSCREEN_CT36X_MISC

		config TOUCHSCREEN_CT36X_MISC_NEW_TPS
		bool "uses new touch point structure"
		default y
		depends on TOUCHSCREEN_CT36X_MISC
endif
```

## drivers/amlogic/ion_dev/Kconfig
```kconfig
menu "ION support"

config AMLOGIC_ION
        tristate "ION memeory management support"
        select ION
        select ARM_HAS_SG_CHAIN
        default y
        ---help---
          Select to enable "Amlogic ion device support.
endmenu
```

## drivers/amlogic/ionvideo/Kconfig
```kconfig
menu "Amlogic ion video support"

config VIDEOBUF2_ION
	tristate "videobuf2-ion video device support"
	select VIDEO_DEV
	select VIDEO_V4L2
	select VIDEOBUF2_CORE
	select VIDEOBUF2_MEMOPS
	select DMA_SHARED_BUFFER
	default y

	---help---
	capture ion video to user

config AMLOGIC_IONVIDEO
	tristate "Amlogic ion video device support"
        select VIDEOBUF2_ION
	default n

	---help---
	capture ion video to user
endmenu
```

## drivers/amlogic/keymanage/Kconfig
```kconfig
#
# Amlogic efuse device configuration
#

menu "key management Support"

config UNIFY_KEY_MANAGE
	bool "unify key management Driver"
	default n
	help
	    unify key management device driver.


endmenu
```

## drivers/amlogic/mhl/Kconfig
```kconfig
menu "MHL Support"

config PANEL_IT6681
	tristate "it6681 hdmi2mhl device"
	default n
	help
	  it6611 HDMI to MHL device

endmenu
```

## drivers/amlogic/mipi/Kconfig
```kconfig
#
# Amlogic mipi devices configuration
#

menu "MIPI Support"

config AMLOGIC_MIPI
	bool "Amlogic MIPI device"
	default n
	help
		Amlogic MIPI device driver
		
config MEM_MIPI
	bool "Amlogic MEM_MIPI device"
	default n
	depends on  AMLOGIC_MIPI
	select AM_GE2D
	help
		Amlogic MEM_MIPI device driver.

config VDIN_MIPI
	bool "Amlogic VDIN_MIPI device"
	default n
	depends on  AMLOGIC_MIPI
	select TVIN
	select TVIN_VDIN
	select AM_GE2D
	help
		Amlogic VDIN_MIPI device driver.

endmenu
```

## drivers/amlogic/mmc/Kconfig
```kconfig
#
# MMC/SD host controller drivers
#

comment "MMC/SD/SDIO Host Controller Drivers"

menu "Multimedia Card support"

config MMC_AML
	bool "Amlogic Multimedia Card support"
	default n
	select MMC
	select MMC_BLOCK
	select MMC_BLOCK_BOUNCE 
 	select MMC_UNSAFE_RESUME
   
config MMC_AML_DEBUG
    bool "Amlogic Multimedia Card Debug support"
	default n
	
config AML_MMC_DEBUG_FORCE_SINGLE_BLOCK_RW
    bool "force read and write to use single-block mode(CMD17/24)."
	default n
    
endmenu
```

## drivers/amlogic/nfc/Kconfig
```kconfig
#
# Near Field Communication (NFC) devices
#

config MESON_NFC
    bool "Near Field Communication (NFC) devices"
    default n


config BCM2079X_NFC
    tristate "bcm2079x NFC driver"
    depends on MESON_NFC
    default n
    ---help---
      Say yes if you want bcm2079x Near Field Communication driver.
      This is for i2c connected version. If unsure, say N here.
```

## drivers/amlogic/of/Kconfig
```kconfig
config OF_LM
	bool "Support for lm bus devices in device tree"
	depends on OF
	default y
```

## drivers/amlogic/pinctrl/Kconfig
```kconfig
# Amlogic PINCTRL


config PINCTRL_AMLOGIC
    bool "PINCTRL support"
    select PINCTRL
    select PINMUX
    select PINCONF
    default y
    help
      This is the Amlogic PINCTRL interface driver
```

## drivers/amlogic/pmu/Kconfig
```kconfig
menu "Amlogic PMU battery algorithm Support"

config AML_PMU_ALGORITHM_SUPPORT
    tristate "Amlogic PMU battery algorithm support"
    select AML_RTC
    help
        Say y if your pmu device need this algorithm support

endmenu
```

## drivers/amlogic/power/Kconfig
```kconfig
menu "Power Management Support"

#############################################################
#
# NOTE:
#
# AMLOGIC_BOARD_HAS_PMU is general switch to compile on-board
# PMU drivers, ALL new added PMU driver should be depend on 
# this config
#
############################################################
config AMLOGIC_BOARD_HAS_PMU
	bool "Amlogic on board Power Management Unit support"
	select POWER_SUPPLY
	default y
	help
	  Say Y here if your board has Power Management Unit

config AMLOGIC_PMU_OF
	bool "Amlogic Power OF support"
	depends on I2C
    depends on AMLOGIC_BOARD_HAS_PMU
    default y
	help
		Power management device tree support

config CW2015
	bool "CellWise gasgauge"
    depends on AMLOGIC_BOARD_HAS_PMU
	default n
	help
	  Say Y here if you want to use the CellWise gasgauge.

config SMBA10XX_BATTERY
	boolean "SMBA10XX battery driver support"
    depends on AMLOGIC_BOARD_HAS_PMU
	select I2C
	default n
	help
	  Say Y if you want to add battery driver supoort for SMBA10XX
	  
config BQ27x00_BATTERY
	bool "BQ27x00 Battery support"
    depends on AMLOGIC_BOARD_HAS_PMU
	select I2C
	default n
	help
	  Say Y here if you want to add battery driver supoort for bq27x00.

config UBOOT_BATTERY_PARAMETERS
	bool "battery parameters get from uboot support"
    depends on AMLOGIC_BOARD_HAS_PMU
	default n
	help
	    Say y if you want to get battery parameters from uboot

config AML_PMU_ALGORITHM_SUPPORT
    tristate "Amlogic PMU battery algorithm support"
    select AML_RTC
    help
        Say y if your pmu device need this algorithm support

config AML_DVFS
    bool "Amlogic DVFS interface support"
    default y
    help
        interface for clock adjustment and power managment

#source "drivers/amlogic/power/act8xxx_pmu/Kconfig"
source "drivers/amlogic/power/axp_power/Kconfig"
source "drivers/amlogic/power/meson_cs_dcdc_regulator/Kconfig"
source "drivers/amlogic/power/aml_pmu/Kconfig"
source "drivers/amlogic/power/ricoh/Kconfig"
endmenu
```
