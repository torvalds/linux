## drivers/amlogic/hdmi/Kconfig
```kconfig
menu "HDMI TX Support"

config AML_HDMI_TX
        bool "HDMI Output Enable"
        default y
        select SWITCH
        select AM_DISPLAY_MODULE
        help  
                hdmi output enable,It should be enalbe if board have hdmi out interface

if AML_HDMI_TX
config AML_HDMI_TX_HDCP
        bool "HDMI HDCP Enable"
        default n
        help
                hdmitx hdcp enable, it should be enalbe if board burned hdmitx hdcp keys

config AML_HDMI_TX_CTS_DVI
        bool "HDMI DVI mode Output Enable"
        default n
        help
                HDMI DVI output enable. By default, Tx will output HDMI mode signal, not DVI.
                If you want to pass HDMI official CTS or compliance DVI device, enable it.

config AML_HDMI_TX_NEW_CEC_DRIVER                                                                                                                 
        bool "HDMI new CEC driver"                                                                                                                
        default n                                                                                                                                 
        help                                                                                                                                      
                hdmitx uses new CEC driver
endif

endmenu
```

## drivers/amlogic/i2c/Kconfig
```kconfig
menu  "I2C Hardware Bus support"
    depends on PLAT_MESON
config I2C_AML
        tristate "Amlogic I2C Driver"
        select I2C
        select I2C_CHARDEV
        select I2C_ALGOBIT
	help
          Yet another Amlogic I2C Driver, normal master

config I2C_SW_AML
        bool "Amlogic software I2C Driver"
        select I2C
        select I2C_CHARDEV
        select I2C_ALGOBIT
	help
          Amlogic software I2C Driver, normal gpio simulate I2C, bit algo
config BCM2079X_I2C
    bool "BCM2079X_I2C support"
    depends on I2C_AML
    help
      If you say yes here you get support for BCM2079x_I2C support

endmenu
```

## drivers/amlogic/input/Kconfig
```kconfig
#
# Input device configuration
#

menuconfig AM_INPUT
	bool "Input Device Support"
	default y
	help
	  "Input devices include keyboard, touchscreen, remote, sensor, etc."

if AM_INPUT

source "drivers/amlogic/input/saradc/Kconfig"
source "drivers/amlogic/input/remote/Kconfig"
source "drivers/amlogic/input/new_remote/Kconfig"
source "drivers/amlogic/input/keyboard/Kconfig"
source "drivers/amlogic/input/touchscreen/Kconfig"
source "drivers/amlogic/input/simcard_detect/Kconfig"
source "drivers/amlogic/input/holdkey/Kconfig"
source "drivers/amlogic/input/call_key/Kconfig"
source "drivers/amlogic/input/sensor/Kconfig"
source "drivers/amlogic/input/gpio_key/Kconfig"

endif
```

## drivers/amlogic/input/call_key/Kconfig
```kconfig
#
# Input core configuration
#



config AML_CALL_KEY
	tristate "Amlogic call key device surport"
	default n
	help
	  Say Y here if you want to use the amlogic call key.
```

## drivers/amlogic/input/gpio_key/Kconfig
```kconfig
#
# Input core configuration
#



config AML_GPIO_KEY
	tristate "Amlogic gpio key device surport"
	default n
	help
	  Say Y here if you want to use the amlogic hold key.
```

## drivers/amlogic/input/holdkey/Kconfig
```kconfig
#
# Input core configuration
#



config AML_HOLD_KEY
	tristate "Amlogic hold key device surport"
	depends on SWITCH
	default n
	help
	  Say Y here if you want to use the amlogic hold key.
```

## drivers/amlogic/input/keyboard/Kconfig
```kconfig
#
# Kyeboard device configuration
#

menuconfig MESON_INPUT_KEYBOARD
	bool "Keyboards and keypads"
	default y
	help
	  Say Y here, and a list of supported keyboards and keypads will be displayed.
	  This option doesn't affect the kernel.

	  If unsure, say Y.

if MESON_INPUT_KEYBOARD

config ADC_KEYPADS_AM
	tristate "Meson ADC keypad support"
	depends on SARADC_AM
	default n
	help
	  Say Y here if you want to use the Meson ADC keypad.

config KEY_INPUT_CUSTOM_AM
	tristate "Meson custom key input support"
        default n
        help
          Say Y here if you want to use the Meson custom key input.

config TOUCH_KEY_PAD_IT7230
	tristate "IT7230 capacitive touch keypad support"
	default n
	help
	  Say Y here if you want to use the IT7230 capacitive touch keypad.

config TOUCH_KEY_PAD_SO340010
	tristate "SO340010 capacitive touch keypad support"
	default n
	help
	  Say Y here if you want to use the SO340010 capacitive touch keypad.

config TOUCH_KEY_PAD_HA2605
        tristate "HA2605 touch keypad support"
        default n
        help
          Say Y here if you want to use the HA2605 touch keypad support.

endif # MESON_INPUT_KEYBOARD
```

## drivers/amlogic/input/new_remote/Kconfig
```kconfig
#
# Remote control drivers
#
menuconfig MESON_NEW_INPUT_REMOTE
	bool "M8 Remotes"
	default y
	help
	  Say Y here, and a list of supported remote controls will be displayed.
	  This option doesn't affect the kernel.

	  If unsure, say Y.

if MESON_NEW_INPUT_REMOTE

config NEW_AM_REMOTE
	tristate "Meson M8 IR remote control support"
	default n
	help
	  Say Y here if you want to use the Meson IR remote control.

config NEW_AM_IR_TX
	tristate "Meson M8 IR TX support"
	default n
	help
	  Say Y here if you want to use the Meson IR tx nec protocl& other protocl function.


endif # MESON_INPUT_REMOTE
```

## drivers/amlogic/input/remote/Kconfig
```kconfig
#
# Remote control drivers
#
menuconfig MESON_INPUT_REMOTE
	bool "Remotes"
	default y
	help
	  Say Y here, and a list of supported remote controls will be displayed.
	  This option doesn't affect the kernel.

	  If unsure, say Y.

if MESON_INPUT_REMOTE

config AM_REMOTE
	tristate "Meson IR remote control support"
	default n
	help
	  Say Y here if you want to use the Meson IR remote control.

config AM_IR_RECEIVER
	tristate "Meson IR receiver (self-learning) support"
	default n
	help
	  Say Y here if you want to use the Meson IR receiver (self-learning) function.

config VIRTUAL_REMOTE
	tristate "Meson virtual IR remote keypad support (EXPERIMENTAL)"
	default n
	help
	  Say Y here if you want to use the Meson virtual remote keypad.
	  It can fill a series of key events into input device for testing.

endif # MESON_INPUT_REMOTE
```

## drivers/amlogic/input/saradc/Kconfig
```kconfig
#
# Input core configuration
#
config SARADC_AM
	bool "Meson SAR ADC support"
	default n
	help
	  Say Y here if you want to use the Meson SAR ADC.
```

## drivers/amlogic/input/sensor/Kconfig
```kconfig
menuconfig SENSOR_DEVICES
	bool "Sensor devices"
	---help---
	  Say Y here to get to see options for sensor device drivers from
	  all categories. This option alone does not add any kernel code.

	  If you say N, all options in this submenu will be skipped and disabled.

if SENSOR_DEVICES

config GRAVITY_BMA250
	tristate "BMA250 acceleration sensor driver"
	depends on I2C=y
	help
	  If you say yes here you get support for Bosch Sensortec's 
	  acceleration sensors BMA250.

config GRAVITY_BMA222
	tristate "BMA222 acceleration sensor driver"
	depends on I2C=y
	help
	  If you say yes here you get support for Bosch Sensortec's 
	  acceleration sensors BMA222.

config GRAVITY_MMA7660
	tristate "MMA7660 acceleration sensor driver"
	depends on I2C
	help
	  If you say yes here you get support for the Freescale's accelerometer sensor MMA7660

config GRAVITY_MIR3DA
	tristate "MIR3DA acceleration sensor driver"
	depends on I2C
	help
	  If you say yes here you get support for the Freescale's accelerometer sensor MIR3DA

config GRAVITY_LIS3DH
	tristate "LIS3DH acceleration sensor driver"
	depends on I2C
	help
	  If you say yes here you get support for the Freescale's accelerometer sensor LIS3DH
 
config GRAVITY_MMA8452
	tristate "MMA8452 accelerometer sensor MMA8452 driver"
	depends on I2C
	help
	  If you say yes here you get support for the Freescale's accelerometer sensor MMA8452

config GRAVITY_MC32X0
	tristate "MC32X0 accelerometer sensor driver"
	depends on I2C && INPUT_POLLDEV
	help
	  Say yes here to support the MC32X0's accelerometer sensor MC32X0

config GRAVITY_DMARD06
	tristate "DMARD06 accelerometer sensor driver"
	depends on I2C
	help
	  Say yes here to support Dominteck's DMARD06 accelerometer sensor

config GRAVITY_MMA865X
	tristate "MMA865X accelerometer sensor driver"
	depends on I2C
	help
	  Say yes here to support the Freescale's MMA865X accelerometer sensor	  

config GRAVITY_LSM303D
	tristate "LSM303 sensor driver"
	depends on I2C
	help
	  Say yes here to support the sensor	 

config GRAVITY_DMARD10
 		tristate "DMARD10 GSENSOR support"
 		---help---
 		  Choose this option.
 		  If you say yes here you get support for accelerometer
 		  sensor DMARD10.

config GRAVITY_KXTJ9
 		tristate "KXTJ9 GSENSOR support"
 		---help---
 		  Choose this option.
 		  If you say yes here you get support for Kionix's accelerometer
 		  sensor KTXJ9.

config GRAVITY_STK8313
	tristate "STK8313 accelerometer sensor driver"
	depends on I2C
	help
	  Say yes here to support Sensortek's STK8313 accelerometer sensor

config GRAVITY_STK8312
	tristate "STK8312 accelerometer sensor driver"
	depends on I2C
	help
	  Say yes here to support Sensortek's STK8312 accelerometer sensor

config GRAVITY_MM3A310
 		tristate "MM3A310 GSENSOR support"
 		---help---
 		  Choose this option.
 		  If you say yes here you get support for MiraMEM's accelerometer
 		  sensor MM3A310.

config GRAVITY_MXC622X
	tristate "MXC622X 2-Axis acceleration sensor driver"
	depends on I2C=y
	help
	  If you say yes here you get support for Memsic's 2-Axis
	  acceleration sensors MXC622X.

config GRAVITY_MXC6255XC
	tristate "MXC6255XC 2-Axis acceleration sensor driver"
	depends on I2C=y
	help
	  If you say yes here you get support for Memsic's 2-Axis
	  acceleration sensors MXC6255XC.

config GYROSCOPE_L3GD20
	tristate "L3GD20 3-Axis gyroscope sensor driver"
	depends on I2C=y
	help
	  If you say yes here you get support for STMicroelectronics 3-Axis
	  gyroscope sensor L3GD20.
	  
config LIGHT_CM36283
	tristate "CM36283 light sensor driver"
	depends on I2C
	help
	  Say yes here to support Capella's CM36283 light sensor and proximity sensor     

config LIGHT_CM3232
	tristate "CM3232 light sensor driver"
	depends on I2C
	help
	  Say yes here to support Capella's CM3232 light sensor and proximity sensor     

config LIGHT_CM3217
	tristate "CM3217 light sensor driver"
	depends on I2C
	help
	  Say yes here to support Capella's CM3217 light sensor and proximity sensor     


config LIGHT_LTR501
 		tristate "LTR501 light sensor support"
 		help
 		  Choose this option.
 		  If you say yes here you get support for Lite-On's light 
 		  sensor LTR501.
	   	
config LIGHT_EPL6814
	tristate "EPL6814 light sensor driver"
	depends on I2C
	help
	   Say Y here to enable the EPL6814.

config LIGHT_ISL29023
	tristate "ISL29023 light sensor driver"
	depends on I2C
	help
	   Say Y here to enable Intersil's light sensor ISL29023.

config LIGHT_STK220X
	bool "STK2203 light sensor in polling mode"
	help
	    Say Y here to enable SensorTek's STK2203 using polling mode.

config LIGHT_LTR558
	bool "Liteon's light sensor LTR558"
	help
	    Say Y here to enable Liteon's LTR558 ambient light sensor.


endif # SENSOR_DEVICES 
```

## drivers/amlogic/input/simcard_detect/Kconfig
```kconfig
#
# Input core configuration
#



config SIMCARD_DETECT_AM
	tristate "Amlogic ADC sim card detect"
	depends on SARADC_AM
	default n
	help
	  Say Y here if you want to use the amlogic ADC sim card detect.
```
