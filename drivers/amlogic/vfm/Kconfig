## drivers/amlogic/vfm/Kconfig
```kconfig
#
# VFM configuration
#

config AML_VFM
	bool "Amlogic VFM Support"
	default y
	help
	  Select to enable VFM support
```

## drivers/amlogic/video_dev/Kconfig
```kconfig
menu "V4L2 Video Support"

config V4L_AMLOGIC_VIDEO
	tristate "Amlogic v4l video device support"
	select VIDEO_DEV
	select VIDEO_V4L2
	select VIDEOBUF_RESOURCE
	default n
	---help---
	  Select to enable "Amlogic v4l video device support.

config V4L_AMLOGIC_VIDEO2
	tristate "Amlogic v4l video2 device support"
	select VIDEO_DEV
	select VIDEOBUF_GEN
	select VIDEO_V4L2_COMMON
	select VIDEOBUF_RESOURCE
	select AM_GE2D
    	default n
	---help---
	  Select to enable "Amlogic v4l video2 device support.

endmenu
```

## drivers/amlogic/watchdog/Kconfig
```kconfig
#
# watchdog configuration
#


config AML_WDT
	bool "Amlogic Watchdog driver"
	select WATCHDOG
	select WATCHDOG_CORE
	default y
	help
	  say y to enable Amlogic watchdog driver.
```

## drivers/amlogic/wifi/Kconfig
```kconfig
menuconfig AM_WIFI
	bool "WiFi support"
	default n

if AM_WIFI
config AM_WIFI_SD_MMC
	bool "Amlogic SDIO Wi-Fi support"
	depends on AM_WIFI
	default n

config DHD_USE_STATIC_BUF
    bool "broadcom wifi static buff support"
    default n

config AM_WIFI_USB
	bool "Amlogic USB Wi-Fi Dongle Support"
	depends on AM_WIFI
	default n


endif # AM_WIFI
```
