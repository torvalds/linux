## drivers/phy/lantiq/Kconfig
```kconfig
# SPDX-License-Identifier: GPL-2.0-only
#
# Phy drivers for Lantiq / Intel platforms
#
config PHY_LANTIQ_VRX200_PCIE
	tristate "Lantiq VRX200/ARX300 PCIe PHY"
	depends on SOC_TYPE_XWAY || COMPILE_TEST
	depends on OF && HAS_IOMEM
	select GENERIC_PHY
	select REGMAP_MMIO
	help
	  Support for the PCIe PHY(s) on the Lantiq / Intel VRX200 and ARX300
	  family SoCs.
	  If unsure, say N.

config PHY_LANTIQ_RCU_USB2
	tristate "Lantiq XWAY SoC RCU based USB PHY"
	depends on OF && (SOC_TYPE_XWAY || COMPILE_TEST)
	select GENERIC_PHY
	help
	  Support for the USB PHY(s) on the Lantiq / Intel XWAY family SoCs.
```

## drivers/phy/m31/Kconfig
```kconfig
# SPDX-License-Identifier: GPL-2.0-only
#
# Phy drivers for Starfive platforms
#

config PHY_M31_DPHY_RX0
	tristate "Starfive M31 MIPI DPHY TX Driver"
	select GENERIC_PHY_MIPI_DPHY
	select GENERIC_PHY
	help
	  Enable this to support the starfive MIPI  DPHY TX0

	  To compile this driver as a module, choose M here: the module
	  will be called phy-starfive-dphy-tx0.
```

## drivers/phy/marvell/Kconfig
```kconfig
# SPDX-License-Identifier: GPL-2.0-only
#
# Phy drivers for Marvell platforms
#
config ARMADA375_USBCLUSTER_PHY
	def_bool y
	depends on MACH_ARMADA_375 || COMPILE_TEST
	depends on OF && HAS_IOMEM
	select GENERIC_PHY

config PHY_BERLIN_SATA
	tristate "Marvell Berlin SATA PHY driver"
	depends on ARCH_BERLIN && HAS_IOMEM && OF
	select GENERIC_PHY
	help
	  Enable this to support the SATA PHY on Marvell Berlin SoCs.

config PHY_BERLIN_USB
	tristate "Marvell Berlin USB PHY Driver"
	depends on ARCH_BERLIN && RESET_CONTROLLER && HAS_IOMEM && OF
	select GENERIC_PHY
	help
	  Enable this to support the USB PHY on Marvell Berlin SoCs.

config PHY_MVEBU_A3700_COMPHY
	tristate "Marvell A3700 comphy driver"
	depends on ARCH_MVEBU || COMPILE_TEST
	depends on OF
	depends on HAVE_ARM_SMCCC
	default y
	select GENERIC_PHY
	help
	  This driver allows to control the comphy, a hardware block providing
	  shared serdes PHYs on Marvell Armada 3700. Its serdes lanes can be
	  used by various controllers: Ethernet, SATA, USB3, PCIe.

config PHY_MVEBU_A3700_UTMI
	tristate "Marvell A3700 UTMI driver"
	depends on ARCH_MVEBU || COMPILE_TEST
	depends on OF
	default y
	select GENERIC_PHY
	help
	  Enable this to support Marvell A3700 UTMI PHY driver.

config PHY_MVEBU_A38X_COMPHY
	tristate "Marvell Armada 38x comphy driver"
	depends on ARCH_MVEBU || COMPILE_TEST
	depends on OF
	select GENERIC_PHY
	help
	  This driver allows to control the comphy, an hardware block providing
	  shared serdes PHYs on Marvell Armada 38x. Its serdes lanes can be
	  used by various controllers (Ethernet, sata, usb, PCIe...).

config PHY_MVEBU_CP110_COMPHY
	tristate "Marvell CP110 comphy driver"
	depends on ARCH_MVEBU || COMPILE_TEST
	depends on OF
	select GENERIC_PHY
	help
	  This driver allows to control the comphy, an hardware block providing
	  shared serdes PHYs on Marvell Armada 7k/8k (in the CP110). Its serdes
	  lanes can be used by various controllers (Ethernet, sata, usb,
	  PCIe...).

config PHY_MVEBU_SATA
	def_bool y
	depends on ARCH_DOVE || MACH_DOVE || MACH_KIRKWOOD
	depends on OF
	select GENERIC_PHY

config PHY_PXA_28NM_HSIC
	tristate "Marvell USB HSIC 28nm PHY Driver"
	depends on HAS_IOMEM
	select GENERIC_PHY
	help
	  Enable this to support Marvell USB HSIC PHY driver for Marvell
	  SoC. This driver will do the PHY initialization and shutdown.
	  The PHY driver will be used by Marvell ehci driver.

	  To compile this driver as a module, choose M here.

config PHY_PXA_28NM_USB2
	tristate "Marvell USB 2.0 28nm PHY Driver"
	depends on HAS_IOMEM
	select GENERIC_PHY
	help
	  Enable this to support Marvell USB 2.0 PHY driver for Marvell
	  SoC. This driver will do the PHY initialization and shutdown.
	  The PHY driver will be used by Marvell udc/ehci/otg driver.

	  To compile this driver as a module, choose M here.

config PHY_PXA_USB
	tristate "Marvell PXA USB PHY Driver"
	depends on ARCH_PXA || ARCH_MMP
	select GENERIC_PHY
	help
	  Enable this to support Marvell PXA USB PHY driver for Marvell
	  SoC. This driver will do the PHY initialization and shutdown.
	  The PHY driver will be used by Marvell udc/ehci/otg driver.

	  To compile this driver as a module, choose M here.
```

## drivers/phy/mediatek/Kconfig
```kconfig
# SPDX-License-Identifier: GPL-2.0-only
#
# Phy drivers for Mediatek devices
#
config PHY_MTK_PCIE
	tristate "MediaTek PCIe-PHY Driver"
	depends on ARCH_MEDIATEK || COMPILE_TEST
	depends on OF
	select GENERIC_PHY
	help
	  Say 'Y' here to add support for MediaTek PCIe PHY driver.
	  This driver create the basic PHY instance and provides initialize
	  callback for PCIe GEN3 port, it supports software efuse
	  initialization.

config PHY_MTK_XFI_TPHY
	tristate "MediaTek 10GE SerDes XFI T-PHY driver"
	depends on ARCH_MEDIATEK || COMPILE_TEST
	depends on OF
	select GENERIC_PHY
	help
	  Say 'Y' here to add support for MediaTek XFI T-PHY driver.
	  The driver provides access to the Ethernet SerDes T-PHY supporting
	  1GE and 2.5GE modes via the LynxI PCS, and 5GE and 10GE modes
	  via the USXGMII PCS found in MediaTek SoCs with 10G Ethernet.

config PHY_MTK_TPHY
	tristate "MediaTek T-PHY Driver"
	depends on ARCH_MEDIATEK || COMPILE_TEST
	depends on OF && OF_ADDRESS
	depends on HAS_IOMEM
	select GENERIC_PHY
	help
	  Say 'Y' here to add support for MediaTek T-PHY driver,
	  it supports multiple usb2.0, usb3.0 ports, PCIe and
	  SATA, and meanwhile supports two version T-PHY which have
	  different banks layout, the T-PHY with shared banks between
	  multi-ports is first version, otherwise is second version,
	  so you can easily distinguish them by banks layout.

config PHY_MTK_UFS
	tristate "MediaTek UFS M-PHY driver"
	depends on ARCH_MEDIATEK || COMPILE_TEST
	depends on OF
	select GENERIC_PHY
	help
	  Support for UFS M-PHY on MediaTek chipsets.
	  Enable this to provide vendor-specific probing,
	  initialization, power on and power off flow of
	  specified M-PHYs.

config PHY_MTK_XSPHY
	tristate "MediaTek XS-PHY Driver"
	depends on ARCH_MEDIATEK || COMPILE_TEST
	depends on OF && OF_ADDRESS
	depends on HAS_IOMEM
	select GENERIC_PHY
	help
	  Enable this to support the SuperSpeedPlus XS-PHY transceiver for
	  USB3.1 GEN2 controllers on MediaTek chips. The driver supports
	  multiple USB2.0, USB3.1 GEN2 ports.

config PHY_MTK_HDMI
	tristate "MediaTek HDMI-PHY Driver"
	depends on ARCH_MEDIATEK || COMPILE_TEST
	depends on COMMON_CLK
	depends on OF
	select GENERIC_PHY
	help
	  Support HDMI PHY for Mediatek SoCs.

config PHY_MTK_MIPI_CSI_0_5
	tristate "MediaTek MIPI CSI CD-PHY v0.5 Driver"
	depends on ARCH_MEDIATEK || COMPILE_TEST
	depends on OF
	select GENERIC_PHY
	help
	  Enable this to support the MIPI CSI CD-PHY receiver version 0.5.
	  The driver supports multiple CSI cdphy ports simultaneously.

	  To compile this driver as a module, choose M here: the
	  module will be called phy-mtk-mipi-csi-0-5.

config PHY_MTK_MIPI_DSI
	tristate "MediaTek MIPI-DSI Driver"
	depends on ARCH_MEDIATEK || COMPILE_TEST
	depends on COMMON_CLK
	depends on OF
	select GENERIC_PHY
	help
	  Support MIPI DSI for Mediatek SoCs.

config PHY_MTK_DP
	tristate "MediaTek DP-PHY Driver"
	depends on ARCH_MEDIATEK || COMPILE_TEST
	depends on OF
	select GENERIC_PHY
	help
	  Support DisplayPort PHY for MediaTek SoCs.
```
