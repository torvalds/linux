## drivers/phy/allwinner/Kconfig
```kconfig
#
# Phy drivers for Allwinner platforms
#
config PHY_SUN4I_USB
	tristate "Allwinner sunxi SoC USB PHY driver"
	depends on ARCH_SUNXI && HAS_IOMEM && OF
	depends on RESET_CONTROLLER
	depends on EXTCON
	depends on POWER_SUPPLY
	depends on USB_SUPPORT
	select GENERIC_PHY
	select USB_COMMON
	help
	  Enable this to support the transceiver that is part of Allwinner
	  sunxi SoCs.

	  This driver controls the entire USB PHY block, both the USB OTG
	  parts, as well as the 2 regular USB 2 host PHYs.

config PHY_SUN6I_MIPI_DPHY
	tristate "Allwinner A31 MIPI D-PHY Support"
	depends on ARCH_SUNXI && HAS_IOMEM && OF
	depends on RESET_CONTROLLER
	select GENERIC_PHY
	select GENERIC_PHY_MIPI_DPHY
	select REGMAP_MMIO
	help
	  Choose this option if you have an Allwinner SoC with
	  MIPI-DSI support. If M is selected, the module will be
	  called sun6i_mipi_dphy.

config PHY_SUN9I_USB
	tristate "Allwinner sun9i SoC USB PHY driver"
	depends on ARCH_SUNXI && HAS_IOMEM && OF
	depends on RESET_CONTROLLER
	depends on USB_SUPPORT
	select USB_COMMON
	select GENERIC_PHY
	help
	  Enable this to support the transceiver that is part of Allwinner
	  sun9i SoCs.

	  This driver controls each individual USB 2 host PHY.
```

## drivers/phy/amlogic/Kconfig
```kconfig
# SPDX-License-Identifier: GPL-2.0-only
#
# Phy drivers for Amlogic platforms
#
config PHY_MESON8B_USB2
	tristate "Meson8, Meson8b, Meson8m2 and GXBB USB2 PHY driver"
	default ARCH_MESON
	depends on OF && (ARCH_MESON || COMPILE_TEST)
	depends on USB_SUPPORT
	select USB_COMMON
	select GENERIC_PHY
	select REGMAP_MMIO
	help
	  Enable this to support the Meson USB2 PHYs found in Meson8,
	  Meson8b and GXBB SoCs.
	  If unsure, say N.

config PHY_MESON_GXL_USB2
	tristate "Meson GXL and GXM USB2 PHY drivers"
	default ARCH_MESON
	depends on OF && (ARCH_MESON || COMPILE_TEST)
	depends on USB_SUPPORT
	select GENERIC_PHY
	select REGMAP_MMIO
	help
	  Enable this to support the Meson USB2 PHYs found in Meson
	  GXL and GXM SoCs.
	  If unsure, say N.

config PHY_MESON_G12A_USB2
	tristate "Meson G12A USB2 PHY driver"
	default ARCH_MESON
	depends on OF && (ARCH_MESON || COMPILE_TEST)
	select GENERIC_PHY
	select REGMAP_MMIO
	help
	  Enable this to support the Meson USB2 PHYs found in Meson
	  G12A SoCs.
	  If unsure, say N.

config PHY_MESON_G12A_USB3_PCIE
	tristate "Meson G12A USB3+PCIE Combo PHY driver"
	default ARCH_MESON
	depends on OF && (ARCH_MESON || COMPILE_TEST)
	select GENERIC_PHY
	select REGMAP_MMIO
	help
	  Enable this to support the Meson USB3 + PCIE Combo PHY found
	  in Meson G12A SoCs.
	  If unsure, say N.

config PHY_MESON_AXG_PCIE
	tristate "Meson AXG PCIE PHY driver"
	default ARCH_MESON
	depends on OF && (ARCH_MESON || COMPILE_TEST)
	select GENERIC_PHY
	select REGMAP_MMIO
	help
	  Enable this to support the Meson MIPI + PCIE PHY found
	  in Meson AXG SoCs.
	  If unsure, say N.

config PHY_MESON_AXG_MIPI_PCIE_ANALOG
	tristate "Meson AXG MIPI + PCIE analog PHY driver"
	default ARCH_MESON
	depends on OF && (ARCH_MESON || COMPILE_TEST)
	select GENERIC_PHY
	select REGMAP_MMIO
	select GENERIC_PHY_MIPI_DPHY
	help
	  Enable this to support the Meson MIPI + PCIE analog PHY
	  found in Meson AXG SoCs.
	  If unsure, say N.

config PHY_MESON_AXG_MIPI_DPHY
	tristate "Meson AXG MIPI DPHY driver"
	default ARCH_MESON
	depends on OF && (ARCH_MESON || COMPILE_TEST)
	select GENERIC_PHY
	select REGMAP_MMIO
	select GENERIC_PHY_MIPI_DPHY
	help
	  Enable this to support the Meson MIPI DPHY found in Meson AXG
	  SoCs.
	  If unsure, say N.
```

## drivers/phy/apple/Kconfig
```kconfig
# SPDX-License-Identifier: GPL-2.0 OR BSD-2-Clause
config PHY_APPLE_ATC
	tristate "Apple Type-C PHY"
	depends on (ARM64 && ARCH_APPLE) || (COMPILE_TEST && !GENERIC_ATOMIC64)
	depends on TYPEC
	select GENERIC_PHY
	select APPLE_TUNABLE
	help
	  Enable this to add support for the Apple Type-C PHY found in
	  Apple Silicon M-series SoCs. This PHY supports USB2,
	  USB3, USB4, Thunderbolt, and DisplayPort.

	  If M is selected the module will be called 'phy-apple-atc'.
```

## drivers/phy/axiado/Kconfig
```kconfig
#
# PHY drivers for Axiado platforms
#

config PHY_AX3000_EMMC
	tristate "Axiado eMMC PHY driver"
	depends on OF && (ARCH_AXIADO || COMPILE_TEST)
	select GENERIC_PHY
	help
	  Enables this to support for the AX3000 EMMC PHY driver.
	  If unsure, say N.
```

## drivers/phy/broadcom/Kconfig
```kconfig
# SPDX-License-Identifier: GPL-2.0-only
#
# Phy drivers for Broadcom platforms
#
config PHY_BCM63XX_USBH
	tristate "BCM63xx USBH PHY driver"
	depends on BMIPS_GENERIC || COMPILE_TEST
	select GENERIC_PHY
	help
	  Enable this to support the BCM63xx USBH PHY driver.
	  If unsure, say N.

config PHY_CYGNUS_PCIE
	tristate "Broadcom Cygnus PCIe PHY driver"
	depends on OF && (ARCH_BCM_CYGNUS || COMPILE_TEST)
	select GENERIC_PHY
	default ARCH_BCM_CYGNUS
	help
	  Enable this to support the Broadcom Cygnus PCIe PHY.
	  If unsure, say N.

config PHY_BCM_SR_USB
	tristate "Broadcom Stingray USB PHY driver"
	depends on OF && (ARCH_BCM_IPROC || COMPILE_TEST)
	select GENERIC_PHY
	default ARCH_BCM_IPROC
	help
	  Enable this to support the Broadcom Stingray USB PHY
	  driver. It supports all versions of Superspeed and
	  Highspeed PHYs.
	  If unsure, say N.

config BCM_KONA_USB2_PHY
	tristate "Broadcom Kona USB2 PHY Driver"
	depends on HAS_IOMEM
	select GENERIC_PHY
	help
	  Enable this to support the Broadcom Kona USB 2.0 PHY.

config PHY_BCM_NS_USB2
	tristate "Broadcom Northstar USB 2.0 PHY Driver"
	depends on ARCH_BCM_IPROC || COMPILE_TEST
	depends on HAS_IOMEM && OF
	select GENERIC_PHY
	help
	  Enable this to support Broadcom USB 2.0 PHY connected to the USB
	  controller on Northstar family.

config PHY_BCM_NS_USB3
	tristate "Broadcom Northstar USB 3.0 PHY Driver"
	depends on ARCH_BCM_IPROC || COMPILE_TEST
	depends on HAS_IOMEM && OF
	depends on MDIO_BUS
	select GENERIC_PHY
	help
	  Enable this to support Broadcom USB 3.0 PHY connected to the USB
	  controller on Northstar family.

config PHY_NS2_PCIE
	tristate "Broadcom Northstar2 PCIe PHY driver"
	depends on (OF && MDIO_BUS_MUX_BCM_IPROC) || (COMPILE_TEST && MDIO_BUS)
	select GENERIC_PHY
	default ARCH_BCM_IPROC
	help
	  Enable this to support the Broadcom Northstar2 PCIe PHY.
	  If unsure, say N.

config PHY_NS2_USB_DRD
	tristate "Broadcom Northstar2 USB DRD PHY support"
	depends on OF && (ARCH_BCM_IPROC || COMPILE_TEST)
	select GENERIC_PHY
	select EXTCON
	default ARCH_BCM_IPROC
	help
	  Enable this to support the Broadcom Northstar2 USB DRD PHY.
	  This driver initializes the PHY in either HOST or DEVICE mode.
	  The host or device configuration is read from device tree.

	  If unsure, say N.

config PHY_BRCM_SATA
	tristate "Broadcom SATA PHY driver"
	depends on ARCH_BRCMSTB || ARCH_BCM_IPROC || BMIPS_GENERIC || \
		   ARCH_BCM_63XX || COMPILE_TEST
	depends on OF
	select GENERIC_PHY
	default ARCH_BCM_IPROC
	help
	  Enable this to support the Broadcom SATA PHY.
	  If unsure, say N.

config PHY_BRCM_USB
	tristate "Broadcom STB USB PHY driver"
	depends on ARCH_BCM4908 || ARCH_BRCMSTB || COMPILE_TEST
	depends on OF
	select GENERIC_PHY
	select SOC_BRCMSTB if ARCH_BRCMSTB
	default ARCH_BCM4908 || ARCH_BRCMSTB
	help
	  Enable this to support the Broadcom STB USB PHY.
	  This driver is required by the USB XHCI, EHCI and OHCI
	  drivers.
	  If unsure, say N.

config PHY_BCM_SR_PCIE
	tristate "Broadcom Stingray PCIe PHY driver"
	depends on OF && (ARCH_BCM_IPROC || COMPILE_TEST)
	select GENERIC_PHY
	select MFD_SYSCON
	default ARCH_BCM_IPROC
	help
	  Enable this to support the Broadcom Stingray PCIe PHY
	  If unsure, say N.
```

## drivers/phy/cadence/Kconfig
```kconfig
# SPDX-License-Identifier: GPL-2.0-only
#
# Phy drivers for Cadence PHYs
#

config PHY_CADENCE_TORRENT
	tristate "Cadence Torrent PHY driver"
	depends on OF
	depends on HAS_IOMEM
	depends on COMMON_CLK
	select GENERIC_PHY
	help
	  Support for Cadence Torrent PHY.

config PHY_CADENCE_DPHY
	tristate "Cadence D-PHY Support"
	depends on HAS_IOMEM && OF
	select GENERIC_PHY
	select GENERIC_PHY_MIPI_DPHY
	help
	  Choose this option if you have a Cadence D-PHY in your
	  system. If M is selected, the module will be called
	  cdns-dphy.

config PHY_CADENCE_DPHY_RX
	tristate "Cadence D-PHY Rx Support"
	depends on HAS_IOMEM && OF
	select GENERIC_PHY
	select GENERIC_PHY_MIPI_DPHY
	help
	  Support for Cadence D-PHY in Rx configuration.

config PHY_CADENCE_SIERRA
	tristate "Cadence Sierra PHY Driver"
	depends on OF && HAS_IOMEM && RESET_CONTROLLER
	depends on COMMON_CLK
	select GENERIC_PHY
	help
	  Enable this to support the Cadence Sierra PHY driver

config PHY_CADENCE_SALVO
	tristate "Cadence Salvo PHY Driver"
	depends on OF && HAS_IOMEM
	select GENERIC_PHY
	help
	  Enable this to support the Cadence SALVO PHY driver,
	  this PHY is a legacy PHY, and only are used for USB3
	  and USB2.
```

## drivers/phy/canaan/Kconfig
```kconfig
# SPDX-License-Identifier: GPL-2.0-only
#
# Phy drivers for Canaan platforms
#
config PHY_CANAAN_USB
	tristate "Canaan USB2 PHY Driver"
	depends on (ARCH_CANAAN || COMPILE_TEST) && OF
	select GENERIC_PHY
	help
	Enable this driver to support the USB 2.0 PHY controller
	on Canaan K230 RISC-V SoCs. This PHY controller
	provides physical layer functionality for USB 2.0 devices.
	If you have a Canaan K230 board and need USB 2.0 support,
	say Y or M here.
```

## drivers/phy/eswin/Kconfig
```kconfig
# SPDX-License-Identifier: GPL-2.0-only
#
# Phy drivers for ESWIN platforms
#
config PHY_EIC7700_SATA
	tristate "eic7700 Sata SerDes/PHY driver"
	depends on ARCH_ESWIN || COMPILE_TEST
	depends on HAS_IOMEM
	select GENERIC_PHY
	help
	  Enable this to support SerDes/Phy found on ESWIN's
	  EIC7700 SoC. This Phy supports SATA 1.5 Gb/s,
	  SATA 3.0 Gb/s, SATA 6.0 Gb/s speeds.
	  It supports one SATA host port to accept one SATA device.
```

## drivers/phy/freescale/Kconfig
```kconfig
# SPDX-License-Identifier: GPL-2.0-only

if (ARCH_MXC && ARM64) || COMPILE_TEST

config PHY_FSL_IMX8MQ_USB
	tristate "Freescale i.MX8M USB3 PHY"
	depends on OF && HAS_IOMEM
	select GENERIC_PHY
	default ARCH_MXC && ARM64

config PHY_MIXEL_LVDS_PHY
	tristate "Mixel LVDS PHY support"
	depends on OF
	select GENERIC_PHY
	select REGMAP_MMIO
	help
	  Enable this to add support for the Mixel LVDS PHY as found
	  on NXP's i.MX8qm SoC.

config PHY_MIXEL_MIPI_DPHY
	tristate "Mixel MIPI DSI PHY support"
	depends on OF && HAS_IOMEM
	select GENERIC_PHY
	select GENERIC_PHY_MIPI_DPHY
	select REGMAP_MMIO
	help
	  Enable this to add support for the Mixel DSI PHY as found
	  on NXP's i.MX8 family of SOCs.

config PHY_FSL_IMX8M_PCIE
	tristate "Freescale i.MX8M PCIE PHY"
	depends on OF && HAS_IOMEM
	select GENERIC_PHY
	help
	  Enable this to add support for the PCIE PHY as found on
	  i.MX8M family of SOCs.

config PHY_FSL_IMX8QM_HSIO
	tristate "Freescale i.MX8QM HSIO PHY"
	depends on OF && HAS_IOMEM
	select GENERIC_PHY
	help
	  Enable this to add support for the HSIO PHY as found on
	  i.MX8QM family of SOCs.

config PHY_FSL_SAMSUNG_HDMI_PHY
	tristate "Samsung HDMI PHY support"
	depends on OF && HAS_IOMEM && COMMON_CLK
	help
	  Enable this to add support for the Samsung HDMI PHY in i.MX8MP.
endif

config PHY_FSL_LYNX_28G
	tristate "Freescale Layerscape Lynx 28G SerDes PHY support"
	depends on OF
	depends on ARCH_LAYERSCAPE || COMPILE_TEST
	select GENERIC_PHY
	help
	  Enable this to add support for the Lynx SerDes 28G PHY as
	  found on NXP's Layerscape platforms such as LX2160A.
	  Used to change the protocol running on SerDes lanes at runtime.
	  Only useful for a restricted set of Ethernet protocols.
```

## drivers/phy/hisilicon/Kconfig
```kconfig
# SPDX-License-Identifier: GPL-2.0-only
#
# Phy drivers for Hisilicon platforms
#
config PHY_HI6220_USB
	tristate "hi6220 USB PHY support"
	depends on (ARCH_HISI && ARM64) || COMPILE_TEST
	depends on HAS_IOMEM
	select GENERIC_PHY
	select MFD_SYSCON
	help
	  Enable this to support the HISILICON HI6220 USB PHY.

	  To compile this driver as a module, choose M here.

config PHY_HI3660_USB
	tristate "hi3660 USB PHY support"
	depends on (ARCH_HISI && ARM64) || COMPILE_TEST
	select GENERIC_PHY
	select MFD_SYSCON
	help
	  Enable this to support the HISILICON HI3660 USB PHY.

	  To compile this driver as a module, choose M here.

config PHY_HI3670_USB
	tristate "hi3670 USB PHY support"
	depends on (ARCH_HISI && ARM64) || COMPILE_TEST
	select GENERIC_PHY
	select MFD_SYSCON
	help
	  Enable this to support the HISILICON HI3670 USB PHY.

	  To compile this driver as a module, choose M here.

config PHY_HISTB_COMBPHY
	tristate "HiSilicon STB SoCs COMBPHY support"
	depends on (ARCH_HISI && ARM64) || COMPILE_TEST
	select GENERIC_PHY
	select MFD_SYSCON
	help
	  Enable this to support the HISILICON STB SoCs COMBPHY.
	  If unsure, say N.

config PHY_HISI_INNO_USB2
	tristate "HiSilicon INNO USB2 PHY support"
	depends on (ARCH_HISI && ARM64) || COMPILE_TEST
	select GENERIC_PHY
	select MFD_SYSCON
	help
	  Support for INNO USB2 PHY on HiSilicon SoCs. This Phy supports
	  USB 1.5Mb/s, USB 12Mb/s, USB 480Mb/s speeds. It supports one
	  USB host port to accept one USB device.

config PHY_HIX5HD2_SATA
	tristate "HIX5HD2 SATA PHY Driver"
	depends on ARCH_HIX5HD2 && OF && HAS_IOMEM
	select GENERIC_PHY
	select MFD_SYSCON
	help
	  Support for SATA PHY on Hisilicon hix5hd2 Soc.
```

## drivers/phy/ingenic/Kconfig
```kconfig
# SPDX-License-Identifier: GPL-2.0
#
# Phy drivers for Ingenic platforms
#
config PHY_INGENIC_USB
	tristate "Ingenic SoCs USB PHY Driver"
	depends on MIPS || COMPILE_TEST
	depends on USB_SUPPORT
	depends on HAS_IOMEM
	select GENERIC_PHY
	help
	  This driver provides USB PHY support for the USB controller found
	  on the JZ-series and X-series SoCs from Ingenic.
```

## drivers/phy/intel/Kconfig
```kconfig
# SPDX-License-Identifier: GPL-2.0
#
# Phy drivers for Intel platforms
#
config PHY_INTEL_KEEMBAY_EMMC
	tristate "Intel Keem Bay EMMC PHY driver"
	depends on ARCH_KEEMBAY || COMPILE_TEST
	depends on HAS_IOMEM
	select GENERIC_PHY
	select REGMAP_MMIO
	help
	  Choose this option if you have an Intel Keem Bay SoC.

	  To compile this driver as a module, choose M here: the module
	  will be called phy-keembay-emmc.ko.

config PHY_INTEL_KEEMBAY_USB
	tristate "Intel Keem Bay USB PHY driver"
	depends on ARCH_KEEMBAY || COMPILE_TEST
	depends on HAS_IOMEM
	select GENERIC_PHY
	select REGMAP_MMIO
	help
	  Choose this option if you have an Intel Keem Bay SoC.

	  To compile this driver as a module, choose M here: the module
	  will be called phy-keembay-usb.ko.

config PHY_INTEL_LGM_COMBO
	bool "Intel Lightning Mountain ComboPHY driver"
	depends on X86 || COMPILE_TEST
	depends on OF && HAS_IOMEM
	select MFD_SYSCON
	select GENERIC_PHY
	select REGMAP
	help
	  Enable this to support Intel ComboPhy.

	  This driver configures ComboPhy subsystem on Intel gateway
	  chipsets which provides PHYs for various controllers, EMAC,
	  SATA and PCIe.

config PHY_INTEL_LGM_EMMC
	tristate "Intel Lightning Mountain EMMC PHY driver"
	depends on X86 || COMPILE_TEST
	select GENERIC_PHY
	help
	  Enable this to support the Intel EMMC PHY

config PHY_INTEL_THUNDERBAY_EMMC
        tristate "Intel Thunder Bay eMMC PHY driver"
        depends on OF && (ARCH_THUNDERBAY || COMPILE_TEST)
        select GENERIC_PHY
        help
	  This option enables support for Intel Thunder Bay SoC eMMC PHY.

	  To compile this driver as a module, choose M here: the module
	  will be called phy-intel-thunderbay-emmc.ko.
```
