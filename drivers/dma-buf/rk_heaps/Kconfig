## drivers/dma-buf/rk_heaps/Kconfig
```kconfig
# SPDX-License-Identifier: GPL-2.0-only
menuconfig DMABUF_HEAPS_ROCKCHIP
	bool "DMA-BUF Userland Memory Heaps for RockChip"
	select DMA_SHARED_BUFFER
	help
	  Choose this option to enable the RockChip DMA-BUF userland memory heaps.
	  This options creates per heap chardevs in /dev/rk_dma_heap/ which
	  allows userspace to allocate dma-bufs that can be shared
	  between drivers.

config DMABUF_HEAPS_ROCKCHIP_CMA_HEAP
	tristate "DMA-BUF RockChip CMA Heap"
	depends on DMABUF_HEAPS_ROCKCHIP
	help
	  Choose this option to enable dma-buf RockChip CMA heap. This heap is backed
	  by the Contiguous Memory Allocator (CMA). If your system has these
	  regions, you should say Y here.

config DMABUF_HEAPS_ROCKCHIP_CMA_ALIGNMENT
	int "Maximum PAGE_SIZE order of alignment for RockChip CMA Heap"
	range 0 12
	depends on DMABUF_HEAPS_ROCKCHIP_CMA_HEAP
	default 8
	help
	  DMA mapping framework by default aligns all buffers to the smallest
	  PAGE_SIZE order which is greater than or equal to the requested buffer
	  size. This works well for buffers up to a few hundreds kilobytes, but
	  for larger buffers it just a memory waste. With this parameter you can
	  specify the maximum PAGE_SIZE order for contiguous buffers. Larger
	  buffers will be aligned only to this specified order. The order is
	  expressed as a power of two multiplied by the PAGE_SIZE.

	  For example, if your system defaults to 4KiB pages, the order value
	  of 8 means that the buffers will be aligned up to 1MiB only.

	  If unsure, leave the default value "8".

config DMABUF_RK_HEAPS_DEBUG
	bool "DMA-BUF RockChip Heap Debug"
	depends on DMABUF_HEAPS_ROCKCHIP
	help
	  Choose this option to enable dma-buf RockChip heap debug.

config DMABUF_RK_HEAPS_DEBUG_PRINT
	bool "DMA-BUF RockChip Heap Debug print log enable"
	depends on DMABUF_HEAPS_ROCKCHIP
	help
	  Choose this option to enable dma-buf RockChip heap debug.
```
