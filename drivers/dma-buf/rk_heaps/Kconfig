## drivers/eisa/Kconfig
```kconfig
# SPDX-License-Identifier: GPL-2.0-only
#
# EISA configuration
#

config HAVE_EISA
	bool

menuconfig EISA
	bool "EISA support"
	depends on HAVE_EISA
	---help---
	  The Extended Industry Standard Architecture (EISA) bus was
	  developed as an open alternative to the IBM MicroChannel bus.

	  The EISA bus provided some of the features of the IBM MicroChannel
	  bus while maintaining backward compatibility with cards made for
	  the older ISA bus.  The EISA bus saw limited use between 1988 and
	  1995 when it was made obsolete by the PCI bus.

	  Say Y here if you are building a kernel for an EISA-based machine.

	  Otherwise, say N.

config EISA_VLB_PRIMING
	bool "Vesa Local Bus priming"
	depends on X86 && EISA
	default n
	---help---
	  Activate this option if your system contains a Vesa Local
	  Bus (VLB) card that identify itself as an EISA card (such as
	  the Adaptec AHA-284x).

	  When in doubt, say N.

config EISA_PCI_EISA
	bool "Generic PCI/EISA bridge"
	depends on !PARISC && PCI && EISA
	default y
	---help---
	  Activate this option if your system contains a PCI to EISA
	  bridge. If your system have both PCI and EISA slots, you
	  certainly need this option.

	  When in doubt, say Y.

# Using EISA_VIRTUAL_ROOT on something other than an Alpha or
# an X86 may lead to crashes...

config EISA_VIRTUAL_ROOT
	bool "EISA virtual root device"
	depends on EISA && (ALPHA || X86)
	default y
	---help---
	  Activate this option if your system only have EISA bus
	  (no PCI slots). The Alpha Jensen is an example of such
	  a system.

	  When in doubt, say Y.

config EISA_NAMES
	bool "EISA device name database"
	depends on EISA
	default y
	---help---
	  By default, the kernel contains a database of all known EISA
	  device names to make the information in sysfs comprehensible
	  to the user. This database increases size of the kernel
	  image by about 40KB, but it gets freed after the system
	  boots up, so it doesn't take up kernel memory. Anyway, if
	  you are building an installation floppy or kernel for an
	  embedded system where kernel image size really matters, you
	  can disable this feature and you'll get device ID instead of
	  names.

	  When in doubt, say Y.
```

## drivers/energy_model/Kconfig
```kconfig
config LEGACY_ENERGY_MODEL_DT
	bool "Legacy DT-based Energy Model of CPUs"
	default n
	help
	  The Energy Aware Scheduler (EAS) used to rely on Energy Models
	  (EMs) statically defined in the Device Tree. More recent
	  versions of EAS now rely on the EM framework to get the power
	  costs of CPUs.

	  This driver reads old-style static EMs in DT and feeds them in
	  the EM framework, hence enabling to use EAS on platforms with
	  old DT files. Since EAS now uses only the active costs of CPUs,
	  the cluster-related costs and idle-costs of the old EM are
	  ignored.

	  If in doubt, say N.
```

## drivers/extcon/Kconfig
```kconfig
# SPDX-License-Identifier: GPL-2.0-only
menuconfig EXTCON
	tristate "External Connector Class (extcon) support"
	help
	  Say Y here to enable external connector class (extcon) support.
	  This allows monitoring external connectors by userspace
	  via sysfs and uevent and supports external connectors with
	  multiple states; i.e., an extcon that may have multiple
	  cables attached. For example, an external connector of a device
	  may be used to connect an HDMI cable and a AC adaptor, and to
	  host USB ports. Many of 30-pin connectors including PDMI are
	  also good examples.

if EXTCON

comment "Extcon Device Drivers"

config EXTCON_ADC_JACK
	tristate "ADC Jack extcon support"
	depends on IIO
	help
	  Say Y here to enable extcon device driver based on ADC values.

config EXTCON_ARIZONA
	tristate "Wolfson Arizona EXTCON support"
	depends on MFD_ARIZONA && INPUT && SND_SOC
	help
	  Say Y here to enable support for external accessory detection
	  with Wolfson Arizona devices. These are audio CODECs with
	  advanced audio accessory detection support.

config EXTCON_AXP288
	tristate "X-Power AXP288 EXTCON support"
	depends on MFD_AXP20X && USB_SUPPORT && X86 && ACPI
	select USB_ROLE_SWITCH
	help
	  Say Y here to enable support for USB peripheral detection
	  and USB MUX switching by X-Power AXP288 PMIC.

config EXTCON_FSA9480
	tristate "FSA9480 EXTCON Support"
	depends on INPUT && I2C
	select IRQ_DOMAIN
	select REGMAP_I2C
	help
	  If you say yes here you get support for the Fairchild Semiconductor
	  FSA9480 microUSB switch and accessory detector chip. The FSA9480 is a USB
	  port accessory detector and switch. The FSA9480 is fully controlled using
	  I2C and enables USB data, stereo and mono audio, video, microphone
	  and UART data to use a common connector port.

config EXTCON_GPIO
	tristate "GPIO extcon support"
	depends on GPIOLIB || COMPILE_TEST
	help
	  Say Y here to enable GPIO based extcon support. Note that GPIO
	  extcon supports single state per extcon instance.

config EXTCON_INTEL_INT3496
	tristate "Intel INT3496 ACPI device extcon driver"
	depends on GPIOLIB && ACPI && (X86 || COMPILE_TEST)
	help
	  Say Y here to enable extcon support for USB OTG ports controlled by
	  an Intel INT3496 ACPI device.

	  This ACPI device is typically found on Intel Baytrail or Cherrytrail
	  based tablets, or other Baytrail / Cherrytrail devices.

config EXTCON_INTEL_CHT_WC
	tristate "Intel Cherrytrail Whiskey Cove PMIC extcon driver"
	depends on INTEL_SOC_PMIC_CHTWC
	help
	  Say Y here to enable extcon support for charger detection / control
	  on the Intel Cherrytrail Whiskey Cove PMIC.

config EXTCON_INTEL_MRFLD
	tristate "Intel Merrifield Basin Cove PMIC extcon driver"
	depends on INTEL_SOC_PMIC_MRFLD
	help
	  Say Y here to enable extcon support for charger detection / control
	  on the Intel Merrifield Basin Cove PMIC.

config EXTCON_MAX14577
	tristate "Maxim MAX14577/77836 EXTCON Support"
	depends on MFD_MAX14577
	select IRQ_DOMAIN
	select REGMAP_I2C
	help
	  If you say yes here you get support for the MUIC device of
	  Maxim MAX14577/77836. The MAX14577/77836 MUIC is a USB port accessory
	  detector and switch.

config EXTCON_MAX3355
	tristate "Maxim MAX3355 USB OTG EXTCON Support"
	depends on GPIOLIB || COMPILE_TEST
	help
	  If you say yes here you get support for the USB OTG role detection by
	  MAX3355. The MAX3355 chip integrates a charge pump and comparators to
	  enable a system with an integrated USB OTG dual-role transceiver to
	  function as an USB OTG dual-role device.

config EXTCON_MAX77693
	tristate "Maxim MAX77693 EXTCON Support"
	depends on MFD_MAX77693 && INPUT
	select IRQ_DOMAIN
	select REGMAP_I2C
	help
	  If you say yes here you get support for the MUIC device of
	  Maxim MAX77693 PMIC. The MAX77693 MUIC is a USB port accessory
	  detector and switch.

config EXTCON_MAX77843
	tristate "Maxim MAX77843 EXTCON Support"
	depends on MFD_MAX77843
	select IRQ_DOMAIN
	select REGMAP_I2C
	help
	  If you say yes here you get support for the MUIC device of
	  Maxim MAX77843. The MAX77843 MUIC is a USB port accessory
	  detector add switch.

config EXTCON_MAX8997
	tristate "Maxim MAX8997 EXTCON Support"
	depends on MFD_MAX8997 && IRQ_DOMAIN
	help
	  If you say yes here you get support for the MUIC device of
	  Maxim MAX8997 PMIC. The MAX8997 MUIC is a USB port accessory
	  detector and switch.

config EXTCON_PALMAS
	tristate "Palmas USB EXTCON support"
	depends on MFD_PALMAS
	help
	  Say Y here to enable support for USB peripheral and USB host
	  detection by palmas usb.

config EXTCON_PTN5150
	tristate "NXP PTN5150 CC LOGIC USB EXTCON support"
	depends on I2C && (GPIOLIB || COMPILE_TEST)
	select REGMAP_I2C
	help
	  Say Y here to enable support for USB peripheral and USB host
	  detection by NXP PTN5150 CC (Configuration Channel) logic chip.

config EXTCON_QCOM_SPMI_MISC
	tristate "Qualcomm USB extcon support"
	depends on ARCH_QCOM || COMPILE_TEST
	help
	  Say Y here to enable SPMI PMIC based USB cable detection
	  support on Qualcomm PMICs such as PM8941.

config EXTCON_RT8973A
	tristate "Richtek RT8973A EXTCON support"
	depends on I2C
	select IRQ_DOMAIN
	select REGMAP_I2C
	select REGMAP_IRQ
	help
	  If you say yes here you get support for the MUIC device of
	  Richtek RT8973A. The RT8973A is a USB port accessory detector
	  and switch that is optimized to protect low voltage system
	  from abnormal high input voltage (up to 28V).

config EXTCON_SM5502
	tristate "Silicon Mitus SM5502 EXTCON support"
	depends on I2C
	select IRQ_DOMAIN
	select REGMAP_I2C
	select REGMAP_IRQ
	help
	  If you say yes here you get support for the MUIC device of
	  Silicon Mitus SM5502. The SM5502 is a USB port accessory
	  detector and switch.

config EXTCON_USB_GPIO
	tristate "USB GPIO extcon support"
	depends on GPIOLIB || COMPILE_TEST
	help
	  Say Y here to enable GPIO based USB cable detection extcon support.
	  Used typically if GPIO is used for USB ID pin detection.

config EXTCON_USBC_CROS_EC
	tristate "ChromeOS Embedded Controller EXTCON support"
	depends on MFD_CROS_EC
	help
	  Say Y here to enable USB Type C cable detection extcon support when
	  using Chrome OS EC based USB Type-C ports.

endif
```

## drivers/fc4/Kconfig
```kconfig
#
# FC4 device configuration
#

menu "Fibre Channel support"

config FC4
	tristate "Fibre Channel and FC4 SCSI support"
	---help---
	  Fibre Channel is a high speed serial protocol mainly used to
	  connect large storage devices to the computer; it is compatible with
	  and intended to replace SCSI.

	  This is an experimental support for storage arrays connected to your
	  computer using optical fibre cables and the "X3.269-199X Fibre
	  Channel Protocol for SCSI" specification. If you want to use this,
	  you need to say Y here and to "SCSI support" as well as to the
	  drivers for the storage array itself and for the interface adapter
	  such as SOC or SOC+. This subsystem could even serve for IP
	  networking, with some code extensions.

	  If unsure, say N.

comment "FC4 drivers"
	depends on FC4

config FC4_SOC
	tristate "Sun SOC/Sbus"
	depends on FC4!=n && SPARC
	help
	  Serial Optical Channel is an interface card with one or two Fibre
	  Optic ports, each of which can be connected to a disk array. Note
	  that if you have older firmware in the card, you'll need the
	  microcode from the Solaris driver to make it work.

	  To compile this support as a module, choose M here: the module will
	  be called soc.

config FC4_SOCAL
	tristate "Sun SOC+ (aka SOCAL)"
	depends on FC4!=n && SPARC
	---help---
	  Serial Optical Channel Plus is an interface card with up to two
	  Fibre Optic ports. This card supports FC Arbitrated Loop (usually
	  A5000 or internal FC disks in E[3-6]000 machines through the
	  Interface Board). You'll probably need the microcode from the
	  Solaris driver to make it work.

	  To compile this support as a module, choose M here: the module will
	  be called socal.

comment "FC4 targets"
	depends on FC4

config SCSI_PLUTO
	tristate "SparcSTORAGE Array 100 and 200 series"
	depends on FC4!=n && SCSI
	help
	  If you never bought a disk array made by Sun, go with N.

	  To compile this support as a module, choose M here: the module will
	  be called pluto.

config SCSI_FCAL
	tristate "Sun Enterprise Network Array (A5000 and EX500)" if SPARC
	depends on FC4!=n && SCSI
	help
	  This driver drives FC-AL disks connected through a Fibre Channel
	  card using the drivers/fc4 layer (currently only SOCAL). The most
	  common is either A5000 array or internal disks in E[3-6]000
	  machines.

	  To compile this support as a module, choose M here: the module will
	  be called fcal.

config SCSI_FCAL
	prompt "Generic FC-AL disk driver"
	depends on FC4!=n && SCSI && !SPARC

endmenu
```

## drivers/firewire/Kconfig
```kconfig
# SPDX-License-Identifier: GPL-2.0-only
menu "IEEE 1394 (FireWire) support"
	depends on PCI || COMPILE_TEST
	# firewire-core does not depend on PCI but is
	# not useful without PCI controller driver

config FIREWIRE
	tristate "FireWire driver stack"
	select CRC_ITU_T
	help
	  This is the new-generation IEEE 1394 (FireWire) driver stack
	  a.k.a. Juju, a new implementation designed for robustness and
	  simplicity.
	  See http://ieee1394.wiki.kernel.org/index.php/Juju_Migration
	  for information about migration from the older Linux 1394 stack
	  to the new driver stack.

	  To compile this driver as a module, say M here: the module will be
	  called firewire-core.

config FIREWIRE_OHCI
	tristate "OHCI-1394 controllers"
	depends on PCI && FIREWIRE && MMU
	help
	  Enable this driver if you have a FireWire controller based
	  on the OHCI specification.  For all practical purposes, this
	  is the only chipset in use, so say Y here.

	  To compile this driver as a module, say M here:  The module will be
	  called firewire-ohci.

config FIREWIRE_SBP2
	tristate "Storage devices (SBP-2 protocol)"
	depends on FIREWIRE && SCSI
	help
	  This option enables you to use SBP-2 devices connected to a
	  FireWire bus.  SBP-2 devices include storage devices like
	  harddisks and DVD drives, also some other FireWire devices
	  like scanners.

	  To compile this driver as a module, say M here:  The module will be
	  called firewire-sbp2.

	  You should also enable support for disks, CD-ROMs, etc. in the SCSI
	  configuration section.

config FIREWIRE_NET
	tristate "IP networking over 1394"
	depends on FIREWIRE && INET
	help
	  This enables IPv4/IPv6 over IEEE 1394, providing IP connectivity
	  with other implementations of RFC 2734/3146 as found on several
	  operating systems.  Multicast support is currently limited.

	  To compile this driver as a module, say M here:  The module will be
	  called firewire-net.

config FIREWIRE_NOSY
	tristate "Nosy - a FireWire traffic sniffer for PCILynx cards"
	depends on PCI
	help
	  Nosy is an IEEE 1394 packet sniffer that is used for protocol
	  analysis and in development of IEEE 1394 drivers, applications,
	  or firmwares.

	  This driver lets you use a Texas Instruments PCILynx 1394 to PCI
	  link layer controller TSB12LV21/A/B as a low-budget bus analyzer.
	  PCILynx is a nowadays very rare IEEE 1394 controller which is
	  not OHCI 1394 compliant.

	  The following cards are known to be based on PCILynx or PCILynx-2:
	  IOI IOI-1394TT (PCI card), Unibrain Fireboard 400 PCI Lynx-2
	  (PCI card), Newer Technology FireWire 2 Go (CardBus card),
	  Apple Power Mac G3 blue & white and G4 with PCI graphics
	  (onboard controller).

	  To compile this driver as a module, say M here:  The module will be
	  called nosy.  Source code of a userspace interface to nosy, called
	  nosy-dump, can be found in tools/firewire/ of the kernel sources.

	  If unsure, say N.

endmenu
```
