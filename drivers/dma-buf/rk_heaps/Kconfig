## drivers/dma/amd/Kconfig
```kconfig
# SPDX-License-Identifier: GPL-2.0-only
#

config AMD_AE4DMA
	tristate  "AMD AE4DMA Engine"
	depends on (X86_64 || COMPILE_TEST) && PCI
	depends on AMD_PTDMA
	select DMA_ENGINE
	select DMA_VIRTUAL_CHANNELS
	help
	  Enable support for the AMD AE4DMA controller. This controller
	  provides DMA capabilities to perform high bandwidth memory to
	  memory and IO copy operations. It performs DMA transfer through
	  queue-based descriptor management. This DMA controller is intended
	  to be used with AMD Non-Transparent Bridge devices and not for
	  general purpose peripheral DMA.

config AMD_PTDMA
	tristate  "AMD PassThru DMA Engine"
	depends on X86_64 && PCI
	select DMA_ENGINE
	select DMA_VIRTUAL_CHANNELS
	help
	  Enable support for the AMD PTDMA controller. This controller
	  provides DMA capabilities to perform high bandwidth memory to
	  memory and IO copy operations. It performs DMA transfer through
	  queue-based descriptor management. This DMA controller is intended
	  to be used with AMD Non-Transparent Bridge devices and not for
	  general purpose peripheral DMA.

config AMD_QDMA
	tristate "AMD Queue-based DMA"
	depends on HAS_IOMEM
	select DMA_ENGINE
	select DMA_VIRTUAL_CHANNELS
	select REGMAP_MMIO
	help
	  Enable support for the AMD Queue-based DMA subsystem. The primary
	  mechanism to transfer data using the QDMA is for the QDMA engine to
	  operate on instructions (descriptors) provided by the host operating
	  system. Using the descriptors, the QDMA can move data in either the
	  Host to Card (H2C) direction or the Card to Host (C2H) direction.
```

## drivers/dma/dw-edma/Kconfig
```kconfig
# SPDX-License-Identifier: GPL-2.0

config DW_EDMA
	tristate "Syanalpsys DesignWare eDMA controller driver"
	depends on PCI && PCI_MSI
	select DMA_ENGINE
	select DMA_VIRTUAL_CHANNELS
	help
	  Support the Syanalpsys DesignWare eDMA controller, analrmally
	  implemented on endpoints SoCs.

if DW_EDMA

config DW_EDMA_PCIE
	tristate "Syanalpsys DesignWare eDMA PCIe driver"
	depends on PCI && PCI_MSI
	help
	  Provides a glue-logic between the Syanalpsys DesignWare
	  eDMA controller and an endpoint PCIe device. This also serves
	  as a reference design to whom desires to use this IP.

endif # DW_EDMA
```

## drivers/dma/dw/Kconfig
```kconfig
# SPDX-License-Identifier: GPL-2.0

#
# DMA engine configuration for dw
#

config DW_DMAC_CORE
	tristate
	select DMA_ENGINE

config DW_DMAC
	tristate "Synopsys DesignWare AHB DMA platform driver"
	depends on HAS_IOMEM
	select DW_DMAC_CORE
	help
	  Support the Synopsys DesignWare AHB DMA controller. This
	  can be integrated in chips such as the Intel Cherrytrail.

config RZN1_DMAMUX
	tristate "Renesas RZ/N1 DMAMUX driver"
	depends on DW_DMAC
	depends on ARCH_RZN1 || COMPILE_TEST
	help
	  Support the Renesas RZ/N1 DMAMUX which is located in front of
	  the Synopsys DesignWare AHB DMA controller located on Renesas
	  SoCs.

config DW_DMAC_PCI
	tristate "Synopsys DesignWare AHB DMA PCI driver"
	depends on PCI
	depends on HAS_IOMEM
	select DW_DMAC_CORE
	help
	  Support the Synopsys DesignWare AHB DMA controller on the
	  platforms that enumerate it as a PCI device. For example,
	  Intel Medfield has integrated this GPDMA controller.
```

## drivers/dma/fsl-dpaa2-qdma/Kconfig
```kconfig
menuconfig FSL_DPAA2_QDMA
	tristate "NXP DPAA2 QDMA"
	depends on ARM64
	depends on FSL_MC_BUS && FSL_MC_DPIO
	select DMA_ENGINE
	select DMA_VIRTUAL_CHANNELS
	help
	  NXP Data Path Acceleration Architecture 2 QDMA driver,
	  using the NXP MC bus driver.
```

## drivers/dma/hsu/Kconfig
```kconfig
# SPDX-License-Identifier: GPL-2.0-only
# DMA engine configuration for hsu
config HSU_DMA
	tristate
	select DMA_ENGINE
	select DMA_VIRTUAL_CHANNELS

config HSU_DMA_PCI
	tristate
	depends on HSU_DMA && PCI
```

## drivers/dma/lgm/Kconfig
```kconfig
# SPDX-License-Identifier: GPL-2.0-only
config INTEL_LDMA
	bool "Lightning Mountain centralized DMA controllers"
	depends on X86 || COMPILE_TEST
	select DMA_ENGINE
	select DMA_VIRTUAL_CHANNELS
	help
	  Enable support for Intel Lightning Mountain SOC DMA controllers.
	  These controllers provide DMA capabilities for a variety of on-chip
	  devices such as HSNAND and GSWIP (Gigabit Switch IP).
```

## drivers/dma/loongson/Kconfig
```kconfig
# SPDX-License-Identifier: GPL-2.0-only
#
# Loongson DMA controllers drivers
#
if MACH_LOONGSON32 || MACH_LOONGSON64 || COMPILE_TEST

config LOONGSON1_APB_DMA
	tristate "Loongson1 APB DMA support"
	depends on MACH_LOONGSON32 || COMPILE_TEST
	select DMA_ENGINE
	select DMA_VIRTUAL_CHANNELS
	help
	  This selects support for the APB DMA controller in Loongson1 SoCs,
	  which is required by Loongson1 NAND and audio support.

config LOONGSON2_APB_DMA
	tristate "Loongson2 APB DMA support"
	depends on MACH_LOONGSON64 || COMPILE_TEST
	select DMA_ENGINE
	select DMA_VIRTUAL_CHANNELS
	help
	  Support for the Loongson2 APB DMA controller driver. The
	  DMA controller is having single DMA channel which can be
	  configured for different peripherals like audio, nand, sdio
	  etc which is in APB bus.

	  This DMA controller transfers data from memory to peripheral fifo.
	  It does not support memory to memory data transfer.

config LOONGSON2_APB_CMC_DMA
	tristate "Loongson2 Chain Multi-Channel DMA support"
	depends on MACH_LOONGSON64 || COMPILE_TEST
	select DMA_ENGINE
	select DMA_VIRTUAL_CHANNELS
	help
	  Support for the Loongson Chain Multi-Channel DMA controller driver.
	  It is discovered on the Loongson-2K chip (Loongson-2K0300/Loongson-2K3000),
	  which has 4/8 channels internally, enabling bidirectional data transfer
	  between devices and memory.

endif
```

## drivers/dma/mediatek/Kconfig
```kconfig
# SPDX-License-Identifier: GPL-2.0-only

config MTK_HSDMA
	tristate "MediaTek High-Speed DMA controller support"
	depends on ARCH_MEDIATEK || COMPILE_TEST
	select DMA_ENGINE
	select DMA_VIRTUAL_CHANNELS
	help
	  Enable support for High-Speed DMA controller on MediaTek
	  SoCs.

	  This controller provides the channels which is dedicated to
	  memory-to-memory transfer to offload from CPU through ring-
	  based descriptor management.

config MTK_CQDMA
	tristate "MediaTek Command-Queue DMA controller support"
	depends on ARCH_MEDIATEK || COMPILE_TEST
	select DMA_ENGINE
	select DMA_VIRTUAL_CHANNELS
	select ASYNC_TX_ENABLE_CHANNEL_SWITCH
	help
	  Enable support for Command-Queue DMA controller on MediaTek
	  SoCs.

	  This controller provides the channels which is dedicated to
	  memory-to-memory transfer to offload from CPU.

config MTK_UART_APDMA
	tristate "MediaTek SoCs APDMA support for UART"
	depends on OF && SERIAL_8250_MT6577
	select DMA_ENGINE
	select DMA_VIRTUAL_CHANNELS
	help
	  Support for the UART DMA engine found on MediaTek MTK SoCs.
	  When SERIAL_8250_MT6577 is enabled, and if you want to use DMA,
	  you can enable the config. The DMA engine can only be used
	  with MediaTek SoCs.
```

## drivers/dma/ptdma/Kconfig
```kconfig
# SPDX-License-Identifier: GPL-2.0-only
config AMD_PTDMA
	tristate  "AMD PassThru DMA Engine"
	depends on X86_64 && PCI
	select DMA_ENGINE
	select DMA_VIRTUAL_CHANNELS
	help
	  Enable support for the AMD PTDMA controller. This controller
	  provides DMA capabilities to perform high bandwidth memory to
	  memory and IO copy operations. It performs DMA transfer through
	  queue-based descriptor management. This DMA controller is intended
	  to be used with AMD Non-Transparent Bridge devices and not for
	  general purpose peripheral DMA.
```

## drivers/dma/pxp/Kconfig
```kconfig
config MXC_PXP_V2
	bool "MXC PxP V2 support"
	depends on ARM
	select DMA_ENGINE
	help
          Support the PxP (Pixel Pipeline) on i.MX6 DualLite and i.MX6 SoloLite.
	  If unsure, select N.

config MXC_PXP_V3
	bool "MXC PxP V3 support"
	depends on ARM
	select DMA_ENGINE
	help
	  Support the PxP V3(Pixel Pipeline) on i.MX7D. The PxP V3 supports
	  more functions than PxP V2, dithering, reagl/-D and etc.
	  If unsure, select N.

config MXC_PXP_CLIENT_DEVICE
	bool "MXC PxP Client Device"
	default y
	depends on MXC_PXP_V2 || MXC_PXP_V3
```

## drivers/dma/qcom/Kconfig
```kconfig
# SPDX-License-Identifier: GPL-2.0-only
config QCOM_ADM
	tristate "Qualcomm ADM support"
	depends on (ARCH_QCOM || COMPILE_TEST) && !PHYS_ADDR_T_64BIT
	select DMA_ENGINE
	select DMA_VIRTUAL_CHANNELS
	help
	  Enable support for the Qualcomm Application Data Mover (ADM) DMA
	  controller, as present on MSM8x60, APQ8064, and IPQ8064 devices.
	  This controller provides DMA capabilities for both general purpose
	  and on-chip peripheral devices.

config QCOM_BAM_DMA
	tristate "QCOM BAM DMA support"
	depends on ARCH_QCOM || (COMPILE_TEST && OF && ARM)
	select DMA_ENGINE
	select DMA_VIRTUAL_CHANNELS
	help
	  Enable support for the QCOM BAM DMA controller.  This controller
	  provides DMA capabilities for a variety of on-chip devices.

config QCOM_GPI_DMA
        tristate "Qualcomm Technologies GPI DMA support"
        depends on ARCH_QCOM
        select DMA_ENGINE
        select DMA_VIRTUAL_CHANNELS
        help
          Enable support for the QCOM GPI DMA controller. This controller
          provides DMA capabilities for a variety of peripheral buses such
          as I2C, UART, and SPI. By using GPI dmaengine driver, bus drivers
          can use a standardize interface that is protocol independent to
          transfer data between DDR and peripheral.

config QCOM_HIDMA_MGMT
	tristate "Qualcomm Technologies HIDMA Management support"
	depends on HAS_IOMEM
	select DMA_ENGINE
	help
	  Enable support for the Qualcomm Technologies HIDMA Management.
	  Each DMA device requires one management interface driver
	  for basic initialization before QCOM_HIDMA channel driver can
	  start managing the channels. In a virtualized environment,
	  the guest OS would run QCOM_HIDMA channel driver and the
	  host would run the QCOM_HIDMA_MGMT management driver.

config QCOM_HIDMA
	tristate "Qualcomm Technologies HIDMA Channel support"
	depends on HAS_IOMEM
	select DMA_ENGINE
	help
	  Enable support for the Qualcomm Technologies HIDMA controller.
	  The HIDMA controller supports optimized buffer copies
	  (user to kernel, kernel to kernel, etc.).  It only supports
	  memcpy interface. The core is not intended for general
	  purpose slave DMA.
```

## drivers/dma/sf-pdma/Kconfig
```kconfig
config SF_PDMA
	tristate "Sifive PDMA controller driver"
	depends on HAS_IOMEM
	select DMA_ENGINE
	select DMA_VIRTUAL_CHANNELS
	help
	  Support the SiFive PDMA controller.
```

## drivers/dma/sh/Kconfig
```kconfig
# SPDX-License-Identifier: GPL-2.0
#
# DMA engine configuration for sh
#

config RENESAS_DMA
	bool
	select DMA_ENGINE

#
# DMA Engine Helpers
#

config SH_DMAE_BASE
	bool "Renesas SuperH DMA Engine support"
	depends on SUPERH || COMPILE_TEST
	depends on !SUPERH || SH_DMA
	depends on !SH_DMA_API
	default SUPERH || SH_DMA
	select RENESAS_DMA
	help
	  Enable support for the Renesas SuperH DMA controllers.

#
# DMA Controllers
#

config SH_DMAE
	tristate "Renesas SuperH DMAC support"
	depends on SH_DMAE_BASE
	help
	  Enable support for the Renesas SuperH DMA controllers.

config RCAR_DMAC
	tristate "Renesas R-Car Gen{2,3} and RZ/G{1,2} DMA Controller"
	depends on ARCH_RENESAS || COMPILE_TEST
	select RENESAS_DMA
	help
	  This driver supports the general purpose DMA controller found in the
	  Renesas R-Car Gen{2,3} and RZ/G{1,2} SoCs.

config RENESAS_USB_DMAC
	tristate "Renesas USB-DMA Controller"
	depends on ARCH_RENESAS || COMPILE_TEST
	select RENESAS_DMA
	select DMA_VIRTUAL_CHANNELS
	help
	  This driver supports the USB-DMA controller found in the Renesas
	  SoCs.

config RZ_DMAC
	tristate "Renesas RZ DMA Controller"
	depends on ARCH_R7S72100 || ARCH_RZG2L || COMPILE_TEST
	select RENESAS_DMA
	select DMA_VIRTUAL_CHANNELS
	help
	  This driver supports the general purpose DMA controller typically
	  found in the Renesas RZ SoC variants.
```

## drivers/dma/stm32/Kconfig
```kconfig
# SPDX-License-Identifier: GPL-2.0-only
#
# STM32 DMA controllers drivers
#
if ARCH_STM32 || COMPILE_TEST

config STM32_DMA
	bool "STMicroelectronics STM32 DMA support"
	select DMA_ENGINE
	select DMA_VIRTUAL_CHANNELS
	help
	  Enable support for the on-chip DMA controller on STMicroelectronics
	  STM32 platforms.
	  If you have a board based on STM32 SoC with such DMA controller
	  and want to use DMA say Y here.

config STM32_DMAMUX
	bool "STMicroelectronics STM32 DMA multiplexer support"
	depends on STM32_DMA
	help
	  Enable support for the on-chip DMA multiplexer on STMicroelectronics
	  STM32 platforms.
	  If you have a board based on STM32 SoC with such DMA multiplexer
	  and want to use DMAMUX say Y here.

config STM32_MDMA
	bool "STMicroelectronics STM32 master DMA support"
	depends on OF
	select DMA_ENGINE
	select DMA_VIRTUAL_CHANNELS
	help
	  Enable support for the on-chip MDMA controller on STMicroelectronics
	  STM32 platforms.
	  If you have a board based on STM32 SoC with such DMA controller
	  and want to use MDMA say Y here.

config STM32_DMA3
	tristate "STMicroelectronics STM32 DMA3 support"
	select DMA_ENGINE
	select DMA_VIRTUAL_CHANNELS
	help
	  Enable support for the on-chip DMA3 controller on STMicroelectronics
	  STM32 platforms.
	  If you have a board based on STM32 SoC with such DMA3 controller
	  and want to use DMA3, say Y here.

endif
```

## drivers/dma/ti/Kconfig
```kconfig
#
# Texas Instruments DMA drivers
#

config TI_CPPI41
	tristate "Texas Instruments CPPI 4.1 DMA support"
	depends on (ARCH_OMAP || ARCH_DAVINCI_DA8XX)
	select DMA_ENGINE
	help
	  The Communications Port Programming Interface (CPPI) 4.1 DMA engine
	  is currently used by the USB driver on AM335x and DA8xx platforms.

config TI_EDMA
	tristate "Texas Instruments EDMA support"
	depends on ARCH_DAVINCI || ARCH_OMAP || ARCH_KEYSTONE || COMPILE_TEST
	select DMA_ENGINE
	select DMA_VIRTUAL_CHANNELS
	select TI_DMA_CROSSBAR if (ARCH_OMAP || COMPILE_TEST)
	default y
	help
	  Enable support for the TI EDMA (Enhanced DMA) controller. This DMA
	  engine is found on TI DaVinci, AM33xx, AM43xx, DRA7xx and Keystone 2
	  parts.

config DMA_OMAP
	tristate "Texas Instruments sDMA (omap-dma) support"
	depends on ARCH_OMAP || COMPILE_TEST
	select DMA_ENGINE
	select DMA_VIRTUAL_CHANNELS
	select TI_DMA_CROSSBAR if (SOC_DRA7XX || COMPILE_TEST)
	default y
	help
	  Enable support for the TI sDMA (System DMA or DMA4) controller. This
	  DMA engine is found on OMAP and DRA7xx parts.

config TI_DMA_CROSSBAR
	bool
```

## drivers/dpll/Kconfig
```kconfig
# SPDX-License-Identifier: GPL-2.0-only
#
# Generic DPLL drivers configuration
#

menu "DPLL device support"

config DPLL
	bool

config DPLL_REFCNT_TRACKER
	bool "DPLL reference count tracking"
	depends on DEBUG_KERNEL && STACKTRACE_SUPPORT && DPLL
	select REF_TRACKER
	help
	  Enable reference count tracking for DPLL devices and pins.
	  This helps debugging reference leaks and use-after-free bugs
	  by recording stack traces for each get/put operation.

	  The tracking information is exposed via debugfs at:
	    /sys/kernel/debug/ref_tracker/dpll_device_*
	    /sys/kernel/debug/ref_tracker/dpll_pin_*

	  If unsure, say N.

source "drivers/dpll/zl3073x/Kconfig"

endmenu
```
