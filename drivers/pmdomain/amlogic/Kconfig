## drivers/pmdomain/amlogic/Kconfig
```kconfig
# SPDX-License-Identifier: GPL-2.0-only
menu "Amlogic PM Domains"

config MESON_EE_PM_DOMAINS
	tristate "Amlogic Meson Everything-Else Power Domains driver"
	depends on ARCH_MESON || COMPILE_TEST
	depends on PM && OF
	default ARCH_MESON
	select PM_GENERIC_DOMAINS
	select PM_GENERIC_DOMAINS_OF
	help
	  Say yes to expose Amlogic Meson Everything-Else Power Domains as
	  Generic Power Domains.

config MESON_SECURE_PM_DOMAINS
	tristate "Amlogic Meson Secure Power Domains driver"
	depends on (ARCH_MESON || COMPILE_TEST) && MESON_SM
	depends on PM && OF
	depends on HAVE_ARM_SMCCC
	default ARCH_MESON
	select PM_GENERIC_DOMAINS
	select PM_GENERIC_DOMAINS_OF
	help
	  Support for the power controller on Amlogic A1/C1 series.
	  Say yes to expose Amlogic Meson Secure Power Domains as Generic
	  Power Domains.

endmenu
```

## drivers/pmdomain/arm/Kconfig
```kconfig
# SPDX-License-Identifier: GPL-2.0-only
config ARM_SCMI_PERF_DOMAIN
	tristate "SCMI performance domain driver"
	depends on ARM_SCMI_PROTOCOL || (COMPILE_TEST && OF)
	default ARM_SCMI_PROTOCOL
	select PM_GENERIC_DOMAINS if PM
	help
	  This enables support for the SCMI performance domains which can be
	  enabled or disabled via the SCP firmware.

	  This driver can also be built as a module. If so, the module will be
	  called scmi_perf_domain.

config ARM_SCMI_POWER_DOMAIN
	tristate "SCMI power domain driver"
	depends on ARM_SCMI_PROTOCOL || (COMPILE_TEST && OF)
	default ARM_SCMI_PROTOCOL
	select PM_GENERIC_DOMAINS if PM
	help
	  This enables support for the SCMI power domains which can be
	  enabled or disabled via the SCP firmware

	  This driver can also be built as a module. If so, the module
	  will be called scmi_pm_domain. Note this may needed early in boot
	  before rootfs may be available.

config ARM_SCPI_POWER_DOMAIN
	tristate "SCPI power domain driver"
	depends on ARM_SCPI_PROTOCOL || (COMPILE_TEST && OF)
	default ARM_SCPI_PROTOCOL
	select PM_GENERIC_DOMAINS if PM
	help
	  This enables support for the SCPI power domains which can be
	  enabled or disabled via the SCP firmware

	  This driver can also be built as a module. If so, the module will be
	  called scpi_pm_domain.
```

## drivers/pmdomain/bcm/Kconfig
```kconfig
# SPDX-License-Identifier: GPL-2.0-only
menu "Broadcom PM Domains"

config BCM2835_POWER
	bool "BCM2835 power domain driver"
	depends on ARCH_BCM2835 || (COMPILE_TEST && OF)
	default y if ARCH_BCM2835
	select PM_GENERIC_DOMAINS if PM
	select RESET_CONTROLLER
	help
	  This enables support for the BCM2835 power domains and reset
	  controller.  Any usage of power domains by the Raspberry Pi
	  firmware means that Linux usage of the same power domain
	  must be accessed using the RASPBERRYPI_POWER driver

config RASPBERRYPI_POWER
	bool "Raspberry Pi power domain driver"
	depends on ARCH_BCM2835 || (COMPILE_TEST && OF)
	depends on RASPBERRYPI_FIRMWARE=y
	select PM_GENERIC_DOMAINS if PM
	help
	  This enables support for the RPi power domains which can be enabled
	  or disabled via the RPi firmware.

config BCM_PMB
	bool "Broadcom PMB (Power Management Bus) driver"
	depends on ARCH_BCMBCA || (COMPILE_TEST && OF)
	default ARCH_BCMBCA
	select PM_GENERIC_DOMAINS if PM
	help
	  This enables support for the Broadcom's PMB (Power Management Bus) that
	  is used for disabling and enabling SoC devices.

config BCM63XX_POWER
	bool "BCM63xx power domain driver"
	depends on BMIPS_GENERIC || (COMPILE_TEST && OF)
	select PM_GENERIC_DOMAINS if PM
	help
	  This enables support for the BCM63xx power domains controller on
	  BCM6318, BCM6328, BCM6362 and BCM63268 SoCs.

endmenu
```

## drivers/pmdomain/marvell/Kconfig
```kconfig
# SPDX-License-Identifier: GPL-2.0-only

menu "Marvell PM Domains"
	depends on ARCH_MMP || COMPILE_TEST

config PXA1908_PM_DOMAINS
	tristate "Marvell PXA1908 power domains"
	depends on OF
	depends on PM
	default y if ARCH_MMP && ARM64
	select AUXILIARY_BUS
	select MFD_SYSCON
	select PM_GENERIC_DOMAINS
	select PM_GENERIC_DOMAINS_OF
	help
	  Say Y here to enable support for Marvell PXA1908's power domanis.

endmenu
```

## drivers/pmdomain/mediatek/Kconfig
```kconfig
# SPDX-License-Identifier: GPL-2.0-only

menu "MediaTek PM Domains"
	depends on ARCH_MEDIATEK || COMPILE_TEST

config MTK_SCPSYS
	bool "MediaTek SCPSYS Support"
	default ARCH_MEDIATEK
	depends on OF
	select REGMAP
	select MTK_INFRACFG
	select PM_GENERIC_DOMAINS if PM
	help
	  Say yes here to add support for the MediaTek SCPSYS power domain
	  driver.

config MTK_SCPSYS_PM_DOMAINS
	bool "MediaTek SCPSYS generic power domain"
	default ARCH_MEDIATEK
	depends on PM
	select PM_GENERIC_DOMAINS
	select REGMAP
	help
	  Say y here to enable power domain support.
	  In order to meet high performance and low power requirements, the System
	  Control Processor System (SCPSYS) has several power management related
	  tasks in the system.

config AIROHA_CPU_PM_DOMAIN
	tristate "Airoha CPU power domain"
	default ARCH_AIROHA
	depends on HAVE_ARM_SMCCC
	depends on PM
	select PM_GENERIC_DOMAINS
	help
	  Say y here to enable CPU power domain support for Airoha SoC.

	  CPU frequency and power is controlled by ATF with SMC command to
	  set performance states.

endmenu
```

## drivers/pmdomain/qcom/Kconfig
```kconfig
# SPDX-License-Identifier: GPL-2.0-only
menu "Qualcomm PM Domains"

config QCOM_CPR
	tristate "QCOM Core Power Reduction (CPR) support"
	depends on ARCH_QCOM && HAS_IOMEM
	select PM_OPP
	select REGMAP
	help
	  Say Y here to enable support for the CPR hardware found on Qualcomm
	  SoCs like QCS404.

	  This driver populates CPU OPPs tables and makes adjustments to the
	  tables based on feedback from the CPR hardware. If you want to do
	  CPUfrequency scaling say Y here.

	  To compile this driver as a module, choose M here: the module will
	  be called qcom-cpr

config QCOM_CPR4PD
	tristate "Power domain driver for QCOM CPR4 hardware"
	depends on ARCH_QCOM && HAS_IOMEM && NVMEM_QCOM_QFPROM && REGULATOR
	select PM_OPP
	help
	  Say Y here to enable support for the CPR4 hardware found on Qualcomm
	  SoCs like MSM8953, SDM450, SDM632.

	  This driver populates CPU OPPs tables based on fuses specific to CPR
	  hardware. If you want to do CPU frequency scaling say Y here.

	  To compile this driver as a module, choose M here: the module will
	  be called qcom-cpr4pd

config QCOM_RPMHPD
	tristate "Qualcomm RPMh Power domain driver"
	depends on QCOM_RPMH && QCOM_COMMAND_DB
	help
	  QCOM RPMh Power domain driver to support power-domains with
	  performance states. The driver communicates a performance state
	  value to RPMh which then translates it into corresponding voltage
	  for the voltage rail.

config QCOM_RPMPD
	tristate "Qualcomm RPM Power domain driver"
	depends on PM && OF
	depends on QCOM_SMD_RPM
	select PM_GENERIC_DOMAINS
	select PM_GENERIC_DOMAINS_OF
	help
	  QCOM RPM Power domain driver to support power-domains with
	  performance states. The driver communicates a performance state
	  value to RPM which then translates it into corresponding voltage
	  for the voltage rail.

endmenu
```

## drivers/pmdomain/renesas/Kconfig
```kconfig
# SPDX-License-Identifier: GPL-2.0
if SOC_RENESAS
menu "Renesas PM Domains"

# SoC Family
config SYSC_RCAR
	bool "System Controller support for R-Car" if COMPILE_TEST

config SYSC_RCAR_GEN4
	bool "System Controller support for R-Car Gen4" if COMPILE_TEST

config SYSC_RMOBILE
	bool "System Controller support for R-Mobile" if COMPILE_TEST

# SoC
config SYSC_R8A7742
	bool "System Controller support for R8A7742 (RZ/G1H)" if COMPILE_TEST
	select SYSC_RCAR

config SYSC_R8A7743
	bool "System Controller support for R8A7743 (RZ/G1M)" if COMPILE_TEST
	select SYSC_RCAR

config SYSC_R8A7745
	bool "System Controller support for R8A7745 (RZ/G1E)" if COMPILE_TEST
	select SYSC_RCAR

config SYSC_R8A77470
	bool "System Controller support for R8A77470 (RZ/G1C)" if COMPILE_TEST
	select SYSC_RCAR

config SYSC_R8A774A1
	bool "System Controller support for R8A774A1 (RZ/G2M)" if COMPILE_TEST
	select SYSC_RCAR

config SYSC_R8A774B1
	bool "System Controller support for R8A774B1 (RZ/G2N)" if COMPILE_TEST
	select SYSC_RCAR

config SYSC_R8A774C0
	bool "System Controller support for R8A774C0 (RZ/G2E)" if COMPILE_TEST
	select SYSC_RCAR

config SYSC_R8A774E1
	bool "System Controller support for R8A774E1 (RZ/G2H)" if COMPILE_TEST
	select SYSC_RCAR

config SYSC_R8A7779
	bool "System Controller support for R8A7779 (R-Car H1)" if COMPILE_TEST
	select SYSC_RCAR

config SYSC_R8A7790
	bool "System Controller support for R8A7790 (R-Car H2)" if COMPILE_TEST
	select SYSC_RCAR

config SYSC_R8A7791
	bool "System Controller support for R8A7791/R8A7793 (R-Car M2-W/N)" if COMPILE_TEST
	select SYSC_RCAR

config SYSC_R8A7792
	bool "System Controller support for R8A7792 (R-Car V2H)" if COMPILE_TEST
	select SYSC_RCAR

config SYSC_R8A7794
	bool "System Controller support for R8A7794 (R-Car E2)" if COMPILE_TEST
	select SYSC_RCAR

config SYSC_R8A7795
	bool "System Controller support for R8A7795 (R-Car H3)" if COMPILE_TEST
	select SYSC_RCAR

config SYSC_R8A77960
	bool "System Controller support for R8A77960 (R-Car M3-W)" if COMPILE_TEST
	select SYSC_RCAR

config SYSC_R8A77961
	bool "System Controller support for R8A77961 (R-Car M3-W+)" if COMPILE_TEST
	select SYSC_RCAR

config SYSC_R8A77965
	bool "System Controller support for R8A77965 (R-Car M3-N)" if COMPILE_TEST
	select SYSC_RCAR

config SYSC_R8A77970
	bool "System Controller support for R8A77970 (R-Car V3M)" if COMPILE_TEST
	select SYSC_RCAR

config SYSC_R8A77980
	bool "System Controller support for R8A77980 (R-Car V3H)" if COMPILE_TEST
	select SYSC_RCAR

config SYSC_R8A77990
	bool "System Controller support for R8A77990 (R-Car E3)" if COMPILE_TEST
	select SYSC_RCAR

config SYSC_R8A77995
	bool "System Controller support for R8A77995 (R-Car D3)" if COMPILE_TEST
	select SYSC_RCAR

config SYSC_R8A779A0
	bool "System Controller support for R8A779A0 (R-Car V3U)" if COMPILE_TEST
	select SYSC_RCAR_GEN4

config SYSC_R8A779F0
	bool "System Controller support for R8A779F0 (R-Car S4-8)" if COMPILE_TEST
	select SYSC_RCAR_GEN4

config SYSC_R8A779G0
	bool "System Controller support for R8A779G0 (R-Car V4H)" if COMPILE_TEST
	select SYSC_RCAR_GEN4

config SYSC_R8A779H0
	bool "System Controller support for R8A779H0 (R-Car V4M)" if COMPILE_TEST
	select SYSC_RCAR_GEN4

endmenu
endif
```

## drivers/pmdomain/samsung/Kconfig
```kconfig
# SPDX-License-Identifier: GPL-2.0
if SOC_SAMSUNG

config EXYANALS_PM_DOMAINS
	bool "Exyanals PM domains" if COMPILE_TEST
	depends on (ARCH_EXYANALS && PM_GENERIC_DOMAINS) || COMPILE_TEST

endif
```

## drivers/pmdomain/st/Kconfig
```kconfig
# SPDX-License-Identifier: GPL-2.0-only
config UX500_PM_DOMAIN
	bool "ST-Ericsson ux500 Power Domain"
	depends on ARCH_U8500 || COMPILE_TEST
	default ARCH_U8500
```

## drivers/pmdomain/sunxi/Kconfig
```kconfig
# SPDX-License-Identifier: GPL-2.0-only

config SUN20I_PPU
	tristate "Allwinner D1 PPU power domain driver"
	depends on ARCH_SUNXI || COMPILE_TEST
	depends on PM
	default ARCH_SUNXI
	select PM_GENERIC_DOMAINS
	help
	  Say y to enable the PPU power domain driver. This is required
	  to enable power to certain peripherals, such as the display
	  engine.

config SUN50I_H6_PRCM_PPU
	tristate "Allwinner H6 PRCM power domain driver"
	depends on ARCH_SUNXI || COMPILE_TEST
	depends on PM
	select PM_GENERIC_DOMAINS
	help
	  Say y to enable the Allwinner H6/H616 PRCM power domain driver.
	  This is required to enable the Mali GPU in the H616 SoC, it is
	  optional for the H6.

config SUN55I_PCK600
	tristate "Allwinner A523 PCK-600 power domain driver"
	depends on ARCH_SUNXI || COMPILE_TEST
	depends on PM
	default ARCH_SUNXI
	select PM_GENERIC_DOMAINS
	help
	  Say y to enable the PCK-600 power domain driver. This is required
	  to enable power to certain peripherals, such as the display and
	  video engines.
```

## drivers/pmdomain/tegra/Kconfig
```kconfig
# SPDX-License-Identifier: GPL-2.0-only

config SOC_TEGRA_POWERGATE_BPMP
	def_bool y
	depends on PM_GENERIC_DOMAINS
	depends on TEGRA_BPMP
```

## drivers/pmdomain/thead/Kconfig
```kconfig
# SPDX-License-Identifier: GPL-2.0-only

config TH1520_PM_DOMAINS
	tristate "Support TH1520 Power Domains"
	depends on TH1520_AON_PROTOCOL
	select REGMAP_MMIO
	help
	  This driver enables power domain management for the T-HEAD
	  TH-1520 SoC. On this SoC there are number of power domains,
	  which can be managed independently. For example GPU, NPU,
	  and DPU reside in their own power domains which can be
	  turned on/off.
```

## drivers/pmdomain/ti/Kconfig
```kconfig
# SPDX-License-Identifier: GPL-2.0-only

config OMAP2PLUS_PRM
	bool
	depends on ARCH_OMAP2PLUS
	default ARCH_OMAP2PLUS

if SOC_TI

config TI_SCI_PM_DOMAINS
	tristate "TI SCI PM Domains Driver"
	depends on TI_SCI_PROTOCOL
	depends on PM_GENERIC_DOMAINS
	help
	  Generic power domain implementation for TI device implementing
	  the TI SCI protocol.

	  To compile this as a module, choose M here. The module will be
	  called ti_sci_pm_domains. Note this is needed early in boot before
	  rootfs may be available.

endif
```

## drivers/pmdomain/xilinx/Kconfig
```kconfig
# SPDX-License-Identifier: GPL-2.0

config ZYNQMP_PM_DOMAINS
	bool "Enable Zynq MPSoC generic PM domains"
	default y
	depends on PM && ZYNQMP_FIRMWARE
	select PM_GENERIC_DOMAINS
	help
	  Say yes to enable device power management through PM domains
	  If in doubt, say N.
```

## drivers/pnp/Kconfig
```kconfig
# SPDX-License-Identifier: GPL-2.0-only
#
# Plug and Play configuration
#

menuconfig PNP
	bool "Plug and Play support"
	depends on HAS_IOMEM
	depends on ISA || ACPI
	help
	  Plug and Play (PnP) is a standard for peripherals which allows those
	  peripherals to be configured by software, e.g. assign IRQ's or other
	  parameters. No jumpers on the cards are needed, instead the values
	  are provided to the cards from the BIOS, from the operating system,
	  or using a user-space utility.

	  Say Y here if you would like Linux to configure your Plug and Play
	  devices. You should then also say Y to all of the protocols below.
	  Alternatively, you can say N here and configure your PnP devices
	  using user space utilities such as the isapnptools package.

	  If unsure, say Y.

config PNP_DEBUG_MESSAGES
	default y
	bool "PNP debugging messages"
	depends on PNP
	help
	  Say Y here if you want the PNP layer to be able to produce debugging
	  messages if needed.  The messages can be enabled at boot-time with
	  the pnp.debug kernel parameter.

	  This option allows you to save a bit of space if you do not want
	  the messages to even be built into the kernel.

	  If you have any doubts about this, say Y here.

if PNP

comment "Protocols"

source "drivers/pnp/isapnp/Kconfig"

source "drivers/pnp/pnpbios/Kconfig"

source "drivers/pnp/pnpacpi/Kconfig"

endif # PNP
```

## drivers/pnp/isapnp/Kconfig
```kconfig
# SPDX-License-Identifier: GPL-2.0-only
#
# ISA Plug and Play configuration
#
config ISAPNP
	bool "ISA Plug and Play support"
	depends on ISA || COMPILE_TEST
	help
	  Say Y here if you would like support for ISA Plug and Play devices.
	  Some information is in <file:Documentation/userspace-api/isapnp.rst>.

	  If unsure, say Y.
```

## drivers/pnp/pnpacpi/Kconfig
```kconfig
# SPDX-License-Identifier: GPL-2.0-only
#
# Plug and Play ACPI configuration
#
config PNPACPI
	bool
	default (PNP && ACPI)
```
