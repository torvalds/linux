## drivers/pnp/pnpbios/Kconfig
```kconfig
# SPDX-License-Identifier: GPL-2.0-only
#
# Plug and Play BIOS configuration
#
config PNPBIOS
	bool "Plug and Play BIOS support"
	depends on ISA && X86_32
	default n
	help
	  Linux uses the PNPBIOS as defined in "Plug and Play BIOS
	  Specification Version 1.0A May 5, 1994" to autodetect built-in
	  mainboard resources (e.g. parallel port resources).

	  Some features (e.g. event notification, docking station information,
	  ISAPNP services) are not currently implemented.

	  If you would like the kernel to detect and allocate resources to
	  your mainboard devices (on some systems they are disabled by the
	  BIOS) say Y here.  Also the PNPBIOS can help prevent resource
	  conflicts between mainboard devices and other bus devices.

	  Note: ACPI is expected to supersede PNPBIOS some day, currently it
	  co-exists nicely.  If you have a non-ISA system that supports ACPI,
	  you probably don't need PNPBIOS support.

config PNPBIOS_PROC_FS
	bool "Plug and Play BIOS /proc interface"
	depends on PNPBIOS && PROC_FS
	help
	  If you say Y here and to "/proc file system support", you will be
	  able to directly access the PNPBIOS.  This includes resource
	  allocation, ESCD, and other PNPBIOS services.  Using this
	  interface is potentially dangerous because the PNPBIOS driver will
	  not be notified of any resource changes made by writing directly.
	  Also some buggy systems will fault when accessing certain features
	  in the PNPBIOS /proc interface (e.g. "boot" configs).

	  See the latest pcmcia-cs (stand-alone package) for a nice set of
	  PNPBIOS /proc interface tools (lspnp and setpnp).

	  Unless you are debugging or have other specific reasons, it is
	  recommended that you say N here.
```

## drivers/power/Kconfig
```kconfig
# SPDX-License-Identifier: GPL-2.0-only
source "drivers/power/reset/Kconfig"
source "drivers/power/sequencing/Kconfig"
source "drivers/power/supply/Kconfig"
```

## drivers/power/avs/Kconfig
```kconfig
# SPDX-License-Identifier: GPL-2.0-only

config QCOM_CPR
	tristate "QCOM Core Power Reduction (CPR) support"
	depends on POWER_AVS && HAS_IOMEM
	select PM_OPP
	select REGMAP
	help
	  Say Y here to enable support for the CPR hardware found on Qualcomm
	  SoCs like QCS404.

	  This driver populates CPU OPPs tables and makes adjustments to the
	  tables based on feedback from the CPR hardware. If you want to do
	  CPUfrequency scaling say Y here.

	  To compile this driver as a module, choose M here: the module will
	  be called qcom-cpr
```

## drivers/power/axp_power/Kconfig
```kconfig
menuconfig AW_AXP
	bool "AXP Power drivers"
	depends on REGULATOR
	default n
	---help---
	  This option allows you to select AXP power driver

if AW_AXP

choice
	prompt "AXP PMU type"
	default AW_AXP20

config AW_AXP18
	bool "AXP18 driver"
	---help---
	  AXP18 driver

config AW_AXP19
	bool "AXP19 driver"
	---help---
	  AXP19 driver

config AW_AXP20
	bool "AXP20 driver"
	---help---
	  AXP20 driver

endchoice

config AXP_CHARGEINIT
	bool "AXP initial charging environment set"
	default y

config AXP_CHGCHANGE
	bool "AXP charging current set when suspend\resume\shutdown"
	default y

endif # !AW_AXP
```

## drivers/power/reset/Kconfig
```kconfig
menuconfig POWER_RESET
	bool "Board level reset or power off"
	help
	  Provides a number of drivers which either reset a complete board
	  or shut it down, by manipulating the main power supply on the board.

	  Say Y here to enable board reset and power off

if POWER_RESET

config POWER_RESET_AS3722
	bool "ams AS3722 power-off driver"
	depends on MFD_AS3722
	help
	  This driver supports turning off board via a ams AS3722 power-off.

config POWER_RESET_AT91_POWEROFF
	tristate "Atmel AT91 poweroff driver"
	depends on ARCH_AT91
	default SOC_AT91SAM9 || SOC_SAMA5
	help
	  This driver supports poweroff for Atmel AT91SAM9 and SAMA5
	  SoCs

config POWER_RESET_AT91_RESET
	tristate "Atmel AT91 reset driver"
	depends on ARCH_AT91
	default SOC_AT91SAM9 || SOC_SAMA5
	help
	  This driver supports restart for Atmel AT91SAM9 and SAMA5
	  SoCs

config POWER_RESET_AT91_SAMA5D2_SHDWC
	tristate "Atmel AT91 SAMA5D2-Compatible shutdown controller driver"
	depends on ARCH_AT91
	default SOC_SAMA5
	help
	  This driver supports the alternate shutdown controller for some Atmel
	  SAMA5 SoCs. It is present for example on SAMA5D2 SoC.

config POWER_RESET_AXXIA
	bool "LSI Axxia reset driver"
	depends on ARCH_AXXIA
	help
	  This driver supports restart for Axxia SoC.

	  Say Y if you have an Axxia family SoC.

config POWER_RESET_BRCMKONA
	bool "Broadcom Kona reset driver"
	depends on ARM || COMPILE_TEST
	default ARCH_BCM_MOBILE
	help
	  This driver provides restart support for Broadcom Kona chips.

	  Say Y here if you have a Broadcom Kona-based board and you wish
	  to have restart support.

config POWER_RESET_BRCMSTB
	bool "Broadcom STB reset driver"
	depends on ARM || ARM64 || MIPS || COMPILE_TEST
	depends on MFD_SYSCON
	default ARCH_BRCMSTB || BMIPS_GENERIC
	help
	  This driver provides restart support for Broadcom STB boards.

	  Say Y here if you have a Broadcom STB board and you wish
	  to have restart support.

config POWER_RESET_GEMINI_POWEROFF
	bool "Cortina Gemini power-off driver"
	depends on ARCH_GEMINI || COMPILE_TEST
	depends on OF && HAS_IOMEM
	default ARCH_GEMINI
	help
	  This driver supports turning off the Cortina Gemini SoC.
	  Select this if you're building a kernel with Gemini SoC support.

config POWER_RESET_GPIO
	bool "GPIO power-off driver"
	depends on OF_GPIO
	help
	  This driver supports turning off your board via a GPIO line.
	  If your board needs a GPIO high/low to power down, say Y and
	  create a binding in your devicetree.

config POWER_RESET_GPIO_RESTART
	bool "GPIO restart driver"
	depends on OF_GPIO
	help
	  This driver supports restarting your board via a GPIO line.
	  If your board needs a GPIO high/low to restart, say Y and
	  create a binding in your devicetree.

config POWER_RESET_HISI
	bool "Hisilicon power-off driver"
	depends on ARCH_HISI
	help
	  Reboot support for Hisilicon boards.

config POWER_RESET_MSM
	bool "Qualcomm MSM power-off driver"
	depends on ARCH_QCOM
	help
	  Power off and restart support for Qualcomm boards.

config POWER_RESET_PIIX4_POWEROFF
	tristate "Intel PIIX4 power-off driver"
	depends on PCI
	depends on MIPS || COMPILE_TEST
	help
	  This driver supports powering off a system using the Intel PIIX4
	  southbridge, for example the MIPS Malta development board. The
	  southbridge SOff state is entered in response to a request to
	  power off the system.

config POWER_RESET_LTC2952
	bool "LTC2952 PowerPath power-off driver"
	depends on OF_GPIO
	help
	  This driver supports an external powerdown trigger and board power
	  down via the LTC2952. Bindings are made in the device tree.

config POWER_RESET_QNAP
	bool "QNAP power-off driver"
	depends on OF_GPIO && PLAT_ORION
	help
	  This driver supports turning off QNAP NAS devices by sending
	  commands to the microcontroller which controls the main power.

	  Say Y if you have a QNAP NAS.

config POWER_RESET_RESTART
	bool "Restart power-off driver"
	help
	  Some boards don't actually have the ability to power off.
	  Instead they restart, and u-boot holds the SoC until the
	  user presses a key. u-boot then boots into Linux.

config POWER_RESET_ST
	bool "ST restart driver"
	depends on ARCH_STI
	help
	  Reset support for STMicroelectronics boards.

config POWER_RESET_VERSATILE
	bool "ARM Versatile family reboot driver"
	depends on ARM
	depends on MFD_SYSCON
	depends on OF
	help
	  Power off and restart support for ARM Versatile family of
	  reference boards.

config POWER_RESET_VEXPRESS
	bool "ARM Versatile Express power-off and reset driver"
	depends on ARM || ARM64
	depends on VEXPRESS_CONFIG
	help
	  Power off and reset support for the ARM Ltd. Versatile
	  Express boards.

config POWER_RESET_XGENE
	bool "APM SoC X-Gene reset driver"
	depends on ARM64
	help
	  Reboot support for the APM SoC X-Gene Eval boards.

config POWER_RESET_KEYSTONE
	bool "Keystone reset driver"
	depends on ARCH_KEYSTONE || COMPILE_TEST
	depends on HAS_IOMEM
	select MFD_SYSCON
	help
	  Reboot support for the KEYSTONE SoCs.

config POWER_RESET_SYSCON
	bool "Generic SYSCON regmap reset driver"
	depends on OF
	depends on HAS_IOMEM
	select MFD_SYSCON
	help
	  Reboot support for generic SYSCON mapped register reset.

config POWER_RESET_SYSCON_POWEROFF
	bool "Generic SYSCON regmap poweroff driver"
	depends on OF
	depends on HAS_IOMEM
	select MFD_SYSCON
	help
	  Poweroff support for generic SYSCON mapped register poweroff.

config POWER_RESET_RMOBILE
	tristate "Renesas R-Mobile reset driver"
	depends on ARCH_RMOBILE || COMPILE_TEST
	depends on HAS_IOMEM
	help
	  Reboot support for Renesas R-Mobile and SH-Mobile SoCs.

config POWER_RESET_ZX
	tristate "ZTE SoCs reset driver"
	depends on ARCH_ZX || COMPILE_TEST
	depends on HAS_IOMEM
	help
	  Reboot support for ZTE SoCs.

config REBOOT_MODE
	tristate

config SYSCON_REBOOT_MODE
	tristate "Generic SYSCON regmap reboot mode driver"
	depends on OF
	depends on MFD_SYSCON
	select REBOOT_MODE
	help
	  Say y here will enable reboot mode driver. This will
	  get reboot mode arguments and store it in SYSCON mapped
	  register, then the bootloader can read it to take different
	  action according to the mode.

endif
```

## drivers/power/sequencing/Kconfig
```kconfig
# SPDX-License-Identifier: GPL-2.0-only

menuconfig POWER_SEQUENCING
	tristate "Power Sequencing support"
	help
	  Say Y here to enable the Power Sequencing subsystem.

	  This subsystem is designed to control power to devices that share
	  complex resources and/or require specific power sequences to be run
	  during power-up.

	  If unsure, say no.

if POWER_SEQUENCING

config POWER_SEQUENCING_QCOM_WCN
	tristate "Qualcomm WCN family PMU driver"
	default m if ARCH_QCOM
	depends on OF
	help
	  Say Y here to enable the power sequencing driver for Qualcomm
	  WCN Bluetooth/WLAN chipsets.

	  Typically, a package from the Qualcomm WCN family contains the BT
	  and WLAN modules whose power is controlled by the PMU module. As the
	  former two share the power-up sequence which is executed by the PMU,
	  this driver is needed for correct power control or else we'd risk not
	  respecting the required delays between enabling Bluetooth and WLAN.

endif
```
