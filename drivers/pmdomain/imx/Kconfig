## drivers/pmdomain/imx/Kconfig
```kconfig
# SPDX-License-Identifier: GPL-2.0-only
menu "i.MX PM Domains"

config IMX_GPCV2_PM_DOMAINS
	bool "i.MX GPCv2 PM domains"
	depends on ARCH_MXC || (COMPILE_TEST && OF)
	depends on PM
	select PM_GENERIC_DOMAINS
	select REGMAP_MMIO
	default y if SOC_IMX7D

config IMX8M_BLK_CTRL
	tristate "i.MX8M BLK CTRL driver"
	depends on SOC_IMX8M
	depends on IMX_GPCV2_PM_DOMAINS
	depends on PM_GENERIC_DOMAINS
	depends on COMMON_CLK
	default y

config IMX9_BLK_CTRL
	tristate "i.MX93 BLK CTRL driver"
	depends on SOC_IMX9
	depends on PM_GENERIC_DOMAINS
	default y

config IMX_SCU_PD
	tristate "IMX SCU Power Domain driver"
	depends on IMX_SCU
	help
	  The System Controller Firmware (SCFW) based power domain driver.

endmenu
```

## drivers/pmdomain/riscv/Kconfig
```kconfig
# SPDX-License-Identifier: GPL-2.0-only

config RISCV_RPMI_DEVICE_POWER
	bool "RISC-V RPMI Based Device Power driver"
	depends on RISCV || COMPILE_TEST
	depends on MAILBOX
	depends on PM
	default RISCV
	select PM_GENERIC_DOMAINS
	help
	  Support for device power domains based on the device power service
	  group defined by the RISC-V platform management interface (RPMI)
	  specification. The power domains advertised by the platform
	  microcontroller are registered as generic power domains, so that
	  devices can reference them through the "power-domains" property.
```

## drivers/scsi/leapraid/Kconfig
```kconfig
# SPDX-License-Identifier: GPL-2.0-or-later

config SCSI_LEAPRAID
	tristate "LeapIO RAID Adapter"
	depends on PCI && SCSI
	select SCSI_SAS_ATTRS
	help
	  This driver supports LeapIO PCIe-based storage
	  and RAID controllers.

	  <http://www.leap-io.com>

	  To compile this driver as a module, choose M here: the
	  resulting kernel module will be named leapraid.
```

## drivers/soc/st/Kconfig
```kconfig
# SPDX-License-Identifier: GPL-2.0-only
menu "ST SoC drivers"

config SOC_STM32MP2
	tristate "STM32MP2 SoC family support"
	depends on ARCH_STM32 || COMPILE_TEST
	default ARCH_STM32 && ARM64
	select SOC_BUS
	help
	  If you say yes here, you get support for the ST STM32MP2 family

endmenu
```

## drivers/soc/starfive/Kconfig
```kconfig
# SPDX-License-Identifier: GPL-2.0-only
menu "StarFive SoC (System On Chip) specific Drivers"

source "drivers/soc/starfive/socinfo/Kconfig"

endmenu
```

## drivers/soc/starfive/socinfo/Kconfig
```kconfig
# SPDX-License-Identifier: GPL-2.0-only

config STARFIVE_JHB100_SOCINFO
	bool "StarFive JHB100 SoC Information"
	depends on ARCH_STARFIVE || COMPILE_TEST
	select SOC_BUS
	select MFD_CORE
	select MFD_SYSCON
	default y
	help
	  Include support for the SoC bus socinfo for the StarFive JHB100 SoC
	  platforms to provide information about the SoC family and variant
	  to user space.
```

## drivers/thermal/samsung/Kconfig
```kconfig
# SPDX-License-Identifier: GPL-2.0-only
config EXYNOS_THERMAL
	tristate "Exynos thermal management unit driver"
	depends on THERMAL_OF
	depends on HAS_IOMEM
	default ARCH_EXYNOS
	help
	  If you say yes here you get support for the TMU (Thermal Management
	  Unit) driver for Samsung Exynos series of SoCs. This driver initialises
	  the TMU, reports temperature and handles cooling action if defined.
	  This driver uses the Exynos core thermal APIs and TMU configuration
	  data from the supported SoCs.

config EXYNOS_ACPM_THERMAL
	tristate "Exynos ACPM thermal management unit driver"
	depends on THERMAL_OF
	depends on HAS_IOMEM
	depends on EXYNOS_ACPM_PROTOCOL
	default ARCH_EXYNOS
	help
	  Support for the Thermal Management Unit (TMU) on Samsung Exynos SoCs
	  utilizing the ACPM IPC protocol, such as the Google GS101.

	  The TMU on these platforms is managed through a hybrid architecture.
	  This driver handles direct register access for thermal interrupt status
	  monitoring and communicates with the Alive Clock and Power Manager
	  (ACPM) firmware via the ACPM IPC protocol for functional sensor control
	  and configuration.

	  Select this if you want to monitor device temperature and enable
	  thermal mitigation on Samsung Exynos ACPM based devices.
```

## drivers/usb/fotg210/Kconfig
```kconfig
# SPDX-License-Identifier: GPL-2.0

config USB_FOTG210
	tristate "Faraday FOTG210 USB2 Dual Role controller"
	depends on USB || USB_GADGET
	depends on HAS_DMA && HAS_IOMEM
	depends on ARCH_GEMINI || COMPILE_TEST
	default ARCH_GEMINI
	select MFD_SYSCON
	help
	  Faraday FOTG210 is a dual-mode USB controller that can act
	  in both host controller and peripheral controller mode.

if USB_FOTG210

config USB_FOTG210_HCD
	bool "Faraday FOTG210 USB Host Controller support"
	depends on USB=y || USB=USB_FOTG210
	depends on USB_EHCI_HCD=y || USB_EHCI_HCD=USB_FOTG210
	select USB_EHCI_DEVIANT_PORT_STATUS_REG
	select USB_EHCI_PORT_RESET_HOOKS
	select USB_EHCI_PORT_SPEED_HOOK
	select USB_EHCI_ROOT_HUB_TT
	help
	  Faraday FOTG210 is an OTG controller which can be configured as
	  an USB2.0 host. It is designed to meet USB2.0 EHCI specification
	  with minor modification.

	  To compile this driver as a module, choose M here: the
	  module will be called fotg210-hcd.

config USB_FOTG210_UDC
	depends on USB_GADGET=y || USB_GADGET=USB_FOTG210
	bool "Faraday FOTG210 USB Peripheral Controller support"
	help
	   Faraday USB2.0 OTG controller which can be configured as
	   high speed or full speed USB device. This driver supports
	   Bulk Transfer so far.

	   Say "y" to link the driver statically, or "m" to build a
	   dynamically linked module called "fotg210-udc".

endif
```

## drivers/virt/coco/arm-cca-guest/Kconfig
```kconfig
config ARM_CCA_GUEST
	tristate "Arm CCA Guest driver"
	depends on ARM_RMM_RSI
	depends on HAVE_ARM_SMCCC_DISCOVERY
	select TSM_REPORTS
	help
	  The driver provides userspace interface to request and
	  attestation report from the Realm Management Monitor(RMM).

	  If you choose 'M' here, this module will be called
	  arm-cca-guest.
```

## fs/ceph/Kconfig
```kconfig
# SPDX-License-Identifier: GPL-2.0-only
config CEPH_FS
	tristate "Ceph distributed file system"
	depends on INET
	select CEPH_LIB
	select NETFS_SUPPORT
	select NETFS_PGPRIV2
	select FS_ENCRYPTION_ALGS if FS_ENCRYPTION
	default n
	help
	  Choose Y or M here to include support for mounting the
	  experimental Ceph distributed file system.  Ceph is an extremely
	  scalable file system designed to provide high performance,
	  reliable access to petabytes of storage.

	  More information at https://ceph.io/.

	  If unsure, say N.

if CEPH_FS

config CEPH_FS_INLINE_DATA
	bool "Enable CephFS inline data support (deprecated)"
	depends on CEPH_FS
	default n
	help
	  Inline data support has been deprecated in the CephFS MDS
	  and is being formally removed.  Existing inline data can be
	  migrated to data pool objects via MDS scrub.  Choose N
	  unless you have a legacy filesystem that requires it,
	  and ensure all inline data has been migrated (see
	  ceph fs set <fs> inline_data false) before enabling.

config CEPH_FSCACHE
	bool "Enable Ceph client caching support"
	depends on CEPH_FS=m && FSCACHE || CEPH_FS=y && FSCACHE=y
	help
	  Choose Y here to enable persistent, read-only local
	  caching support for Ceph clients using FS-Cache

endif

config CEPH_FS_POSIX_ACL
	bool "Ceph POSIX Access Control Lists"
	depends on CEPH_FS
	select FS_POSIX_ACL
	help
	  POSIX Access Control Lists (ACLs) support permissions for users and
	  groups beyond the owner/group/world scheme.

	  If you don't know what Access Control Lists are, say N

config CEPH_FS_SECURITY_LABEL
	bool "CephFS Security Labels"
	depends on CEPH_FS && SECURITY
	help
	  Security labels support alternative access control models
	  implemented by security modules like SELinux. This option
	  enables an extended attribute handler for file security
	  labels in the Ceph filesystem.

	  If you are not using a security module that requires using
	  extended attributes for file security labels, say N.
```

## fs/smb/server/tests/Kconfig
```kconfig
# SPDX-License-Identifier: GPL-2.0-or-later
# Copyright (C) 2026 Hang Nan <nanx95726@gmail.com>

config SMB_SERVER_KUNIT_TESTS
	tristate "KUnit tests for SMB3 server helpers" if !KUNIT_ALL_TESTS
	depends on SMB_SERVER && SMB_KUNIT_TESTS && TMPFS_XATTR
	default SMB_KUNIT_TESTS
	help
	  This builds the KUnit tests for ksmbd server helpers. The tests
	  exercise internal server functionality and help detect regressions
	  in server-side behavior. They are intended for kernel developers
	  and are not suitable for production systems.

	  For more information on KUnit and unit tests in the kernel,
	  please read Documentation/dev-tools/kunit/index.rst.
```

## kernel/trace/rv/monitors/wakeup/Kconfig
```kconfig
# SPDX-License-Identifier: GPL-2.0-only
#
config RV_MON_WAKEUP
	depends on RV
	depends on RV_MON_RTAPP
	depends on HAVE_SYSCALL_TRACEPOINTS
	default y
	select LTL_MON_EVENTS_ID
	bool "wakeup monitor"
	help
	  This monitor detects a lower-priority task waking up a
	  higher-priority task. The RV_MON_SLEEP monitor already
	  detects this case, but this monitor detects in the context
	  of the waker task instead. This and RV_MON_SLEEP can be
	  enabled together to get the stacktrace of both the waker
	  task and the wakee task.
```
