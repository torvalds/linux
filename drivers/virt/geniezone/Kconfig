## drivers/virtio/Kconfig
```kconfig
# SPDX-License-Identifier: GPL-2.0-only
config VIRTIO_ANCHOR
	bool

config VIRTIO
	tristate
	select VIRTIO_ANCHOR
	help
	  This option is selected by any driver which implements the virtio
	  bus, such as CONFIG_VIRTIO_PCI, CONFIG_VIRTIO_MMIO, CONFIG_RPMSG
	  or CONFIG_S390_GUEST.

config VIRTIO_PCI_LIB
	tristate
	help
	  Modern PCI device implementation. This module implements the
	  basic probe and control for devices which are based on modern
	  PCI device with possible vendor specific extensions. Any
	  module that selects this module must depend on PCI.

config VIRTIO_PCI_LIB_LEGACY
	tristate
	help
	  Legacy PCI device (Virtio PCI Card 0.9.x Draft and older device)
	  implementation.
	  This module implements the basic probe and control for devices
	  which are based on legacy PCI device. Any module that selects this
	  module must depend on PCI.

menuconfig VIRTIO_MENU
	bool "Virtio drivers"
	default y

if VIRTIO_MENU

config VIRTIO_HARDEN_NOTIFICATION
        bool "Harden virtio notification"
        depends on BROKEN
        help
          Enable this to harden the device notifications and suppress
          those that happen at a time where notifications are illegal.

          Experimental: Note that several drivers still have issues that
          may cause crashes or hangs when correct handling of
          notifications is enforced; depending on the subset of
          drivers and devices you use, this may or may not work.

          If unsure, say N.

config VIRTIO_PCI
	tristate "PCI driver for virtio devices"
	depends on PCI
	select VIRTIO_PCI_LIB
	select VIRTIO
	help
	  This driver provides support for virtio based paravirtual device
	  drivers over PCI.  This requires that your VMM has appropriate PCI
	  virtio backends.  Most QEMU based VMMs should support these devices
	  (like KVM or Xen).

	  If unsure, say M.

config VIRTIO_PCI_ADMIN_LEGACY
	bool
	depends on VIRTIO_PCI && (X86 || COMPILE_TEST)
	default y

config VIRTIO_PCI_LEGACY
	bool "Support for legacy virtio draft 0.9.X and older devices"
	default y
	depends on VIRTIO_PCI
	select VIRTIO_PCI_LIB_LEGACY
	help
          Virtio PCI Card 0.9.X Draft (circa 2014) and older device support.

	  This option enables building a transitional driver, supporting
	  both devices conforming to Virtio 1 specification, and legacy devices.
	  If disabled, you get a slightly smaller, non-transitional driver,
	  with no legacy compatibility.

          So look out into your driveway.  Do you have a flying car?  If
          so, you can happily disable this option and virtio will not
          break.  Otherwise, leave it set.  Unless you're testing what
          life will be like in The Future.

	  If unsure, say Y.

config VIRTIO_VDPA
	tristate "vDPA driver for virtio devices"
	depends on VDPA
	select VIRTIO
	help
	  This driver provides support for virtio based paravirtual
	  device driver over vDPA bus. For this to be useful, you need
	  an appropriate vDPA device implementation that operates on a
	  physical device to allow the datapath of virtio to be
	  offloaded to hardware.

	  If unsure, say M.

config VIRTIO_PMEM
	tristate "Support for virtio pmem driver"
	depends on VIRTIO
	depends on LIBNVDIMM
	help
	  This driver provides access to virtio-pmem devices, storage devices
	  that are mapped into the physical address space - similar to NVDIMMs
	   - with a virtio-based flushing interface.

	  If unsure, say Y.

config VIRTIO_BALLOON
	tristate "Virtio balloon driver"
	depends on VIRTIO
	select MEMORY_BALLOON
	select PAGE_REPORTING
	help
	 This driver supports increasing and decreasing the amount
	 of memory within a KVM guest.

	 If unsure, say M.

config VIRTIO_MEM
	tristate "Virtio mem driver"
	depends on X86_64 || ARM64 || RISCV || S390
	depends on VIRTIO
	depends on MEMORY_HOTPLUG
	depends on MEMORY_HOTREMOVE
	depends on CONTIG_ALLOC
	depends on EXCLUSIVE_SYSTEM_RAM
	help
	 This driver provides access to virtio-mem paravirtualized memory
	 devices, allowing to hotplug and hotunplug memory.

	 This driver currently supports x86-64, arm64, riscv and s390.
	 Although it should compile on other architectures that implement
	 memory hot(un)plug, architecture-specific and/or common
	 code changes may be required for virtio-mem, kdump and kexec to
	 work as expected.

	 If unsure, say M.

config VIRTIO_INPUT
	tristate "Virtio input driver"
	depends on VIRTIO
	depends on INPUT
	help
	 This driver supports virtio input devices such as
	 keyboards, mice and tablets.

	 If unsure, say M.

config VIRTIO_MMIO
	tristate "Platform bus driver for memory mapped virtio devices"
	depends on HAS_IOMEM && HAS_DMA
	select VIRTIO
	help
	 This drivers provides support for memory mapped virtio
	 platform device driver.

 	 If unsure, say N.

config VIRTIO_MMIO_CMDLINE_DEVICES
	bool "Memory mapped virtio devices parameter parsing"
	depends on VIRTIO_MMIO
	help
	 Allow virtio-mmio devices instantiation via the kernel command line
	 or module parameters. Be aware that using incorrect parameters (base
	 address in particular) can crash your system - you have been warned.
	 See Documentation/admin-guide/kernel-parameters.rst for details.

	 If unsure, say 'N'.

config VIRTIO_DMA_SHARED_BUFFER
	tristate
	depends on DMA_SHARED_BUFFER
	help
	 This option adds a flavor of dma buffers that are backed by
	 virtio resources.

config VIRTIO_DEBUG
	bool "Debug facilities"
	depends on VIRTIO
	help
	  Enable this to expose debug facilities over debugfs.
	  This allows to debug features, to see what features the device
	  advertises and to set filter for features used by driver.

	  If unsure, say N.

config VIRTIO_RTC
	tristate "Virtio RTC driver"
	depends on VIRTIO
	depends on PTP_1588_CLOCK_OPTIONAL
	help
	 This driver provides current time from a Virtio RTC device. The driver
	 provides the time through one or more clocks. The Virtio RTC PTP
	 clocks and/or the Real Time Clock driver for Virtio RTC must be
	 enabled to expose the clocks to userspace.

	 To compile this code as a module, choose M here: the module will be
	 called virtio_rtc.

	 If unsure, say M.

if VIRTIO_RTC

comment "WARNING: Consider enabling VIRTIO_RTC_PTP and/or VIRTIO_RTC_CLASS."
	depends on !VIRTIO_RTC_PTP && !VIRTIO_RTC_CLASS

comment "Enable PTP_1588_CLOCK in order to enable VIRTIO_RTC_PTP."
	depends on PTP_1588_CLOCK=n

config VIRTIO_RTC_PTP
	bool "Virtio RTC PTP clocks"
	default y
	depends on PTP_1588_CLOCK
	help
	 This exposes any Virtio RTC clocks as PTP Hardware Clocks (PHCs) to
	 userspace. The PHC sysfs attribute "clock_name" describes the clock
	 type.

	 If unsure, say Y.

config VIRTIO_RTC_ARM
	bool "Virtio RTC cross-timestamping using Arm Generic Timer"
	default y
	depends on VIRTIO_RTC_PTP && ARM_ARCH_TIMER
	help
	 This enables Virtio RTC cross-timestamping using the Arm Generic Timer.
	 It only has an effect if the Virtio RTC device also supports this. The
	 cross-timestamp is available through the PTP clock driver precise
	 cross-timestamp ioctl (PTP_SYS_OFFSET_PRECISE2 aka
	 PTP_SYS_OFFSET_PRECISE).

	 If unsure, say Y.

comment "Enable RTC_CLASS in order to enable VIRTIO_RTC_CLASS."
	depends on RTC_CLASS=n

config VIRTIO_RTC_CLASS
	bool "Real Time Clock driver for Virtio RTC"
	default y
	depends on RTC_CLASS
	help
	 This exposes the Virtio RTC UTC-like clock as a Linux Real Time Clock.
	 It only has an effect if the Virtio RTC device has a UTC-like clock
	 which smears leap seconds to avoid steps. The Real Time Clock is
	 read-only, and may support setting an alarm.

	 If unsure, say Y.

endif # VIRTIO_RTC

endif # VIRTIO_MENU
```

## drivers/virtio/vdpa/Kconfig
```kconfig
# SPDX-License-Identifier: GPL-2.0-only
config VDPA
	tristate
	help
	  Enable this module to support vDPA device that uses a
	  datapath which complies with virtio specifications with
	  vendor specific control path.

menuconfig VDPA_MENU
	bool "VDPA drivers"
	default n

if VDPA_MENU

config VDPA_SIM
	tristate "vDPA device simulator"
	depends on RUNTIME_TESTING_MENU
	select VDPA
	select VHOST_RING
	default n
	help
	  vDPA networking device simulator which loop TX traffic back
	  to RX. This device is used for testing, prototyping and
	  development of vDPA.

endif # VDPA_MENU
```

## drivers/visorbus/Kconfig
```kconfig
# SPDX-License-Identifier: GPL-2.0-only
#
# Unisys visorbus configuration
#

config UNISYS_VISORBUS
	tristate "Unisys visorbus driver"
	depends on X86_64 && ACPI
	help
	The visorbus driver is a virtualized bus for the Unisys s-Par firmware.
	Virtualized devices allow Linux guests on a system to share disks and
	network cards that do not have SR-IOV support, and to be accessed using
	the partition desktop application. The visorbus driver is required to
	discover devices on an s-Par guest, and must be present for any other
	s-Par guest driver to function correctly.
```

## drivers/vlynq/Kconfig
```kconfig
# SPDX-License-Identifier: GPL-2.0-only
menu "TI VLYNQ"
	depends on AR7

config VLYNQ
	bool "TI VLYNQ bus support"
	help
	  Support for Texas Instruments(R) VLYNQ bus.
	  The VLYNQ bus is a high-speed, serial and packetized
	  data bus which allows external peripherals of a SoC
	  to appear into the system's main memory.

	  If unsure, say N

config VLYNQ_DEBUG
	bool "VLYNQ bus debug"
	depends on VLYNQ && DEBUG_KERNEL
	help
	  Turn on VLYNQ bus debugging.

endmenu
```

## drivers/vme/Kconfig
```kconfig
# SPDX-License-Identifier: GPL-2.0-only
#
# VME configuration.
#

menuconfig VME_BUS
	bool "VME bridge support"
	depends on PCI
	help
	  If you say Y here you get support for the VME bridge Framework.

if VME_BUS

source "drivers/vme/bridges/Kconfig"

source "drivers/vme/boards/Kconfig"

endif # VME
```

## drivers/vme/boards/Kconfig
```kconfig
# SPDX-License-Identifier: GPL-2.0-only
comment "VME Board Drivers"

config VMIVME_7805
	tristate "VMIVME-7805"
	help
	  If you say Y here you get support for the VMIVME-7805 board.
	  This board has an additional control interface to the Universe II
	  chip. This driver has to be included if you want to access VME bus
	  with VMIVME-7805 board.
```

## drivers/vme/bridges/Kconfig
```kconfig
# SPDX-License-Identifier: GPL-2.0-only
comment "VME Bridge Drivers"

config VME_CA91CX42
	tristate "Universe II"
	depends on VIRT_TO_BUS
	help
	 If you say Y here you get support for the Tundra CA91C142
	 (Universe II) VME bridge chip.

config VME_TSI148
	tristate "Tempe"
	depends on HAS_DMA
	help
	 If you say Y here you get support for the Tundra TSI148 VME bridge
	 chip.

config VME_FAKE
	tristate "Fake"
	help
	 If you say Y here you get support for the fake VME bridge. This
	 provides a virtualised VME Bus for devices with no VME bridge. This
	 is mainly useful for VME development (in the absence of VME
	 hardware).
```

## drivers/w1/Kconfig
```kconfig
menuconfig W1
	tristate "Dallas's 1-wire support"
	depends on HAS_IOMEM
	---help---
	  Dallas' 1-wire bus is useful to connect slow 1-pin devices
	  such as iButtons and thermal sensors.

	  If you want W1 support, you should say Y here.

	  This W1 support can also be built as a module.  If so, the module
	  will be called wire.

if W1

config W1_CON
	depends on CONNECTOR
	bool "Userspace communication over connector"
	default y
	---help---
	  This allows to communicate with userspace using connector. For more
	  information see <file:Documentation/connector/connector.txt>.
	  There are three types of messages between w1 core and userspace:
	  1. Events. They are generated each time new master or slave device found
		either due to automatic or requested search.
	  2. Userspace commands. Includes read/write and search/alarm search commands.
	  3. Replies to userspace commands.

source "drivers/w1/masters/Kconfig"
source "drivers/w1/slaves/Kconfig"

endif # W1
```

## drivers/w1/masters/Kconfig
```kconfig
# SPDX-License-Identifier: GPL-2.0-only
#
# 1-wire bus master configuration
#

menu "1-wire Bus Masters"

config W1_MASTER_AMD_AXI
	tristate "AMD AXI 1-wire bus host"
	help
	  Say Y here is you want to support the AMD AXI 1-wire IP core.
	  This driver makes use of the programmable logic IP to perform
	  correctly timed 1 wire transactions without relying on GPIO timing
	  through the kernel.

	  This driver can also be built as a module.  If so, the module will be
	  called amd_w1_axi.

config W1_MASTER_MATROX
	tristate "Matrox G400 transport layer for 1-wire"
	depends on PCI
	help
	  Say Y here if you want to communicate with your 1-wire devices
	  using Matrox's G400 GPIO pins.

	  This support is also available as a module.  If so, the module
	  will be called matrox_w1.

config W1_MASTER_DS2490
	tristate "DS2490 USB <-> W1 transport layer for 1-wire"
  	depends on USB
  	help
	  Say Y here if you want to have a driver for DS2490 based USB <-> W1 bridges,
	  for example DS9490*.

  	  This support is also available as a module.  If so, the module
	  will be called ds2490.

config W1_MASTER_DS2482
	tristate "Maxim DS2482 I2C to 1-Wire bridge"
	depends on I2C
	help
	  If you say yes here you get support for the Maxim DS2482
	  I2C to 1-Wire bridge.

	  This driver can also be built as a module.  If so, the module
	  will be called ds2482.

config W1_MASTER_MXC
	tristate "Freescale MXC 1-wire busmaster"
	depends on ARCH_MXC || COMPILE_TEST
	help
	  Say Y here to enable MXC 1-wire host

config W1_MASTER_GPIO
	tristate "GPIO 1-wire busmaster"
	depends on GPIOLIB || COMPILE_TEST
	help
	  Say Y here if you want to communicate with your 1-wire devices using
	  GPIO pins. This driver uses the GPIO API to control the wire.

	  This support is also available as a module.  If so, the module
	  will be called w1-gpio.

config HDQ_MASTER_OMAP
	tristate "OMAP HDQ driver"
	depends on ARCH_OMAP || COMPILE_TEST
	help
	  Say Y here if you want support for the 1-wire or HDQ Interface
	  on an OMAP processor.

config W1_MASTER_SGI
	tristate "SGI ASIC driver"
	help
	  Say Y here if you want support for your 1-wire devices using
	  SGI ASIC 1-Wire interface

	  This support is also available as a module.  If so, the module
	  will be called sgi_w1.

config W1_MASTER_UART
	tristate "UART 1-wire driver"
	depends on SERIAL_DEV_BUS
	help
	  Say Y here if you want to communicate with your 1-wire devices using
	  UART interface.

	  This support is also available as a module.  If so, the module
	  will be called w1-uart.

endmenu
```
