## drivers/soc/qcom/dcvs/Kconfig
```kconfig
# SPDX-License-Identifier: GPL-2.0-only
#
# QCOM DCVS drivers
#
config QCOM_PMU_LIB
	tristate "QCOM PMU Driver"
	depends on ARCH_QCOM
	default n
	help
	  This enables the QCOM PMU driver which manages and maintains
	  per-CPU performance counters that are available on some
	  Qualcomm Technologies, Inc. (QTI) chipsets. This includes
	  preserving them across CPU idle and hotplug events.

config QCOM_DCVS_FP
	tristate "Enable QCOM DCVS Fast Path Interface"
	depends on ARCH_QCOM && QCOM_RPMH
	default n
	help
	  This enables the QCOM DCVS FP (Fast Path) driver which relies on
	  certain "fast path" APIs from QCOM_RPMH to vote for various DCVS HW
	  blocks in a faster scheme than standard voting paths. This requires a
	  Qualcomm Technologies, Inc. (QTI) chipset that supports this feature.

config QCOM_DCVS
	tristate "QCOM DCVS Driver"
	select INTERCONNECT
	default n
	help
	  This enables the main QCOM DCVS framework which supports various
	  DCVS HW blocks and voting interfaces that are supported on some
	  Qualcomm Technologies, Inc. (QTI) chipsets. This includes voting
	  interfaces from both QCOM_DCVS_FP and INTERCONNECT.

config QCOM_MEMLAT
	tristate "QCOM Memlat Driver"
	depends on QCOM_DCVS && QCOM_PMU_LIB
	default n
	help
	  This enables the QCOM Memlat driver which monitors CPU performance
	  counters to identify memory latency bound workloads and vote for
	  DCVS HW (memory) frequencies through the QCOM DCVS framework. This
	  driver also configures epss memlat if enabled.

config QCOM_BWMON
	tristate "QCOM BWMON Driver"
	depends on QCOM_DCVS
	default n
	help
	  This enables the QCOM BWMON driver which monitors bandwidth counters
	  to identify memory bandwidth bound workloads and vote for DCVS HW
	  (memory) frequencies through the QCOM DCVS framework. This driver
	  handles voting for DDR and LLCC.

config QCOM_BWPROF
	tristate "QCOM BWPROF Driver"
	depends on ARCH_QCOM
	default n
	help
	  This enables the QCOM BWPROF driver which monitors bandwidth counters
	  and provides them to userspace clients at modest time intervals for
	  the intention of bandwidth profiling and DDR frequency monitoring. The
	  purpose of the driver is to enable the monitoring of the bandwidth usage
	  at regular intervals, providing the userspace clients with a detailed
	  view of the current state of the system.

config QCOM_LLCC_MISS
	tristate "Qualcomm Technologies Inc. LLCC_MISS_STATS Driver"
	depends on ARCH_QCOM && QCOM_BUS_PROF
	default n
	help
	  This enables the QCOM LLCC miss stats driver which exposes LLCC miss
	  stats to user space clients at modest time intervals for the intention
	  of profiling.

	  The purpose of the driver is to enable the monitoring of LLCC misses
	  at regular intervals and providing the miss rate data to the user
	  space clients upon read.

config QCOM_BUS_PROF
	tristate "Qualcomm Technologies Inc. BUS_PROF Driver"
	depends on ARCH_QCOM
	default n
	help
	  This enables the QCOM bus profiling common framework and ftraces,
	  which provide support for a variety of features. These features
	  include memory latency, LLCC miss, and LLCC occupancy, all of
	  which are supported on certain Qualcomm Technologies, Inc.
	  (QTI) chipsets.

config QTI_PMU_SCMI_CLIENT
	tristate "Qualcomm Technologies Inc. SCMI client driver for PMU"
	depends on QTI_SCMI_PMU_PROTOCOL && QCOM_PMU_LIB
	default n
	help
	  SCMI client driver registers itself with SCMI framework for pmu
	  vendor protocol.

	  This driver delivers the pmu vendor protocol handle to interface
	  driver, and interface driver will use this handle to communicate with
	  cpucp.

config QTI_QCOM_SCMI_CLIENT
	tristate "Qualcomm Technologies Inc. SCMI client driver"
	depends on QTI_SCMI_VENDOR_PROTOCOL
	default n
	help
	  SCMI client driver registers for Qcom vendor protocol.

	  This driver delivers the qcom vendor protocol handle to interface
	  driver, and interface driver will use this handle to communicate with
	  cpucp.

config QTI_C1DCVS_SCMI_CLIENT
	tristate "Qualcomm Technologies Inc. SCMI client driver for cpudcvs"
	depends on QTI_SCMI_C1DCVS_PROTOCOL
	default n
	help
	  SCMI client driver registers itself with SCMI framework for c1dcvs
	  vendor protocol.

	  This driver delivers the cpudcvs protocol handle to interface
	  driver, and interface driver will use this handle to communicate with
	  cpucp.

config QTI_C1DCVS_SCMI_V2
	tristate "Qualcomm Technologies Inc. SCMI client driver for C1 DCVS"
	depends on QTI_SCMI_VENDOR_PROTOCOL
	help
	  C1 DCVS driver to expose sysfs node to user space and
	  register with SCMI framework.

	  This driver is used to expose sysfs  interface to communicate
	  with cpucp for C1 DCVS based on SCMI consolidation.

config QTI_MPAM
	tristate "Qualcomm Technologies Inc. MPAM Interface Driver"
	depends on QTI_SCMI_VENDOR_PROTOCOL
	default n
	help
	  Driver to expose MPAM sysfs nodes to user space.

	  This driver gathers MPAM configuration parameters from sysfs
	  userspace and relays them to CPUCP via SCMI communication.
	  It is intended to be used by clients familiar with modifying
	  the ARM MPAM configuration settings.

config QTI_CPUFREQ_STATS_SCMI_V2
	tristate "Qualcomm Technologies Inc. SCMI client driver for CPU and L3 cpu freq stats"
	depends on QTI_SCMI_VENDOR_PROTOCOL
	default n
	help
	  Driver to expose CPU freq stats debugfs nodes to user space.

	  This driver is used to expose debugfs interface to communicate
	  with cpucp for CPU freq stats based on SCMI consolidation protocol.
	  It is intended to be used by clients to get CPU and L3 residency data.

config QTI_DYNPF_SCMI
	tristate "Qualcomm Technologies Inc. SCMI client driver for DYNPF"
	depends on QTI_SCMI_VENDOR_PROTOCOL
	default n
	help
	  Driver to expose DYNPF configuration APIs to userspace via sysfs.

	  This driver gathers DYNPF configuration parameters from sysfs
	  userspace and relays them to CPUCP via SCMI communication.
	  It is intended to be used by clients familiar with modifying
	  the DYNPF settings.
```

## drivers/soc/qcom/hab/Kconfig
```kconfig
# SPDX-License-Identifier: GPL-2.0-only
#
# HAB configuration
#
config MSM_HAB
	tristate "Enable Hypervisor ABstraction Layer"
	depends on QCOM_DMABUF_HEAPS
	select WANT_DEV_COREDUMP
	help
	  HAB(Hypervisor ABstraction) driver can provide the message
	  transmission and memory sharing services among different OSes.
	  Internally, HAB makes use of some specific communication mechanism
	  provided by the underlying hypervisor.
	  It is required by the virtualization support for some multimedia
	  and platform devices in MSM devices.

config MSM_HAB_DEFAULT_VMID
	int
	default 2
	help
	  The default HAB VMID.
	  It will not be used when there are some other configuration sources,
	  e.g., device tree.

config MSM_VIRTIO_HAB
	bool "Enable hab plugin for virtio hypervisor"
	depends on VIRTIO
	depends on MSM_HAB
	help
	  hab plugin for virtio devices on guest OS.
	  The plugin running on guest OS relies on
	  virtio queues to transport HAB messages and
	  communicate with host OS.

config MSM_VHOST_HAB
	bool "Enable hab plugin for vhost hypervisor"
	select VHOST
	depends on MSM_HAB
	help
	  hab plugin for vhost device on host OS.
	  The plugin running on host OS relies on
	  vhost framework to transport HAB messages
	  and communicate with guest OS.
```

## drivers/soc/qcom/hgsl/Kconfig
```kconfig
# SPDX-License-Identifier: GPL-2.0-only
#
# Hypervisor graphics system layer configuration
#
config QCOM_HGSL
	tristate "Graphics driver for Hypervisor"
	depends on QTI_QUIN_GVM || ARCH_QTI_VM
	depends on MSM_HAB
	help
	  This driver could help commands submmitting functions for
	  hypervisor Linux. With HFI feature provided by A6x, it
	  could submit commands directly to hardware without passing
	  them to host system.

config QCOM_HGSL_TCSR_SIGNAL
	tristate "TCSR signal for Hypervisor GSL"
	depends on MFD_SYSCON && QCOM_HGSL
	help
	  The TCSR compute signal module provides hgsl driver
	  in hypervisor Linux a way to send/receive signals
	  to/from A6x GPU hardware directly, without going
	  through host system.
```

## drivers/soc/qcom/mem_buf/Kconfig
```kconfig
# SPDX-License-Identifier: GPL-2.0-only

config QCOM_MEM_BUF
	tristate "Qualcomm Technologies, Inc. Memory Buffer Sharing Driver"
	select QCOM_MEM_BUF_DEV
	help
	  Add support for lending memory from one virtual machine to another.
	  This driver communicates with the hypervisor, as well as other
	  virtual machines, to request and lend memory from and to VMs
	  respectively.
	  If unsure, say N

config QCOM_MEM_BUF_GH
	bool "Qualcomm Technologies, Inc. Memory Buffer Gunyah Hypervisor Support"
	depends on GH_RM_DRV
	select QCOM_MEM_BUF_DEV_GH
	help
	  Enables additional support for sharing memory with VMs that have their own
	  operating systems, as opposed to peripheral VMs, which do not have their
	  own operating systems. These VMs are managed by the Gunyah Hypervisor, and thus
	  sharing memory with them requires interacting with the Gunyah Hypervisor.
	  If unsure, say N.

config QCOM_MEM_BUF_DEV
	tristate

config QCOM_MEM_BUF_DEV_GH
	bool

config QCOM_MEM_BUF_MSGQ
	tristate "Qualcomm Technologies, Inc. Memory Buffer Message Queue Support"
	depends on GH_MSGQ && QCOM_MEM_BUF_DEV_GH
	help
	  Enables support for communicating with VMs over message queues. The communication
	  with the VMs follows a specific communication format that is defined by the mem-buf
	  message queue protocol. The protocol allows for allocation requests to be submitted
	  between VMs, and relinquished when a VM is finished with the memory that it
	  requested from another VM.
	  If unsure, say N.
```

## drivers/soc/qcom/memshare/Kconfig
```kconfig
# SPDX-License-Identifier: GPL-2.0-only
#
# Shared Heap for external processors
#
config MEM_SHARE_QMI_SERVICE
	tristate "Shared Heap for external processors"
	select QCOM_QMI_HELPERS
	help
		Memory Share Kernel QTI Messaging Interface Service
		receives requests from Modem Processor Sub System
		for heap alloc/free from Application Processor
		Sub System and send a response back to client with
		proper handle/address.
```

## drivers/soc/qcom/tmecom/Kconfig
```kconfig
# SPDX-License-Identifier: GPL-2.0-only
#
# QCOM TMECOM driver

config MSM_TMECOM_QMP
	tristate "TMECom QMP interface for HWKM master"
	select MSM_QMP
	help
        Set to enable TMECom interface over QTI Mailbox
        Protocol (QMP) for HWKM master on MSM platform.
        This interface helps to comminicate with TME
        mainly for HWKM functionality.
```
