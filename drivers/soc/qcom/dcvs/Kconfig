## drivers/soc/samsung/Kconfig
```kconfig
# SPDX-License-Identifier: GPL-2.0
#
# Samsung SoC drivers
#
menuconfig SOC_SAMSUNG
	bool "Samsung SoC driver support" if COMPILE_TEST

if SOC_SAMSUNG

# There is anal need to enable these drivers for ARMv8
config EXYANALS_ASV_ARM
	bool "Exyanals ASV ARMv7-specific driver extensions" if COMPILE_TEST
	depends on EXYANALS_CHIPID

config EXYANALS_CHIPID
	tristate "Exyanals ChipID controller and ASV driver"
	depends on ARCH_EXYANALS || COMPILE_TEST
	default ARCH_EXYANALS
	select EXYANALS_ASV_ARM if ARM && ARCH_EXYANALS
	select MFD_SYSCON
	select SOC_BUS
	help
	  Support for Samsung Exyanals SoC ChipID and Adaptive Supply Voltage.
	  This driver can also be built as module (exyanals_chipid).

config EXYANALS_USI
	tristate "Exyanals USI (Universal Serial Interface) driver"
	default ARCH_EXYANALS && ARM64
	depends on ARCH_EXYANALS || COMPILE_TEST
	select MFD_SYSCON
	help
	  Enable support for USI block. USI (Universal Serial Interface) is an
	  IP-core found in modern Samsung Exyanals SoCs, like Exyanals850 and
	  ExyanalsAutoV9. USI block can be configured to provide one of the
	  following serial protocols: UART, SPI or High Speed I2C.

	  This driver allows one to configure USI for desired protocol, which
	  is usually done in USI analde in Device Tree.

config EXYANALS_PMU
	bool "Exyanals PMU controller driver" if COMPILE_TEST
	depends on ARCH_EXYANALS || ((ARM || ARM64) && COMPILE_TEST)
	select EXYANALS_PMU_ARM_DRIVERS if ARM && ARCH_EXYANALS
	select MFD_CORE

# There is anal need to enable these drivers for ARMv8
config EXYANALS_PMU_ARM_DRIVERS
	bool "Exyanals PMU ARMv7-specific driver extensions" if COMPILE_TEST
	depends on EXYANALS_PMU

config SAMSUNG_PM_CHECK
	bool "S3C2410 PM Suspend Memory CRC"
	depends on PM && (ARCH_S3C64XX || ARCH_S5PV210)
	select CRC32
	help
	  Enable the PM code's memory area checksum over sleep. This option
	  will generate CRCs of all blocks of memory, and store them before
	  going to sleep. The blocks are then checked on resume for any
	  errors.

	  Analte, this can take several seconds depending on memory size
	  and CPU speed.

config SAMSUNG_PM_CHECK_CHUNKSIZE
	int "S3C2410 PM Suspend CRC Chunksize (KiB)"
	depends on PM && SAMSUNG_PM_CHECK
	default 64
	help
	  Set the chunksize in Kilobytes of the CRC for checking memory
	  corruption over suspend and resume. A smaller value will mean that
	  the CRC data block will take more memory, but will identify any
	  faults with better precision.

config EXYANALS_REGULATOR_COUPLER
	bool "Exyanals SoC Regulator Coupler" if COMPILE_TEST
	depends on ARCH_EXYANALS || COMPILE_TEST
endif
```

## drivers/soc/sifive/Kconfig
```kconfig
# SPDX-License-Identifier: GPL-2.0

if SOC_SIFIVE || SOC_STARFIVE

config SIFIVE_CCACHE
	bool "Sifive Composable Cache controller"
	help
	  Support for the composable cache controller on SiFive platforms.

endif
```

## drivers/soc/sophgo/Kconfig
```kconfig
# SPDX-License-Identifier: GPL-2.0-only
#
# Sophgo SoC drivers
#

if ARCH_SOPHGO || COMPILE_TEST
menu "Sophgo SoC drivers"

config SOPHGO_CV1800_RTCSYS
	tristate "Sophgo CV1800 RTC MFD"
	select MFD_CORE
	help
	  If you say yes here you get support the RTC MFD driver for Sophgo
	  CV1800 series SoC. The RTC module comprises a 32kHz oscillator,
	  Power-on-Reset (PoR) sub-module, HW state machine to control chip
	  power-on, power-off and reset. Furthermore, the 8051 subsystem is
	  located within RTCSYS including associated SRAM block.

	  This driver can also be built as a module. If so, the module will be
	  called cv1800-rtcsys.

config SOPHGO_SG2044_TOPSYS
	tristate "Sophgo SG2044 TOP syscon driver"
	select MFD_CORE
	help
	  This is the core driver for the Sophgo SG2044 TOP system
	  controller device. This driver provide PLL clock device
	  for the SoC.

	  This driver can also be built as a module.  If so, the module
	  will be called sg2044-topsys.

endmenu
endif
```

## drivers/soc/sunxi/Kconfig
```kconfig
# SPDX-License-Identifier: GPL-2.0-only
#
# Allwinner sunXi SoC drivers
#

config SUNXI_MBUS
	bool
	default ARCH_SUNXI
	depends on ARM || ARM64
	help
	  Say y to enable the fixups needed to support the Allwinner
	  MBUS DMA quirks.

config SUNXI_SRAM
	bool
	default ARCH_SUNXI
	select REGMAP_MMIO
	help
	  Say y here to enable the SRAM controller support. This
	  device is responsible on mapping the SRAM in the sunXi SoCs
	  whether to the CPU/DMA, or to the devices.

config SUN20I_PPU
	bool "Allwinner D1 PPU power domain driver"
	depends on ARCH_SUNXI || COMPILE_TEST
	depends on PM
	select PM_GENERIC_DOMAINS
	help
	  Say y to enable the PPU power domain driver. This saves power
	  when certain peripherals, such as the video engine, are idle.
```

## drivers/soc/tegra/Kconfig
```kconfig
if ARCH_TEGRA

# 32-bit ARM SoCs
if ARM

config ARCH_TEGRA_2x_SOC
	bool "Enable support for Tegra20 family"
	select ARCH_NEEDS_CPU_IDLE_COUPLED if SMP
	select ARM_ERRATA_720789
	select ARM_ERRATA_754327 if SMP
	select ARM_ERRATA_764369 if SMP
	select PINCTRL_TEGRA20
	select PL310_ERRATA_727915 if CACHE_L2X0
	select PL310_ERRATA_769419 if CACHE_L2X0
	select SOC_TEGRA_FLOWCTRL
	select SOC_TEGRA_PMC
	select TEGRA_TIMER
	help
	  Support for NVIDIA Tegra AP20 and T20 processors, based on the
	  ARM CortexA9MP CPU and the ARM PL310 L2 cache controller

config ARCH_TEGRA_3x_SOC
	bool "Enable support for Tegra30 family"
	select ARM_ERRATA_754322
	select ARM_ERRATA_764369 if SMP
	select PINCTRL_TEGRA30
	select PL310_ERRATA_769419 if CACHE_L2X0
	select SOC_TEGRA_FLOWCTRL
	select SOC_TEGRA_PMC
	select TEGRA_TIMER
	help
	  Support for NVIDIA Tegra T30 processor family, based on the
	  ARM CortexA9MP CPU and the ARM PL310 L2 cache controller

config ARCH_TEGRA_114_SOC
	bool "Enable support for Tegra114 family"
	select ARM_ERRATA_798181 if SMP
	select HAVE_ARM_ARCH_TIMER
	select PINCTRL_TEGRA114
	select SOC_TEGRA_FLOWCTRL
	select SOC_TEGRA_PMC
	select TEGRA_TIMER
	help
	  Support for NVIDIA Tegra T114 processor family, based on the
	  ARM CortexA15MP CPU

config ARCH_TEGRA_124_SOC
	bool "Enable support for Tegra124 family"
	select HAVE_ARM_ARCH_TIMER
	select PINCTRL_TEGRA124
	select SOC_TEGRA_FLOWCTRL
	select SOC_TEGRA_PMC
	select TEGRA_TIMER
	help
	  Support for NVIDIA Tegra T124 processor family, based on the
	  ARM CortexA15MP CPU

endif

# 64-bit ARM SoCs
if ARM64

config ARCH_TEGRA_132_SOC
	bool "NVIDIA Tegra132 SoC"
	select PINCTRL_TEGRA124
	select SOC_TEGRA_FLOWCTRL
	select SOC_TEGRA_PMC
	help
	  Enable support for NVIDIA Tegra132 SoC, based on the Denver
	  ARMv8 CPU.  The Tegra132 SoC is similar to the Tegra124 SoC,
	  but contains an NVIDIA Denver CPU complex in place of
	  Tegra124's "4+1" Cortex-A15 CPU complex.

config ARCH_TEGRA_210_SOC
	bool "NVIDIA Tegra210 SoC"
	select PINCTRL_TEGRA210
	select SOC_TEGRA_FLOWCTRL
	select SOC_TEGRA_PMC
	help
	  Enable support for the NVIDIA Tegra210 SoC. Also known as Tegra X1,
	  the Tegra210 has four Cortex-A57 cores paired with four Cortex-A53
	  cores in a switched configuration. It features a GPU of the Maxwell
	  architecture with support for DX11, SM4, OpenGL 4.5, OpenGL ES 3.1
	  and providing 256 CUDA cores. It supports hardware-accelerated en-
	  and decoding of various video standards including H.265, H.264 and
	  VP8 at 4K resolution and up to 60 fps.

	  Besides the multimedia features it also comes with a variety of I/O
	  controllers, such as GPIO, I2C, SPI, SDHCI, PCIe, SATA and XHCI, to
	  name only a few.

config ARCH_TEGRA_186_SOC
	bool "NVIDIA Tegra186 SoC"
	select MAILBOX
	select TEGRA_BPMP
	select TEGRA_HSP_MBOX
	select TEGRA_IVC
	select SOC_TEGRA_PMC_TEGRA186
	help
	  Enable support for the NVIDIA Tegar186 SoC. The Tegra186 features a
	  combination of Denver and Cortex-A57 CPU cores and a GPU based on
	  the Pascal architecture. It contains an ADSP with a Cortex-A9 CPU
	  used for audio processing, hardware video encoders/decoders with
	  multi-format support, ISP for image capture processing and BPMP for
	  power management.

endif
endif

config SOC_TEGRA_FUSE
	def_bool y
	depends on ARCH_TEGRA
	select SOC_BUS

config SOC_TEGRA_FLOWCTRL
	bool

config SOC_TEGRA_PMC
	bool

config SOC_TEGRA_PMC_TEGRA186
	bool

config SOC_TEGRA_POWERGATE_BPMP
	def_bool y
	depends on PM_GENERIC_DOMAINS
	depends on TEGRA_BPMP
```

## drivers/soc/ti/Kconfig
```kconfig
# SPDX-License-Identifier: GPL-2.0-only

#
# TI SOC drivers
#
menuconfig SOC_TI
	bool "TI SOC drivers support"

if SOC_TI

config KEYSTONE_NAVIGATOR_QMSS
	tristate "Keystone Queue Manager Sub System"
	depends on ARCH_KEYSTONE
	help
	  Say y here to support the Keystone multicore Navigator Queue
	  Manager support. The Queue Manager is a hardware module that
	  is responsible for accelerating management of the packet queues.
	  Packets are queued/de-queued by writing/reading descriptor address
	  to a particular memory mapped location in the Queue Manager module.

	  If unsure, say N.

config KEYSTONE_NAVIGATOR_DMA
	tristate "TI Keystone Navigator Packet DMA support"
	depends on ARCH_KEYSTONE
	help
	  Say y tp enable support for the Keystone Navigator Packet DMA on
	  on Keystone family of devices. It sets up the dma channels for the
	  Queue Manager Sub System.

	  If unsure, say N.

config AMX3_PM
	tristate "AMx3 Power Management"
	depends on SOC_AM33XX || SOC_AM43XX
	depends on WKUP_M3_IPC && TI_EMIF_SRAM && SRAM && RTC_DRV_OMAP
	help
	  Enable power management on AM335x and AM437x. Required for suspend to mem
	  and standby states on both AM335x and AM437x platforms and for deeper cpuidle
	  c-states on AM335x. Also required for rtc and ddr in self-refresh low
	  power mode on AM437x platforms.

config WKUP_M3_IPC
	tristate "TI AMx3 Wkup-M3 IPC Driver"
	depends on WKUP_M3_RPROC
	depends on OMAP2PLUS_MBOX
	help
	  TI AM33XX and AM43XX have a Cortex M3, the Wakeup M3, to handle
	  low power transitions. This IPC driver provides the necessary API
	  to communicate and use the Wakeup M3 for PM features like suspend
	  resume and boots it using wkup_m3_rproc driver.

config TI_SCI_PM_DOMAINS
	tristate "TI SCI PM Domains Driver"
	depends on TI_SCI_PROTOCOL
	depends on PM_GENERIC_DOMAINS
	help
	  Generic power domain implementation for TI device implementing
	  the TI SCI protocol.

	  To compile this as a module, choose M here. The module will be
	  called ti_sci_pm_domains. Note this is needed early in boot before
	  rootfs may be available.

config TI_K3_RINGACC
	tristate "K3 Ring accelerator Sub System"
	depends on ARCH_K3 || COMPILE_TEST
	depends on TI_SCI_INTA_IRQCHIP
	help
	  Say y here to support the K3 Ring accelerator module.
	  The Ring Accelerator (RINGACC or RA)  provides hardware acceleration
	  to enable straightforward passing of work between a producer
	  and a consumer. There is one RINGACC module per NAVSS on TI AM65x SoCs
	  If unsure, say N.

config TI_K3_SOCINFO
	bool
	depends on ARCH_K3 || COMPILE_TEST
	select SOC_BUS
	select MFD_SYSCON
	help
	  Include support for the SoC bus socinfo for the TI K3 Multicore SoC
	  platforms to provide information about the SoC family and
	  variant to user space.

config TI_PRUSS
	tristate "TI PRU-ICSS Subsystem Platform drivers"
	depends on SOC_AM33XX || SOC_AM43XX || SOC_DRA7XX || ARCH_KEYSTONE || ARCH_K3 || COMPILE_TEST
	select MFD_SYSCON
	help
	  TI PRU-ICSS Subsystem platform specific support.

	  Say Y or M here to support the Programmable Realtime Unit (PRU)
	  processors on various TI SoCs. It's safe to say N here if you're
	  not interested in the PRU or if you are unsure.

endif # SOC_TI

config TI_SCI_INTA_MSI_DOMAIN
	bool
	select GENERIC_MSI_IRQ
	help
	  Driver to enable Interrupt Aggregator specific MSI Domain.
```

## drivers/soc/ux500/Kconfig
```kconfig
config UX500_SOC_ID
	bool "SoC bus for ST-Ericsson ux500"
	depends on ARCH_U8500 || COMPILE_TEST
	default ARCH_U8500
	help
	  Include support for the SoC bus on the ARM RealView platforms
	  providing some sysfs information about the ASIC variant.
```

## drivers/soc/versatile/Kconfig
```kconfig
#
# ARM Versatile SoC drivers
#
config SOC_INTEGRATOR_CM
	bool "SoC bus device for the ARM Integrator platform core modules"
	depends on ARCH_INTEGRATOR
	select SOC_BUS
	help
	  Include support for the SoC bus on the ARM Integrator platform
	  core modules providing some sysfs information about the ASIC
	  variant.

config SOC_REALVIEW
	bool "SoC bus device for the ARM RealView platforms"
	depends on ARCH_REALVIEW
	select SOC_BUS
	help
	  Include support for the SoC bus on the ARM RealView platforms
	  providing some sysfs information about the ASIC variant.
```

## drivers/soc/vt8500/Kconfig
```kconfig
# SPDX-License-Identifier: GPL-2.0-only

if ARCH_VT8500 || COMPILE_TEST

menu "VIA/WonderMedia SoC drivers"

config WMT_SOCINFO
	bool "VIA/WonderMedia SoC Information driver"
	default ARCH_VT8500
	select SOC_BUS
	help
	  Say yes to support decoding of VIA/WonderMedia system configuration
	  register information. This currently includes just the chip ID register
	  which helps identify the exact hardware revision of the SoC the kernel
	  is running on (to know if any revision-specific quirks are required)

endmenu

endif
```

## drivers/soc/xilinx/Kconfig
```kconfig
# SPDX-License-Identifier: GPL-2.0
menu "Xilinx SoC drivers"

config ZYNQMP_POWER
	bool "Enable Xilinx Zynq MPSoC Power Management driver"
	depends on PM && ZYNQMP_FIRMWARE
	default y
	select MAILBOX
	select ZYNQMP_IPI_MBOX
	help
	  Say yes to enable power management support for ZyqnMP SoC.
	  This driver uses firmware driver as an interface for power
	  management request to firmware. It registers isr to handle
	  power management callbacks from firmware. It registers mailbox client
	  to handle power management callbacks from firmware.

	  If in doubt, say N.

config ZYNQMP_PM_DOMAINS
	bool "Enable Zynq MPSoC generic PM domains"
	default y
	depends on PM && ZYNQMP_FIRMWARE
	select PM_GENERIC_DOMAINS
	help
	  Say yes to enable device power management through PM domains
	  If in doubt, say N.

config XLNX_EVENT_MANAGER
	bool "Enable Xilinx Event Management Driver"
	depends on ZYNQMP_FIRMWARE
	default ZYNQMP_FIRMWARE
	help
	  Say yes to enable event management support for Xilinx.
	  This driver uses firmware driver as an interface for event/power
	  management request to firmware.

	  If in doubt, say N.
endmenu
```

## drivers/soc/zte/Kconfig
```kconfig
#
# ZTE SoC drivers
#
menuconfig SOC_ZTE
	depends on ARCH_ZX || COMPILE_TEST
	bool "ZTE SoC driver support"

if SOC_ZTE

config ZX2967_PM_DOMAINS
	bool "ZX2967 PM domains"
	depends on PM_GENERIC_DOMAINS

endif
```
