## drivers/soc/imx/Kconfig
```kconfig
# SPDX-License-Identifier: GPL-2.0-only
menu "i.MX SoC drivers"

config SOC_IMX8M
	tristate "i.MX8M SoC family support"
	depends on ARCH_MXC || COMPILE_TEST
	default ARCH_MXC && ARM64
	select SOC_BUS
	select ARM_GIC_V3 if ARCH_MXC && ARCH_MULTI_V7
	help
	  If you say yes here you get support for the NXP i.MX8M family
	  support, it will provide the SoC info like SoC family,
	  ID and revision etc.

config SOC_IMX9
	tristate "i.MX9 SoC family support"
	depends on ARCH_MXC || COMPILE_TEST
	default ARCH_MXC && ARM64
	select SOC_BUS
	help
	  If you say yes here, you get support for the NXP i.MX9 family

endmenu
```

## drivers/soc/ixp4xx/Kconfig
```kconfig
# SPDX-License-Identifier: GPL-2.0-only
if ARCH_IXP4XX || COMPILE_TEST

menu "IXP4xx SoC drivers"

config IXP4XX_QMGR
	tristate "IXP4xx Queue Manager support"
	help
	  This driver supports IXP4xx built-in hardware queue manager
	  and is automatically selected by Ethernet and HSS drivers.

config IXP4XX_NPE
	tristate "IXP4xx Network Processor Engine support"
	select FW_LOADER
	help
	  This driver supports IXP4xx built-in network coprocessors
	  and is automatically selected by Ethernet and HSS drivers.

endmenu

endif
```

## drivers/soc/kendryte/Kconfig
```kconfig
# SPDX-License-Identifier: GPL-2.0

if SOC_KENDRYTE

config K210_SYSCTL
	bool "Kendryte K210 system controller"
	default y
	depends on RISCV
	help
	  Enables controlling the K210 various clocks and to enable
	  general purpose use of the extra 2MB of SRAM normally
	  reserved for the AI engine.

endif
```

## drivers/soc/litex/Kconfig
```kconfig
# SPDX-License_Identifier: GPL-2.0

menu "Enable LiteX SoC Builder specific drivers"

config LITEX
	bool

config LITEX_SOC_CONTROLLER
	tristate "Enable LiteX SoC Controller driver"
	depends on OF
	depends on HAS_IOMEM
	select LITEX
	help
	  This option enables the SoC Controller Driver which verifies
	  LiteX CSR access and provides common litex_[read|write]*
	  accessors.
	  All drivers that use functions from litex.h must depend on
	  LITEX.

endmenu
```

## drivers/soc/loongson/Kconfig
```kconfig
# SPDX-License-Identifier: GPL-2.0+
#
# Loongson-2 series SoC drivers
#

config LOONGSON2_GUTS
	tristate "Loongson-2 SoC Global UtiliTieS (GUTS) register block"
	depends on LOONGARCH || COMPILE_TEST
	select SOC_BUS
	help
	 The global utilities block controls PCIE device enabling, alternate
	 function selection for multiplexed signals, consistency of HDA, USB
	 and PCIE, configuration of memory controller, rtc controller, lio
	 controller, and clock control. This patch adds a driver to manage
	 and access global utilities block for LoongArch architecture Loongson-2
	 SoCs. Initially only reading SVR and registering soc device are
	 supported. Other guts accesses, such as reading firmware configuration
	 by default, should eventually be added into this driver as well.

config LOONGSON2_PM
	bool "Loongson-2 SoC Power Management Controller Driver"
	depends on LOONGARCH && OF
	depends on INPUT=y
	help
	  The Loongson-2's power management controller was ACPI, supports ACPI
	  S2Idle (Suspend To Idle), ACPI S3 (Suspend To RAM), ACPI S4 (Suspend To
	  Disk), ACPI S5 (Soft Shutdown) and supports multiple wake-up methods
	  (USB, GMAC, PWRBTN, etc.). This driver was to add power management
	  controller support that base on dts for Loongson-2 series SoCs.
```

## drivers/soc/mediatek/Kconfig
```kconfig
# SPDX-License-Identifier: GPL-2.0-only
#
# MediaTek SoC drivers
#
menu "MediaTek SoC drivers"
	depends on ARCH_MEDIATEK || COMPILE_TEST

config MTK_CMDQ
	tristate "MediaTek CMDQ Support"
	depends on ARCH_MEDIATEK || COMPILE_TEST
	select MAILBOX
	select MTK_CMDQ_MBOX
	select MTK_INFRACFG
	help
	  Say yes here to add support for the MediaTek Command Queue (CMDQ)
	  driver. The CMDQ is used to help read/write registers with critical
	  time limitation, such as updating display configuration during the
	  vblank.

config MTK_DEVAPC
	tristate "Mediatek Device APC Support"
	help
	  Say yes here to enable support for Mediatek Device APC driver.
	  This driver is mainly used to handle the violation which catches
	  unexpected transaction.
	  The violation information is logged for further analysis or
	  countermeasures.

config MTK_DVFSRC
	tristate "MediaTek DVFSRC Support"
	depends on ARCH_MEDIATEK
	help
	  Say yes here to add support for the MediaTek Dynamic Voltage
	  and Frequency Scaling Resource Collector (DVFSRC): a HW
	  IP found on many MediaTek SoCs, which is responsible for
	  collecting DVFS requests from various SoC IPs, other than
	  software, and performing bandwidth scaling to provide the
	  best achievable performance-per-watt.

config MTK_INFRACFG
	bool "MediaTek INFRACFG Support"
	select REGMAP
	help
	  Say yes here to add support for the MediaTek INFRACFG controller. The
	  INFRACFG controller contains various infrastructure registers not
	  directly associated to any device.

config MTK_PMIC_WRAP
	tristate "MediaTek PMIC Wrapper Support"
	depends on RESET_CONTROLLER
	depends on OF
	select REGMAP
	help
	  Say yes here to add support for MediaTek PMIC Wrapper found
	  on different MediaTek SoCs. The PMIC wrapper is a proprietary
	  hardware to connect the PMIC.

config MTK_REGULATOR_COUPLER
	bool "MediaTek SoC Regulator Coupler" if COMPILE_TEST
	default ARCH_MEDIATEK
	depends on REGULATOR

config MTK_MMSYS
	tristate "MediaTek MMSYS Support"
	default ARCH_MEDIATEK
	depends on HAS_IOMEM
	depends on MTK_CMDQ || MTK_CMDQ=n
	help
	  Say yes here to add support for the MediaTek Multimedia
	  Subsystem (MMSYS).

config MTK_SVS
	tristate "MediaTek Smart Voltage Scaling(SVS)"
	depends on NVMEM_MTK_EFUSE && NVMEM
	help
	  The Smart Voltage Scaling(SVS) engine is a piece of hardware
	  which has several controllers(banks) for calculating suitable
	  voltage to different power domains(CPU/GPU/CCI) according to
	  chip process corner, temperatures and other factors. Then DVFS
	  driver could apply SVS bank voltage to PMIC/Buck.

config MTK_SOCINFO
	tristate "MediaTek SoC Information"
	default y
	depends on NVMEM_MTK_EFUSE
	select SOC_BUS
	help
	  The MediaTek SoC Information (mtk-socinfo) driver provides
	  information about the SoC to the userspace including the
	  manufacturer name, marketing name and soc name.

endmenu
```

## drivers/soc/microchip/Kconfig
```kconfig
config POLARFIRE_SOC_IRQ_MUX
	bool "Microchip PolarFire SoC's GPIO IRQ Mux"
	depends on ARCH_MICROCHIP
	select REGMAP
	select REGMAP_MMIO
	default y
	help
	  Support for the interrupt mux on Polarfire SoC. It sits between
	  the GPIO controllers and the PLIC, as only 41 interrupts are shared
	  between 3 GPIO controllers with a total of 70 interrupts.

config POLARFIRE_SOC_SYS_CTRL
	tristate "Microchip PolarFire SoC (MPFS) system controller support"
	depends on POLARFIRE_SOC_MAILBOX
	depends on MTD
	help
	  This driver adds support for the PolarFire SoC (MPFS) system controller.

	  To compile this driver as a module, choose M here. the
	  module will be called mpfs_system_controller.

	  If unsure, say N.

config POLARFIRE_SOC_SYSCONS
	bool "PolarFire SoC (MPFS) syscon drivers"
	default y
	depends on ARCH_MICROCHIP
	select MFD_CORE
	help
	  These drivers add support for the syscons on PolarFire SoC (MPFS).
	  Without these drivers core parts of the kernel such as clocks
	  and resets will not function correctly.

	  If unsure, and on a PolarFire SoC, say y.
```

## drivers/soc/nuvoton/Kconfig
```kconfig
# SPDX-License-Identifier: GPL-2.0
menuconfig WPCM450_SOC
	tristate "Nuvoton WPCM450 SoC driver"
	default y if ARCH_WPCM450
	select SOC_BUS
	help
	  Say Y here to compile the SoC information driver for Nuvoton
	  WPCM450 SoCs.

	  This driver provides information such as the SoC model and
	  revision.
```

## drivers/soc/pxa/Kconfig
```kconfig
# SPDX-License-Identifier: GPL-2.0-only
config PLAT_PXA
	bool

config PXA_SSP
	tristate
	help
	  Enable support for PXA2xx SSP ports
```
