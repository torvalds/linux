## drivers/soc/apple/Kconfig
```kconfig
# SPDX-License-Identifier: GPL-2.0-only

if ARCH_APPLE || COMPILE_TEST

menu "Apple SoC drivers"

config APPLE_PMGR_PWRSTATE
	bool "Apple SoC PMGR power state control"
	depends on PM
	select REGMAP
	select MFD_SYSCON
	select PM_GENERIC_DOMAINS
	select RESET_CONTROLLER
	default ARCH_APPLE
	help
	  The PMGR block in Apple SoCs provides high-level power state
	  controls for SoC devices. This driver manages them through the
	  generic power domain framework, and also provides reset support.

config APPLE_RTKIT
	tristate "Apple RTKit co-processor IPC protocol"
	depends on MAILBOX
	depends on ARCH_APPLE || COMPILE_TEST
	default ARCH_APPLE
	help
	  Apple SoCs such as the M1 come with various co-processors running
	  their proprietary RTKit operating system. This option enables support
	  for the protocol library used to communicate with those. It is used
	  by various client drivers.

	  Say 'y' here if you have an Apple SoC.

config APPLE_SART
	tristate "Apple SART DMA address filter"
	depends on ARCH_APPLE || COMPILE_TEST
	default ARCH_APPLE
	help
	  Apple SART is a simple DMA address filter used on Apple SoCs such
	  as the M1. It is usually required for the NVMe coprocessor which does
	  not use a proper IOMMU.

	  Say 'y' here if you have an Apple SoC.

endmenu

endif
```

## drivers/soc/aspeed/Kconfig
```kconfig
# SPDX-License-Identifier: GPL-2.0-only

if ARCH_ASPEED || COMPILE_TEST

menu "ASPEED SoC drivers"

config ASPEED_BMC_DEV
	tristate "ASPEED BMC Device"

config ASPEED_HOST_BMC_DEV
	tristate "ASPEED Host BMC Device"

config ASPEED_LPC_CTRL
	tristate "ASPEED LPC firmware cycle control"
	select REGMAP
	select MFD_SYSCON
	default ARCH_ASPEED
	help
	  Control LPC firmware cycle mappings through ioctl()s. The driver
	  also provides a read/write interface to a BMC ram region where the
	  host LPC read/write region can be buffered.

config ASPEED_LPC_SNOOP
	tristate "ASPEED LPC snoop support"
	select REGMAP
	select MFD_SYSCON
	default ARCH_ASPEED
	help
	  Provides a driver to control the LPC snoop interface which
	  allows the BMC to listen on and save the data written by
	  the host to an arbitrary LPC I/O port.

config ASPEED_SSP
	tristate "ASPEED SSP loader"
	default n
	help
	  Driver for loading secondary-service-processor binary

config ASPEED_MCTP
	tristate "Aspeed ast2600 MCTP Controller support"
	depends on REGMAP && MFD_SYSCON
	help
	  Enable support for ast2600 MCTP Controller.
	  The MCTP controller allows the BMC to communicate with devices on
	  the host PCIe network.

config ASPEED_UART_ROUTING
	tristate "ASPEED uart routing control"
	select REGMAP
	select MFD_SYSCON
	default ARCH_ASPEED
	help
	  Provides a driver to control the UART routing paths, allowing
	  users to perform runtime configuration of the RX muxes among
	  the UART controllers and I/O pins.

config ASPEED_LPC_MAILBOX
	tristate "ASPEED LPC mailbox support"
	select REGMAP
	select MFD_SYSCON
	default ARCH_ASPEED
	help
	  Provides a driver to control the LPC mailbox which possesses
	  up to 32 data registers for the communication between the Host
	  and the BMC over LPC.

config ASPEED_P2A_CTRL
	tristate "ASPEED P2A (VGA MMIO to BMC) bridge control"
	select REGMAP
	select MFD_SYSCON
	default ARCH_ASPEED
	help
	  Control ASPEED P2A VGA MMIO to BMC mappings through ioctl()s.  The
	  driver also provides an interface for userspace mappings to a
	  pre-defined region.

config ASPEED_SOCINFO
	bool "ASPEED SoC Information driver"
	default ARCH_ASPEED
	select SOC_BUS
	default ARCH_ASPEED
	help
	  Say yes to support decoding of ASPEED BMC information.

config ASPEED_XDMA
	tristate "ASPEED XDMA Engine Driver"
	select REGMAP
	select MFD_SYSCON
	depends on HAS_DMA
	help
	  Enable support for the XDMA Engine found on the ASPEED BMC
	  SoCs. The XDMA engine can perform PCIe DMA operations between the BMC
	  and a host processor.

config ASPEED_SBC
	bool "ASPEED Secure Boot Controller driver"
	default MACH_ASPEED_G6
	help
	  Say yes to provide information about the secure boot controller in
	  debugfs.

config ASPEED_ESPI
	tristate "ASPEED eSPI slave driver"
	select AST2500_ESPI if MACH_ASPEED_G5
	select AST2600_ESPI if MACH_ASPEED_G6
	select AST2700_ESPI if MACH_ASPEED_G7
	default n
	help
	  Enable driver support for the Aspeed eSPI engine. The eSPI engine
	  plays as a slave device in BMC to communicate with the Host over
	  the eSPI interface. The four eSPI channels, namely peripheral,
	  virtual wire, out-of-band, and flash are supported.

config AST2500_ESPI
	tristate
	depends on ASPEED_ESPI
	help
	  Enable driver support for Aspeed AST2500 eSPI engine.

config AST2600_ESPI
	tristate
	depends on ASPEED_ESPI
	help
	  Enable driver support for Aspeed AST2600 eSPI engine.

config AST2700_ESPI
	tristate
	depends on ASPEED_ESPI
	help
	  Enable driver support for Aspeed AST2600 eSPI engine.

config ASPEED_LPC_PCC
	tristate "Aspeed Post Code Capture support"
	depends on ARCH_ASPEED && REGMAP && MFD_SYSCON
	help
	  Provides a driver to control the LPC PCC interface,
	  allowing the BMC to snoop data bytes written by the
	  the host to an arbitrary LPC I/O port.

config ASPEED_UDMA
	tristate "Aspeed UDMA Engine Driver"
	depends on ARCH_ASPEED && REGMAP && MFD_SYSCON && HAS_DMA
	help
	  Enable support for the Aspeed UDMA Engine found on the Aspeed AST2XXX
	  SOCs. The UDMA engine can perform UART DMA operations between the memory
	  buffer and the UART/VUART devices.

config ASPEED_OTP
	tristate "Aspeed OTP Driver"
	depends on MACH_ASPEED_G6

config ASPEED_DISP_INTF
	bool "ASPEED Display Interface driver"
	select REGMAP
	select MFD_SYSCON
	default ARCH_ASPEED
	help
	  Say yes to support control the display interface of ASPEED BMC.

source "drivers/soc/aspeed/rvas/Kconfig"

endmenu

endif
```

## drivers/soc/aspeed/rvas/Kconfig
```kconfig
menu "ASPEED RVAS drivers"

config ASPEED_RVAS
	tristate "ASPEED RVAS driver"
	default n
	help
	  Driver for ASPEED RVAS Engine

endmenu
```

## drivers/soc/atmel/Kconfig
```kconfig
# SPDX-License-Identifier: GPL-2.0-only
config AT91_SOC_ID
	bool "SoC bus for Atmel ARM SoCs"
	depends on ARCH_AT91 || COMPILE_TEST
	default ARCH_AT91
	help
	  Include support for the SoC bus on the Atmel ARM SoCs.

config AT91_SOC_SFR
	tristate "Special Function Registers support"
	depends on ARCH_AT91 || COMPILE_TEST
	help
	  This is a driver for the Special Function Registers available on
	  Atmel SAMA5Dx SoCs, providing access to specific aspects of the
	  integrated memory, bridge implementations, processor etc.

	  This driver can also be built as a module. If so, the module
	  will be called sfr.
```

## drivers/soc/bcm/Kconfig
```kconfig
# SPDX-License-Identifier: GPL-2.0-only
menu "Broadcom SoC drivers"

config SOC_BRCMSTB
	bool "Broadcom STB SoC drivers"
	depends on ARCH_BRCMSTB || BMIPS_GENERIC || COMPILE_TEST
	select SOC_BUS
	help
	  Enables drivers for the Broadcom Set-Top Box (STB) series of chips.
	  This option alone enables only some support code, while the drivers
	  can be enabled individually within this menu.

	  If unsure, say N.

source "drivers/soc/bcm/brcmstb/Kconfig"

endmenu
```

## drivers/soc/bcm/bcm63xx/Kconfig
```kconfig
# SPDX-License-Identifier: GPL-2.0-only
if SOC_BCM63XX

config BCM63XX_POWER
	bool "BCM63xx power domain driver"
	depends on BMIPS_GENERIC || (COMPILE_TEST && OF)
	select PM_GENERIC_DOMAINS if PM
	help
	  This enables support for the BCM63xx power domains controller on
	  BCM6318, BCM6328, BCM6362 and BCM63268 SoCs.

endif # SOC_BCM63XX

config BCM_PMB
	bool "Broadcom PMB (Power Management Bus) driver"
	depends on ARCH_BCM4908 || (COMPILE_TEST && OF)
	default ARCH_BCM4908
	select PM_GENERIC_DOMAINS if PM
	help
	  This enables support for the Broadcom's PMB (Power Management Bus) that
	  is used for disabling and enabling SoC devices.
```

## drivers/soc/bcm/brcmstb/Kconfig
```kconfig
# SPDX-License-Identifier: GPL-2.0-only
if SOC_BRCMSTB

config BRCMSTB_PM
	bool "Support suspend/resume for STB platforms"
	default y
	depends on PM
	depends on ARCH_BRCMSTB || BMIPS_GENERIC
	select ARM_CPU_SUSPEND if ARM

endif # SOC_BRCMSTB
```

## drivers/soc/brcmstb/Kconfig
```kconfig
menuconfig SOC_BRCMSTB
	bool "Broadcom STB SoC drivers"
	depends on ARM
	select SOC_BUS
	help
	  Enables drivers for the Broadcom Set-Top Box (STB) series of chips.
	  This option alone enables only some support code, while the drivers
	  can be enabled individually within this menu.

	  If unsure, say N.
```

## drivers/soc/canaan/Kconfig
```kconfig
# SPDX-License-Identifier: GPL-2.0

config SOC_K210_SYSCTL
	bool "Canaan Kendryte K210 SoC system controller"
	depends on RISCV && SOC_CANAAN_K210 && OF
	depends on COMMON_CLK_K210
	default SOC_CANAAN_K210
	select PM
	select MFD_SYSCON
	help
	  Canaan Kendryte K210 SoC system controller driver.
```

## drivers/soc/cirrus/Kconfig
```kconfig
# SPDX-License-Identifier: GPL-2.0-only

if ARCH_EP93XX

config EP93XX_SOC
	bool "Cirrus EP93xx chips SoC"
	select SOC_BUS
	select AUXILIARY_BUS
	default y
	help
	  Enable support SoC for Cirrus EP93xx chips.

	  Cirrus EP93xx chips have several swlocked registers,
	  this driver provides locked access for reset, pinctrl
	  and clk devices implemented as auxiliary devices.

endif
```

## drivers/soc/fsl/Kconfig
```kconfig
# SPDX-License-Identifier: GPL-2.0-only
#
# NXP/Freescale QorIQ series SOC drivers
#

menu "NXP/Freescale QorIQ SoC drivers"

source "drivers/soc/fsl/qbman/Kconfig"
source "drivers/soc/fsl/qe/Kconfig"

config FSL_GUTS
	bool
	select SOC_BUS
	help
	  The global utilities block controls power management, I/O device
	  enabling, power-onreset(POR) configuration monitoring, alternate
	  function selection for multiplexed signals,and clock control.
	  This driver is to manage and access global utilities block.
	  Initially only reading SVR and registering soc device are supported.
	  Other guts accesses, such as reading RCW, should eventually be moved
	  into this driver as well.

config FSL_MC_DPIO
        tristate "QorIQ DPAA2 DPIO driver"
        depends on FSL_MC_BUS
        select SOC_BUS
        help
	  Driver for the DPAA2 DPIO object.  A DPIO provides queue and
	  buffer management facilities for software to interact with
	  other DPAA2 objects. This driver does not expose the DPIO
	  objects individually, but groups them under a service layer
	  API.
endmenu
```

## drivers/soc/fsl/qbman/Kconfig
```kconfig
# SPDX-License-Identifier: GPL-2.0-only
menuconfig FSL_DPAA
	bool "QorIQ DPAA1 framework support"
	depends on ((FSL_SOC_BOOKE || ARCH_LAYERSCAPE) && ARCH_DMA_ADDR_T_64BIT)
	select GENERIC_ALLOCATOR
	help
	  The Freescale Data Path Acceleration Architecture (DPAA) is a set of
	  hardware components on specific QorIQ multicore processors.
	  This architecture provides the infrastructure to support simplified
	  sharing of networking interfaces and accelerators by multiple CPUs.
	  The major h/w blocks composing DPAA are BMan and QMan.

	  The Buffer Manager (BMan) is a hardware buffer pool management block
	  that allows software and accelerators on the datapath to acquire and
	  release buffers in order to build frames.

	  The Queue Manager (QMan) is a hardware queue management block
	  that allows software and accelerators on the datapath to enqueue and
	  dequeue frames in order to communicate.

if FSL_DPAA

config FSL_DPAA_CHECKING
	bool "Additional driver checking"
	help
	  Compiles in additional checks, to sanity-check the drivers and
	  any use of the exported API. Not recommended for performance.

config FSL_BMAN_TEST
	tristate "BMan self-tests"
	help
	  Compile the BMan self-test code. These tests will
	  exercise the BMan APIs to confirm functionality
	  of both the software drivers and hardware device.

config FSL_BMAN_TEST_API
	bool "High-level API self-test"
	depends on FSL_BMAN_TEST
	default y
	help
	  This requires the presence of cpu-affine portals, and performs
	  high-level API testing with them (whichever portal(s) are affine
	  to the cpu(s) the test executes on).

config FSL_QMAN_TEST
	tristate "QMan self-tests"
	help
	  Compile self-test code for QMan.

config FSL_QMAN_TEST_API
	bool "QMan high-level self-test"
	depends on FSL_QMAN_TEST
	default y
	help
	  This requires the presence of cpu-affine portals, and performs
	  high-level API testing with them (whichever portal(s) are affine to
	  the cpu(s) the test executes on).

config FSL_QMAN_TEST_STASH
	bool "QMan 'hot potato' data-stashing self-test"
	depends on FSL_QMAN_TEST
	default y
	help
	  This performs a "hot potato" style test enqueuing/dequeuing a frame
	  across a series of FQs scheduled to different portals (and cpus), with
	  DQRR, data and context stashing always on.

endif # FSL_DPAA
```

## drivers/soc/fsl/qe/Kconfig
```kconfig
# SPDX-License-Identifier: GPL-2.0-only
#
# QE Communication options
#

config QUICC_ENGINE
	bool "QUICC Engine (QE) framework support"
	depends on OF && HAS_IOMEM
	depends on PPC || ARM || ARM64 || COMPILE_TEST
	select GENERIC_ALLOCATOR
	select CRC32
	help
	  The QUICC Engine (QE) is a new generation of communications
	  coprocessors on Freescale embedded CPUs (akin to CPM in older chips).
	  Selecting this option means that you wish to build a kernel
	  for a machine with a QE coprocessor.

config UCC_SLOW
	bool
	default y if SERIAL_QE || (CPM_QMC && QUICC_ENGINE)
	help
	  This option provides qe_lib support to UCC slow
	  protocols: UART, BISYNC, QMC

config UCC_FAST
	bool
	default y if UCC_GETH || QE_TDM
	help
	  This option provides qe_lib support to UCC fast
	  protocols: HDLC, Ethernet, ATM, transparent

config UCC
	bool
	default y if UCC_FAST || UCC_SLOW || (CPM_TSA && QUICC_ENGINE)

config CPM_TSA
	tristate "CPM/QE TSA support"
	depends on OF && HAS_IOMEM
	depends on CPM1 || QUICC_ENGINE || \
		   ((CPM || QUICC_ENGINE) && COMPILE_TEST)
	help
	  Freescale CPM/QE Time Slot Assigner (TSA)
	  controller.

	  This option enables support for this
	  controller

config CPM_QMC
	tristate "CPM/QE QMC support"
	depends on OF && HAS_IOMEM
	depends on FSL_SOC
	depends on CPM_TSA
	help
	  Freescale CPM/QE QUICC Multichannel Controller
	  (QMC)

	  This option enables support for this
	  controller

config QE_TDM
	bool
	default y if FSL_UCC_HDLC

config QE_USB
	bool
	depends on QUICC_ENGINE
	default y if USB_FSL_QE
	help
	  QE USB Controller support
```

## drivers/soc/fujitsu/Kconfig
```kconfig
# SPDX-License-Identifier: GPL-2.0-only
menu "fujitsu SoC drivers"

config A64FX_DIAG
	bool "A64FX diag driver"
	depends on ARM64
	depends on ACPI
	help
	  Say Y here if you want to enable diag interrupt on Fujitsu A64FX.
	  This driver enables BMC's diagnostic requests and enables
	  A64FX-specific interrupts. This allows administrators to obtain
	  kernel dumps via diagnostic requests using ipmitool, etc.

	  If unsure, say N.

endmenu
```

## drivers/soc/hisilicon/Kconfig
```kconfig
# SPDX-License-Identifier: GPL-2.0-only

menu "Hisilicon SoC drivers"
	depends on ARCH_HISI || COMPILE_TEST

config KUNPENG_HCCS
	tristate "HCCS driver on Kunpeng SoC"
	depends on ACPI
	depends on MAILBOX
	depends on ARM64 || COMPILE_TEST
	help
	  The Huawei Cache Coherence System (HCCS) is a multi-chip
	  interconnection bus protocol.
	  The performance of application may be affected if some HCCS
	  ports are not in full lane status, have a large number of CRC
	  errors and so on.

	  Say M here if you want to include support for querying the
	  health status and port information of HCCS on Kunpeng SoC.

endmenu
```
