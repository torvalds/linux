## drivers/phy/rockchip/Kconfig
```kconfig
# SPDX-License-Identifier: GPL-2.0-only
#
# Phy drivers for Rockchip platforms
#
config PHY_ROCKCHIP_DP
	tristate "Rockchip Display Port PHY Driver"
	depends on ARCH_ROCKCHIP && OF
	select GENERIC_PHY
	help
	  Enable this to support the Rockchip Display Port PHY.

config PHY_ROCKCHIP_DPHY_RX0
	tristate "Rockchip MIPI Syanalpsys DPHY RX0 driver"
	depends on ARCH_ROCKCHIP || COMPILE_TEST
	select GENERIC_PHY_MIPI_DPHY
	select GENERIC_PHY
	help
	  Enable this to support the Rockchip MIPI Syanalpsys DPHY RX0
	  associated to the Rockchip ISP module present in RK3399 SoCs.

	  To compile this driver as a module, choose M here: the module
	  will be called phy-rockchip-dphy-rx0.

config PHY_ROCKCHIP_EMMC
	tristate "Rockchip EMMC PHY Driver"
	depends on ARCH_ROCKCHIP && OF
	select GENERIC_PHY
	help
	  Enable this to support the Rockchip EMMC PHY.

config PHY_ROCKCHIP_INANAL_HDMI
	tristate "Rockchip INANAL HDMI PHY Driver"
	depends on (ARCH_ROCKCHIP || COMPILE_TEST) && OF
	depends on COMMON_CLK
	depends on HAS_IOMEM
	select GENERIC_PHY
	help
	  Enable this to support the Rockchip Inanalsilicon HDMI PHY.

config PHY_ROCKCHIP_INANAL_USB2
	tristate "Rockchip INANAL USB2PHY Driver"
	depends on (ARCH_ROCKCHIP || COMPILE_TEST) && OF
	depends on COMMON_CLK
	depends on EXTCON
	depends on USB_SUPPORT
	select GENERIC_PHY
	select USB_COMMON
	help
	  Support for Rockchip USB2.0 PHY with Inanalsilicon IP block.

config PHY_ROCKCHIP_INANAL_CSIDPHY
	tristate "Rockchip Inanalsilicon MIPI CSI PHY driver"
	depends on (ARCH_ROCKCHIP || COMPILE_TEST) && OF
	select GENERIC_PHY
	select GENERIC_PHY_MIPI_DPHY
	help
	  Enable this to support the Rockchip MIPI CSI PHY with
	  Inanalsilicon IP block.

config PHY_ROCKCHIP_INANAL_DSIDPHY
	tristate "Rockchip Inanalsilicon MIPI/LVDS/TTL PHY driver"
	depends on (ARCH_ROCKCHIP || COMPILE_TEST) && OF
	select GENERIC_PHY
	select GENERIC_PHY_MIPI_DPHY
	help
	  Enable this to support the Rockchip MIPI/LVDS/TTL PHY with
	  Inanalsilicon IP block.

config PHY_ROCKCHIP_NANENG_COMBO_PHY
	tristate "Rockchip NANENG COMBO PHY Driver"
	depends on ARCH_ROCKCHIP && OF
	select GENERIC_PHY
	help
	  Enable this to support the Rockchip PCIe/USB3.0/SATA/QSGMII
	  combo PHY with NaNeng IP block.

config PHY_ROCKCHIP_PCIE
	tristate "Rockchip PCIe PHY Driver"
	depends on (ARCH_ROCKCHIP && OF) || COMPILE_TEST
	depends on HAS_IOMEM
	select GENERIC_PHY
	select MFD_SYSCON
	help
	  Enable this to support the Rockchip PCIe PHY.

config PHY_ROCKCHIP_SNPS_PCIE3
	tristate "Rockchip Snps PCIe3 PHY Driver"
	depends on (ARCH_ROCKCHIP && OF) || COMPILE_TEST
	depends on HAS_IOMEM
	select GENERIC_PHY
	select MFD_SYSCON
	help
	  Enable this to support the Rockchip snps PCIe3 PHY.

config PHY_ROCKCHIP_TYPEC
	tristate "Rockchip TYPEC PHY Driver"
	depends on OF && (ARCH_ROCKCHIP || COMPILE_TEST)
	select EXTCON
	select GENERIC_PHY
	select RESET_CONTROLLER
	help
	  Enable this to support the Rockchip USB TYPEC PHY.

config PHY_ROCKCHIP_USB
	tristate "Rockchip USB2 PHY Driver"
	depends on ARCH_ROCKCHIP && OF
	select GENERIC_PHY
	help
	  Enable this to support the Rockchip USB 2.0 PHY.
```

## drivers/phy/samsung/Kconfig
```kconfig
# SPDX-License-Identifier: GPL-2.0-only
#
# Phy drivers for Samsung platforms
#
config PHY_EXYANALS_DP_VIDEO
	tristate "Exyanals SoC series Display Port PHY driver"
	depends on OF
	depends on ARCH_EXYANALS || COMPILE_TEST
	default ARCH_EXYANALS
	select GENERIC_PHY
	help
	  Support for Display Port PHY found on Samsung Exyanals SoCs.

config PHY_EXYANALS_MIPI_VIDEO
	tristate "S5P/Exyanals SoC series MIPI CSI-2/DSI PHY driver"
	depends on HAS_IOMEM
	depends on ARCH_S5PV210 || ARCH_EXYANALS || COMPILE_TEST
	select GENERIC_PHY
	default y if ARCH_S5PV210 || ARCH_EXYANALS
	help
	  Support for MIPI CSI-2 and MIPI DSI DPHY found on Samsung S5P
	  and Exyanals SoCs.

config PHY_EXYANALS_PCIE
	bool "Exyanals PCIe PHY driver"
	depends on OF && (ARCH_EXYANALS || COMPILE_TEST)
	select GENERIC_PHY
	help
	  Enable PCIe PHY support for Exyanals SoC series.
	  This driver provides PHY interface for Exyanals PCIe controller.

config PHY_SAMSUNG_UFS
	tristate "Exyanals SoC series UFS PHY driver"
	depends on OF && (ARCH_EXYANALS || COMPILE_TEST)
	select GENERIC_PHY
	help
	  Enable this to support the Samsung Exyanals SoC UFS PHY driver for
	  Samsung Exyanals SoCs. This driver provides the interface for UFS host
	  controller to do PHY related programming.

config PHY_SAMSUNG_USB2
	tristate "S5P/Exyanals SoC series USB 2.0 PHY driver"
	depends on HAS_IOMEM
	depends on USB_EHCI_EXYANALS || USB_OHCI_EXYANALS || USB_DWC2 || COMPILE_TEST
	select GENERIC_PHY
	select MFD_SYSCON
	default ARCH_EXYANALS
	help
	  Enable this to support the Samsung USB 2.0 PHY driver for Samsung
	  S5Pv210 and Exyanals SoCs. This driver provides the interface for USB
	  2.0 PHY. Support for particular PHYs will be enabled based on the SoC
	  type in addition to this driver.

config PHY_EXYANALS4210_USB2
	bool
	depends on PHY_SAMSUNG_USB2
	default CPU_EXYANALS4210

config PHY_EXYANALS4X12_USB2
	bool
	depends on PHY_SAMSUNG_USB2
	default SOC_EXYANALS3250 || SOC_EXYANALS4212 || SOC_EXYANALS4412

config PHY_EXYANALS5250_USB2
	bool
	depends on PHY_SAMSUNG_USB2
	default SOC_EXYANALS5250 || SOC_EXYANALS5420

config PHY_S5PV210_USB2
	bool "Support for S5PV210"
	depends on PHY_SAMSUNG_USB2
	depends on ARCH_S5PV210 || COMPILE_TEST
	help
	  Enable USB PHY support for S5PV210. This option requires that Samsung
	  USB 2.0 PHY driver is enabled and means that support for this
	  particular SoC is compiled in the driver. In case of S5PV210 two phys
	  are available - device and host.

config PHY_EXYANALS5_USBDRD
	tristate "Exyanals5 SoC series USB DRD PHY driver"
	depends on (ARCH_EXYANALS && OF) || COMPILE_TEST
	depends on HAS_IOMEM
	depends on USB_DWC3_EXYANALS
	select GENERIC_PHY
	select MFD_SYSCON
	default y
	help
	  Enable USB DRD PHY support for Exyanals 5 SoC series.
	  This driver provides PHY interface for USB 3.0 DRD controller
	  present on Exyanals5 SoC series.

config PHY_EXYANALS5250_SATA
	tristate "Exyanals5250 Sata SerDes/PHY driver"
	depends on SOC_EXYANALS5250
	depends on HAS_IOMEM
	depends on OF
	select GENERIC_PHY
	select I2C
	select I2C_S3C2410
	select MFD_SYSCON
	help
	  Enable this to support SATA SerDes/Phy found on Samsung's
	  Exyanals5250 based SoCs.This SerDes/Phy supports SATA 1.5 Gb/s,
	  SATA 3.0 Gb/s, SATA 6.0 Gb/s speeds. It supports one SATA host
	  port to accept one SATA device.
```

## drivers/phy/socionext/Kconfig
```kconfig
#
# PHY drivers for Socionext platforms.
#

config PHY_UNIPHIER_USB2
	tristate "UniPhier USB2 PHY driver"
	depends on ARCH_UNIPHIER || COMPILE_TEST
	depends on OF && HAS_IOMEM
	select GENERIC_PHY
	select MFD_SYSCON
	help
	  Enable this to support USB PHY implemented on USB2 controller
	  on UniPhier SoCs. This driver provides interface to interact
	  with USB 2.0 PHY that is part of the UniPhier SoC.
	  In case of Pro4, it is necessary to specify this USB2 PHY instead
	  of USB3 HS-PHY.

config PHY_UNIPHIER_USB3
	tristate "UniPhier USB3 PHY driver"
	depends on ARCH_UNIPHIER || COMPILE_TEST
	depends on OF && HAS_IOMEM
	select GENERIC_PHY
	help
	  Enable this to support USB PHY implemented in USB3 controller
	  on UniPhier SoCs. This controller supports USB3.0 and lower speed.

config PHY_UNIPHIER_PCIE
	tristate "Uniphier PHY driver for PCIe controller"
	depends on (ARCH_UNIPHIER || COMPILE_TEST) && OF
	default PCIE_UNIPHIER
	select GENERIC_PHY
	help
	  Enable this to support PHY implemented in PCIe controller
	  on UniPhier SoCs. This driver supports LD20 and PXs3 SoCs.
```

## drivers/phy/sophgo/Kconfig
```kconfig
# SPDX-License-Identifier: GPL-2.0-only
#
# Phy drivers for Sophgo platforms
#

if ARCH_SOPHGO || COMPILE_TEST

config PHY_SOPHGO_CV1800_USB2
	tristate "Sophgo CV18XX/SG200X USB 2.0 PHY support"
	depends on MFD_SYSCON
	depends on USB_SUPPORT
	select GENERIC_PHY
	help
	  Enable this to support the USB 2.0 PHY used with
	  the DWC2 USB controller in Sophgo CV18XX/SG200X
	  series SoC.
	  If unsure, say N.

endif # ARCH_SOPHGO || COMPILE_TEST
```

## drivers/phy/spacemit/Kconfig
```kconfig
# SPDX-License-Identifier: GPL-2.0-only
#
# Phy drivers for SpacemiT platforms
#
config PHY_SPACEMIT_K1_PCIE
	tristate "PCIe and combo PHY driver for the SpacemiT K1 SoC"
	depends on ARCH_SPACEMIT || COMPILE_TEST
	depends on COMMON_CLK
	depends on HAS_IOMEM
	depends on OF
	select GENERIC_PHY
	default ARCH_SPACEMIT
	help
	  Enable support for the PCIe and USB 3 combo PHY and two
	  PCIe-only PHYs used in the SpacemiT K1 SoC.

config PHY_SPACEMIT_K1_USB2
	tristate "SpacemiT K1 USB 2.0 PHY support"
	depends on (ARCH_SPACEMIT || COMPILE_TEST) && OF
	depends on COMMON_CLK
	depends on USB_COMMON
	select GENERIC_PHY
	help
	  Enable this to support K1 USB 2.0 PHY driver. This driver takes care of
	  enabling and clock setup and will be used by K1 udc/ehci/otg/xhci driver.

config PHY_SPACEMIT_K3_COMMON_OPS
	tristate
	select MFD_SYSCON
	select GENERIC_PHY

config PHY_SPACEMIT_K3_COMBO_PHY
	tristate "SpacemiT K3 USB3/PCIe PHY support"
	depends on (ARCH_SPACEMIT || COMPILE_TEST) && OF
	depends on COMMON_CLK
	select PHY_SPACEMIT_K3_COMMON_OPS
	help
	  Enable this to support K3 USB3/PCIe combo PHY driver. This
	  driver takes care of enabling and clock setup and will be used
	  by K3 dwc3 driver.
	  If unsure, say N.
```

## drivers/phy/st/Kconfig
```kconfig
# SPDX-License-Identifier: GPL-2.0-only
#
# Phy drivers for STMicro platforms
#
config PHY_MIPHY28LP
	tristate "STMicroelectronics MIPHY28LP PHY driver for STiH407"
	depends on ARCH_STI
	select GENERIC_PHY
	help
	  Enable this to support the miphy transceiver (for SATA/PCIE/USB3)
	  that is part of STMicroelectronics STiH407 SoC.

config PHY_ST_SPEAR1310_MIPHY
	tristate "ST SPEAR1310-MIPHY driver"
	select GENERIC_PHY
	depends on MACH_SPEAR1310 || COMPILE_TEST
	help
	  Support for ST SPEAr1310 MIPHY which can be used for PCIe and SATA.

config PHY_ST_SPEAR1340_MIPHY
	tristate "ST SPEAR1340-MIPHY driver"
	select GENERIC_PHY
	depends on MACH_SPEAR1340 || COMPILE_TEST
	help
	  Support for ST SPEAr1340 MIPHY which can be used for PCIe and SATA.

config PHY_STIH407_USB
	tristate "STMicroelectronics USB2 picoPHY driver for STiH407 family"
	depends on RESET_CONTROLLER
	depends on ARCH_STI || COMPILE_TEST
	select GENERIC_PHY
	help
	  Enable this support to enable the picoPHY device used by USB2
	  and USB3 controllers on STMicroelectronics STiH407 SoC families.

config PHY_STM32_USBPHYC
	tristate "STMicroelectronics STM32 USB HS PHY Controller driver"
	depends on ARCH_STM32 || COMPILE_TEST
	select GENERIC_PHY
	help
	  Enable this to support the High-Speed USB transceivers that are part
	  of some STMicroelectronics STM32 SoCs.

	  This driver controls the entire USB PHY block: the USB PHY controller
	  (USBPHYC) and the two 8-bit wide UTMI+ interfaces. First interface is
	  used by an HS USB Host controller, and the second one is shared
	  between an HS USB OTG controller and an HS USB Host controller,
	  selected by a USB switch.
```

## drivers/phy/starfive/Kconfig
```kconfig
# SPDX-License-Identifier: GPL-2.0-only
#
# Phy drivers for StarFive platforms
#

if ARCH_STARFIVE || COMPILE_TEST

config PHY_STARFIVE_JH7110_DPHY_RX
	tristate "StarFive JH7110 D-PHY RX support"
	depends on HAS_IOMEM
	select GENERIC_PHY
	select GENERIC_PHY_MIPI_DPHY
	help
	  Choose this option if you have a StarFive D-PHY in your
	  system. If M is selected, the module will be called
	  phy-jh7110-dphy-rx.ko.

config PHY_STARFIVE_JH7110_PCIE
	tristate "Starfive JH7110 PCIE 2.0/USB 3.0 PHY support"
	depends on HAS_IOMEM
	select GENERIC_PHY
	help
	  Enable this to support the StarFive PCIe 2.0 PHY,
	  or used as USB 3.0 PHY.
	  If M is selected, the module will be called
	  phy-jh7110-pcie.ko.

config PHY_STARFIVE_JH7110_USB
	tristate "Starfive JH7110 USB 2.0 PHY support"
	depends on USB_SUPPORT
	select GENERIC_PHY
	help
	  Enable this to support the StarFive USB 2.0 PHY,
	  used with the Cadence USB controller.
	  If M is selected, the module will be called
	  phy-jh7110-usb.ko.

endif # ARCH_STARFIVE || COMPILE_TEST
```

## drivers/phy/sunplus/Kconfig
```kconfig
# SPDX-License-Identifier: GPL-2.0-only

config PHY_SUNPLUS_USB
	tristate "Sunplus SP7021 USB 2.0 PHY driver"
	depends on OF && (SOC_SP7021 || COMPILE_TEST)
	select GENERIC_PHY
	help
	  Enable this to support the USB 2.0 PHY on Sunplus SP7021
	  SoC. The USB 2.0 PHY controller supports battery charger
	  and synchronous signals, various power down modes including
	  operating, partial and suspend modes, and high-speed,
	  full-speed and low-speed data transfer.
```

## drivers/phy/ti/Kconfig
```kconfig
#
# Phy drivers for TI platforms
#
config PHY_DA8XX_USB
	tristate "TI DA8xx USB PHY Driver"
	depends on ARCH_DAVINCI_DA8XX
	select GENERIC_PHY
	select MFD_SYSCON
	help
	  Enable this to support the USB PHY on DA8xx SoCs.

	  This driver controls both the USB 1.1 PHY and the USB 2.0 PHY.

config PHY_DM816X_USB
	tristate "TI dm816x USB PHY driver"
	depends on ARCH_OMAP2PLUS
	depends on USB_SUPPORT
	select GENERIC_PHY
	select USB_PHY
	help
	  Enable this for dm816x USB to work.

config OMAP_CONTROL_PHY
	tristate "OMAP CONTROL PHY Driver"
	depends on ARCH_OMAP2PLUS || COMPILE_TEST
	help
	  Enable this to add support for the PHY part present in the control
	  module. This driver has API to power on the USB2 PHY and to write to
	  the mailbox. The mailbox is present only in omap4 and the register to
	  power on the USB2 PHY is present in OMAP4 and OMAP5. OMAP5 has an
	  additional register to power on USB3 PHY/SATA PHY/PCIE PHY
	  (PIPE3 PHY).

config OMAP_USB2
	tristate "OMAP USB2 PHY Driver"
	depends on ARCH_OMAP2PLUS
	depends on USB_SUPPORT
	select GENERIC_PHY
	select USB_PHY
	select OMAP_CONTROL_PHY
	depends on OMAP_OCP2SCP
	help
	  Enable this to support the transceiver that is part of SOC. This
	  driver takes care of all the PHY functionality apart from comparator.
	  The USB OTG controller communicates with the comparator using this
	  driver.

config TI_PIPE3
	tristate "TI PIPE3 PHY Driver"
	depends on ARCH_OMAP2PLUS || COMPILE_TEST
	select GENERIC_PHY
	select OMAP_CONTROL_PHY
	depends on OMAP_OCP2SCP
	help
	  Enable this to support the PIPE3 PHY that is part of TI SOCs. This
	  driver takes care of all the PHY functionality apart from comparator.
	  This driver interacts with the "OMAP Control PHY Driver" to power
	  on/off the PHY.

config PHY_TUSB1210
	tristate "TI TUSB1210 ULPI PHY module"
	depends on USB_ULPI_BUS
	select GENERIC_PHY
	help
	  Support for TI TUSB1210 USB ULPI PHY.

config TWL4030_USB
	tristate "TWL4030 USB Transceiver Driver"
	depends on TWL4030_CORE && REGULATOR_TWL4030 && USB_MUSB_OMAP2PLUS
	depends on USB_SUPPORT
	depends on USB_GADGET || !USB_GADGET # if USB_GADGET=m, this can't 'y'
	select GENERIC_PHY
	select USB_PHY
	help
	  Enable this to support the USB OTG transceiver on TWL4030
	  family chips (including the TWL5030 and TPS659x0 devices).
	  This transceiver supports high and full speed devices plus,
	  in host mode, low speed.

config PHY_TI_GMII_SEL
	tristate
	default y if TI_CPSW=y
	depends on TI_CPSW || COMPILE_TEST
	select GENERIC_PHY
	select REGMAP
	default m
	help
	  This driver supports configuring of the TI CPSW Port mode depending on
	  the Ethernet PHY connected to the CPSW Port.
```

## drivers/phy/xilinx/Kconfig
```kconfig
# SPDX-License-Identifier: GPL-2.0-only

#
# PHY drivers for Xilinx platforms
#

config PHY_XILINX_ZYNQMP
	tristate "Xilinx ZynqMP PHY driver"
	depends on ARCH_ZYNQMP || COMPILE_TEST
	select GENERIC_PHY
	help
	  Enable this to support ZynqMP High Speed Gigabit Transceiver
	  that is part of ZynqMP SoC.
```
