## drivers/phy/microchip/Kconfig
```kconfig
# SPDX-License-Identifier: GPL-2.0-only
#
# Phy drivers for Microchip devices
#

config PHY_SPARX5_SERDES
	tristate "Microchip Sparx5 SerDes PHY driver"
	select GENERIC_PHY
	depends on ARCH_SPARX5 || COMPILE_TEST
	depends on OF
	depends on HAS_IOMEM
	help
	  Enable this for support of the 10G/25G SerDes on Microchip Sparx5.

config PHY_LAN966X_SERDES
	tristate "SerDes PHY driver for Microchip LAN966X"
	select GENERIC_PHY
	depends on SOC_LAN966 || MCHP_LAN966X_PCI || COMPILE_TEST
	depends on OF
	depends on MFD_SYSCON
	help
	  Enable this for supporting SerDes muxing with Microchip LAN966X
```

## drivers/phy/motorola/Kconfig
```kconfig
#
# Phy drivers for Motorola devices
#
config PHY_CPCAP_USB
	tristate "CPCAP PMIC USB PHY driver"
	depends on USB_SUPPORT && IIO
	depends on USB_MUSB_HDRC || USB_MUSB_HDRC=n
	select GENERIC_PHY
	select USB_PHY
	help
	  Enable this for USB to work on Motorola phones and tablets
	  such as Droid 4.

config PHY_MAPPHONE_MDM6600
	tristate "Motorola Mapphone MDM6600 modem USB PHY driver"
	depends on OF && USB_SUPPORT && GPIOLIB
	select GENERIC_PHY
	help
	  Enable this for MDM6600 USB modem to work on Motorola phones
	  and tablets such as Droid 4.
```

## drivers/phy/mscc/Kconfig
```kconfig
# SPDX-License-Identifier: GPL-2.0-only
#
# Phy drivers for Microsemi devices
#

config PHY_OCELOT_SERDES
	tristate "SerDes PHY driver for Microsemi Ocelot"
	select GENERIC_PHY
	depends on OF
	depends on MFD_SYSCON
	help
	  Enable this for supporting SerDes muxing with Microsemi Ocelot.
```

## drivers/phy/nuvoton/Kconfig
```kconfig
# SPDX-License-Identifier: GPL-2.0-only
#
# PHY drivers for Nuvoton MA35 platforms
#
config PHY_MA35_USB
	tristate "Nuvoton MA35 USB2.0 PHY driver"
	depends on ARCH_MA35 || COMPILE_TEST
	depends on OF
	select GENERIC_PHY
	help
	  Enable this to support the USB2.0 PHY on the Nuvoton MA35
	  series SoCs.
```

## drivers/phy/qualcomm/Kconfig
```kconfig
# SPDX-License-Identifier: GPL-2.0-only
#
# Phy drivers for Qualcomm and Atheros platforms
#
config PHY_ATH79_USB
	tristate "Atheros AR71XX/9XXX USB PHY driver"
	depends on OF && (ATH79 || COMPILE_TEST)
	default y if USB_EHCI_HCD_PLATFORM || USB_OHCI_HCD_PLATFORM
	select RESET_CONTROLLER
	select GENERIC_PHY
	help
	  Enable this to support the USB PHY on Atheros AR71XX/9XXX SoCs.

config PHY_QCOM_APQ8064_SATA
	tristate "Qualcomm APQ8064 SATA SerDes/PHY driver"
	depends on ARCH_QCOM
	depends on HAS_IOMEM
	depends on OF
	select GENERIC_PHY

config PHY_QCOM_EDP
	tristate "Qualcomm eDP PHY driver"
	depends on ARCH_QCOM || COMPILE_TEST
	depends on OF
	depends on COMMON_CLK
	select GENERIC_PHY
	help
	  Enable this driver to support the Qualcomm eDP PHY found in various
	  Qualcomm chipsets.

config PHY_QCOM_IPQ4019_USB
	tristate "Qualcomm IPQ4019 USB PHY driver"
	depends on OF && (ARCH_QCOM || COMPILE_TEST)
	select GENERIC_PHY
	help
	  Support for the USB PHY-s on Qualcomm IPQ40xx SoC-s.

config PHY_QCOM_IPQ806X_SATA
	tristate "Qualcomm IPQ806x SATA SerDes/PHY driver"
	depends on ARCH_QCOM
	depends on HAS_IOMEM
	depends on OF
	select GENERIC_PHY

config PHY_QCOM_PCIE2
	tristate "Qualcomm PCIe Gen2 PHY Driver"
	depends on OF && COMMON_CLK && (ARCH_QCOM || COMPILE_TEST)
	select GENERIC_PHY
	help
	  Enable this to support the Qualcomm PCIe PHY, used with the Synopsys
	  based PCIe controller.

menuconfig PHY_QCOM_QMP
	tristate "Qualcomm QMP PHY Drivers"
	depends on OF && COMMON_CLK && (ARCH_QCOM || COMPILE_TEST)

if PHY_QCOM_QMP

config PHY_QCOM_QMP_COMBO
	tristate "Qualcomm QMP Combo PHY Driver"
	default PHY_QCOM_QMP
	select GENERIC_PHY
	help
	  Enable this to support the QMP Combo PHY transceiver that is used
	  with USB3 and DisplayPort controllers on Qualcomm chips.

config PHY_QCOM_QMP_PCIE
	tristate "Qualcomm QMP PCIe PHY Driver"
	depends on PCI || COMPILE_TEST
	select GENERIC_PHY
	default PHY_QCOM_QMP
	help
	  Enable this to support the QMP PCIe PHY transceiver that is used
	  with PCIe controllers on Qualcomm chips.

config PHY_QCOM_QMP_PCIE_8996
	tristate "Qualcomm QMP PCIe 8996 PHY Driver"
	depends on PCI || COMPILE_TEST
	select GENERIC_PHY
	default PHY_QCOM_QMP
	help
	  Enable this to support the QMP PCIe PHY transceiver that is used
	  with PCIe controllers on Qualcomm msm8996 chips.

config PHY_QCOM_QMP_UFS
	tristate "Qualcomm QMP UFS PHY Driver"
	select GENERIC_PHY
	default PHY_QCOM_QMP
	help
	  Enable this to support the QMP UFS PHY transceiver that is used
	  with UFS controllers on Qualcomm chips.

config PHY_QCOM_QMP_USB
	tristate "Qualcomm QMP USB PHY Driver"
	select GENERIC_PHY
	default PHY_QCOM_QMP
	help
	  Enable this to support the QMP USB PHY transceiver that is used
	  with USB3 controllers on Qualcomm chips.

endif # PHY_QCOM_QMP

menuconfig PHY_QCOM_UFS
	tristate "Qualcomm Technologies, Inc. UFS PHY driver"
	depends on OF && ARCH_QCOM
	select GENERIC_PHY
	help
	  Enables support for UFS PHY on Qualcomm Technologies, Inc.
	  chipsets.
	  This driver together with the UFS PHY controller specific
	  driver enables the UFS PHY support for Qualcomm Technologies, Inc.
	  chips.

if PHY_QCOM_UFS

config PHY_QCOM_UFS_V3
	tristate "Qualcomm Technologies, Inc. Sdmsteppe Phy Driver"
	depends on PHY_QCOM_UFS
	help
	  Enables support for UFS PHY on Qualcomm Technologies, Inc.
	  chipsets.
	  Support for 11nm UFS QMP phy present on QCOM chipsets.
	  This is required to enable UFS on Sdmsteppe chipset.

config PHY_QCOM_UFS_V3_SM4350
	tristate "Qualcomm Technologies, Inc. UFS Holi Phy Driver"
	help
	  Qualcomm Technologies, Inc. UFS Holi Phy Driver.
	  Enables support for UFS PHY on Qualcomm Technologies, Inc.
	  Holi chipsets. This is required to enable UFS on Holi chipset.
	  To compile this driver as a module, choose M here.

config PHY_QCOM_UFS_V4
	tristate
	default PHY_QCOM_UFS
	help
	  Support for 7nm UFS QMP phy present on QCOM chipsets.

config PHY_QCOM_UFS_QRBTC_SDM845
	tristate "Qualcomm Technologies, Inc. UFS Presil Phy Driver"
	depends on PHY_QCOM_UFS && REGULATOR_STUB
	help
          Enable this to support UFS PHY on pre-silicon platforms.
	  The support is restricted to HS-G1 only on both Tx and Rx.
	  No low power mode support is present.
	  Doesn't restrict number of lanes.


config PHY_QCOM_UFS_V4_KALAMA
        tristate "Qualcomm Technologies, Inc. UFS Kalama Phy Driver"
        help
          Support for UFS phy present on QCOM kalama chipsets.
	  This is required to enable UFS on Kalama chipset.
          To compile this driver as a module, choose M here.

config PHY_QCOM_UFS_V4_PINEAPPLE
        tristate "Qualcomm Technologies, Inc. UFS Pineapple Phy Driver"
        help
          Support for UFS phy present on QCOM Pineapple chipsets.
          This is required to enable UFS on Pineapple chipset.
          To compile this driver as a module, choose M here.

config PHY_QCOM_UFS_V4_NIOBE
	tristate "Qualcomm Technologies, Inc. UFS Niobe Phy Driver"
	help
	  Support for UFS phy present on QCOM Niobe chipsets.
	  This is required to enable UFS on Niobe chipset.
	  To compile this driver as a module, choose M here.
	  This would be needed for all niobe ufs platforms.

config PHY_QCOM_UFS_V4_WAIPIO
        tristate "Qualcomm Technologies, Inc. UFS Waipio Phy Driver"
        help
          Support for UFS phy present on QCOM Waipio chipsets.
          This is required to enable UFS on Waipio chipset.
          To compile this driver as a module, choose M here.


config PHY_QCOM_UFS_V4_BLAIR
	tristate "Qualcomm Technologies, Inc. UFS Blair Phy Driver"
	help
	  Support for UFS phy present on QCOM Blair chipsets.
	  This is required to enable UFS on Blair chipset.
          To compile this driver as a module, choose M here.

config PHY_QCOM_UFS_V4_LAHAINA
	tristate "Qualcomm Technologies, Inc. UFS Lahaina Phy Driver"
	help
	  Support for UFS phy present on QCOM Lahaina chipsets.
	  This is required to enable UFS on Lahaina chipset.
	  To compile this driver as a module, choose M here.

config PHY_QCOM_UFS_V4_CROW
	tristate "Qualcomm Technologies, Inc. UFS Crow Phy Driver"
	help
	  Support for UFS phy present on QCOM Crow chipsets is essential
	  for enabling UFS on Crow chipsets.
	  To compile this driver as a module, users can choose "M" to have
	  the flexibility of loading and unloading the driver as needed.
	  By incorporating support for UFS phy on Crow chipsets, users
	  can take advantage of the benefits offered by CROW UFS PHY.

endif

config PHY_QCOM_QUSB2
	tristate "Qualcomm QUSB2 PHY Driver"
	depends on OF && (ARCH_QCOM || COMPILE_TEST)
	depends on NVMEM || !NVMEM
	select GENERIC_PHY
	help
	  Enable this to support the HighSpeed QUSB2 PHY transceiver for USB
	  controllers on Qualcomm chips. This driver supports the high-speed
	  PHY which is usually paired with either the ChipIdea or Synopsys DWC3
	  USB IPs on MSM SOCs.

config PHY_QCOM_USB_HS
	tristate "Qualcomm USB HS PHY module"
	depends on USB_ULPI_BUS
	depends on EXTCON || !EXTCON # if EXTCON=m, this cannot be built-in
	select GENERIC_PHY
	help
	  Support for the USB high-speed ULPI compliant phy on Qualcomm
	  chipsets.

config PHY_QCOM_USB_SNPS_FEMTO_V2
	tristate "Qualcomm SNPS FEMTO USB HS PHY V2 module"
	depends on OF && (ARCH_QCOM || COMPILE_TEST)
	select GENERIC_PHY
	help
	  Enable support for the USB high-speed SNPS Femto phy on Qualcomm
	  chipsets.  This PHY has differences in the register map compared
	  to the V1 variants.  The PHY is paired with a Synopsys DWC3 USB
	  controller on Qualcomm SOCs.

config PHY_QCOM_USB_HSIC
	tristate "Qualcomm USB HSIC ULPI PHY module"
	depends on USB_ULPI_BUS
	select GENERIC_PHY
	help
	  Support for the USB HSIC ULPI compliant PHY on QCOM chipsets.

config PHY_QCOM_USB_HS_28NM
	tristate "Qualcomm 28nm High-Speed PHY"
	depends on OF && (ARCH_QCOM || COMPILE_TEST)
	depends on EXTCON || !EXTCON # if EXTCON=m, this cannot be built-in
	select GENERIC_PHY
	help
	  Enable this to support the Qualcomm Synopsys DesignWare Core 28nm
	  High-Speed PHY driver. This driver supports the Hi-Speed PHY which
	  is usually paired with either the ChipIdea or Synopsys DWC3 USB
	  IPs on MSM SOCs.

config PHY_QCOM_USB_SS
	tristate "Qualcomm USB Super-Speed PHY driver"
	depends on OF && (ARCH_QCOM || COMPILE_TEST)
	depends on EXTCON || !EXTCON # if EXTCON=m, this cannot be built-in
	select GENERIC_PHY
	help
	  Enable this to support the Super-Speed USB transceiver on various
	  Qualcomm chipsets.

config PHY_QCOM_IPQ806X_USB
	tristate "Qualcomm IPQ806x DWC3 USB PHY driver"
	depends on HAS_IOMEM
	depends on OF && (ARCH_QCOM || COMPILE_TEST)
	select GENERIC_PHY
	help
	  This option enables support for the Synopsis PHYs present inside the
	  Qualcomm USB3.0 DWC3 controller on ipq806x SoC. This driver supports
	  both HS and SS PHY controllers.
```

## drivers/phy/ralink/Kconfig
```kconfig
# SPDX-License-Identifier: GPL-2.0-only
#
# PHY drivers for Ralink platforms.
#
config PHY_MT7621_PCI
	tristate "MediaTek MT7621 PCI PHY Driver"
	depends on (RALINK && OF) || COMPILE_TEST
	select GENERIC_PHY
	select REGMAP_MMIO
	help
	  Say 'Y' here to add support for MediaTek MT7621 PCI PHY driver,

config PHY_RALINK_USB
	tristate "Ralink USB PHY driver"
	depends on RALINK || COMPILE_TEST
	depends on HAS_IOMEM
	select GENERIC_PHY
	select MFD_SYSCON
	help
	  This option enables support for the Ralink USB PHY found inside
	  RT3352, MT7620, MT7628 and MT7688.
```

## drivers/phy/realtek/Kconfig
```kconfig
# SPDX-License-Identifier: GPL-2.0
#
# Phy drivers for Realtek platforms
#

if ARCH_REALTEK || COMPILE_TEST

config PHY_RTK_RTD_USB2PHY
	tristate "Realtek RTD USB2 PHY Transceiver Driver"
	depends on USB_SUPPORT
	select GENERIC_PHY
	select USB_PHY
	select USB_COMMON
	help
	  Enable this to support Realtek SoC USB2 phy transceiver.
	  The DHC (digital home center) RTD series SoCs used the Synopsys
	  DWC3 USB IP. This driver will do the PHY initialization
	  of the parameters.

config PHY_RTK_RTD_USB3PHY
	tristate "Realtek RTD USB3 PHY Transceiver Driver"
	depends on USB_SUPPORT
	select GENERIC_PHY
	select USB_PHY
	select USB_COMMON
	help
	  Enable this to support Realtek SoC USB3 phy transceiver.
	  The DHC (digital home center) RTD series SoCs used the Synopsys
	  DWC3 USB IP. This driver will do the PHY initialization
	  of the parameters.

endif # ARCH_REALTEK || COMPILE_TEST
```

## drivers/phy/renesas/Kconfig
```kconfig
# SPDX-License-Identifier: GPL-2.0
#
# Phy drivers for Renesas platforms
#
# NOTE: Please sorted config names alphabetically.
config PHY_R8A779F0_ETHERNET_SERDES
	tristate "Renesas R-Car S4-8 Ethernet SERDES driver"
	depends on ARCH_RENESAS || COMPILE_TEST
	select GENERIC_PHY
	help
	  Support for Ethernet SERDES found on Renesas R-Car S4-8 SoCs.

config PHY_RCAR_GEN2
	tristate "Renesas R-Car generation 2 USB PHY driver"
	depends on ARCH_RENESAS
	depends on GENERIC_PHY
	help
	  Support for USB PHY found on Renesas R-Car generation 2 SoCs.

config PHY_RCAR_GEN3_PCIE
	tristate "Renesas R-Car generation 3 PCIe PHY driver"
	depends on ARCH_RENESAS
	select GENERIC_PHY
	help
	  Support for the PCIe PHY found on Renesas R-Car generation 3 SoCs.

config PHY_RCAR_GEN3_USB2
	tristate "Renesas R-Car generation 3 USB 2.0 PHY driver"
	depends on ARCH_RENESAS
	depends on EXTCON || !EXTCON # if EXTCON=m, this cannot be built-in
	depends on USB_SUPPORT
	select GENERIC_PHY
	select USB_COMMON
	help
	  Support for USB 2.0 PHY found on Renesas R-Car generation 3 SoCs.

config PHY_RCAR_GEN3_USB3
	tristate "Renesas R-Car generation 3 USB 3.0 PHY driver"
	depends on ARCH_RENESAS || COMPILE_TEST
	select GENERIC_PHY
	help
	  Support for USB 3.0 PHY found on Renesas R-Car generation 3 SoCs.
```
