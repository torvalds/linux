## drivers/pinctrl/actions/Kconfig
```kconfig
# SPDX-License-Identifier: GPL-2.0-only
config PINCTRL_OWL
	bool "Actions Semi OWL pinctrl driver"
	depends on (ARCH_ACTIONS || COMPILE_TEST) && OF
	select PINMUX
	select PINCONF
	select GENERIC_PINCONF
	select GPIOLIB
	select GPIOLIB_IRQCHIP
	help
	  Say Y here to enable Actions Semi OWL pinctrl driver

config PINCTRL_S500
	bool "Actions Semi S500 pinctrl driver"
	depends on ARM || COMPILE_TEST
	depends on PINCTRL_OWL
	help
	  Say Y here to enable Actions Semi S500 pinctrl driver

config PINCTRL_S700
	bool "Actions Semi S700 pinctrl driver"
	depends on ARM64 || COMPILE_TEST
	depends on PINCTRL_OWL
	help
	  Say Y here to enable Actions Semi S700 pinctrl driver

config PINCTRL_S900
	bool "Actions Semi S900 pinctrl driver"
	depends on ARM64 || COMPILE_TEST
	depends on PINCTRL_OWL
	help
	  Say Y here to enable Actions Semi S900 pinctrl driver
```

## drivers/pinctrl/aspeed/Kconfig
```kconfig
# SPDX-License-Identifier: GPL-2.0-only
config PINCTRL_ASPEED
	bool
	depends on (ARCH_ASPEED || COMPILE_TEST) && OF
	select MFD_SYSCON
	select PINMUX
	select PINCONF
	select GENERIC_PINCONF
	select REGMAP_MMIO

config PINCTRL_ASPEED_G4
	bool "Aspeed G4 SoC pin control"
	depends on (MACH_ASPEED_G4 || COMPILE_TEST) && OF
	select PINCTRL_ASPEED
	help
	  Say Y here to enable pin controller support for Aspeed's 4th
	  generation SoCs. GPIO is provided by a separate GPIO driver.

config PINCTRL_ASPEED_G5
	bool "Aspeed G5 SoC pin control"
	depends on (MACH_ASPEED_G5 || COMPILE_TEST) && OF
	select PINCTRL_ASPEED
	help
	  Say Y here to enable pin controller support for Aspeed's 5th
	  generation SoCs. GPIO is provided by a separate GPIO driver.

config PINCTRL_ASPEED_G6
	bool "Aspeed G6 SoC pin control"
	depends on (MACH_ASPEED_G6 || COMPILE_TEST) && OF
	select PINCTRL_ASPEED
	help
	  Say Y here to enable pin controller support for Aspeed's 6th
	  generation SoCs. GPIO is provided by a separate GPIO driver.

config PINCTRL_ASPEED_G7_SOC0
	bool "Aspeed G7 SoC pin control"
	depends on (ARCH_ASPEED || COMPILE_TEST) && OF
	select PINCTRL_ASPEED
	help
	  Say Y here to enable pin controller support for the SoC0 instance
	  of Aspeed's 7th generation SoCs. GPIO is provided by a separate
	  GPIO driver.

config PINCTRL_ASPEED_G7_SOC1
	bool "Aspeed G7 SoC1 pin control"
	depends on (ARCH_ASPEED || COMPILE_TEST) && OF
	select MFD_SYSCON
	select PINMUX
	select GENERIC_PINCTRL_GROUPS
	select GENERIC_PINMUX_FUNCTIONS
	select GENERIC_PINCONF
	select REGMAP_MMIO
	help
	  Say Y here to enable pin controller support for the SoC1 instance
	  of Aspeed's 7th generation SoCs. GPIO is provided by a separate
	  GPIO driver.
```

## drivers/pinctrl/bcm/Kconfig
```kconfig
# SPDX-License-Identifier: GPL-2.0-only
#
# Broadcom pinctrl drivers
#

config PINCTRL_BCM281XX
	bool "Broadcom BCM281xx pinctrl driver"
	depends on OF && (ARCH_BCM_MOBILE || COMPILE_TEST)
	select PINMUX
	select PINCONF
	select GENERIC_PINCONF
	select REGMAP_MMIO
	default ARCH_BCM_MOBILE
	help
	  Say Y here to support Broadcom BCM281xx pinctrl driver, which is used
	  for the BCM281xx SoC family, including BCM11130, BCM11140, BCM11351,
	  BCM28145, and BCM28155 SoCs.  This driver requires the pinctrl
	  framework.  GPIO is provided by a separate GPIO driver.

config PINCTRL_BCM2835
	bool "Broadcom BCM2835 GPIO (with PINCONF) driver"
	depends on OF && (ARCH_BCM2835 || ARCH_BRCMSTB || COMPILE_TEST)
	select PINMUX
	select PINCONF
	select GENERIC_PINCONF
	select GPIOLIB
	select GPIOLIB_IRQCHIP
	default ARCH_BCM2835 || ARCH_BRCMSTB
	help
	   Say Y here to enable the Broadcom BCM2835 GPIO driver.

config PINCTRL_BCM63XX
	bool
	select GENERIC_PINCONF
	select GPIO_REGMAP
	select PINCONF
	select PINMUX

config PINCTRL_BCM6318
	bool "Broadcom BCM6318 GPIO driver"
	depends on (BMIPS_GENERIC || COMPILE_TEST)
	select PINCTRL_BCM63XX
	default BMIPS_GENERIC
	help
	   Say Y here to enable the Broadcom BCM6318 GPIO driver.

config PINCTRL_BCM6328
	bool "Broadcom BCM6328 GPIO driver"
	depends on (BMIPS_GENERIC || COMPILE_TEST)
	select PINCTRL_BCM63XX
	default BMIPS_GENERIC
	help
	   Say Y here to enable the Broadcom BCM6328 GPIO driver.

config PINCTRL_BCM6358
	bool "Broadcom BCM6358 GPIO driver"
	depends on (BMIPS_GENERIC || COMPILE_TEST)
	select PINCTRL_BCM63XX
	default BMIPS_GENERIC
	help
	   Say Y here to enable the Broadcom BCM6358 GPIO driver.

config PINCTRL_BCM6362
	bool "Broadcom BCM6362 GPIO driver"
	depends on (BMIPS_GENERIC || COMPILE_TEST)
	select PINCTRL_BCM63XX
	default BMIPS_GENERIC
	help
	   Say Y here to enable the Broadcom BCM6362 GPIO driver.

config PINCTRL_BCM6368
	bool "Broadcom BCM6368 GPIO driver"
	depends on (BMIPS_GENERIC || COMPILE_TEST)
	select PINCTRL_BCM63XX
	default BMIPS_GENERIC
	help
	   Say Y here to enable the Broadcom BCM6368 GPIO driver.

config PINCTRL_BCM63268
	bool "Broadcom BCM63268 GPIO driver"
	depends on (BMIPS_GENERIC || COMPILE_TEST)
	select PINCTRL_BCM63XX
	default BMIPS_GENERIC
	help
	   Say Y here to enable the Broadcom BCM63268 GPIO driver.

config PINCTRL_IPROC_GPIO
	bool "Broadcom iProc GPIO (with PINCONF) driver"
	depends on OF_GPIO && (ARCH_BCM_IPROC || COMPILE_TEST)
	select GPIOLIB_IRQCHIP
	select PINCONF
	select GENERIC_PINCONF
	default ARCH_BCM_IPROC
	help
	  Say yes here to enable the Broadcom iProc GPIO driver.

	  The Broadcom iProc based SoCs- Cygnus, NS2, NSP and Stingray, use
	  same GPIO Controller IP hence this driver could be used for all.

	  The Broadcom Cygnus SoC has 3 GPIO controllers including the ASIU
	  GPIO controller (ASIU), the chipCommonG GPIO controller (CCM), and
	  the always-ON GPIO controller (CRMU/AON). All 3 GPIO controllers are
	  supported by this driver.

	  The Broadcom NSP has two GPIO controllers including the ChipcommonA
	  GPIO, the ChipcommonB GPIO. Later controller is supported by this
	  driver.

	  The Broadcom NS2 has two GPIO controller including the CRMU GPIO,
	  the ChipcommonG GPIO. Both controllers are supported by this driver.

	  The Broadcom Stingray GPIO controllers are supported by this driver.

	  All above SoCs GPIO controllers support basic PINCONF functions such
	  as bias pull up, pull down, and drive strength configurations, when
	  these pins are muxed to GPIO.

	  It provides the framework where pins from the individual GPIO can be
	  individually muxed to GPIO function, through interaction with the
	  SoCs IOMUX controller. This features could be used only on SoCs which
	  support individual pin muxing.

config PINCTRL_CYGNUS_MUX
	bool "Broadcom Cygnus IOMUX driver"
	depends on (ARCH_BCM_CYGNUS || COMPILE_TEST)
	depends on OF
	select PINMUX
	select GENERIC_PINCONF
	default ARCH_BCM_CYGNUS
	help
	  Say yes here to enable the Broadcom Cygnus IOMUX driver.

	  The Broadcom Cygnus IOMUX driver supports group based IOMUX
	  configuration, with the exception that certain individual pins
	  can be overridden to GPIO function

config PINCTRL_NS
	bool "Broadcom Northstar pins driver"
	depends on OF && (ARCH_BCM_5301X || COMPILE_TEST)
	select PINMUX
	select GENERIC_PINCONF
	default ARCH_BCM_5301X
	help
	  Say yes here to enable the Broadcom NS SoC pins driver.

	  The Broadcom Northstar pins driver supports muxing multi-purpose pins
	  that can be used for various functions (e.g. SPI, I2C, UART) as well
	  as GPIOs.

config PINCTRL_NSP_GPIO
	bool "Broadcom NSP GPIO (with PINCONF) driver"
	depends on OF_GPIO && (ARCH_BCM_NSP || COMPILE_TEST)
	select GPIOLIB_IRQCHIP
	select PINCONF
	select GENERIC_PINCONF
	default ARCH_BCM_NSP
	help
	  Say yes here to enable the Broadcom NSP GPIO driver.

	  The Broadcom Northstar Plus SoC ChipcommonA GPIO controller is
	  supported by this driver.

	  The ChipcommonA GPIO controller support basic PINCONF functions such
	  as bias pull up, pull down, and drive strength configurations, when
	  these pins are muxed to GPIO.

config PINCTRL_NS2_MUX
	bool "Broadcom Northstar2 pinmux driver"
	depends on OF
	depends on ARCH_BCM_IPROC || COMPILE_TEST
	select PINMUX
	select GENERIC_PINCONF
	default ARM64 && ARCH_BCM_IPROC
	help
	  Say yes here to enable the Broadcom NS2 MUX driver.

	  The Broadcom Northstar2 IOMUX driver supports group based IOMUX
	  configuration.

config PINCTRL_NSP_MUX
	bool "Broadcom NSP IOMUX driver"
	depends on (ARCH_BCM_NSP || COMPILE_TEST)
	depends on OF
	select PINMUX
	select GENERIC_PINCONF
	default ARCH_BCM_NSP
	help
	  Say yes here to enable the Broadcom NSP SOC IOMUX driver.

	  The Broadcom Northstar Plus IOMUX driver supports pin based IOMUX
	  configuration, with certain individual pins can be overridden
	  to GPIO function.
```

## drivers/pinctrl/bcm/Kconfig.stb
```kconfig
# SPDX-License-Identifier: GPL-2.0-only
if PINCTRL_BRCMSTB

config PINCTRL_BCM2712
	tristate "BCM2712 SoC pin controller driver"
	help
	  Driver for BCM2712 integrated pin controller,
	  commonly found on Raspberry Pi 5.

endif
```

## drivers/pinctrl/berlin/Kconfig
```kconfig
# SPDX-License-Identifier: GPL-2.0-only
if (ARCH_BERLIN || COMPILE_TEST)

config PINCTRL_BERLIN
	bool
	select PINMUX
	select REGMAP_MMIO

config PINCTRL_AS370
	bool "Synaptics as370 pin controller driver"
	depends on OF
	select PINCTRL_BERLIN

config PINCTRL_BERLIN_BG2
	def_bool MACH_BERLIN_BG2
	depends on OF
	select PINCTRL_BERLIN

config PINCTRL_BERLIN_BG2CD
	def_bool MACH_BERLIN_BG2CD
	depends on OF
	select PINCTRL_BERLIN

config PINCTRL_BERLIN_BG2Q
	def_bool MACH_BERLIN_BG2Q
	depends on OF
	select PINCTRL_BERLIN

config PINCTRL_BERLIN_BG4CT
	bool "Marvell berlin4ct pin controller driver"
	depends on OF
	select PINCTRL_BERLIN

endif
```

## drivers/pinctrl/cirrus/Kconfig
```kconfig
# SPDX-License-Identifier: GPL-2.0-only
config PINCTRL_LOCHNAGAR
	tristate "Cirrus Logic Lochnagar pinctrl driver"
	# Avoid clash caused by MIPS defining RST, which is used in the driver
	depends on MFD_LOCHNAGAR && !MIPS
	select GPIOLIB
	select PINMUX
	select PINCONF
	select GENERIC_PINCONF
	help
	  This driver supports configuring the GPIO and other pin configuration
	  of the Cirrus Logic Lochnagar audio development board.

# This is all selected by the Madera MFD driver Kconfig options
config PINCTRL_MADERA
	tristate
	select PINMUX
	select GENERIC_PINCONF

config PINCTRL_CS47L15
	bool

config PINCTRL_CS47L35
	bool

config PINCTRL_CS47L85
	bool

config PINCTRL_CS47L90
	bool

config PINCTRL_CS47L92
	bool
```
