## drivers/amlogic/amports/Kconfig
```kconfig
#
# Amlogic streaming device configuration
#
config  AM_PTSSERVER
	bool 
	default n

config  H264_4K2K_SINGLE_CORE
	bool 
	default n
	
config  VSYNC_RDMA
	bool "VSYNC CBUS RDMA"
	default n
	help
	  Select to enable VSYNC CBUS RDMA.
	
config AM_VIDEO
	bool "Video management"
	default n
	select AM_CANVAS
	select AM_PTSMGR
	select AM_TIMESYNC
	select AM_PTSSERVER
	help
	  Driver for video display.

config AM_VIDEO2
	bool "Video2 management"
	default n
	select AM_VIDEO
	help
	  Driver for video2 display.

config KEEP_FRAME_RESERVED
	bool "Video keep frame used reserved buffer"
	default n
	depends on  AM_VIDEO
	help
	  Select to enable reserved buffer for last frame keeep.

config SUPPORT_VIDEO_ON_VPP2
	bool "Support video on vpp2"
	default n
	depends on !AM_VIDEO2
	help
	  Support displaying video on vpp2

config GE2D_KEEP_FRAME
    bool "Amlogic Video protect video streambuf framebuf"
    default y
    depends on  AM_VIDEO
    help
      Select to enable protect video streambuf framebuf.

menu "Video Decoders"
	depends on AM_VIDEO
config AM_VDEC_MPEG12
	tristate "Amlogic MPEG1/2 Video Decoder"
	default y
	
	select AM_PTSSERVER
	help
	  Driver for mpeg1/2 video decoder.

config AM_VDEC_MPEG4
	tristate "Amlogic MPEG4 Video Decoder"
	default y
	
	select AM_PTSSERVER
	help
	  Driver for mpeg4 video decoder.

config AM_VDEC_VC1
	tristate "Amlogic VC1 Video Decoder"
	default y
	
	select AM_PTSSERVER
	help
	  Driver for vc1 video decoder.

config AM_VDEC_H264
	tristate "Amlogic H264 Video Decoder"
	default y
	
	select AM_PTSSERVER
	help
	  Driver for h264 video decoder.

config AM_VDEC_H264MVC
	tristate "Amlogic H264MVC Video Decoder"
	default n
	
	select AM_PTSSERVER
	help
	  Driver for h264mvc video decoder.

config AM_VDEC_H264_4K2K
        tristate "Amlogic H264_4K2K Video Decoder"
	 depends on ARCH_MESON8 || ARCH_MESON6TVD
        default y

        select AM_PTSSERVER
        help
          Driver for h264 4Kx2K video decoder.

config AM_VDEC_H265
        tristate "Amlogic H265 Video Decoder"
        depends on ARCH_MESON8B || ARCH_MESON8
        default y

        select AM_PTSSERVER
        help
          Driver for h265 video decoder.

config AM_VDEC_MJPEG
	tristate "Amlogic Motion JPEG Video Decoder"
	default y
	
	select AM_PTSSERVER
	help
	  Driver for motion jpeg video decoder.

config AM_ENCODER
	tristate "Amlogic AVC encoder"
	default n
	
	select AM_PTSSERVER
	help
	  Driver for avc encoder.
config AM_JPEG_ENCODER
	tristate "Amlogic jpeg encoder"
	default n
	
	select AM_PTSSERVER
	help
	  Driver for jpeg encoder.	  
config AM_PIC_DEC
	tristate "Amlogic picture decoder"
	default y
	
	select AM_PTSSERVER
	help
	  Driver for picture decoder.	  	  
config AM_VDEC_REAL
	tristate "Amlogic Real Video Decoder"
    default y
    
	select AM_PTSSERVER
    help
      Driver for real video decoder.

config AM_VDEC_AVS
	tristate "Amlogic AVS Video Decoder"
    default y
    
	select AM_PTSSERVER
    help
      Driver for avs video decoder.

config AM_JPEGDEC
    tristate "Amlogic HW jpeg decoder"
    default y
    
	select AM_PTSSERVER
	help
	  Select to enable HW jpeg decoder.

config AM_TIMESYNC
	bool "Amlogic Time sync driver"
	default y
	help
	  AV sync and play rate control management.

config AM_STREAMING
	bool "Amlogic AV Streaming support"
	default y
	select AM_PTSSERVER
	help
	  Driver for the AV streaming ports.

config AM_SUBTITLE
	bool "Amlogic SubTitle support"
	default y
	help 
		Internal Sub Title support driver

config AM_VIDEOCAPTURE
	bool "Amlogic Video Capture support"
	default y
	help
		Internal Video Capture driver
endmenu
```

## drivers/amlogic/amvecm/Kconfig
```kconfig
#
# AMLOGIC tvin devices configuration
#

menu "Amlogic VE & CM"

config AM_VECM
	tristate "Amlogic VE & CM"
	default n
	help
		Video Enhancement & Color Management.

endmenu
```

## drivers/amlogic/audiodsp/Kconfig
```kconfig
#
# audio dsp  configuration
#
menu "Audio dsp process "

config  AML_AUDIO_DSP
	tristate  "audio dsp control support "
	default n
	help  
		aupport the audio dsp ;
		

endmenu	
```

## drivers/amlogic/bluetooth/Kconfig
```kconfig
menu "Bluetooth Device Support"

config BT_DEVICE
    bool "BT Device support"
    depends on BT && RFKILL
    select BACKLIGHT_CLASS_DEVICE
    default n
    help
      Say Y here if you want to use the BT device.
      
config BT_WAKE_CTRL
    bool "BT Wake Control support"
    select BACKLIGHT_CLASS_DEVICE
    default n
    help
        Say Y here if you want to use the BT LPM fucnction.
		
source "drivers/amlogic/bluetooth/rtk8723/Kconfig"		
endmenu
```

## drivers/amlogic/bluetooth/rtk8723/Kconfig
```kconfig
config BT_RTKBTUSB
	tristate "RTK HCI USB driver"
	depends on USB
	help
	  RTK Bluetooth HCI USB driver.
```
