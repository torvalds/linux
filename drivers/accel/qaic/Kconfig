## drivers/acpi/apei/Kconfig
```kconfig
# SPDX-License-Identifier: GPL-2.0
config HAVE_ACPI_APEI
	bool

config HAVE_ACPI_APEI_NMI
	bool

config ACPI_APEI
	bool "ACPI Platform Error Interface (APEI)"
	select MISC_FILESYSTEMS
	select PSTORE
	select UEFI_CPER
	depends on HAVE_ACPI_APEI
	help
	  APEI allows to report errors (for example from the chipset)
	  to the operating system. This improves NMI handling
	  especially. In addition it supports error serialization and
	  error injection.

config ACPI_APEI_GHES
	bool "APEI Generic Hardware Error Source"
	depends on ACPI_APEI
	select ACPI_HED
	select IRQ_WORK
	select GENERIC_ALLOCATOR
	help
	  Generic Hardware Error Source provides a way to report
	  platform hardware errors (such as that from chipset). It
	  works in so called "Firmware First" mode, that is, hardware
	  errors are reported to firmware firstly, then reported to
	  Linux by firmware. This way, some non-standard hardware
	  error registers or non-standard hardware link can be checked
	  by firmware to produce more valuable hardware error
	  information for Linux.

config ACPI_APEI_PCIEAER
	bool "APEI PCIe AER logging/recovering support"
	depends on ACPI_APEI && PCIEAER
	help
	  PCIe AER errors may be reported via APEI firmware first mode.
	  Turn on this option to enable the corresponding support.

config ACPI_APEI_SEA
	bool
	depends on ARM64 && ACPI_APEI_GHES
	default y

config ACPI_APEI_MEMORY_FAILURE
	bool "APEI memory error recovering support"
	depends on ACPI_APEI && MEMORY_FAILURE
	help
	  Memory errors may be reported via APEI firmware first mode.
	  Turn on this option to enable the memory recovering support.

config ACPI_APEI_EINJ
	tristate "APEI Error INJection (EINJ)"
	depends on ACPI_APEI && DEBUG_FS
	help
	  EINJ provides a hardware error injection mechanism, it is
	  mainly used for debugging and testing the other parts of
	  APEI and some other RAS features.

config ACPI_APEI_EINJ_CXL
	bool "CXL Error INJection Support"
	default ACPI_APEI_EINJ
	depends on ACPI_APEI_EINJ
	depends on CXL_BUS && CXL_BUS <= ACPI_APEI_EINJ
	help
	  Support for CXL protocol Error INJection through debugfs/cxl.
	  Availability and which errors are supported is dependent on
	  the host platform. Look to ACPI v6.5 section 18.6.4 and kernel
	  EINJ documentation for more information.

	  If unsure say 'n'

config ACPI_APEI_ERST_DEBUG
	tristate "APEI Error Record Serialization Table (ERST) Debug Support"
	depends on ACPI_APEI
	help
	  ERST is a way provided by APEI to save and retrieve hardware
	  error information to and from a persistent store. Enable this
	  if you want to debugging and testing the ERST kernel support
	  and firmware implementation.
```

## drivers/acpi/arm64/Kconfig
```kconfig
# SPDX-License-Identifier: GPL-2.0-only
#
# ACPI Configuration for ARM64
#

config ACPI_IORT
	bool

config ACPI_GTDT
	bool

config ACPI_AGDI
	bool "Arm Generic Diagnostic Dump and Reset Device Interface"
	depends on ARM_SDE_INTERFACE
	help
	  Arm Generic Diagnostic Dump and Reset Device Interface (AGDI) is
	  a standard that enables issuing a non-maskable diagnostic dump and
	  reset command.

	  If set, the kernel parses AGDI table and listens for the command.

config ACPI_APMT
	bool
```

## drivers/acpi/dptf/Kconfig
```kconfig
# SPDX-License-Identifier: GPL-2.0

menuconfig ACPI_DPTF
	bool "Intel DPTF (Dynamic Platform and Thermal Framework) Support"
	depends on X86
	help
	  Intel Dynamic Platform and Thermal Framework (DPTF) is a platform
	  level hardware/software solution for power and thermal management.

	  As a container for multiple power/thermal technologies, DPTF provides
	  a coordinated approach for different policies to effect the hardware
	  state of a system.

if ACPI_DPTF

config DPTF_POWER
	tristate "Platform Power DPTF Participant"
	default m
	help
	  This driver adds support for Dynamic Platform and Thermal Framework
	  (DPTF) Platform Power Participant device (INT3407) support.
	  This participant is responsible for exposing platform telemetry:
		max_platform_power
		platform_power_source
		adapter_rating
		battery_steady_power
		charger_type

	  To compile this driver as a module, choose M here:
	  the module will be called dptf_power.

config DPTF_PCH_FIVR
	tristate "PCH FIVR DPTF Participant"
	default m
	help
	  This driver adds support for Dynamic Platform and Thermal Framework
	  (DPTF) PCH FIVR Participant device support. This driver allows to
	  switch the PCH FIVR (Fully Integrated Voltage Regulator) frequency.
	  This participant is responsible for exposing:
		freq_mhz_low_clock
		freq_mhz_high_clock

	  To compile this driver as a module, choose M here:
	  the module will be called dptf_pch_fivr.

endif
```

## drivers/acpi/hmat/Kconfig
```kconfig
# SPDX-License-Identifier: GPL-2.0
config ACPI_HMAT
	bool "ACPI Heterogeneous Memory Attribute Table Support"
	depends on ACPI_NUMA
	select HMEM_REPORTING
	help
	 If set, this option has the kernel parse and report the
	 platform's ACPI HMAT (Heterogeneous Memory Attributes Table),
	 register memory initiators with their targets, and export
	 performance attributes through the node's sysfs device if
	 provided.
```

## drivers/acpi/nfit/Kconfig
```kconfig
# SPDX-License-Identifier: GPL-2.0
config ACPI_NFIT
	tristate "ACPI NVDIMM Firmware Interface Table (NFIT)"
	depends on PHYS_ADDR_T_64BIT
	depends on BLK_DEV
	depends on ARCH_HAS_PMEM_API
	select LIBNVDIMM
	help
	  Infrastructure to probe ACPI 6 compliant platforms for
	  NVDIMMs (NFIT) and register a libnvdimm device tree.  In
	  addition to storage devices this also enables libnvdimm to pass
	  ACPI._DSM messages for platform/dimm configuration.

	  To compile this driver as a module, choose M here:
	  the module will be called nfit.

config NFIT_SECURITY_DEBUG
	bool "Enable debug for NVDIMM security commands"
	depends on ACPI_NFIT
	help
	  Some NVDIMM devices and controllers support encryption and
	  other security features. The payloads for the commands that
	  enable those features may contain sensitive clear-text
	  security material. Disable debug of those command payloads
	  by default. If you are a kernel developer actively working
	  on NVDIMM security enabling say Y, otherwise say N.
```

## drivers/acpi/numa/Kconfig
```kconfig
# SPDX-License-Identifier: GPL-2.0
config ACPI_NUMA
	bool "NUMA support"
	depends on NUMA
	depends on (X86 || IA64 || ARM64 || LOONGARCH)
	default y if IA64 || ARM64

config ACPI_HMAT
	bool "ACPI Heterogeneous Memory Attribute Table Support"
	depends on ACPI_NUMA
	select HMEM_REPORTING
	select MEMREGION
	help
	 If set, this option has the kernel parse and report the
	 platform's ACPI HMAT (Heterogeneous Memory Attributes Table),
	 register memory initiators with their targets, and export
	 performance attributes through the node's sysfs device if
	 provided.
```

## drivers/acpi/pmic/Kconfig
```kconfig
# SPDX-License-Identifier: GPL-2.0

menuconfig PMIC_OPREGION
	bool "PMIC (Power Management Integrated Circuit) operation region support"
	help
	  Select this option to enable support for ACPI operation
	  region of the PMIC chip. The operation region can be used
	  to control power rails and sensor reading/writing on the
	  PMIC chip.

if PMIC_OPREGION

config BYTCRC_PMIC_OPREGION
	bool "ACPI operation region support for Bay Trail Crystal Cove PMIC"
	depends on INTEL_SOC_PMIC
	help
	  This config adds ACPI operation region support for the Bay Trail
	  version of the Crystal Cove PMIC.

config CHTCRC_PMIC_OPREGION
	bool "ACPI operation region support for Cherry Trail Crystal Cove PMIC"
	depends on INTEL_SOC_PMIC
	help
	  This config adds ACPI operation region support for the Cherry Trail
	  version of the Crystal Cove PMIC.

config XPOWER_PMIC_OPREGION
	bool "ACPI operation region support for XPower AXP288 PMIC"
	depends on MFD_AXP20X_I2C && IOSF_MBI=y
	help
	  This config adds ACPI operation region support for XPower AXP288 PMIC.

config BXT_WC_PMIC_OPREGION
	bool "ACPI operation region support for BXT WhiskeyCove PMIC"
	depends on INTEL_SOC_PMIC_BXTWC
	help
	  This config adds ACPI operation region support for BXT WhiskeyCove PMIC.

config CHT_WC_PMIC_OPREGION
	bool "ACPI operation region support for CHT Whiskey Cove PMIC"
	depends on INTEL_SOC_PMIC_CHTWC
	help
	  This config adds ACPI operation region support for CHT Whiskey Cove PMIC.

config CHT_DC_TI_PMIC_OPREGION
	bool "ACPI operation region support for Dollar Cove TI PMIC"
	depends on INTEL_SOC_PMIC_CHTDC_TI
	help
	  This config adds ACPI operation region support for Dollar Cove TI PMIC.

endif	# PMIC_OPREGION

config TPS68470_PMIC_OPREGION
	bool "ACPI operation region support for TPS68470 PMIC"
	depends on INTEL_SKL_INT3472
	help
	  This config adds ACPI operation region support for TI TPS68470 PMIC.
	  TPS68470 device is an advanced power management unit that powers
	  a Compact Camera Module (CCM), generates clocks for image sensors,
	  drives a dual LED for flash and incorporates two LED drivers for
	  general purpose indicators.
	  This driver enables ACPI operation region support control voltage
	  regulators and clocks.

	  This option is a bool as it provides an ACPI operation
	  region, which must be available before any of the devices
	  using this, are probed.
```

## drivers/acpi/riscv/Kconfig
```kconfig
# SPDX-License-Identifier: GPL-2.0-only
#
# ACPI Configuration for RISC-V
#

config ACPI_RIMT
	bool
```

## drivers/adc/Kconfig
```kconfig
#
# ADC subsystem configuration
#

menuconfig ADC
	bool "ADC support"
        depends on PLAT_RK
	default y
if ADC

source drivers/adc/plat/Kconfig

endif # ADC
```

## drivers/adc/plat/Kconfig
```kconfig
#
# Adc hardware configuration
#

choice
	prompt "ADC hardware drivers"
	default ADC_RK29 if ARCH_RK29
	default ADC_RK30 if ARCH_RK30

config ADC_NULL
	bool "NULL"

config ADC_RK28
	bool "RK28 adc interface"
        depends on ARCH_RK2818 || ARCH_RK2808 || ARCH_RK2816
	help
		This supports the use of the ADC interface on rk28 processors.

config ADC_RK29
	bool "RK29 adc interface"
        depends on ARCH_RK29
	help
		This supports the use of the ADC interface on rk29 processors.

config ADC_RK30
	bool "RK30 adc interface"
        depends on ARCH_RK30 || ARCH_RK2928
	help
		This supports the use of the ADC interface on rk30 processors.
endchoice
```

## drivers/amba/Kconfig
```kconfig
# SPDX-License-Identifier: GPL-2.0
config ARM_AMBA
	bool

if ARM_AMBA

config TEGRA_AHB
	bool "Enable AHB driver for NVIDIA Tegra SoCs" if COMPILE_TEST
	default y if ARCH_TEGRA
	help
	  Adds AHB configuration functionality for NVIDIA Tegra SoCs,
	  which controls AHB bus master arbitration and some performance
	  parameters (priority, prefetch size).

endif
```

## drivers/amlogic/Kconfig
```kconfig
#
# Amlogic driver configuration
#
menu "Amlogic Device Drivers"
	depends on PLAT_MESON

#
#	Char devices
#
comment "Char devices"

source "drivers/amlogic/early_init/Kconfig"
source "drivers/amlogic/regd/Kconfig"
source "drivers/amlogic/uart/Kconfig"
source "drivers/amlogic/of/Kconfig"
source "drivers/amlogic/rtc/Kconfig"
source "drivers/amlogic/i2c/Kconfig"
source "drivers/amlogic/input/Kconfig"
source "drivers/amlogic/gpio/Kconfig"
source "drivers/amlogic/pinctrl/Kconfig"
source "drivers/amlogic/power/Kconfig"
source "drivers/amlogic/securitykeys/Kconfig"
source "drivers/amlogic/keymanage/Kconfig"
source "drivers/amlogic/efuse/Kconfig"
source "drivers/amlogic/smartcard/Kconfig"
source "drivers/amlogic/thermal/Kconfig"
source "drivers/amlogic/watchdog/Kconfig"
source "drivers/amlogic/spi/Kconfig"
source "drivers/amlogic/pwm/Kconfig"

#
#	Block devices
#
#comment "Block devices"
source "drivers/amlogic/usb/Kconfig"
#source "drivers/amlogic/cardreader/Kconfig"
source "drivers/amlogic/mmc/Kconfig"
source "drivers/amlogic/spi_nor/Kconfig"

#
#	Network devices
#
comment "Network devices"
source "drivers/amlogic/ethernet/Kconfig"
source "drivers/amlogic/wifi/Kconfig"

source "drivers/amlogic/bluetooth/Kconfig"
source "drivers/amlogic/nfc/Kconfig"

#
#  Audio
#
comment "Audio devices"
source "drivers/amlogic/amaudio/Kconfig"
source "drivers/amlogic/amaudio2/Kconfig"
source "drivers/amlogic/audiodsp/Kconfig"

#
#  Video
#
comment "Video devices"
source "drivers/amlogic/vfm/Kconfig"
source "drivers/amlogic/amports/Kconfig"
source "drivers/amlogic/canvas/Kconfig"
source "drivers/amlogic/display/Kconfig"
source "drivers/amlogic/hdmi/Kconfig"
source "drivers/amlogic/tvin/Kconfig"
source "drivers/amlogic/ext_hdmiin/Kconfig"
source "drivers/amlogic/ppmgr/Kconfig"
source "drivers/amlogic/camera/Kconfig"
source "drivers/amlogic/video_dev/Kconfig"
source "drivers/amlogic/ionvideo/Kconfig"
source "drivers/amlogic/deinterlace/Kconfig"
source "drivers/amlogic/mipi/Kconfig"
source "drivers/amlogic/d2d3/Kconfig"
source "drivers/amlogic/amvecm/Kconfig"
source "drivers/amlogic/dvb_tv/Kconfig"
source "drivers/amlogic/ion_dev/Kconfig"

#
# crypto
#
source "drivers/amlogic/crypto/Kconfig"

source "drivers/amlogic/mhl/Kconfig"
source "drivers/amlogic/pmu/Kconfig"
source "drivers/amlogic/touch/Kconfig"
endmenu
```

## drivers/amlogic/amaudio/Kconfig
```kconfig
# AML AUDIO control drivers

menu "Audio Interface"

config	AMAUDIO
	bool "Amlogic Audio Interface"
    default y
    select SOUND
    select SND_SOC
    select SND
    select AML_AUDIO_DSP
    select SND_AML_SOC
    select SWITCH
	help
		"Amlogic Audio Interface"
	
endmenu	
```

## drivers/amlogic/amaudio2/Kconfig
```kconfig
# AML AUDIO V2 control drivers

menu "Amlogic Audio Interface V2"

config	AMAUDIO2
	bool "Amlogic Audio Interface V2"
    default n
    select SOUND
    select SND_SOC
    select SND
    select AML_AUDIO_DSP
    select SND_AML_SOC
    select SWITCH
	help
		"Amlogic Audio Interface V2, The interface different from amaudio"
	
endmenu	
```
