## drivers/accel/qaic/Kconfig
```kconfig
# SPDX-License-Identifier: GPL-2.0-only
#
# Qualcomm Cloud AI accelerators driver
#

config DRM_ACCEL_QAIC
	tristate "Qualcomm Cloud AI accelerators"
	depends on DRM_ACCEL
	depends on PCI && HAS_IOMEM
	depends on MHI_BUS
	select CRC32
	help
	  Enables driver for Qualcomm's Cloud AI accelerator PCIe cards that are
	  designed to accelerate Deep Learning inference workloads.

	  The driver manages the PCIe devices and provides an IOCTL interface
	  for users to submit workloads to the devices.

	  If unsure, say N.

	  To compile this driver as a module, choose M here: the
	  module will be called qaic.
```

## drivers/accel/rocket/Kconfig
```kconfig
# SPDX-License-Identifier: GPL-2.0-only

config DRM_ACCEL_ROCKET
	tristate "Rocket (support for Rockchip NPUs)"
	depends on DRM_ACCEL
	depends on (ARCH_ROCKCHIP && ARM64) || COMPILE_TEST
	depends on ROCKCHIP_IOMMU || COMPILE_TEST
	depends on MMU
	select DRM_SCHED
	select DRM_GEM_SHMEM_HELPER
	help
	  Choose this option if you have a Rockchip SoC that contains a
	  compatible Neural Processing Unit (NPU), such as the RK3588. Called by
	  Rockchip either RKNN or RKNPU, it accelerates inference of neural
	  networks.

	  The interface exposed to userspace is described in
	  include/uapi/drm/rocket_accel.h and is used by the Rocket userspace
	  driver in Mesa3D.

	  If unsure, say N.

	  To compile this driver as a module, choose M here: the
	  module will be called rocket.
```

## drivers/accessibility/Kconfig
```kconfig
# SPDX-License-Identifier: GPL-2.0
menuconfig ACCESSIBILITY
	bool "Accessibility support"
	---help---
	  Accessibility handles all special kinds of hardware devices or
	  software adapters which help people with disabilities (e.g.
	  blindness) to use computers.

	  That includes braille devices, speech synthesis, keyboard
	  remapping, etc.

	  Say Y here to get to see options for accessibility.
	  This option alone does not add any kernel code.

	  If you say N, all options in this submenu will be skipped and disabled.

	  If unsure, say N.

if ACCESSIBILITY
config A11Y_BRAILLE_CONSOLE
	bool "Console on braille device"
	depends on VT
	depends on SERIAL_CORE_CONSOLE
	---help---
	  Enables console output on a braille device connected to a 8250
	  serial port. For now only the VisioBraille device is supported.

	  To actually enable it, you need to pass option
	  console=brl,ttyS0
	  to the kernel. Options are the same as for serial console.

	  If unsure, say N.

endif # ACCESSIBILITY
```

## drivers/accessory/Kconfig
```kconfig
#
# Accessory Configuration
#

menuconfig ACCESSORY
	bool "Accessory devices"
	default y
	---help---
	Say Y here to get to see options for Samsung Accessories
	If you say N, all options in this submenu will be skipped and disabled.

if ACCESSORY

config 30PIN_CONN
        tristate "Accessory detection driver"
        depends on I2C
        help
         Provides support for detecting Accessory,such as TA, Keyboard

config MHL_SII9234
    	tristate "SiI9234 MHL(Mobile HD Link) Transmitter support"
	depends on I2C
	---help---
	Mobile HD Link Transmitter driver for SiI9234

config SEC_KEYBOARD_DOCK
    	tristate "sec keyboard dock support"

config HPD_PULL
	tristate "HPD pull up by PMIC LDO"

config SAMSUNG_MHL_9290
	tristate "support 9290 dongle and 9292 dongle"

endif # ACCESSORY
```

## drivers/acorn/block/Kconfig
```kconfig
#
# Block device driver configuration
#

menu "Acorn-specific block devices"
	depends on ARCH_ACORN

config BLK_DEV_FD1772
	tristate "Old Archimedes floppy (1772) support"
	depends on ARCH_ARC || ARCH_A5K
	help
	  Support the floppy drive on the Acorn Archimedes (A300, A4x0, A540,
	  R140 and R260) series of computers; it supports only 720K floppies
	  at the moment. If you don't have one of these machines just answer
	  N.

config BLK_DEV_MFM
	tristate "MFM harddisk support"
	depends on ARCH_ARC || ARCH_A5K
	help
	  Support the MFM hard drives on the Acorn Archimedes both
	  on-board the A4x0 motherboards and via the Acorn MFM podules.
	  Drives up to 64MB are supported. If you haven't got one of these
	  machines or drives just say N.

config BLK_DEV_MFM_AUTODETECT
	bool "Autodetect hard drive geometry"
	depends on BLK_DEV_MFM
	help
	  If you answer Y, the MFM code will attempt to automatically detect
	  the cylinders/heads/sectors count on your hard drive. WARNING: This
	  sometimes doesn't work and it also does some dodgy stuff which
	  potentially might damage your drive.

endmenu
```
