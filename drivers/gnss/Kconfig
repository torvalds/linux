## drivers/gpu/arm/bifrost/arbitration/Kconfig
```kconfig
# SPDX-License-Identifier: GPL-2.0 WITH Linux-syscall-note OR MIT
#
# (C) COPYRIGHT 2012-2021 ARM Limited. All rights reserved.
#
# This program is free software and is provided to you under the terms of the
# GNU General Public License version 2 as published by the Free Software
# Foundation, and any use by you of this program is subject to the terms
# of such GNU license.
#
# This program is distributed in the hope that it will be useful,
# but WITHOUT ANY WARRANTY; without even the implied warranty of
# MERCHANTABILITY or FITNESS FOR A PARTICULAR PURPOSE. See the
# GNU General Public License for more details.
#
# You should have received a copy of the GNU General Public License
# along with this program; if not, you can access it online at
# http://www.gnu.org/licenses/gpl-2.0.html.
#
#

config MALI_XEN
	tristate "Enable Xen Interface reference code"
	depends on MALI_ARBITRATION && XEN
	default n
	help
	  Enables the build of xen interface modules used in the reference
	  virtualization setup for Mali
	  If unsure, say N.

config MALI_ARBITER_MODULES
	tristate "Enable mali arbiter modules"
	depends on MALI_ARBITRATION
	default y
	help
	  Enables the build of the arbiter modules used in the reference
	  virtualization setup for Mali
	  If unsure, say N

config MALI_GPU_POWER_MODULES
	tristate "Enable gpu power modules"
	depends on MALI_ARBITRATION
	default y
	help
	  Enables the build of the gpu power modules used in the reference
	  virtualization setup for Mali
	  If unsure, say N


source "drivers/gpu/arm/bifrost/arbitration/ptm/Kconfig"
```

## drivers/gpu/arm/bifrost/tests/Kconfig
```kconfig
# SPDX-License-Identifier: GPL-2.0 WITH Linux-syscall-note
#
# (C) COPYRIGHT 2017, 2020-2021 ARM Limited. All rights reserved.
#
# This program is free software and is provided to you under the terms of the
# GNU General Public License version 2 as published by the Free Software
# Foundation, and any use by you of this program is subject to the terms
# of such GNU license.
#
# This program is distributed in the hope that it will be useful,
# but WITHOUT ANY WARRANTY; without even the implied warranty of
# MERCHANTABILITY or FITNESS FOR A PARTICULAR PURPOSE. See the
# GNU General Public License for more details.
#
# You should have received a copy of the GNU General Public License
# along with this program; if not, you can access it online at
# http://www.gnu.org/licenses/gpl-2.0.html.
#
#

menuconfig MALI_KUTF
	bool "Build Mali Kernel Unit Test Framework modules"
	depends on MALI_BIFROST && MALI_BIFROST_DEBUG
	default y if MALI_BIFROST_DEBUG
	help
	  This option will build the Mali testing framework modules.

	  Modules:
	   - kutf.ko
	   - kutf_test.ko

config MALI_KUTF_IRQ_TEST
	bool "Build Mali KUTF IRQ test module"
	depends on MALI_KUTF
	default y
	help
	  This option will build the IRQ latency measurement test module.
	  It can determine the latency of the Mali GPU IRQ on your system.

	  Modules:
	    - mali_kutf_irq_test.ko

config MALI_KUTF_CLK_RATE_TRACE
	bool "Build Mali KUTF Clock rate trace test module"
	depends on MALI_KUTF
	default y
	help
	  This option will build the clock rate trace portal test module.
	  It can test the clocks integration into the platform and exercise some
	  basic trace test in the system.

	  Modules:
	    - mali_kutf_clk_rate_trace_test_portal.ko


comment "Enable MALI_BIFROST_DEBUG for KUTF modules support"
	depends on MALI_BIFROST && !MALI_BIFROST_DEBUG && MALI_KUTF
```

## drivers/gpu/arm/bifrost/tests/mali_kutf_clk_rate_trace/kernel/Kconfig
```kconfig
# SPDX-License-Identifier: GPL-2.0
#
# (C) COPYRIGHT 2020 ARM Limited. All rights reserved.
#
# This program is free software and is provided to you under the terms of the
# GNU General Public License version 2 as published by the Free Software
# Foundation, and any use by you of this program is subject to the terms
# of such GNU license.
#
# This program is distributed in the hope that it will be useful,
# but WITHOUT ANY WARRANTY; without even the implied warranty of
# MERCHANTABILITY or FITNESS FOR A PARTICULAR PURPOSE. See the
# GNU General Public License for more details.
#
# You should have received a copy of the GNU General Public License
# along with this program; if not, you can access it online at
# http://www.gnu.org/licenses/gpl-2.0.html.
#
#

config CONFIG_MALI_CLK_RATE_TRACE_PORTAL
 tristate "Mali GPU Clock Trace Test portal"
 depends on MALI_BIFROST && MALI_BIFROST_DEBUG && MALI_KUTF
 default m
 help
   This option will build a test module mali_kutf_clk_rate_trace_test_portal
   that can test the clocks integration into the platform and exercise some
   basic trace test in the system. Choosing M here will generate a single
   module called mali_kutf_clk_rate_trace_test_portal.
```

## drivers/gpu/arm/bifrost/tests/mali_kutf_irq_test/Kconfig
```kconfig
#
# (C) COPYRIGHT 2017 ARM Limited. All rights reserved.
#
# This program is free software and is provided to you under the terms of the
# GNU General Public License version 2 as published by the Free Software
# Foundation, and any use by you of this program is subject to the terms
# of such GNU licence.
#
# This program is distributed in the hope that it will be useful,
# but WITHOUT ANY WARRANTY; without even the implied warranty of
# MERCHANTABILITY or FITNESS FOR A PARTICULAR PURPOSE. See the
# GNU General Public License for more details.
#
# You should have received a copy of the GNU General Public License
# along with this program; if not, you can access it online at
# http://www.gnu.org/licenses/gpl-2.0.html.
#
# SPDX-License-Identifier: GPL-2.0
#
#

config MALI_IRQ_LATENCY
 tristate "Mali GPU IRQ latency measurement"
 depends on MALI_BIFROST && MALI_BIFROST_DEBUG && MALI_KUTF
 default m
 help
   This option will build a test module mali_kutf_irq_test that
   can determine the latency of the Mali GPU IRQ on your system.
   Choosing M here will generate a single module called mali_kutf_irq_test.
```

## drivers/gpu/arm/bifrost_for_linux/tests/mali_kutf_irq_test/Kconfig
```kconfig
#
# (C) COPYRIGHT 2017 ARM Limited. All rights reserved.
#
# This program is free software and is provided to you under the terms of the
# GNU General Public License version 2 as published by the Free Software
# Foundation, and any use by you of this program is subject to the terms
# of such GNU licence.
#
# A copy of the licence is included with the program, and can also be obtained
# from Free Software Foundation, Inc., 51 Franklin Street, Fifth Floor,
# Boston, MA  02110-1301, USA.
#
#


config MALI_IRQ_LATENCY
 tristate "Mali GPU IRQ latency measurement"
 depends on MALI_BIFROST && MALI_BIFROST_DEBUG && MALI_KUTF
 default m
 help
   This option will build a test module mali_kutf_irq_test that
   can determine the latency of the Mali GPU IRQ on your system.
   Choosing M here will generate a single module called mali_kutf_irq_test.
```

## drivers/gpu/arm/mali/Kconfig
```kconfig
menu "Mali GPU OpenGL device driver"
config MALI400
	tristate "Mali-300/400/450 support"
	depends on ARM
	default y
	select DMA_SHARED_BUFFER
	---help---
	  This enables support for the ARM Mali-300, Mali-400, and Mali-450
	  GPUs.

	  To compile this driver as a module, choose M here: the module will be
	  called mali.

config MALI400_DEBUG
	bool "Enable debug in Mali driver"
	depends on MALI400
	---help---
	  This enabled extra debug checks and messages in the Mali driver.

config MALI400_PROFILING_EXTRA_SUPPORT
	bool "Select other items in kernel to support PROFILING."
	depends on MALI400_PROFILING
	select PROFILING
	select FTRACE
	select PERF_EVENTS
	select ENABLE_DEFAULT_TRACERS
	select DEBUG_MUTEXES
	select HIGH_RES_TIMERS
	select HW_PERF_EVENTS
	select CPU_FREQ

config MALI400_PROFILING
	bool "Enable Mali profiling"
	depends on MALI400
	select MALI400_DEBUG
	select TRACEPOINTS
	default n
	---help---
	  This enables gator profiling of Mali GPU events.

config MALI400_INTERNAL_PROFILING
	bool "Enable internal Mali profiling API"
	depends on MALI400_PROFILING
	default n
	---help---
	  This enables the internal legacy Mali profiling API.

config MALI400_UMP
	bool "Enable UMP support"
	depends on MALI400
    default y
	---help---
	  This enables support for the UMP memory sharing API in the Mali driver.

config MALI400_POWER_PERFORMANCE_POLICY
	bool "Enable Mali power performance policy"
	depends on ARM
	default n
	---help---
	  This enables support for dynamic performance scaling of Mali with the goal of lowering power consumption.

config MALI_DMA_BUF_MAP_ON_ATTACH
	bool "Map dma-buf attachments on attach"
	depends on MALI400 && DMA_SHARED_BUFFER
	default y
	---help---
	  This makes the Mali driver map dma-buf attachments after doing
	  attach. If this is not set the dma-buf attachments will be mapped for
	  every time the GPU need to access the buffer.

	  Mapping for each access can cause lower performance.

config MALI_SHARED_INTERRUPTS
	bool "Support for shared interrupts"
	depends on MALI400
	default n
	---help---
	  Adds functionality required to properly support shared interrupts.  Without this support,
	  the device driver will fail during insmod if it detects shared interrupts.  This also
	  works when the GPU is not using shared interrupts, but might have a slight performance
	  impact.

if ARCH_MESON6
config	MESON6_GPU_EXTRA
	bool "M6 fix"
	depends on MALI400
	default y
	select MALI_SHARED_INTERRUPTS
endif

config MALI_PMU_PARALLEL_POWER_UP
	bool "Power up Mali PMU domains in parallel"
	depends on MALI400
	default n
	---help---
	  This makes the Mali driver power up all PMU power domains in parallel, instead of
	  powering up domains one by one, with a slight delay in between. Powering on all power
	  domains at the same time may cause peak currents higher than what some systems can handle.
	  These systems must not enable this option.
	  
endmenu
```

## drivers/gpu/arm/mali400/Kconfig
```kconfig
source "drivers/gpu/arm/mali400/mali/Kconfig"

config VIDEO_SAMSUNG
	bool "Samsung Multimedia Devices"
	depends on VIDEO_CAPTURE_DRIVERS && VIDEO_V4L2
	select VIDEO_FIXED_MINOR_RANGES
	default n
	help
	  This is a representative video4linux configuration for Samsung multimedia devices.

config VIDEO_SAMSUNG_V4L2
	bool "V4L2 API for digital camera to be contributed by samsung"
	depends on VIDEO_DEV && VIDEO_SAMSUNG
	default n
	help
	  This feature is for new V4L2 APIs all about digital camera
```

## drivers/gpu/arm/mali400/mali/Kconfig
```kconfig
config MALI400
	tristate "Mali-300/400/450 support"
	depends on ARM || ARM64
	select DMA_SHARED_BUFFER
	---help---
	  This enables support for the ARM Mali-300, Mali-400, and Mali-450
	  GPUs.

	  To compile this driver as a module, choose M here: the module will be
	  called mali.

config MALI450
	bool "Enable Mali-450 support"
	depends on MALI400
	---help---
	  This enables support for Mali-450 specific features.

config MALI470
	bool "Enable Mali-470 support"
	depends on MALI400
	---help---
	  This enables support for Mali-470 specific features.

config MALI400_DEBUG
	bool "Enable debug in Mali driver"
	depends on MALI400
	---help---
	  This enabled extra debug checks and messages in the Mali driver.

config MALI400_PROFILING
	bool "Enable Mali profiling"
	depends on MALI400
	select TRACEPOINTS
	default y
	---help---
	  This enables gator profiling of Mali GPU events.

config MALI400_INTERNAL_PROFILING
	bool "Enable internal Mali profiling API"
	depends on MALI400_PROFILING
	default n
	---help---
	  This enables the internal legacy Mali profiling API.

config MALI400_UMP
	bool "Enable UMP support"
	depends on MALI400
	---help---
	  This enables support for the UMP memory sharing API in the Mali driver.

config MALI_DVFS
	bool "Enable Mali dynamically frequency change"
	depends on MALI400
	default y
	---help---
	  This enables support for dynamic change frequency of Mali with the goal of lowering power consumption.

config MALI_DMA_BUF_MAP_ON_ATTACH
	bool "Map dma-buf attachments on attach"
	depends on MALI400 && DMA_SHARED_BUFFER
	default y
	---help---
	  This makes the Mali driver map dma-buf attachments after doing
	  attach. If this is not set the dma-buf attachments will be mapped for
	  every time the GPU need to access the buffer.

	  Mapping for each access can cause lower performance.

config MALI_SHARED_INTERRUPTS
	bool "Support for shared interrupts"
	depends on MALI400
	default n
	---help---
	  Adds functionality required to properly support shared interrupts.  Without this support,
	  the device driver will fail during insmod if it detects shared interrupts.  This also
	  works when the GPU is not using shared interrupts, but might have a slight performance
	  impact.

config MALI_PMU_PARALLEL_POWER_UP
	bool "Power up Mali PMU domains in parallel"
	depends on MALI400
	default n
	---help---
	  This makes the Mali driver power up all PMU power domains in parallel, instead of
	  powering up domains one by one, with a slight delay in between. Powering on all power
	  domains at the same time may cause peak currents higher than what some systems can handle.
	  These systems must not enable this option.

config MALI_DT
	bool "Using device tree to initialize module"
	depends on MALI400 && OF
	default n
	---help---
	  This enable the Mali driver to choose the device tree path to get platform resoures
	  and disable the old config method. Mali driver could run on the platform which the
	  device tree is enabled in kernel and corresponding hardware description is implemented
	  properly in device DTS file.

config MALI_QUIET
	bool "Make Mali driver very quiet"
	depends on MALI400 && !MALI400_DEBUG
	default n
	---help---
	  This forces the Mali driver to never print any messages.

	  If unsure, say N.
```

## drivers/gpu/arm/mali400/ump/Kconfig
```kconfig
config UMP_DEBUG
	bool "Enable extra debug in UMP"
	depends on MALI400_UMP
	default n
	---help---
	  This enabled extra debug checks and messages in UMP.
```
