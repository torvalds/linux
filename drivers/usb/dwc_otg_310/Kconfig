## drivers/usb/image/Kconfig
```kconfig
# SPDX-License-Identifier: GPL-2.0
#
# USB Imaging devices configuration
#
comment "USB Imaging devices"

config USB_MDC800
	tristate "USB Mustek MDC800 Digital Camera support"
	help
	  Say Y here if you want to connect this type of still camera to
	  your computer's USB port. This driver can be used with gphoto 0.4.3
	  and higher (look at <http://www.gphoto.org/>).
	  To use it create a device node with "mknod /dev/mustek c 180 32" and
	  configure it in your software.

	  To compile this driver as a module, choose M here: the
	  module will be called mdc800.

config USB_MICROTEK
	tristate "Microtek X6USB scanner support"
	depends on SCSI
	help
	  Say Y here if you want support for the Microtek X6USB and
	  possibly the Phantom 336CX, Phantom C6 and ScanMaker V6U(S)L.
	  Support for anything but the X6 is experimental.
	  Please report failures and successes.
	  The scanner will appear as a scsi generic device to the rest
	  of the system. Scsi support is required.
	  This driver can be compiled as a module, called microtek.
```

## drivers/usb/input/Kconfig
```kconfig
#
# USB Input driver configuration
#
comment "USB Input Devices"
	depends on USB

config USB_POWERMATE
	tristate "Griffin PowerMate and Contour Jog support"
	depends on USB && INPUT
	---help---
	  Say Y here if you want to use Griffin PowerMate or Contour Jog devices.
	  These are aluminum dials which can measure clockwise and anticlockwise
	  rotation.  The dial also acts as a pushbutton.  The base contains an LED
	  which can be instructed to pulse or to switch to a particular intensity.

	  You can download userspace tools from
	  <http://sowerbutts.com/powermate/>.

	  To compile this driver as a module, choose M here: the
	  module will be called powermate.

config USB_YEALINK
	tristate "Yealink usb-p1k voip phone"
	depends on USB && INPUT && EXPERIMENTAL
	---help---
	  Say Y here if you want to enable keyboard and LCD functions of the
	  Yealink usb-p1k usb phones. The audio part is enabled by the generic
	  usb sound driver, so you might want to enable that as well.

	  For information about how to use these additional functions, see
	  <file:Documentation/input/yealink.txt>.

	  To compile this driver as a module, choose M here: the module will be
	  called yealink.

config USB_ATI_REMOTE
	tristate "ATI / X10 USB RF remote control"
	depends on USB && INPUT
	---help---
	  Say Y here if you want to use an ATI or X10 "Lola" USB remote control.
	  These are RF remotes with USB receivers. 
	  The ATI remote comes with many of ATI's All-In-Wonder video cards.
	  The X10 "Lola" remote is available at:
	     <http://www.x10.com/products/lola_sg1.htm>
	  This driver provides mouse pointer, left and right mouse buttons, 
	  and maps all the other remote buttons to keypress events.
	  
	  To compile this driver as a module, choose M here: the module will be
	  called ati_remote.

config USB_ATI_REMOTE2
	tristate "ATI / Philips USB RF remote control"
	depends on USB && INPUT
	---help---
	  Say Y here if you want to use an ATI or Philips USB RF remote control.
	  These are RF remotes with USB receivers.
	  ATI Remote Wonder II comes with some ATI's All-In-Wonder video cards
	  and is also available as a separate product.
	  This driver provides mouse pointer, left and right mouse buttons,
	  and maps all the other remote buttons to keypress events.

	  To compile this driver as a module, choose M here: the module will be
	  called ati_remote2.

config USB_KEYSPAN_REMOTE
	tristate "Keyspan DMR USB remote control (EXPERIMENTAL)"
	depends on USB && INPUT && EXPERIMENTAL
	---help---
	  Say Y here if you want to use a Keyspan DMR USB remote control.
	  Currently only the UIA-11 type of receiver has been tested.  The tag
	  on the receiver that connects to the USB port should have a P/N that
	  will tell you what type of DMR you have.  The UIA-10 type is not
	  supported at this time.  This driver maps all buttons to keypress
	  events.

	  To compile this driver as a module, choose M here: the module will
	  be called keyspan_remote.

config USB_APPLETOUCH
	tristate "Apple USB Touchpad support"
	depends on USB && INPUT
	---help---
	  Say Y here if you want to use an Apple USB Touchpad.

	  These are the touchpads that can be found on post-February 2005
	  Apple Powerbooks (prior models have a Synaptics touchpad connected
	  to the ADB bus).

	  This driver provides a basic mouse driver but can be interfaced
	  with the synaptics X11 driver to provide acceleration and
	  scrolling in X11.

	  For further information, see
	  <file:Documentation/input/appletouch.txt>.

	  To compile this driver as a module, choose M here: the
	  module will be called appletouch.
```

## drivers/usb/isp1760/Kconfig
```kconfig
# SPDX-License-Identifier: GPL-2.0

config USB_ISP1760
	tristate "NXP ISP 1760/1761 support"
	depends on USB || USB_GADGET
	help
	  Say Y or M here if your system as an ISP1760 USB host controller
	  or an ISP1761 USB dual-role controller.

	  This driver does not support isochronous transfers or OTG.
	  This USB controller is usually attached to a non-DMA-Master
	  capable bus. NXP's eval kit brings this chip on PCI card
	  where the chip itself is behind a PLB to simulate such
	  a bus.

	  To compile this driver as a module, choose M here: the
	  module will be called isp1760.

config USB_ISP1760_HCD
	bool

config USB_ISP1761_UDC
	bool

if USB_ISP1760

choice
	bool "ISP1760 Mode Selection"
	default USB_ISP1760_DUAL_ROLE if (USB && USB_GADGET)
	default USB_ISP1760_HOST_ROLE if (USB && !USB_GADGET)
	default USB_ISP1760_GADGET_ROLE if (!USB && USB_GADGET)

config USB_ISP1760_HOST_ROLE
	bool "Host only mode"
	depends on USB=y || USB=USB_ISP1760
	select USB_ISP1760_HCD
	help
	  Select this if you want to use the ISP1760 in host mode only. The
	  gadget function will be disabled.

config USB_ISP1760_GADGET_ROLE
	bool "Gadget only mode"
	depends on USB_GADGET=y || USB_GADGET=USB_ISP1760
	select USB_ISP1761_UDC
	help
	  Select this if you want to use the ISP1760 in peripheral mode only.
	  The host function will be disabled.

config USB_ISP1760_DUAL_ROLE
	bool "Dual Role mode"
	depends on USB=y || USB=USB_ISP1760
	depends on USB_GADGET=y || USB_GADGET=USB_ISP1760
	select USB_ISP1760_HCD
	select USB_ISP1761_UDC
	help
	  Select this if you want to use the ISP1760 in both host and
	  peripheral modes.

endchoice

endif
```

## drivers/usb/media/Kconfig
```kconfig
#
# USB Multimedia device configuration
#
comment "USB Multimedia devices"
	depends on USB

config USB_DABUSB
	tristate "DABUSB driver"
	depends on USB
	---help---
	  A Digital Audio Broadcasting (DAB) Receiver for USB and Linux
	  brought to you by the DAB-Team
	  <http://wwwbode.cs.tum.edu/Par/arch/dab/>.  This driver can be taken
	  as an example for URB-based bulk, control, and isochronous
	  transactions. URB's are explained in
	  <file:Documentation/usb/URB.txt>.

	  To compile this driver as a module, choose M here: the
	  module will be called dabusb.

comment "Video4Linux support is needed for USB Multimedia device support"
	depends on USB && VIDEO_DEV=n

config USB_VICAM
	tristate "USB 3com HomeConnect (aka vicam) support (EXPERIMENTAL)"
	depends on USB && VIDEO_DEV && EXPERIMENTAL
	---help---
	  Say Y here if you have 3com homeconnect camera (vicam).

	  This driver uses the Video For Linux API. You must say Y or M to
	  "Video For Linux" (under Multimedia Devices) to use this driver.
	  Information on this API and pointers to "v4l" programs may be found
	  at <file:Documentation/video4linux/API.html>.

	  To compile this driver as a module, choose M here: the
	  module will be called vicam.

config USB_DSBR
	tristate "D-Link USB FM radio support (EXPERIMENTAL)"
	depends on USB && VIDEO_DEV && EXPERIMENTAL
	---help---
	  Say Y here if you want to connect this type of radio to your
	  computer's USB port. Note that the audio is not digital, and
	  you must connect the line out connector to a sound card or a
	  set of speakers.

	  This driver uses the Video For Linux API.  You must enable
	  (Y or M in config) Video For Linux (under Character Devices)
	  to use this driver.  Information on this API and pointers to
	  "v4l" programs may be found at
	  <file:Documentation/video4linux/API.html>.

	  To compile this driver as a module, choose M here: the
	  module will be called dsbr100.

config USB_IBMCAM
	tristate "USB IBM (Xirlink) C-it Camera support"
	depends on USB && VIDEO_DEV
	---help---
	  Say Y here if you want to connect a IBM "C-It" camera, also known as
	  "Xirlink PC Camera" to your computer's USB port.  For more
	  information, read <file:Documentation/usb/ibmcam.txt>.

	  This driver uses the Video For Linux API.  You must enable
	  (Y or M in config) Video For Linux (under Character Devices)
	  to use this driver.  Information on this API and pointers to
	  "v4l" programs may be found at
	  <file:Documentation/video4linux/API.html>.

	  To compile this driver as a module, choose M here: the
	  module will be called ibmcam.

	  This camera has several configuration options which
	  can be specified when you load the module. Read
	  <file:Documentation/usb/ibmcam.txt> to learn more.

config USB_KONICAWC
	tristate "USB Konica Webcam support"
	depends on USB && VIDEO_DEV
	---help---
	  Say Y here if you want support for webcams based on a Konica
	  chipset. This is known to work with the Intel YC76 webcam.

	  This driver uses the Video For Linux API.  You must enable
	  (Y or M in config) Video For Linux (under Character Devices)
	  to use this driver.  Information on this API and pointers to
	  "v4l" programs may be found at
	  <file:Documentation/video4linux/API.html>.

	  To compile this driver as a module, choose M here: the
	  module will be called konicawc.

config USB_OV511
	tristate "USB OV511 Camera support"
	depends on USB && VIDEO_DEV
	---help---
	  Say Y here if you want to connect this type of camera to your
	  computer's USB port. See <file:Documentation/usb/ov511.txt> for more
	  information and for a list of supported cameras.

	  This driver uses the Video For Linux API. You must say Y or M to
	  "Video For Linux" (under Character Devices) to use this driver.
	  Information on this API and pointers to "v4l" programs may be found
	  at <file:Documentation/video4linux/API.html>.

	  To compile this driver as a module, choose M here: the
	  module will be called ov511.

config USB_SE401
	tristate "USB SE401 Camera support"
	depends on USB && VIDEO_DEV
	---help---
	  Say Y here if you want to connect this type of camera to your
	  computer's USB port. See <file:Documentation/usb/se401.txt> for more
	  information and for a list of supported cameras.

	  This driver uses the Video For Linux API. You must say Y or M to
	  "Video For Linux" (under Multimedia Devices) to use this driver.
	  Information on this API and pointers to "v4l" programs may be found
	  at <file:Documentation/video4linux/API.html>.

	  To compile this driver as a module, choose M here: the
	  module will be called se401.

config USB_SN9C102
	tristate "USB SN9C10x PC Camera Controller support"
	depends on USB && VIDEO_DEV
	---help---
	  Say Y here if you want support for cameras based on SONiX SN9C101,
	  SN9C102 or SN9C103 PC Camera Controllers.

	  See <file:Documentation/usb/sn9c102.txt> for more informations.

	  This driver uses the Video For Linux API. You must say Y or M to
	  "Video For Linux" to use this driver.

	  To compile this driver as a module, choose M here: the
	  module will be called sn9c102.

config USB_STV680
	tristate "USB STV680 (Pencam) Camera support"
	depends on USB && VIDEO_DEV
	---help---
	  Say Y here if you want to connect this type of camera to your
	  computer's USB port. This includes the Pencam line of cameras.
	  See <file:Documentation/usb/stv680.txt> for more information and for
	  a list of supported cameras.

	  This driver uses the Video For Linux API. You must say Y or M to
	  "Video For Linux" (under Multimedia Devices) to use this driver.
	  Information on this API and pointers to "v4l" programs may be found
	  at <file:Documentation/video4linux/API.html>.

	  To compile this driver as a module, choose M here: the
	  module will be called stv680.

config USB_W9968CF
	tristate "USB W996[87]CF JPEG Dual Mode Camera support"
	depends on USB && VIDEO_DEV && I2C && VIDEO_OVCAMCHIP
	---help---
	  Say Y here if you want support for cameras based on OV681 or
	  Winbond W9967CF/W9968CF JPEG USB Dual Mode Camera Chips.
	
	  This driver has an optional plugin, which is distributed as a
	  separate module only (released under GPL). It allows to use higher 
	  resolutions and framerates, but cannot be included in the official 
	  Linux kernel for performance purposes.

	  See <file:Documentation/usb/w9968cf.txt> for more informations.

	  This driver uses the Video For Linux and the I2C APIs. It needs the
	  OmniVision Camera Chip support as well. You must say Y or M to
	  "Video For Linux", "I2C Support" and "OmniVision Camera Chip 
	  support" to use this driver.

	  To compile this driver as a module, choose M here: the
	  module will be called w9968cf.

config USB_PWC
	tristate "USB Philips Cameras"
	depends on USB && VIDEO_DEV
	---help---
	  Say Y or M here if you want to use one of these Philips & OEM
          webcams:
           * Philips PCA645, PCA646
           * Philips PCVC675, PCVC680, PCVC690
           * Philips PCVC720/40, PCVC730, PCVC740, PCVC750
	   * Askey VC010
	   * Logitech QuickCam Pro 3000, 4000, 'Zoom', 'Notebook Pro' 
             and 'Orbit'/'Sphere'
           * Samsung MPC-C10, MPC-C30
	   * Creative Webcam 5, Pro Ex
	   * SOTEC Afina Eye
	   * Visionite VCS-UC300, VCS-UM100
	   
	  The PCA635, PCVC665 and PCVC720/20 are not supported by this driver
	  and never will be, but the 665 and 720/20 are supported by other 
	  drivers.

	  See <file:Documentation/usb/philips.txt> for more information and
	  installation instructions.

	  The built-in microphone is enabled by selecting USB Audio support.

	  This driver uses the Video For Linux API. You must say Y or M to
	  "Video For Linux" (under Character Devices) to use this driver.
	  Information on this API and pointers to "v4l" programs may be found
	  at <file:Documentation/video4linux/API.html>.

	  To compile this driver as a module, choose M here: the
	  module will be called pwc.
```
