## drivers/usb/dwc_otg_310/Kconfig
```kconfig
# SPDX-License-Identifier: GPL-2.0
menu "ROCKCHIP USB Support"
	depends on ARCH_ROCKCHIP

config USB20_HOST
	tristate "Rockchip USB 2.0 host controller"
	depends on USB
	---help---
	  This driver supports Rockchip USB2.0 host
	  controller.

config USB20_OTG
	tristate "RockChip USB 2.0 OTG controller"
	depends on USB || USB_GADGET
	---help---
	  This driver supports Rockchip USB2.0  DWC_OTG
	  controller.

config DWC_OTG_310
	tristate
	default y if USB20_HOST || USB20_OTG
endmenu
```

## drivers/usb/dwc_otg_bak/Kconfig
```kconfig
config USB11_HOST 
	tristate "RockChip USB 1.1 host controller"
	depends on USB
	---help---
	  This driver supports Rockchip USB 1.1 HOST
	  controller.

config USB11_HOST_EN
	bool "---usb1.1 host controller enable"
	depends on USB11_HOST
	default y

config USB20_HOST
	tristate "Rockchip USB 2.0 host controller"
	depends on USB
	---help---
	  This driver supports Rockchip USB2.0 host
	  controller.

config USB20_HOST_EN
	bool "---usb2.0 host controller enable"
	depends on USB20_HOST
	default y

config USB20_OTG
	tristate "RockChip USB 2.0 OTG controller"
	depends on USB||USB_GADGET
        ---help---
          This driver supports Rockchip USB2.0  DWC_OTG 
	  controller.
choice
	bool "USB2.0 OTG controller mode"
	depends on USB20_OTG
	default DWC_OTG_DEVICE_ONLY
	help
	   RockChip DWC_OTG Controller can only work
	   in one of following mode
	
config DWC_OTG_HOST_ONLY
        boolean "HOST ONLY MODE"
        depends on USB20_OTG && USB 
	help
	   USB2.0 OTG controller worked in host mode 
	   and device can support other gadgets.

config DWC_OTG_DEVICE_ONLY
        boolean "DEVICE ONLY MODE"
        depends on USB20_OTG && USB_GADGET
	help 
	  USB2.0 OTG controller worked in device mode
     	  and device can connect to PC via USB cable.

config DWC_OTG_BOTH_HOST_SLAVE
	bool "BOTH HOST AND SLAVE"
	depends on USB20_OTG && USB_GADGET && USB

endchoice

choice 
	bool "Controller default status"
	depends on DWC_OTG_BOTH_HOST_SLAVE
	default DWC_OTG_DEFAULT_ID

config DWC_OTG_DEFAULT_ID
	bool "depends on USB_ID"

config DWC_OTG_DEFAULT_HOST
	bool "HOST"

config DWC_OTG_DEFAULT_DEVICE
	bool "DEVICE"
endchoice

config DWC_CONN_EN
	bool "---connect to PC when vbus detect"
	depends on USB_GADGET
	default y
	help
	  USB2.0 OTG controller always polling the USB vbus
	  
	  if selected, device will connect to PC automatic

config USB20_OTG_EN
	bool "---usb2.0 otg host controller enable"
	depends on DWC_OTG_HOST_ONLY || DWC_OTG_BOTH_HOST_SLAVE
	default y

config DWC_OTG_DEBUG
	bool "DWC_OTG debug messages"
	depends on USB11_HOST || USB20_HOST || USB20_OTG

config DWC_REMOTE_WAKEUP
	bool "remote wakeup support in DWC_OTG controller"
	depends on USB11_HOST || USB20_HOST || USB20_OTG
config DWC_OTG
	tristate	
	default y if USB11_HOST || USB20_HOST || USB20_OTG
```
