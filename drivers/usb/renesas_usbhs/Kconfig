## drivers/usb/typec/Kconfig
```kconfig
# SPDX-License-Identifier: GPL-2.0

menuconfig TYPEC
	tristate "USB Type-C Support"
	help
	  USB Type-C Specification defines a cable and connector for USB where
	  only one type of plug is supported on both ends, i.e. there will not
	  be Type-A plug on one end of the cable and Type-B plug on the other.
	  Determination of the host-to-device relationship happens through a
	  specific Configuration Channel (CC) which goes through the USB Type-C
	  cable. The Configuration Channel may also be used to detect optional
	  Accessory Modes - Analog Audio and Debug - and if USB Power Delivery
	  is supported, the Alternate Modes, where the connector is used for
	  something else then USB communication.

	  USB Power Delivery Specification defines a protocol that can be used
	  to negotiate the voltage and current levels with the connected
	  partners. USB Power Delivery allows higher voltages then the normal
	  5V, up to 20V, and current up to 5A over the cable. The USB Power
	  Delivery protocol is also used to negotiate the optional Alternate
	  Modes when they are supported. USB Power Delivery does not depend on
	  USB Type-C connector, however it is mostly used together with USB
	  Type-C connectors.

	  USB Type-C and USB Power Delivery Specifications define a set of state
	  machines that need to be implemented in either software or firmware.
	  Simple USB Type-C PHYs, for example USB Type-C Port Controller
	  Interface Specification compliant "Port Controllers" need the state
	  machines to be handled in the OS, but stand-alone USB Type-C and Power
	  Delivery controllers handle the state machines inside their firmware.
	  The USB Type-C and Power Delivery controllers usually function
	  autonomously, and do not necessarily require drivers.

	  Enable this configurations option if you have USB Type-C connectors on
	  your system and 1) you know your USB Type-C hardware requires OS
	  control (a driver) to function, or 2) if you need to be able to read
	  the status of the USB Type-C ports in your system, or 3) if you need
	  to be able to swap the power role (decide are you supplying or
	  consuming power over the cable) or data role (host or device) when
	  both roles are supported.

	  For more information, see the kernel documentation for USB Type-C
	  Connector Class API (Documentation/driver-api/usb/typec.rst)
	  <https://www.kernel.org/doc/html/latest/driver-api/usb/typec.html>
	  and ABI (Documentation/ABI/testing/sysfs-class-typec).

if TYPEC

source "drivers/usb/typec/tcpm/Kconfig"

source "drivers/usb/typec/ucsi/Kconfig"

source "drivers/usb/typec/tipd/Kconfig"

config TYPEC_ANX7411
	tristate "Analogix ANX7411 Type-C DRP Port controller driver"
	depends on I2C
	depends on USB_ROLE_SWITCH
	depends on POWER_SUPPLY
	help
	  Say Y or M here if your system has Analogix ANX7411 Type-C DRP Port
	  controller driver.

	  If you choose to build this driver as a dynamically linked module, the
	  module will be called anx7411.ko.

config TYPEC_RT1719
	tristate "Richtek RT1719 Sink Only Type-C controller driver"
	depends on USB_ROLE_SWITCH || !USB_ROLE_SWITCH
	depends on I2C
	depends on POWER_SUPPLY
	select REGMAP_I2C
	help
	  Say Y or M here if your system has Richtek RT1719 sink only
	  Type-C port controller driver.

	  If you choose to build this driver as a dynamically linked module, the
	  module will be called rt1719.ko

config TYPEC_HD3SS3220
	tristate "TI HD3SS3220 Type-C DRP Port controller driver"
	depends on I2C
	depends on USB_ROLE_SWITCH
	help
	  Say Y or M here if your system has TI HD3SS3220 Type-C DRP Port
	  controller driver.

	  If you choose to build this driver as a dynamically linked module, the
	  module will be called hd3ss3220.ko.

config TYPEC_STUSB160X
	tristate "STMicroelectronics STUSB160x Type-C controller driver"
	depends on USB_ROLE_SWITCH || !USB_ROLE_SWITCH
	depends on I2C
	select REGMAP_I2C
	help
	  Say Y or M here if your system has STMicroelectronics STUSB160x
	  Type-C port controller.

	  If you choose to build this driver as a dynamically linked module, the
	  module will be called stusb160x.ko.

config TYPEC_WUSB3801
	tristate "Willsemi WUSB3801 Type-C port controller driver"
	depends on I2C
	select REGMAP_I2C
	help
	  Say Y or M here if your system has a WUSB3801 Type-C port controller.

	  If you choose to build this driver as a dynamically linked module, the
	  module will be called wusb3801.ko.

source "drivers/usb/typec/mux/Kconfig"

source "drivers/usb/typec/altmodes/Kconfig"

endif # TYPEC
```

## drivers/usb/typec/altmodes/Kconfig
```kconfig
# SPDX-License-Identifier: GPL-2.0

menu "USB Type-C Alternate Mode drivers"

config TYPEC_DP_ALTMODE
	tristate "DisplayPort Alternate Mode driver"
	depends on DRM
	help
	  DisplayPort USB Type-C Alternate Mode allows DisplayPort
	  displays and adapters to be attached to the USB Type-C
	  connectors on the system.

	  To compile this driver as a module, choose M here: the
	  module will be called typec_displayport.

config TYPEC_NVIDIA_ALTMODE
	tristate "NVIDIA Alternate Mode driver"
	depends on TYPEC_DP_ALTMODE
	help
	  Latest NVIDIA GPUs support VirtualLink devices. Select this
	  to enable support for VirtualLink devices with NVIDIA GPUs.

	  To compile this driver as a module, choose M here: the
	  module will be called typec_nvidia.

endmenu
```

## drivers/usb/typec/fusb302/Kconfig
```kconfig
config TYPEC_FUSB302
	tristate "Fairchild FUSB302 Type-C chip driver"
	depends on I2C && POWER_SUPPLY
	help
	  The Fairchild FUSB302 Type-C chip driver that works with
	  Type-C Port Controller Manager to provide USB PD and USB
	  Type-C functionalities.
```

## drivers/usb/typec/mux/Kconfig
```kconfig
# SPDX-License-Identifier: GPL-2.0

menu "USB Type-C Multiplexer/DeMultiplexer Switch support"

config TYPEC_MUX_FSA4480
	tristate "ON Semi FSA4480 Analog Audio Switch driver"
	depends on I2C
	select REGMAP_I2C
	help
	  Driver for the ON Semiconductor FSA4480 Analog Audio Switch, which
	  provides support for muxing analog audio and sideband signals on a
	  common USB Type-C connector.
	  If compiled as a module, the module will be named fsa4480.

config TYPEC_MUX_GPIO_SBU
	tristate "Generic GPIO based SBU mux for USB Type-C applications"
	help
	  Say Y or M if your system uses a GPIO based mux for managing the
	  connected state and the swapping of the SBU lines in a Type-C port.

config TYPEC_MUX_PI3USB30532
	tristate "Pericom PI3USB30532 Type-C cross switch driver"
	depends on I2C
	help
	  Say Y or M if your system has a Pericom PI3USB30532 Type-C cross
	  switch / mux chip found on some devices with a Type-C port.

config TYPEC_MUX_INTEL_PMC
	tristate "Intel PMC mux control"
	depends on ACPI
	depends on INTEL_SCU_IPC
	select USB_COMMON
	select USB_ROLE_SWITCH
	help
	  Driver for USB muxes controlled by Intel PMC FW. Intel PMC FW can
	  control the USB role switch and also the multiplexer/demultiplexer
	  switches used with USB Type-C Alternate Modes.

config TYPEC_MUX_IT5205
	tristate "ITE IT5205 Type-C USB Alt Mode Passive MUX driver"
	depends on I2C
	select REGMAP_I2C
	help
	  Driver for the ITE IT5205 Type-C USB Alternate Mode Passive MUX
	  which provides support for muxing DisplayPort and sideband signals
	  on a common USB Type-C connector.
	  If compiled as a module, the module will be named it5205.

config TYPEC_MUX_NB7VPQ904M
	tristate "On Semiconductor NB7VPQ904M Type-C redriver driver"
	depends on I2C
	depends on DRM || DRM=n
	select DRM_AUX_BRIDGE if DRM_BRIDGE && OF
	select REGMAP_I2C
	help
	  Say Y or M if your system has a On Semiconductor NB7VPQ904M Type-C
	  redriver chip found on some devices with a Type-C port.

config TYPEC_MUX_PTN36502
	tristate "NXP PTN36502 Type-C redriver driver"
	depends on I2C
	depends on DRM || DRM=n
	select DRM_AUX_BRIDGE if DRM_BRIDGE && OF
	select REGMAP_I2C
	help
	  Say Y or M if your system has a NXP PTN36502 Type-C redriver chip
	  found on some devices with a Type-C port.

config TYPEC_MUX_WCD939X_USBSS
	tristate "Qualcomm WCD939x USBSS Analog Audio Switch driver"
	depends on I2C
	select REGMAP_I2C
	help
	  Driver for the Qualcomm WCD939x Audio Codec USBSS domain which
	  provides support for muxing analog audio and sideband signals on a
	  common USB Type-C connector.
	  If compiled as a module, the module will be named wcd939x-usbss.

endmenu
```

## drivers/usb/typec/tcpm/Kconfig
```kconfig
# SPDX-License-Identifier: GPL-2.0

config TYPEC_TCPM
	tristate "USB Type-C Port Controller Manager"
	depends on USB
	select USB_ROLE_SWITCH
	select POWER_SUPPLY
	help
	  The Type-C Port Controller Manager provides a USB PD and USB Type-C
	  state machine for use with Type-C Port Controllers.

if TYPEC_TCPM

config TYPEC_TCPCI
	tristate "Type-C Port Controller Interface driver"
	depends on I2C
	select REGMAP_I2C
	help
	  Type-C Port Controller driver for TCPCI-compliant controller.

if TYPEC_TCPCI

config TYPEC_RT1711H
	tristate "Richtek RT1711H Type-C chip driver"
	help
	  Richtek RT1711H Type-C chip driver that works with
	  Type-C Port Controller Manager to provide USB PD and USB
	  Type-C functionalities.

config TYPEC_MT6360
	tristate "Mediatek MT6360 Type-C driver"
	depends on MFD_MT6360
	help
	  Mediatek MT6360 is a multi-functional IC that includes
	  USB Type-C. It works with Type-C Port Controller Manager
	  to provide USB PD and USB Type-C functionalities.

config TYPEC_TCPCI_MT6370
	tristate "MediaTek MT6370 Type-C driver"
	depends on MFD_MT6370
	help
	  MediaTek MT6370 is a multi-functional IC that includes
	  USB Type-C. It works with Type-C Port Controller Manager
	  to provide USB PD and USB Type-C functionalities.

	  This driver can also be built as a module. The module
	  will be called "tcpci_mt6370".

config TYPEC_TCPCI_MAXIM
	tristate "Maxim TCPCI based Type-C chip driver"
	help
	  MAXIM TCPCI based Type-C/PD chip driver. Works with
	  with Type-C Port Controller Manager.

endif # TYPEC_TCPCI

config TYPEC_FUSB302
	tristate "Fairchild FUSB302 Type-C chip driver"
	depends on I2C
	depends on EXTCON || !EXTCON
	help
	  The Fairchild FUSB302 Type-C chip driver that works with
	  Type-C Port Controller Manager to provide USB PD and USB
	  Type-C functionalities.

config TYPEC_WCOVE
	tristate "Intel WhiskeyCove PMIC USB Type-C PHY driver"
	depends on ACPI
	depends on MFD_INTEL_PMC_BXT
	depends on BXT_WC_PMIC_OPREGION
	help
	  This driver adds support for USB Type-C on Intel Broxton platforms
	  that have Intel Whiskey Cove PMIC. The driver works with USB Type-C
	  Port Controller Manager to provide USB PD and Type-C functionalities.

	  To compile this driver as module, choose M here: the module will be
	  called typec_wcove.ko

config TYPEC_QCOM_PMIC
	tristate "Qualcomm PMIC USB Type-C Port Controller Manager driver"
	depends on ARCH_QCOM || COMPILE_TEST
	depends on DRM || DRM=n
	select DRM_AUX_HPD_BRIDGE if DRM_BRIDGE && OF
	help
	  A Type-C port and Power Delivery driver which aggregates two
	  discrete pieces of silicon in the PM8150b PMIC block: the
	  Type-C port controller and the Power Delivery PHY.

	  This driver enables Type-C role switching, orientation, Alternate
	  mode and Power Delivery support both for VBUS and VCONN.

endif # TYPEC_TCPM
```

## drivers/usb/typec/tipd/Kconfig
```kconfig
config TYPEC_TPS6598X
	tristate "TI TPS6598x USB Power Delivery controller driver"
	depends on I2C
	select POWER_SUPPLY
	select REGMAP_I2C
	select USB_ROLE_SWITCH
	help
	  Say Y or M here if your system has TI TPS65982 or TPS65983 USB Power
	  Delivery controller.

	  If you choose to build this driver as a dynamically linked module, the
	  module will be called tps6598x.ko.
```

## drivers/usb/typec/ucsi/Kconfig
```kconfig
# SPDX-License-Identifier: GPL-2.0

config TYPEC_UCSI
	tristate "USB Type-C Connector System Software Interface driver"
	depends on !CPU_BIG_ENDIAN
	depends on USB_ROLE_SWITCH || !USB_ROLE_SWITCH
	help
	  USB Type-C Connector System Software Interface (UCSI) is a
	  specification for an interface that allows the operating system to
	  control the USB Type-C ports. On UCSI system the USB Type-C ports
	  function autonomously by default, but in order to get the status of
	  the ports and support basic operations like role swapping, the driver
	  is required. UCSI is available on most of the new Intel based systems
	  that are equipped with Embedded Controller and USB Type-C ports.

	  UCSI specification does not define the interface method, so depending
	  on the platform, ACPI, PCI, I2C, etc. may be used. Therefore this
	  driver only provides the core part, and separate drivers are needed
	  for every supported interface method.

	  The UCSI specification can be downloaded from:
	  https://www.intel.com/content/www/us/en/io/universal-serial-bus/usb-type-c-ucsi-spec.html

	  To compile the driver as a module, choose M here: the module will be
	  called typec_ucsi.

if TYPEC_UCSI

config UCSI_CCG
	tristate "UCSI Interface Driver for Cypress CCGx"
	depends on I2C
	help
	  This driver enables UCSI support on platforms that expose a
	  Cypress CCGx Type-C controller over I2C interface.

	  To compile the driver as a module, choose M here: the module will be
	  called ucsi_ccg.

config UCSI_ACPI
	tristate "UCSI ACPI Interface Driver"
	depends on ACPI
	help
	  This driver enables UCSI support on platforms that expose UCSI
	  interface as ACPI device. On new Intel Atom based platforms starting
	  from Broxton SoCs and Core platforms stating from Skylake, UCSI is an
	  ACPI enumerated device.

	  To compile the driver as a module, choose M here: the module will be
	  called ucsi_acpi

config UCSI_STM32G0
	tristate "UCSI Interface Driver for STM32G0"
	depends on I2C
	help
	  This driver enables UCSI support on platforms that expose a STM32G0
	  Type-C controller over I2C interface.

	  To compile the driver as a module, choose M here: the module will be
	  called ucsi_stm32g0.

config UCSI_PMIC_GLINK
	tristate "UCSI Qualcomm PMIC GLINK Interface Driver"
	depends on QCOM_PMIC_GLINK
	help
	  This driver enables UCSI support on platforms that expose UCSI
	  interface as PMIC GLINK device.

	  To compile the driver as a module, choose M here: the module will be
	  called ucsi_glink.

endif
```
