## drivers/usb/renesas_usbhs/Kconfig
```kconfig
#
# Renesas USBHS Controller Drivers
#

config USB_RENESAS_USBHS
	tristate 'Renesas USBHS controller'
	depends on USB_GADGET
	depends on ARCH_SHMOBILE || SUPERH || COMPILE_TEST
	depends on EXTCON || !EXTCON # if EXTCON=m, USBHS cannot be built-in
	default n
	help
	  Renesas USBHS is a discrete USB host and peripheral controller chip
	  that supports both full and high speed USB 2.0 data transfers.
	  It has nine or more configurable endpoints, and endpoint zero.

	  Say "y" to link the driver statically, or "m" to build a
	  dynamically linked module called "renesas_usbhs"
```

## drivers/usb/repeater/Kconfig
```kconfig
# SPDX-License-Identifier: GPL-2.0-only
#
# USB eUSB2 repeater driver configuration
#
menu "USB eUSB2 repeater drivers"

config USB_REPEATER
	tristate "usb repeater framework"
	help
	  Enable this to allow eUSB2 PHY driver and connected repeater driver
	  to bind with together, and provide eUS2 PHY driver ways to perform
	  set of operations with repeater for USB2 functionality using eUSB2
	  PHY and eUSB2 repeater.

config QTI_PMIC_EUSB2_REPEATER
	tristate "QTI PMIC eUSB2 repeater driver"
	depends on USB_REPEATER && SPMI
	select REGMAP_SPMI
	help
	  Enable this to support the USB EUSB2 REPEATER on PMIC chips. This driver
	  provides support to reset, initialiated, power up and configure eUSB2
	  repeater for USB HS/FS/LS functionality where eUSB2 repeater is used.

	  To compile this driver as a module, choose M here.

config I2C_EUSB2_REPEATER
	tristate "eUSB2 i2c repeater driver"
	depends on ARCH_QCOM
	depends on USB_REPEATER
	depends on I2C
	help
	  Enable this to support the I2C EUSB2 REPEATER. This driver provides
	  support to reset, initialize, power up and configure eUSB2 repeater
	  for USB HS/FS/LS functionality where eUSB2 repeater is used.

	  To compile this driver as a module, choose M here.
endmenu
```

## drivers/usb/roles/Kconfig
```kconfig
# SPDX-License-Identifier: GPL-2.0

config USB_ROLE_SWITCH
	tristate "USB Role Switch Support"
	help
	  USB Role Switch is a device that can select the USB role - host or
	  device - for a USB port (connector). In most cases dual-role capable
	  USB controller will also represent the switch, but on some platforms
	  multiplexer/demultiplexer switch is used to route the data lines on
	  the USB connector between separate USB host and device controllers.

	  Say Y here if your USB connectors support both device and host roles.
	  To compile the driver as module, choose M here: the module will be
	  called roles.ko.

if USB_ROLE_SWITCH

config USB_ROLES_INTEL_XHCI
	tristate "Intel XHCI USB Role Switch"
	depends on ACPI && X86
	help
	  Driver for the internal USB role switch for switching the USB data
	  lines between the xHCI host controller and the dwc3 gadget controller
	  found on various Intel SoCs.

	  To compile the driver as a module, choose M here: the module will
	  be called intel-xhci-usb-role-switch.

endif # USB_ROLE_SWITCH
```
