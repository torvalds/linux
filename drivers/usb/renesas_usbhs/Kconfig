## drivers/usb/usbip/Kconfig
```kconfig
config USBIP_CORE
	tristate "USB/IP support"
	depends on NET
	select USB_COMMON
	select SGL_ALLOC
	---help---
	  This enables pushing USB packets over IP to allow remote
	  machines direct access to USB devices. It provides the
	  USB/IP core that is required by both drivers.

	  For more details, and to get the userspace utility
	  programs, please see <http://usbip.sourceforge.net/>.

	  To compile this as a module, choose M here: the module will
	  be called usbip-core.

	  If unsure, say N.

config USBIP_VHCI_HCD
	tristate "VHCI hcd"
	depends on USBIP_CORE && USB
	---help---
	  This enables the USB/IP virtual host controller driver,
	  which is run on the remote machine.

	  To compile this driver as a module, choose M here: the
	  module will be called vhci-hcd.

config USBIP_VHCI_HC_PORTS
	int "Number of ports per USB/IP virtual host controller"
	range 1 15
	default 8
	depends on USBIP_VHCI_HCD
	---help---
	  To increase number of ports available for USB/IP virtual
	  host controller driver, this defines number of ports per
	  USB/IP virtual host controller.

config USBIP_VHCI_NR_HCS
	int "Number of USB/IP virtual host controllers"
	range 1 128
	default 1
	depends on USBIP_VHCI_HCD
	---help---
	  To increase number of ports available for USB/IP virtual
	  host controller driver, this defines number of USB/IP
	  virtual host controllers as if adding physical host
	  controllers.

config USBIP_HOST
	tristate "Host driver"
	depends on USBIP_CORE && USB
	---help---
	  This enables the USB/IP host driver, which is run on the
	  machine that is sharing the USB devices.

	  To compile this driver as a module, choose M here: the
	  module will be called usbip-host.

config USBIP_VUDC
	tristate "VUDC driver"
	depends on USBIP_CORE && USB_GADGET
	---help---
	  This enables the USB/IP virtual USB device controller
	  driver, which is run on the host machine, allowing the
	  machine itself to act as a device.

	  To compile this driver as a module, choose M here: the
	  module will be called usbip-vudc.

config USBIP_DEBUG
	bool "Debug messages for USB/IP"
	depends on USBIP_CORE
	---help---
	  This enables the debug messages from the USB/IP drivers.
```

## drivers/usb/wusbcore/Kconfig
```kconfig
# SPDX-License-Identifier: GPL-2.0
#
# Wireless USB Core configuration
#
config USB_WUSB
	tristate "Enable Wireless USB extensions"
	depends on UWB
	select CRYPTO
	select CRYPTO_AES
	select CRYPTO_CCM
	help
	  Enable the host-side support for Wireless USB.

          To compile this support select Y (built in). It is safe to
	  select even if you don't have the hardware.

config USB_WUSB_CBAF
	tristate "Support WUSB Cable Based Association (CBA)"
	depends on USB
	help
	  Some WUSB devices support Cable Based Association. It's used to
	  enable the secure communication between the host and the
	  device.

	  Enable this option if your WUSB device must to be connected
	  via wired USB before establishing a wireless link.

	  It is safe to select even if you don't have a compatible
	  hardware.

config USB_WUSB_CBAF_DEBUG
	bool "Enable CBA debug messages"
	depends on USB_WUSB_CBAF
	help
	  Say Y here if you want the CBA to produce a bunch of debug messages
	  to the system log. Select this if you are having a problem with
	  CBA support and want to see more of what is going on.
```

## drivers/uwb/Kconfig
```kconfig
#
# UWB device configuration
#

menuconfig UWB
	tristate "Ultra Wideband devices"
	default n
	help
	  UWB is a high-bandwidth, low-power, point-to-point radio
	  technology using a wide spectrum (3.1-10.6GHz). It is
	  optimized for in-room use (480Mbps at 2 meters, 110Mbps at
	  10m). It serves as the transport layer for other protocols,
	  such as Wireless USB (WUSB).

	  The topology is peer to peer; however, higher level
	  protocols (such as WUSB) might impose a master/slave
	  relationship.

	  Say Y here if your computer has UWB radio controllers (USB or PCI)
	  based. You will need to enable the radio controllers
	  below.  It is ok to select all of them, no harm done.

	  For more help check the UWB and WUSB related files in
	  <file:Documentation/usb/>.

	  To compile the UWB stack as a module, choose M here.

if UWB

config UWB_HWA
	tristate "UWB Radio Control driver for WUSB-compliant USB dongles (HWA)"
	depends on USB
	help
	  This driver enables the radio controller for HWA USB
	  devices. HWA stands for Host Wire Adapter, and it is a UWB
	  Radio Controller connected to your system via USB. Most of
	  them come with a Wireless USB host controller also.

	  To compile this driver select Y (built in) or M (module). It
	  is safe to select any even if you do not have the hardware.

config UWB_WHCI
        tristate "UWB Radio Control driver for WHCI-compliant cards"
        depends on PCI
        help
          This driver enables the radio controller for WHCI cards.

          WHCI is a specification developed by Intel
          (http://www.intel.com/technology/comms/wusb/whci.htm) much
          in the spirit of USB's EHCI, but for UWB and Wireless USB
          radio/host controllers connected via memory mapping (eg:
          PCI). Most of these cards come also with a Wireless USB host
          controller.

          To compile this driver select Y (built in) or M (module). It
          is safe to select any even if you do not have the hardware.

config UWB_I1480U
        tristate "Support for Intel Wireless UWB Link 1480 HWA"
        depends on UWB_HWA
        select FW_LOADER
        help
         This driver enables support for the i1480 when connected via
         USB. It consists of a firmware uploader that will enable it
         to behave as an HWA device.

         To compile this driver select Y (built in) or M (module). It
         is safe to select any even if you do not have the hardware.

endif # UWB
```

## drivers/vdpa/Kconfig
```kconfig
# SPDX-License-Identifier: GPL-2.0-only
menuconfig VDPA
	tristate "vDPA drivers"
	depends on NET
	help
	  Enable this module to support vDPA device that uses a
	  datapath which complies with virtio specifications with
	  vendor specific control path.

if VDPA

config VDPA_SIM
	tristate "vDPA device simulator core"
	depends on RUNTIME_TESTING_MENU && HAS_DMA
	select DMA_OPS
	select VHOST_RING
	select IOMMU_IOVA
	help
	  Enable this module to support vDPA device simulators. These devices
	  are used for testing, prototyping and development of vDPA.

config VDPA_SIM_NET
	tristate "vDPA simulator for networking device"
	depends on VDPA_SIM
	select GENERIC_NET_UTILS
	help
	  vDPA networking device simulator which loops TX traffic back to RX.

config VDPA_SIM_BLOCK
	tristate "vDPA simulator for block device"
	depends on VDPA_SIM
	help
	  vDPA block device simulator which terminates IO request in a
	  memory buffer.

config VDPA_USER
	tristate "VDUSE (vDPA Device in Userspace) support"
	depends on EVENTFD && MMU && HAS_DMA
	select DMA_OPS
	select VHOST_IOTLB
	select IOMMU_IOVA
	help
	  With VDUSE it is possible to emulate a vDPA Device
	  in a userspace program.

config IFCVF
	tristate "Intel IFC VF vDPA driver"
	depends on PCI_MSI
	help
	  This kernel module can drive Intel IFC VF NIC to offload
	  virtio dataplane traffic to hardware.
	  To compile this driver as a module, choose M here: the module will
	  be called ifcvf.

config MLX5_VDPA
	bool
	select VHOST_IOTLB
	help
	  Support library for Mellanox VDPA drivers. Provides code that is
	  common for all types of VDPA drivers. The following drivers are planned:
	  net, block.

config MLX5_VDPA_NET
	tristate "vDPA driver for ConnectX devices"
	select MLX5_VDPA
	select VHOST_RING
	depends on MLX5_CORE
	help
	  VDPA network driver for ConnectX6 and newer. Provides offloading
	  of virtio net datapath such that descriptors put on the ring will
	  be executed by the hardware. It also supports a variety of stateless
	  offloads depending on the actual device used and firmware version.

config MLX5_VDPA_STEERING_DEBUG
	bool "expose steering counters on debugfs"
	select MLX5_VDPA
	help
	  Expose RX steering counters in debugfs to aid in debugging. For each VLAN
	  or non VLAN interface, two hardware counters are added to the RX flow
	  table: one for unicast and one for multicast.
	  The counters counts the number of packets and bytes and exposes them in
	  debugfs. Once can read the counters using, e.g.:
	  cat /sys/kernel/debug/mlx5/mlx5_core.sf.1/vdpa-0/rx/untagged/ucast/packets
	  cat /sys/kernel/debug/mlx5/mlx5_core.sf.1/vdpa-0/rx/untagged/mcast/bytes

config VP_VDPA
	tristate "Virtio PCI bridge vDPA driver"
	select VIRTIO_PCI_LIB
	depends on PCI_MSI
	help
	  This kernel module bridges virtio PCI device to vDPA bus.

config ALIBABA_ENI_VDPA
	tristate "vDPA driver for Alibaba ENI"
	select VIRTIO_PCI_LIB_LEGACY
	depends on PCI_MSI && X86
	help
	  VDPA driver for Alibaba ENI (Elastic Network Interface) which is built upon
	  virtio 0.9.5 specification.

 config SNET_VDPA
	tristate "SolidRun's vDPA driver for SolidNET"
	depends on PCI_MSI && PCI_IOV && (HWMON || HWMON=n)

	# This driver MAY create a HWMON device.
	# Depending on (HWMON || HWMON=n) ensures that:
	# If HWMON=n the driver can be compiled either as a module or built-in.
	# If HWMON=y the driver can be compiled either as a module or built-in.
	# If HWMON=m the driver is forced to be compiled as a module.
	# By doing so, IS_ENABLED can be used instead of IS_REACHABLE

	help
	  vDPA driver for SolidNET DPU.
	  With this driver, the VirtIO dataplane can be
	  offloaded to a SolidNET DPU.
	  This driver includes a HW monitor device that
	  reads health values from the DPU.

endif # VDPA
```

## drivers/vfio/Kconfig
```kconfig
# SPDX-License-Identifier: GPL-2.0-only
menuconfig VFIO
	tristate "VFIO Non-Privileged userspace driver framework"
	select IOMMU_API
	select VFIO_IOMMU_TYPE1 if MMU && (X86 || S390 || ARM || ARM64)
	select INTERVAL_TREE
	help
	  VFIO provides a framework for secure userspace device drivers.
	  See Documentation/driver-api/vfio.rst for more details.

	  If you don't know what to do here, say N.

if VFIO
config VFIO_IOMMU_TYPE1
	tristate
	default n

config VFIO_IOMMU_SPAPR_TCE
	tristate
	depends on SPAPR_TCE_IOMMU
	default VFIO

config VFIO_SPAPR_EEH
	tristate
	depends on EEH && VFIO_IOMMU_SPAPR_TCE
	default VFIO

config VFIO_VIRQFD
	tristate
	select EVENTFD
	default n

config VFIO_NOIOMMU
	bool "VFIO No-IOMMU support"
	help
	  VFIO is built on the ability to isolate devices using the IOMMU.
	  Only with an IOMMU can userspace access to DMA capable devices be
	  considered secure.  VFIO No-IOMMU mode enables IOMMU groups for
	  devices without IOMMU backing for the purpose of re-using the VFIO
	  infrastructure in a non-secure mode.  Use of this mode will result
	  in an unsupportable kernel and will therefore taint the kernel.
	  Device assignment to virtual machines is also not possible with
	  this mode since there is no IOMMU to provide DMA translation.

	  If you don't know what to do here, say N.

source "drivers/vfio/pci/Kconfig"
source "drivers/vfio/platform/Kconfig"
source "drivers/vfio/mdev/Kconfig"
source "drivers/vfio/fsl-mc/Kconfig"
endif

source "virt/lib/Kconfig"
```

## drivers/vfio/cdx/Kconfig
```kconfig
# SPDX-License-Identifier: GPL-2.0
#
# VFIO CDX configuration
#
# Copyright (C) 2022-2023, Advanced Micro Devices, Inc.
#

config VFIO_CDX
	tristate "VFIO support for CDX bus devices"
	depends on CDX_BUS
	select EVENTFD
	help
	  Driver to enable VFIO support for the devices on CDX bus.
	  This is required to make use of CDX devices present in
	  the system using the VFIO framework.

	  If you don't know what to do here, say N.
```

## drivers/vfio/fsl-mc/Kconfig
```kconfig
menu "VFIO support for FSL_MC bus devices"
	depends on FSL_MC_BUS

config VFIO_FSL_MC
	tristate "VFIO support for QorIQ DPAA2 fsl-mc bus devices"
	select EVENTFD
	help
	  Driver to enable support for the VFIO QorIQ DPAA2 fsl-mc
	  (Management Complex) devices. This is required to passthrough
	  fsl-mc bus devices using the VFIO framework.

	  If you don't know what to do here, say N.

endmenu
```

## drivers/vfio/pci/Kconfig
```kconfig
# SPDX-License-Identifier: GPL-2.0-only
menu "VFIO support for PCI devices"
	depends on PCI && MMU

config VFIO_PCI_CORE
	tristate
	select VFIO_VIRQFD
	select IRQ_BYPASS_MANAGER

config VFIO_PCI_MMAP
	def_bool y if !S390
	depends on VFIO_PCI_CORE

config VFIO_PCI_INTX
	def_bool y if !S390
	depends on VFIO_PCI_CORE

config VFIO_PCI
	tristate "Generic VFIO support for any PCI device"
	select VFIO_PCI_CORE
	help
	  Support for the generic PCI VFIO bus driver which can connect any
	  PCI device to the VFIO framework.

	  If you don't know what to do here, say N.

if VFIO_PCI
config VFIO_PCI_VGA
	bool "Generic VFIO PCI support for VGA devices"
	depends on X86 && VGA_ARB
	help
	  Support for VGA extension to VFIO PCI.  This exposes an additional
	  region on VGA devices for accessing legacy VGA addresses used by
	  BIOS and generic video drivers.

	  If you don't know what to do here, say N.

config VFIO_PCI_IGD
	bool "Generic VFIO PCI extensions for Intel graphics (GVT-d)"
	depends on X86
	default y
	help
	  Support for Intel IGD specific extensions to enable direct
	  assignment to virtual machines.  This includes exposing an IGD
	  specific firmware table and read-only copies of the host bridge
	  and LPC bridge config space.

	  To enable Intel IGD assignment through vfio-pci, say Y.
endif

config VFIO_PCI_ZDEV_KVM
	bool "VFIO PCI extensions for s390x KVM passthrough"
	depends on S390 && KVM
	default y
	help
	  Support s390x-specific extensions to enable support for enhancements
	  to KVM passthrough capabilities, such as interpretive execution of
	  zPCI instructions.

	  To enable s390x KVM vfio-pci extensions, say Y.

source "drivers/vfio/pci/mlx5/Kconfig"

source "drivers/vfio/pci/hisilicon/Kconfig"

endmenu
```

## drivers/vfio/pci/hisilicon/Kconfig
```kconfig
# SPDX-License-Identifier: GPL-2.0-only
config HISI_ACC_VFIO_PCI
	tristate "VFIO support for HiSilicon ACC PCI devices"
	depends on ARM64 || (COMPILE_TEST && 64BIT)
	depends on PCI_MSI
	depends on CRYPTO_DEV_HISI_QM
	depends on CRYPTO_DEV_HISI_HPRE
	depends on CRYPTO_DEV_HISI_SEC2
	depends on CRYPTO_DEV_HISI_ZIP
	select VFIO_PCI_CORE
	help
	  This provides generic PCI support for HiSilicon ACC devices
	  using the VFIO framework.

	  If you don't know what to do here, say N.
```
