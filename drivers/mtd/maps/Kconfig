## drivers/mtd/ubi/Kconfig
```kconfig
menuconfig MTD_UBI
	tristate "Enable UBI - Unsorted block images"
	select CRC32
	help
	  UBI is a software layer above MTD layer which admits of LVM-like
	  logical volumes on top of MTD devices, hides some complexities of
	  flash chips like wear and bad blocks and provides some other useful
	  capabilities. Please, consult the MTD web site for more details
	  (www.linux-mtd.infradead.org).

if MTD_UBI

config MTD_UBI_WL_THRESHOLD
	int "UBI wear-leveling threshold"
	default 4096
	range 2 65536
	help
	  This parameter defines the maximum difference between the highest
	  erase counter value and the lowest erase counter value of eraseblocks
	  of UBI devices. When this threshold is exceeded, UBI starts performing
	  wear leveling by means of moving data from eraseblock with low erase
	  counter to eraseblocks with high erase counter.

	  The default value should be OK for SLC NAND flashes, NOR flashes and
	  other flashes which have eraseblock life-cycle 100000 or more.
	  However, in case of MLC NAND flashes which typically have eraseblock
	  life-cycle less than 10000, the threshold should be lessened (e.g.,
	  to 128 or 256, although it does not have to be power of 2).

config MTD_UBI_BEB_LIMIT
	int "Maximum expected bad eraseblock count per 1024 eraseblocks"
	default 20
	range 0 768
	help
	  This option specifies the maximum bad physical eraseblocks UBI
	  expects on the MTD device (per 1024 eraseblocks). If the underlying
	  flash does not admit of bad eraseblocks (e.g. NOR flash), this value
	  is ignored.

	  NAND datasheets often specify the minimum and maximum NVM (Number of
	  Valid Blocks) for the flashes' endurance lifetime. The maximum
	  expected bad eraseblocks per 1024 eraseblocks then can be calculated
	  as "1024 * (1 - MinNVB / MaxNVB)", which gives 20 for most NANDs
	  (MaxNVB is basically the total count of eraseblocks on the chip).

	  To put it differently, if this value is 20, UBI will try to reserve
	  about 1.9% of physical eraseblocks for bad blocks handling. And that
	  will be 1.9% of eraseblocks on the entire NAND chip, not just the MTD
	  partition UBI attaches. This means that if you have, say, a NAND
	  flash chip admits maximum 40 bad eraseblocks, and it is split on two
	  MTD partitions of the same size, UBI will reserve 40 eraseblocks when
	  attaching a partition.

	  This option can be overridden by the "mtd=" UBI module parameter or
	  by the "attach" ioctl.

	  Leave the default value if unsure.

config MTD_UBI_FASTMAP
	bool "UBI Fastmap (Experimental feature)"
	default n
	help
	   Important: this feature is experimental so far and the on-flash
	   format for fastmap may change in the next kernel versions

	   Fastmap is a mechanism which allows attaching an UBI device
	   in nearly constant time. Instead of scanning the whole MTD device it
	   only has to locate a checkpoint (called fastmap) on the device.
	   The on-flash fastmap contains all information needed to attach
	   the device. Using fastmap makes only sense on large devices where
	   attaching by scanning takes long. UBI will not automatically install
	   a fastmap on old images, but you can set the UBI module parameter
	   fm_autoconvert to 1 if you want so. Please note that fastmap-enabled
	   images are still usable with UBI implementations without
	   fastmap support. On typical flash devices the whole fastmap fits
	   into one PEB. UBI will reserve PEBs to hold two fastmaps.

	   If in doubt, say "N".

config MTD_UBI_GLUEBI
	tristate "MTD devices emulation driver (gluebi)"
	help
	   This option enables gluebi - an additional driver which emulates MTD
	   devices on top of UBI volumes: for each UBI volumes an MTD device is
	   created, and all I/O to this MTD device is redirected to the UBI
	   volume. This is handy to make MTD-oriented software (like JFFS2)
	   work on top of UBI. Do not enable this unless you use legacy
	   software.

endif # MTD_UBI
```

## drivers/mtd/ubi/Kconfig.debug
```kconfig
comment "UBI debugging options"

config MTD_UBI_DEBUG
	bool "UBI debugging"
	depends on SYSFS
	select DEBUG_FS
	select KALLSYMS_ALL if KALLSYMS && DEBUG_KERNEL
	help
	  This option enables UBI debugging.

if MTD_UBI_DEBUG

config MTD_UBI_DEBUG_DISABLE_BGT
	bool "Do not enable the UBI background thread"
	help
	  This option switches the background thread off by default. The thread
	  may be also be enabled/disabled via UBI sysfs.

config MTD_UBI_DEBUG_EMULATE_BITFLIPS
	bool "Emulate flash bit-flips"
	help
	  This option emulates bit-flips with probability 1/50, which in turn
	  causes scrubbing. Useful for debugging and stressing UBI.

config MTD_UBI_DEBUG_EMULATE_WRITE_FAILURES
	bool "Emulate flash write failures"
	help
	  This option emulates write failures with probability 1/100. Useful for
	  debugging and testing how UBI handlines errors.

config MTD_UBI_DEBUG_EMULATE_ERASE_FAILURES
	bool "Emulate flash erase failures"
	help
	  This option emulates erase failures with probability 1/100. Useful for
	  debugging and testing how UBI handlines errors.

endif # MTD_UBI_DEBUG
```

## drivers/mtk_wcn_combo/Kconfig
```kconfig
menu "MediaTek Connectivity Combo Chip Config"

config MTK_COMBO
	bool "MediaTek Connectivity Combo Chip Support"
	help
	  MTK connectivity combo chip driver for MT6620

#
# MTK Combo Chip Selection
#
choice
	prompt "Select Chip"
	depends on MTK_COMBO

config MTK_COMBO_CHIP_MT6620
	bool "MT6620"

#config MTK_COMBO_CHIP_MT6628
#	bool "MT6628"
endchoice

#
# Target Platform Selection
#
config MTK_COMBO_PLAT_PATH
	string "Platform folder name"
	depends on MTK_COMBO
	default "sample" if MTK_COMBO_PLAT_SAMPLE
	help
	  Specify platform folder under common driver platform folder: 
	  mtk_wcn_combo/common/platform/*

config MTK_COMBO_DRIVER_VERSION_JB2
       depends on MTK_COMBO
       bool "MediaTek Connectivity Combo Driver version is JB2 V1.0"
       default n

       help
          MTK driver V3.1 will use a different configuration about SDIO.

#
# MTK COMBO Chip Configuration
#
config MTK_COMBO_COMM
	depends on MTK_COMBO
	tristate "MediaTek Combo Chip Common part driver"
	help
	  MediaTek combo chip common part driver

#config MTK_COMBO_COMM_PS
#	depends on MTK_COMBO_COMM
#	bool "Enable PS support"
#	default n
#	help
#	  Enable PS support of common UART interface

config MTK_COMBO_COMM_UART
	depends on MTK_COMBO_COMM
	tristate "Common interface UART"
	help
	  Use UART for common part interface type

#config MTK_COMBO_COMM_SDIO
#	depends on MTK_COMBO_COMM
#	tristate "Common interface SDIO"
#	help
#	  Use SDIO for common part interface type

config MTK_COMBO_BT
	tristate "MediaTek Combo Chip BT driver"
	depends on MTK_COMBO
	help
	  MTK BT /dev/stpbt driver for Bluedroid (mtk_stp_bt.ko)
        
config MTK_COMBO_BT_HCI
	tristate "MediaTek Combo Chip BlueZ driver"
	depends on BT && MTK_COMBO
	help
	  MTK BT driver for BlueZ (hci_stp.ko)

config MTK_COMBO_FM
	tristate "MediaTek Combo Chip FM driver"
	depends on MTK_COMBO
	help
	  MTK FM /dev/fm driver (mt6620_fm_drv.ko, mtk_fm_priv.ko)

config MTK_COMBO_WIFI
	tristate "MediaTek Combo Chip Wi-Fi support"
	depends on MTK_COMBO
	depends on MMC
	depends on IPV6
	select WIRELESS_EXT
	select WEXT_PRIV
	help
	  This module adds support for wireless adapters based on
	  MTK MT6620 chipset.

	  This driver uses the kernel's wireless extensions subsystem.

	  If you choose to build a module, it'll be called dhd. Say M if
	  unsure.

#config MTK_COMBO_WIFI_FW_PATH
#	depends on MTK_COMBO_WIFI
#	string "Firmware path"
#	default "/system/etc/firmware/WIFI_RAM_CODE"
#	help
#	  Path to the firmware file

config MTK_COMBO_WIFI_DEBUG
	depends on MTK_COMBO_WIFI
	bool "Enable debug output from MT6620 driver"
	help
	  Enable debug messages output from MT6620 driver

config MTK_COMBO_WIFI_PROC
	depends on MTK_COMBO_WIFI
	bool "Enable procfs support"
	help
	  Enable procfs support.

#config MTK_WAPI_SUPPORT
#	depends on MTK_COMBO_WIFI
#	bool "Enable WAPI support in MT6620 driver"
#	help
#	  Enable WAPI support for devices using MT6620

choice
	prompt "Host Interface"
	depends on MTK_COMBO_WIFI

config MTK_COMBO_WIFI_HIF_SDIO1
	bool "SDIO #1"
	depends on MTK_COMBO_WIFI
endchoice


config MTK_GPS
	tristate "MediaTek GPS Support"
	help
	  MTK GPS /dev/gps driver (mtk_gps.ko)

config MTK_COMBO_GPS
	tristate "MediaTek Combo Chip GPS driver"
	depends on MTK_COMBO && MTK_GPS
	help
	  MTK GPS /dev/stpgps driver (mtk_stp_gps.ko)

endmenu
```

## drivers/mux/Kconfig
```kconfig
#
# Multiplexer devices
#

menuconfig MULTIPLEXER
	tristate "Multiplexer subsystem"
	help
	  Multiplexer controller subsystem. Multiplexers are used in a
	  variety of settings, and this subsystem abstracts their use
	  so that the rest of the kernel sees a common interface. When
	  multiple parallel multiplexers are controlled by one single
	  multiplexer controller, this subsystem also coordinates the
	  multiplexer accesses.

	  To compile the subsystem as a module, choose M here: the module will
	  be called mux-core.

if MULTIPLEXER

config MUX_ADG792A
	tristate "Analog Devices ADG792A/ADG792G Multiplexers"
	depends on I2C
	help
	  ADG792A and ADG792G Wide Bandwidth Triple 4:1 Multiplexers

	  The driver supports both operating the three multiplexers in
	  parallel and operating them independently.

	  To compile the driver as a module, choose M here: the module will
	  be called mux-adg792a.

config MUX_GPIO
	tristate "GPIO-controlled Multiplexer"
	depends on GPIOLIB || COMPILE_TEST
	help
	  GPIO-controlled Multiplexer controller.

	  The driver builds a single multiplexer controller using a number
	  of gpio pins. For N pins, there will be 2^N possible multiplexer
	  states. The GPIO pins can be connected (by the hardware) to several
	  multiplexers, which in that case will be operated in parallel.

	  To compile the driver as a module, choose M here: the module will
	  be called mux-gpio.

config MUX_MMIO
	tristate "MMIO register bitfield-controlled Multiplexer"
	depends on (OF && MFD_SYSCON) || COMPILE_TEST
	help
	  MMIO register bitfield-controlled Multiplexer controller.

	  The driver builds multiplexer controllers for bitfields in a syscon
	  register. For N bit wide bitfields, there will be 2^N possible
	  multiplexer states.

	  To compile the driver as a module, choose M here: the module will
	  be called mux-mmio.

endif
```

## drivers/mxc/Kconfig
```kconfig
# drivers/mxc/Kconfig

if ARCH_MXC

menu "MXC support drivers"

config MXC_IPU
	bool "Image Processing Unit Driver"
	select MXC_IPU_V3
	help
	  If you plan to use the Image Processing unit, say
	  Y here. IPU is needed by Framebuffer and V4L2 drivers.

source "drivers/mxc/mlb/Kconfig"
source "drivers/mxc/ipu3/Kconfig"
source "drivers/mxc/gpu-viv/Kconfig"
source "drivers/mxc/sim/Kconfig"
source "drivers/mxc/vpu/Kconfig"
source "drivers/mxc/hdmi-cec/Kconfig"

endmenu

endif
```

## drivers/mxc/gpu-viv/Kconfig
```kconfig
menu "MXC Vivante GPU support"
	depends on SOC_IMX6

config MXC_GPU_VIV
	tristate "MXC Vivante GPU support"
	---help---
         Say Y to get the GPU driver support.

endmenu
```

## drivers/mxc/hdmi-cec/Kconfig
```kconfig
menu "MXC HDMI CEC (Consumer Electronics Control) support"

config MXC_HDMI_CEC
	tristate "Support for MXC HDMI CEC (Consumer Electronics Control)"
	depends on MFD_MXC_HDMI
	depends on FB_MXC_HDMI
	help
	  The HDMI CEC device implement low level protocol on i.MX6x platforms.

endmenu
```

## drivers/mxc/ipu3/Kconfig
```kconfig
config MXC_IPU_V3
	bool

config MXC_IPU_V3_PRG
	tristate "i.MX IPUv3 prefetch gasket engine"
	depends on MXC_IPU_V3 && MXC_IPU_V3_PRE
	help
	  This enables support for the IPUv3 prefetch gasket engine to
	  support double buffer handshake control bewteen IPUv3 and
	  prefetch engine(PRE), snoop the AXI interface for display
	  refresh requests to memory and modify the request address to
	  fetch the double buffered row of blocks in OCRAM.

config MXC_IPU_V3_PRE
	tristate "i.MX IPUv3 prefetch engine"
	depends on MXC_IPU_V3
	select MXC_IPU_V3_PRG
	help
	  This enables support for the IPUv3 prefetch engine to improve
	  the system memory performance.  The engine has the capability
	  to resolve framebuffers in tile pixel format to linear.
```

## drivers/mxc/mipi/Kconfig
```kconfig
#
# MIPI configuration
#

menu "MXC MIPI Support"

config MXC_MIPI_CSI2
	tristate "MIPI CSI2 support"
	depends on (SOC_IMX6 || SOC_IMX7)
	default n
	---help---
	Say Y to get the MIPI CSI2 support.

endmenu
```

## drivers/mxc/mlb/Kconfig
```kconfig
#
# MLB150 configuration
#

menu "MXC Media Local Bus Driver"

config MXC_MLB
	boolean

config MXC_MLB150
	tristate "MLB150 support"
	depends on SOC_IMX6Q
	select MXC_MLB
	---help---
	Say Y to get the MLB150 support.

endmenu
```

## drivers/mxc/sim/Kconfig
```kconfig
#
# SIM configuration
#

menu "MXC SIM Support"

config MXC_SIM
	tristate "MXC SIM support"
	default n
	---help---
	Say Y to get MXC SIM support.

endmenu
```

## drivers/mxc/vpu/Kconfig
```kconfig
#
# Codec configuration
#

menu "MXC VPU(Video Processing Unit) support"

config MXC_VPU
	  tristate "Support for MXC VPU(Video Processing Unit)"
	  depends on (SOC_IMX27 || SOC_IMX5 || SOC_IMX6Q)
	  default y
	---help---
	  The VPU codec device provides codec function for H.264/MPEG4/H.263,
	  as well as MPEG2/VC-1/DivX on some platforms.

config MXC_VPU_DEBUG
	bool "MXC VPU debugging"
	depends on MXC_VPU != n
	help
	  This is an option for the developers; most people should
	  say N here.  This enables MXC VPU driver debugging.

config MX6_VPU_352M
	bool "MX6 VPU 352M"
	depends on MXC_VPU
	default n
	help
	 Increase VPU frequncy to 352M, the config will disable bus frequency
	 adjust dynamic, and CPU lowest setpoint will be 352Mhz.
	 This config is used for special VPU use case.

endmenu
```
