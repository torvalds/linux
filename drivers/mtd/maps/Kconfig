## drivers/mtd/nand/raw/brcmnand/Kconfig
```kconfig
config MTD_NAND_BRCMNAND
	tristate "Broadcom STB NAND controller"
	depends on ARM || ARM64 || MIPS || COMPILE_TEST
	depends on HAS_IOMEM
	help
	  Enables the Broadcom NAND controller driver. The controller was
	  originally designed for Set-Top Box but is used on various BCM7xxx,
	  BCM3xxx, BCM63xxx, iProc/Cygnus and more.

if MTD_NAND_BRCMNAND

config MTD_NAND_BRCMNAND_BCM63XX
	tristate "Broadcom BCM63xx NAND controller glue"
	default BCM63XX
	help
	  Enables the BRCMNAND glue driver to register the NAND controller
	  on Broadcom BCM63xx MIPS-based DSL platforms.

config MTD_NAND_BRCMNAND_BCMA
	tristate "Broadcom BCMA NAND controller"
	depends on BCMA_NFLASH
	depends on BCMA
	help
	  Enables the BRCMNAND controller over BCMA on BCM47186/BCM5358 SoCs.
	  The glue driver will take care of performing the low-level I/O
	  operations to interface the BRCMNAND controller over the BCMA bus.

config MTD_NAND_BRCMNAND_BCMBCA
	tristate "Broadcom BCMBCA NAND controller glue"
	default ARCH_BCMBCA
	help
	  Enables the BRCMNAND glue driver to register the NAND controller
	  on Broadcom BCA platforms.

config MTD_NAND_BRCMNAND_BRCMSTB
	tristate "Broadcom STB Nand controller glue"
	default ARCH_BRCMSTB
	help
	  Enables the BRCMNAND glue driver to register the NAND controller
	  on Broadcom STB platforms.

config MTD_NAND_BRCMNAND_IPROC
	tristate "Broadcom iProc NAND controller glue"
	default ARCH_BCM_IPROC
	help
	  Enables the BRCMNAND controller glue driver to register the NAND
	  controller on Broadcom iProc platforms.

endif # MTD_NAND_BRCMNAND
```

## drivers/mtd/nand/raw/ingenic/Kconfig
```kconfig
config MTD_NAND_JZ4740
	tristate "JZ4740 NAND controller"
	depends on MACH_JZ4740 || COMPILE_TEST
	depends on HAS_IOMEM
	help
	  Enables support for NAND Flash on JZ4740 SoC based boards.

config MTD_NAND_JZ4780
	tristate "JZ4780 NAND controller"
	depends on JZ4780_NEMC
	help
	  Enables support for NAND Flash connected to the NEMC on JZ4780 SoC
	  based boards, using the BCH controller for hardware error correction.

if MTD_NAND_JZ4780

config MTD_NAND_INGENIC_ECC
	tristate

config MTD_NAND_JZ4740_ECC
	tristate "Hardware BCH support for JZ4740 SoC"
	select MTD_NAND_INGENIC_ECC
	help
	  Enable this driver to support the Reed-Solomon error-correction
	  hardware present on the JZ4740 SoC from Ingenic.

	  This driver can also be built as a module. If so, the module
	  will be called jz4740-ecc.

config MTD_NAND_JZ4725B_BCH
	tristate "Hardware BCH support for JZ4725B SoC"
	select MTD_NAND_INGENIC_ECC
	help
	  Enable this driver to support the BCH error-correction hardware
	  present on the JZ4725B SoC from Ingenic.

	  This driver can also be built as a module. If so, the module
	  will be called jz4725b-bch.

config MTD_NAND_JZ4780_BCH
	tristate "Hardware BCH support for JZ4780 SoC"
	select MTD_NAND_INGENIC_ECC
	help
	  Enable this driver to support the BCH error-correction hardware
	  present on the JZ4780 SoC from Ingenic.

	  This driver can also be built as a module. If so, the module
	  will be called jz4780-bch.

endif # MTD_NAND_JZ4780
```

## drivers/mtd/nand/spi/Kconfig
```kconfig
# SPDX-License-Identifier: GPL-2.0-only
menuconfig MTD_SPI_NAND
	tristate "SPI NAND device Support"
	select MTD_NAND_CORE
	depends on SPI_MASTER
	select SPI_MEM
	select MTD_NAND_BBT_USING_FLASH
	help
	  This is the framework for the SPI NAND device drivers.
```

## drivers/mtd/onenand/Kconfig
```kconfig
menuconfig MTD_ONENAND
	tristate "OneNAND Device Support"
	depends on MTD
	help
	  This enables support for accessing all type of OneNAND flash
	  devices. For further information see
	  <http://www.samsung.com/Products/Semiconductor/OneNAND/index.htm>

if MTD_ONENAND

config MTD_ONENAND_VERIFY_WRITE
	bool "Verify OneNAND page writes"
	help
	  This adds an extra check when data is written to the flash. The
	  OneNAND flash device internally checks only bits transitioning
	  from 1 to 0. There is a rare possibility that even though the
	  device thinks the write was successful, a bit could have been
	  flipped accidentally due to device wear or something else.

config MTD_ONENAND_GENERIC
	tristate "OneNAND Flash device via platform device driver"
	help
	  Support for OneNAND flash via platform device driver.

config MTD_ONENAND_OMAP2
	tristate "OneNAND on OMAP2/OMAP3 support"
	depends on ARCH_OMAP2 || ARCH_OMAP3
	help
	  Support for a OneNAND flash device connected to an OMAP2/OMAP3 CPU
	  via the GPMC memory controller.

config MTD_ONENAND_SAMSUNG
        tristate "OneNAND on Samsung SOC controller support"
        depends on ARCH_S3C64XX || ARCH_S5PC100 || ARCH_S5PV210 || ARCH_EXYNOS4
        help
          Support for a OneNAND flash device connected to an Samsung SOC.
          S3C64XX/S5PC100 use command mapping method.
          S5PC110/S5PC210 use generic OneNAND method.

config MTD_ONENAND_OTP
	bool "OneNAND OTP Support"
	select HAVE_MTD_OTP
	help
	  One Block of the NAND Flash Array memory is reserved as
	  a One-Time Programmable Block memory area.
	  Also, 1st Block of NAND Flash Array can be used as OTP.

	  The OTP block can be read, programmed and locked using the same
	  operations as any other NAND Flash Array memory block.
	  OTP block cannot be erased.

	  OTP block is fully-guaranteed to be a valid block.

config MTD_ONENAND_2X_PROGRAM
	bool "OneNAND 2X program support"
	help
	  The 2X Program is an extension of Program Operation.
	  Since the device is equipped with two DataRAMs, and two-plane NAND
	  Flash memory array, these two component enables simultaneous program
	  of 4KiB. Plane1 has only even blocks such as block0, block2, block4
	  while Plane2 has only odd blocks such as block1, block3, block5.
	  So MTD regards it as 4KiB page size and 256KiB block size

	  Now the following chips support it. (KFXXX16Q2M)
	    Demux: KFG2G16Q2M, KFH4G16Q2M, KFW8G16Q2M,
	    Mux:   KFM2G16Q2M, KFN4G16Q2M,

	  And more recent chips

config MTD_ONENAND_SIM
	tristate "OneNAND simulator support"
	help
	  The simulator may simulate various OneNAND flash chips for the
	  OneNAND MTD layer.

endif # MTD_ONENAND
```

## drivers/mtd/parsers/Kconfig
```kconfig
# SPDX-License-Identifier: GPL-2.0-only
config MTD_AR7_PARTS
	tristate "TI AR7 partitioning parser"
	help
	  TI AR7 partitioning parser support

config MTD_BCM47XX_PARTS
	tristate "BCM47XX partitioning parser"
	depends on BCM47XX || ARCH_BCM_5301X
	help
	  This provides partitions parser for devices based on BCM47xx
	  boards.

config MTD_BCM63XX_PARTS
	bool "BCM63XX CFE partitioning parser"
	depends on BCM63XX || BMIPS_GENERIC || COMPILE_TEST
	select CRC32
	select MTD_PARSER_IMAGETAG
	help
	  This provides partition parsing for BCM63xx devices with CFE
	  bootloaders.

config MTD_CMDLINE_PARTS
	tristate "Command line partition table parsing"
	depends on MTD
	help
	  Allow generic configuration of the MTD partition tables via the kernel
	  command line. Multiple flash resources are supported for hardware where
	  different kinds of flash memory are available.

	  You will still need the parsing functions to be called by the driver
	  for your particular device. It won't happen automatically. The
	  SA1100 map driver (CONFIG_MTD_SA1100) has an option for this, for
	  example.

	  The format for the command line is as follows:

	  mtdparts=<mtddef>[;<mtddef]
	  <mtddef>  := <mtd-id>:<partdef>[,<partdef>]
	  <partdef> := <size>[@offset][<name>][ro]
	  <mtd-id>  := unique id used in mapping driver/device
	  <size>    := standard linux memsize OR "-" to denote all
	  remaining space
	  <name>    := (NAME)

	  Due to the way Linux handles the command line, no spaces are
	  allowed in the partition definition, including mtd id's and partition
	  names.

	  Examples:

	  1 flash resource (mtd-id "sa1100"), with 1 single writable partition:
	  mtdparts=sa1100:-

	  Same flash, but 2 named partitions, the first one being read-only:
	  mtdparts=sa1100:256k(ARMboot)ro,-(root)

	  If unsure, say 'N'.

config MTD_OF_PARTS
	tristate "OpenFirmware (device tree) partitioning parser"
	default y
	depends on OF
	help
	  This provides a open firmware device tree partition parser
	  which derives the partition map from the children of the
	  flash memory node, as described in
	  Documentation/devicetree/bindings/mtd/partition.txt.

config MTD_OF_PARTS_BCM4908
	bool "BCM4908 partitioning support"
	depends on MTD_OF_PARTS && (ARCH_BCM4908 || COMPILE_TEST)
	default ARCH_BCM4908
	help
	  This provides partitions parser for BCM4908 family devices
	  that can have multiple "firmware" partitions. It takes care of
	  finding currently used one and backup ones.

config MTD_PARSER_IMAGETAG
	tristate "Parser for BCM963XX Image Tag format partitions"
	depends on BCM63XX || BMIPS_GENERIC || COMPILE_TEST
	select CRC32
	help
	  Image Tag is the firmware header used by broadcom on their xDSL line
	  of devices. It is used to describe the offsets and lengths of kernel
	  and rootfs partitions.
	  This driver adds support for parsing a partition with an Image Tag
	  header and creates up to two partitions, kernel and rootfs.

config MTD_AFS_PARTS
	tristate "ARM Firmware Suite partition parsing"
	depends on (ARM || ARM64)
	help
	  The ARM Firmware Suite allows the user to divide flash devices into
	  multiple 'images'. Each such image has a header containing its name
	  and offset/size etc.

	  If you need code which can detect and parse these tables, and
	  register MTD 'partitions' corresponding to each image detected,
	  enable this option.

	  You will still need the parsing functions to be called by the driver
	  for your particular device. It won't happen automatically. The
	  'physmap' map driver (CONFIG_MTD_PHYSMAP) does this, for example.

config MTD_PARSER_TRX
	tristate "Parser for TRX format partitions"
	depends on MTD && (BCM47XX || ARCH_BCM_5301X || COMPILE_TEST)
	help
	  TRX is a firmware format used by Broadcom on their devices. It
	  may contain up to 3/4 partitions (depending on the version).
	  This driver will parse TRX header and report at least two partitions:
	  kernel and rootfs.

config MTD_SHARPSL_PARTS
	tristate "Sharp SL Series NAND flash partition parser"
	depends on MTD_NAND_SHARPSL || MTD_NAND_TMIO || COMPILE_TEST
	help
	  This provides the read-only FTL logic necessary to read the partition
	  table from the NAND flash of Sharp SL Series (Zaurus) and the MTD
	  partition parser using this code.

config MTD_REDBOOT_PARTS
	tristate "RedBoot partition table parsing"
	help
	  RedBoot is a ROM monitor and bootloader which deals with multiple
	  'images' in flash devices by putting a table one of the erase
	  blocks on the device, similar to a partition table, which gives
	  the offsets, lengths and names of all the images stored in the
	  flash.

	  If you need code which can detect and parse this table, and register
	  MTD 'partitions' corresponding to each image in the table, enable
	  this option.

	  You will still need the parsing functions to be called by the driver
	  for your particular device. It won't happen automatically. The
	  SA1100 map driver (CONFIG_MTD_SA1100) has an option for this, for
	  example.

if MTD_REDBOOT_PARTS

config MTD_REDBOOT_DIRECTORY_BLOCK
	int "Location of RedBoot partition table"
	default "-1"
	help
	  This option is the Linux counterpart to the
	  CYGNUM_REDBOOT_FIS_DIRECTORY_BLOCK RedBoot compile time
	  option.

	  The option specifies which Flash sectors holds the RedBoot
	  partition table.  A zero or positive value gives an absolute
	  erase block number. A negative value specifies a number of
	  sectors before the end of the device.

	  For example "2" means block number 2, "-1" means the last
	  block and "-2" means the penultimate block.

config MTD_REDBOOT_PARTS_UNALLOCATED
	bool "Include unallocated flash regions"
	help
	  If you need to register each unallocated flash region as a MTD
	  'partition', enable this option.

config MTD_REDBOOT_PARTS_READONLY
	bool "Force read-only for RedBoot system images"
	help
	  If you need to force read-only for 'RedBoot', 'RedBoot Config' and
	  'FIS directory' images, enable this option.

endif # MTD_REDBOOT_PARTS

config MTD_QCOMSMEM_PARTS
	tristate "Qualcomm SMEM flash partition parser"
	depends on QCOM_SMEM
	help
	  This provides support for parsing partitions from Shared Memory (SMEM)
	  for NAND and SPI flash on Qualcomm platforms.
```

## drivers/mtd/rknand/Kconfig
```kconfig
# 
# linux/drivers/mtd/rknand/Kconfig 
# 
 
config MTD_RKNAND 
	tristate "RK NAND Device Support" 
	depends on MTD 
	select MTD_RK_NAND_IDS 
	help 
	  RK NAND Device Support 
if MTD_RKNAND 
 
config MTD_NAND_RK
	tristate "RK on-chip NAND Flash Controller driver with FTL" 
	depends on MTD_RKNAND 
    default y 
	help 
	  This enables the RK28xx on-chip NAND flash controller and NFTL driver. 
 
config MTD_RKNAND_BUFFER
	tristate "RK Nand buffer write enables" 
	depends on MTD_RKNAND 
    default y 
	help 
	
config MTD_EMMC_CLK_POWER_SAVE 
	tristate "RK emmc clock power save" 
	depends on MTD_RKNAND 
    default n
	help 
 
config MTD_NAND_RK_DEBUG 
	tristate "RK Nand driver debug enables"
	depends on MTD_RKNAND 
    default n 
	help 
	 
config MTD_NAND_RK_DEBUG_VERBOSE 
	int "Debugging verbosity (0 = quiet, 3 = noisy)" 
	depends on MTD_NAND_RK29XX_DEBUG 
	default "0" 
	help 
	  Determines the verbosity level of the MTD NAND debugging messages. 
	   
endif # MTD_RKNAND 
 
```

## drivers/mtd/spi-nor/Kconfig
```kconfig
# SPDX-License-Identifier: GPL-2.0-only
menuconfig MTD_SPI_NOR
	tristate "SPI NOR device support"
	depends on MTD
	depends on MTD && SPI_MASTER
	select SPI_MEM
	help
	  This is the framework for the SPI NOR which can be used by the SPI
	  device drivers and the SPI NOR device driver.

if MTD_SPI_NOR

config MTD_SPI_NOR_USE_4K_SECTORS
	bool "Use small 4096 B erase sectors"
	default y
	help
	  Many flash memories support erasing small (4096 B) sectors. Depending
	  on the usage this feature may provide performance gain in comparison
	  to erasing whole blocks (32/64 KiB).
	  Changing a small part of the flash's contents is usually faster with
	  small sectors. On the other hand erasing should be faster when using
	  64 KiB block instead of 16 × 4 KiB sectors.

	  Please note that some tools/drivers/filesystems may not work with
	  4096 B erase size (e.g. UBIFS requires 15 KiB as a minimum).

config MTD_SPI_NOR_MISC
	bool "Support SPI NOR misc device"
	default n
	help
	  Support obtaining flash information through the ioctl interface
	  of the misc device.

source "drivers/mtd/spi-nor/controllers/Kconfig"

endif # MTD_SPI_NOR
```

## drivers/mtd/spi-nor/controllers/Kconfig
```kconfig
# SPDX-License-Identifier: GPL-2.0-only
config SPI_HISI_SFC
	tristate "Hisilicon FMC SPI NOR Flash Controller(SFC)"
	depends on ARCH_HISI || COMPILE_TEST
	depends on HAS_IOMEM
	help
	  This enables support for HiSilicon FMC SPI NOR flash controller.

config SPI_NXP_SPIFI
	tristate "NXP SPI Flash Interface (SPIFI)"
	depends on OF && (ARCH_LPC18XX || COMPILE_TEST)
	depends on HAS_IOMEM
	help
	  Enable support for the NXP LPC SPI Flash Interface controller.

	  SPIFI is a specialized controller for connecting serial SPI
	  Flash. Enable this option if you have a device with a SPIFI
	  controller and want to access the Flash as a mtd device.
```
