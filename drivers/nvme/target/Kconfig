## drivers/pci/hotplug/Kconfig
```kconfig
# SPDX-License-Identifier: GPL-2.0
#
# PCI Hotplug support
#

menuconfig HOTPLUG_PCI
	bool "Support for PCI Hotplug"
	depends on PCI && SYSFS
	default y if USB4
	help
	  Say Y here if you have a motherboard with a PCI Hotplug controller.
	  This allows you to add and remove PCI cards while the machine is
	  powered up and running.

	  Thunderbolt/USB4 PCIe tunneling depends on native PCIe hotplug.

	  When in doubt, say N.

if HOTPLUG_PCI

config HOTPLUG_PCI_COMPAQ
	tristate "Compaq PCI Hotplug driver"
	depends on X86 && PCI_BIOS
	help
	  Say Y here if you have a motherboard with a Compaq PCI Hotplug
	  controller.

	  To compile this driver as a module, choose M here: the
	  module will be called cpqphp.

	  When in doubt, say N.

config HOTPLUG_PCI_COMPAQ_NVRAM
	bool "Save configuration into NVRAM on Compaq servers"
	depends on HOTPLUG_PCI_COMPAQ
	help
	  Say Y here if you have a Compaq server that has a PCI Hotplug
	  controller.  This will allow the PCI Hotplug driver to store the PCI
	  system configuration options in NVRAM.

	  When in doubt, say N.

config HOTPLUG_PCI_IBM
	tristate "IBM PCI Hotplug driver"
	depends on X86_IO_APIC && X86 && PCI_BIOS
	help
	  Say Y here if you have a motherboard with a IBM PCI Hotplug
	  controller.

	  To compile this driver as a module, choose M here: the
	  module will be called ibmphp.

	  When in doubt, say N.

config HOTPLUG_PCI_ACPI
	bool "ACPI PCI Hotplug driver"
	depends on HOTPLUG_PCI=y && ((!ACPI_DOCK && ACPI) || (ACPI_DOCK))
	help
	  Say Y here if you have a system that supports PCI Hotplug using
	  ACPI.

	  When in doubt, say N.

config HOTPLUG_PCI_ACPI_AMPERE_ALTRA
	tristate "ACPI PCI Hotplug driver Ampere Altra extensions"
	depends on HOTPLUG_PCI_ACPI
	depends on HAVE_ARM_SMCCC_DISCOVERY
	help
	  Say Y here if you have an Ampere Altra system.

	  To compile this driver as a module, choose M here: the
	  module will be called acpiphp_ampere_altra.

	  When in doubt, say N.

config HOTPLUG_PCI_ACPI_IBM
	tristate "ACPI PCI Hotplug driver IBM extensions"
	depends on HOTPLUG_PCI_ACPI
	help
	  Say Y here if you have an IBM system that supports PCI Hotplug using
	  ACPI.

	  To compile this driver as a module, choose M here: the
	  module will be called acpiphp_ibm.

	  When in doubt, say N.

config HOTPLUG_PCI_CPCI
	bool "CompactPCI Hotplug driver"
	help
	  Say Y here if you have a CompactPCI system card with CompactPCI
	  hotswap support per the PICMG 2.1 specification.

	  When in doubt, say N.

config HOTPLUG_PCI_CPCI_ZT5550
	tristate "Ziatech ZT5550 CompactPCI Hotplug driver"
	depends on HOTPLUG_PCI_CPCI && X86
	help
	  Say Y here if you have an Performance Technologies (formerly Intel,
	  formerly just Ziatech) Ziatech ZT5550 CompactPCI system card.

	  To compile this driver as a module, choose M here: the
	  module will be called cpcihp_zt5550.

	  When in doubt, say N.

config HOTPLUG_PCI_CPCI_GENERIC
	tristate "Generic port I/O CompactPCI Hotplug driver"
	depends on HOTPLUG_PCI_CPCI && X86
	help
	  Say Y here if you have a CompactPCI system card that exposes the #ENUM
	  hotswap signal as a bit in a system register that can be read through
	  standard port I/O.

	  To compile this driver as a module, choose M here: the
	  module will be called cpcihp_generic.

	  When in doubt, say N.

config HOTPLUG_PCI_SHPC
	bool "SHPC PCI Hotplug driver"
	help
	  Say Y here if you have a motherboard with a SHPC PCI Hotplug
	  controller.

	  When in doubt, say N.

config HOTPLUG_PCI_POWERNV
	tristate "PowerPC PowerNV PCI Hotplug driver"
	depends on PPC_POWERNV && EEH
	select OF_DYNAMIC
	help
	  Say Y here if you run PowerPC PowerNV platform that supports
	  PCI Hotplug

	  To compile this driver as a module, choose M here: the
	  module will be called pnv-php.

	  When in doubt, say N.

config HOTPLUG_PCI_RPA
	tristate "RPA PCI Hotplug driver"
	depends on PPC_PSERIES && EEH
	help
	  Say Y here if you have a RPA system that supports PCI Hotplug.

	  To compile this driver as a module, choose M here: the
	  module will be called rpaphp.

	  When in doubt, say N.

config HOTPLUG_PCI_RPA_DLPAR
	tristate "RPA Dynamic Logical Partitioning for I/O slots"
	depends on HOTPLUG_PCI_RPA
	help
	  Say Y here if your system supports Dynamic Logical Partitioning
	  for I/O slots.

	  To compile this driver as a module, choose M here: the
	  module will be called rpadlpar_io.

	  When in doubt, say N.

config HOTPLUG_PCI_S390
	bool "System z PCI Hotplug Support"
	depends on S390 && 64BIT
	help
	  Say Y here if you want to use the System z PCI Hotplug
	  driver for PCI devices. Without this driver it is not
	  possible to access stand-by PCI functions nor to deconfigure
	  PCI functions.

	  When in doubt, say Y.

endif # HOTPLUG_PCI
```

## drivers/pci/pcie/Kconfig
```kconfig
# SPDX-License-Identifier: GPL-2.0
#
# PCI Express Port Bus Configuration
#
config PCIEPORTBUS
	bool "PCI Express Port Bus support"
	default y if USB4
	help
	  This enables PCI Express Port Bus support. Users can then enable
	  support for Native Hot-Plug, Advanced Error Reporting, Power
	  Management Events, and Downstream Port Containment.

#
# Include service Kconfig here
#
config HOTPLUG_PCI_PCIE
	bool "PCI Express Hotplug driver"
	depends on HOTPLUG_PCI && PCIEPORTBUS
	default y if USB4
	help
	  Say Y here if you have a motherboard that supports PCIe native
	  hotplug.

	  Thunderbolt/USB4 PCIe tunneling depends on native PCIe hotplug.

	  When in doubt, say N.

config PCIEAER
	bool "PCI Express Advanced Error Reporting support"
	depends on PCIEPORTBUS
	select RAS
	help
	  This enables PCI Express Root Port Advanced Error Reporting
	  (AER) driver support. Error reporting messages sent to Root
	  Port will be handled by PCI Express AER driver.

config PCIEAER_INJECT
	tristate "PCI Express error injection support"
	depends on PCIEAER
	select GENERIC_IRQ_INJECTION
	help
	  This enables PCI Express Root Port Advanced Error Reporting
	  (AER) software error injector.

	  Debugging AER code is quite difficult because it is hard
	  to trigger various real hardware errors. Software-based
	  error injection can fake almost all kinds of errors with the
	  help of a user space helper tool aer-inject, which can be
	  gotten from:
	     https://github.com/intel/aer-inject.git

config PCIEAER_CXL
	bool "PCI Express CXL RAS support"
	default y
	depends on PCIEAER && CXL_PCI
	help
	  Enables CXL error handling.

	  If unsure, say Y.

#
# PCI Express ECRC
#
config PCIE_ECRC
	bool "PCI Express ECRC settings control"
	depends on PCIEAER
	help
	  Used to override firmware/bios settings for PCI Express ECRC
	  (transaction layer end-to-end CRC checking).

	  When in doubt, say N.

#
# PCI Express ASPM
#
config PCIEASPM
	bool "PCI Express ASPM control" if EXPERT
	default y
	help
	  This enables OS control over PCI Express ASPM (Active State
	  Power Management) and Clock Power Management. ASPM supports
	  state L0/L0s/L1.

	  ASPM is initially set up by the firmware. With this option enabled,
	  Linux can modify this state in order to disable ASPM on known-bad
	  hardware or configurations and enable it when known-safe.

	  ASPM can be disabled or enabled at runtime via
	  /sys/module/pcie_aspm/parameters/policy

	  When in doubt, say Y.

choice
	prompt "Default ASPM policy"
	default PCIEASPM_DEFAULT
	depends on PCIEASPM

config PCIEASPM_DEFAULT
	bool "BIOS default"
	depends on PCIEASPM
	help
	  Use the BIOS defaults for PCI Express ASPM.

config PCIEASPM_POWERSAVE
	bool "Powersave"
	depends on PCIEASPM
	help
	  Enable PCI Express ASPM L0s and L1 where possible, even if the
	  BIOS did not.

config PCIEASPM_POWER_SUPERSAVE
	bool "Power Supersave"
	depends on PCIEASPM
	help
	  Same as PCIEASPM_POWERSAVE, except it also enables L1 substates where
	  possible. This would result in higher power savings while staying in L1
	  where the components support it.

config PCIEASPM_PERFORMANCE
	bool "Performance"
	depends on PCIEASPM
	help
	  Disable PCI Express ASPM L0s and L1, even if the BIOS enabled them.
endchoice

config PCIE_PME
	def_bool y
	depends on PCIEPORTBUS && PM

config PCIE_DPC
	bool "PCI Express Downstream Port Containment support"
	depends on PCIEPORTBUS && PCIEAER
	help
	  This enables PCI Express Downstream Port Containment (DPC)
	  driver support.  DPC events from Root and Downstream ports
	  will be handled by the DPC driver.  If your system doesn't
	  have this capability or you do not want to use this feature,
	  it is safe to answer N.

config PCIE_PTM
	bool "PCI Express Precision Time Measurement support"
	help
	  This enables PCI Express Precision Time Measurement (PTM)
	  support.

	  This is only useful if you have devices that support PTM, but it
	  is safe to enable even if you don't.

config PCIE_EDR
	bool "PCI Express Error Disconnect Recover support"
	depends on PCIE_DPC && ACPI
	help
	  This option adds Error Disconnect Recover support as specified
	  in the Downstream Port Containment Related Enhancements ECN to
	  the PCI Firmware Specification r3.2.  Enable this if you want to
	  support hybrid DPC model which uses both firmware and OS to
	  implement DPC.
```

## drivers/pci/pcie/aer/Kconfig
```kconfig
# SPDX-License-Identifier: GPL-2.0
#
# PCI Express Root Port Device AER Configuration
#

config PCIEAER
	bool "Root Port Advanced Error Reporting support"
	depends on PCIEPORTBUS
	select RAS
	default y
	help
	  This enables PCI Express Root Port Advanced Error Reporting
	  (AER) driver support. Error reporting messages sent to Root
	  Port will be handled by PCI Express AER driver.

config PCIEAER_INJECT
	tristate "PCIe AER error injector support"
	depends on PCIEAER
	default n
	help
	  This enables PCI Express Root Port Advanced Error Reporting
	  (AER) software error injector.

	  Debugging PCIe AER code is quite difficult because it is hard
	  to trigger various real hardware errors. Software based
	  error injection can fake almost all kinds of errors with the
	  help of a user space helper tool aer-inject, which can be
	  gotten from:
	     http://www.kernel.org/pub/linux/utils/pci/aer-inject/

#
# PCI Express ECRC
#
config PCIE_ECRC
	bool "PCI Express ECRC settings control"
	depends on PCIEAER
	help
	  Used to override firmware/bios settings for PCI Express ECRC
	  (transaction layer end-to-end CRC checking).

	  When in doubt, say N.
```

## drivers/pci/pcie/aer/Kconfig.debug
```kconfig
#
# PCI Express Root Port Device AER Debug Configuration
#

config PCIEAER_INJECT
	tristate "PCIe AER error injector support"
	depends on PCIEAER
	default n
	help
	  This enables PCI Express Root Port Advanced Error Reporting
	  (AER) software error injector.

	  Debugging PCIe AER code is quite difficult because it is hard
	  to trigger various real hardware errors. Software based
	  error injection can fake almost all kinds of errors with the
	  help of a user space helper tool aer-inject, which can be
	  gotten from:
	     http://www.kernel.org/pub/linux/utils/pci/aer-inject/
```

## drivers/pci/pwrctl/Kconfig
```kconfig
# SPDX-License-Identifier: GPL-2.0-only

config HAVE_PWRCTL
	bool

config PCI_PWRCTL
	tristate

config PCI_PWRCTL_PWRSEQ
	tristate
	select POWER_SEQUENCING
	select PCI_PWRCTL
```

## drivers/pci/pwrctrl/Kconfig
```kconfig
# SPDX-License-Identifier: GPL-2.0-only

config HAVE_PWRCTRL
	bool

config PCI_PWRCTRL
	tristate

config PCI_PWRCTRL_PWRSEQ
	tristate
	select POWER_SEQUENCING
	select PCI_PWRCTRL

config PCI_PWRCTRL_SLOT
	tristate "PCI Power Control driver for PCI slots"
	select POWER_SEQUENCING
	select PCI_PWRCTRL
	help
	  Say Y here to enable the PCI Power Control driver to control the power
	  state of PCI slots.

	  This is a generic driver that controls the power state of different
	  PCI slots. The voltage regulators powering the rails of the PCI slots
	  are expected to be defined in the devicetree node of the PCI bridge.

config PCI_PWRCTRL_TC9563
	tristate "PCI Power Control driver for TC9563 PCIe switch"
	select PCI_PWRCTRL
	default m if ARCH_QCOM
	depends on I2C
	help
	  Say Y here to enable the PCI Power Control driver of TC9563 PCIe
	  switch.

	  This driver enables power and configures the TC9563 PCIe switch
	  through i2c. TC9563 is a PCIe switch which has one upstream and three
	  downstream ports. To one of the downstream ports integrated ethernet
	  MAC is connected as endpoint device. Other two downstream ports are
	  supposed to connect to external device.

# deprecated
config HAVE_PWRCTL
	bool
	select HAVE_PWRCTRL

# deprecated
config PCI_PWRCTL_PWRSEQ
	tristate
	select PCI_PWRCTRL_PWRSEQ
```

## drivers/pci/switch/Kconfig
```kconfig
# SPDX-License-Identifier: GPL-2.0

menu "PCI switch controller drivers"
	depends on PCI

config PCI_SW_SWITCHTEC
	tristate "MicroSemi Switchtec PCIe Switch Management Driver"
	help
	 Enables support for the management interface for the MicroSemi
	 Switchtec series of PCIe switches. Supports userspace access
	 to submit MRPC commands to the switch via /dev/switchtecX
	 devices. See <file:Documentation/driver-api/switchtec.rst> for more
	 information.

endmenu
```
