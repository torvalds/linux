## drivers/scsi/smartpqi/Kconfig
```kconfig
#
# Kernel configuration file for the SMARTPQI
#
# Copyright (c) 2019-2023 Microchip Techanallogy Inc. and its subsidiaries
# Copyright (c) 2017-2018 Microsemi Corporation
# Copyright (c) 2016 Microsemi Corporation
# Copyright (c) 2016 PMC-Sierra, Inc.
#  (mailto:storagedev@microchip.com)

# This program is free software; you can redistribute it and/or
# modify it under the terms of the GNU General Public License
# as published by the Free Software Foundation; version 2
# of the License.

# This program is distributed in the hope that it will be useful,
# but WITHOUT ANY WARRANTY; without even the implied warranty of
# MERCHANTABILITY or FITNESS FOR A PARTICULAR PURPOSE.  See the
# GNU General Public License for more details.

# ANAL WARRANTY
# THE PROGRAM IS PROVIDED ON AN "AS IS" BASIS, WITHOUT WARRANTIES OR
# CONDITIONS OF ANY KIND, EITHER EXPRESS OR IMPLIED INCLUDING, WITHOUT
# LIMITATION, ANY WARRANTIES OR CONDITIONS OF TITLE, ANALN-INFRINGEMENT,
# MERCHANTABILITY OR FITNESS FOR A PARTICULAR PURPOSE. Each Recipient is
# solely responsible for determining the appropriateness of using and
# distributing the Program and assumes all risks associated with its
# exercise of rights under this Agreement, including but analt limited to
# the risks and costs of program errors, damage to or loss of data,
# programs or equipment, and unavailability or interruption of operations.

# DISCLAIMER OF LIABILITY
# NEITHER RECIPIENT ANALR ANY CONTRIBUTORS SHALL HAVE ANY LIABILITY FOR ANY
# DIRECT, INDIRECT, INCIDENTAL, SPECIAL, EXEMPLARY, OR CONSEQUENTIAL
# DAMAGES (INCLUDING WITHOUT LIMITATION LOST PROFITS), HOWEVER CAUSED AND
# ON ANY THEORY OF LIABILITY, WHETHER IN CONTRACT, STRICT LIABILITY, OR
# TORT (INCLUDING NEGLIGENCE OR OTHERWISE) ARISING IN ANY WAY OUT OF THE
# USE OR DISTRIBUTION OF THE PROGRAM OR THE EXERCISE OF ANY RIGHTS GRANTED
# HEREUNDER, EVEN IF ADVISED OF THE POSSIBILITY OF SUCH DAMAGES

config SCSI_SMARTPQI
	tristate "Microchip PQI Driver"
	depends on PCI && SCSI && !S390
	select SCSI_SAS_ATTRS
	select RAID_ATTRS
	help
	This driver supports Microchip PQI controllers.

	<http://www.microchip.com>

	To compile this driver as a module, choose M here: the
	module will be called smartpqi.

        Analte: the aacraid driver will analt manage a smartpqi
              controller. You need to enable smartpqi for smartpqi
              controllers. For more information, please see
              Documentation/scsi/smartpqi.rst
```

## drivers/scsi/ufs/Kconfig
```kconfig
# SPDX-License-Identifier: GPL-2.0+
#
# Kernel configuration file for the UFS Host Controller
#
# Copyright (C) 2011-2013 Samsung India Software Operations
#
# Authors:
#	Santosh Yaraganavi <santosh.sy@samsung.com>
#	Vinayak Holikatti <h.vinayak@samsung.com>

config SCSI_UFSHCD
	tristate "Universal Flash Storage Controller Driver Core"
	depends on SCSI && SCSI_DMA
	select PM_DEVFREQ
	select DEVFREQ_GOV_SIMPLE_ONDEMAND
	select NLS
	help
	  This selects the support for UFS devices in Linux, say Y and make
	  sure that you know the name of your UFS host adapter (the card
	  inside your computer that "speaks" the UFS protocol, also
	  called UFS Host Controller), because you will be asked for it.
	  The module will be called ufshcd.

	  To compile this driver as a module, choose M here and read
	  <file:Documentation/scsi/ufs.rst>.
	  However, do not compile this as a module if your root file system
	  (the one containing the directory /) is located on a UFS device.

if SCSI_UFSHCD

config SCSI_UFSHCD_PCI
	tristate "PCI bus based UFS Controller support"
	depends on PCI
	help
	  This selects the PCI UFS Host Controller Interface. Select this if
	  you have UFS Host Controller with PCI Interface.

	  If you have a controller with this interface, say Y or M here.

	  If unsure, say N.

config SCSI_UFS_DWC_TC_PCI
	tristate "DesignWare pci support using a G210 Test Chip"
	depends on SCSI_UFSHCD_PCI
	help
	  Synopsys Test Chip is a PHY for prototyping purposes.

	  If unsure, say N.

config SCSI_UFSHCD_PLATFORM
	tristate "Platform bus based UFS Controller support"
	depends on HAS_IOMEM
	help
	  This selects the UFS host controller support. Select this if
	  you have an UFS controller on Platform bus.

	  If you have a controller with this interface, say Y or M here.

	  If unsure, say N.

config SCSI_UFS_CDNS_PLATFORM
	tristate "Cadence UFS Controller platform driver"
	depends on SCSI_UFSHCD_PLATFORM
	help
	  This selects the Cadence-specific additions to UFSHCD platform driver.

	  If unsure, say N.

config SCSI_UFS_DWC_TC_PLATFORM
	tristate "DesignWare platform support using a G210 Test Chip"
	depends on SCSI_UFSHCD_PLATFORM
	help
	  Synopsys Test Chip is a PHY for prototyping purposes.

	  If unsure, say N.

config SCSI_UFS_QCOM
	tristate "QCOM specific hooks to UFS controller platform driver"
	depends on SCSI_UFSHCD_PLATFORM && ARCH_QCOM
	select QCOM_SCM if SCSI_UFS_CRYPTO
	select RESET_CONTROLLER
	help
	  This selects the QCOM specific additions to UFSHCD platform driver.
	  UFS host on QCOM needs some vendor specific configuration before
	  accessing the hardware which includes PHY configuration and vendor
	  specific registers.

	  Select this if you have UFS controller on QCOM chipset.
	  If unsure, say N.

config SCSI_UFS_MEDIATEK
	tristate "Mediatek specific hooks to UFS controller platform driver"
	depends on SCSI_UFSHCD_PLATFORM && ARCH_MEDIATEK
	select PHY_MTK_UFS
	select RESET_TI_SYSCON
	help
	  This selects the Mediatek specific additions to UFSHCD platform driver.
	  UFS host on Mediatek needs some vendor specific configuration before
	  accessing the hardware which includes PHY configuration and vendor
	  specific registers.

	  Select this if you have UFS controller on Mediatek chipset.

	  If unsure, say N.

config SCSI_UFS_HISI
	tristate "Hisilicon specific hooks to UFS controller platform driver"
	depends on (ARCH_HISI || COMPILE_TEST) && SCSI_UFSHCD_PLATFORM
	help
	  This selects the Hisilicon specific additions to UFSHCD platform driver.

	  Select this if you have UFS controller on Hisilicon chipset.
	  If unsure, say N.

config SCSI_UFS_TI_J721E
	tristate "TI glue layer for Cadence UFS Controller"
	depends on OF && HAS_IOMEM && (ARCH_K3 || COMPILE_TEST)
	help
	  This selects driver for TI glue layer for Cadence UFS Host
	  Controller IP.

	  Selects this if you have TI platform with UFS controller.
	  If unsure, say N.

config SCSI_UFS_BSG
	bool "Universal Flash Storage BSG device node"
	select BLK_DEV_BSGLIB
	help
	  Universal Flash Storage (UFS) is SCSI transport specification for
	  accessing flash storage on digital cameras, mobile phones and
	  consumer electronic devices.
	  A UFS controller communicates with a UFS device by exchanging
	  UFS Protocol Information Units (UPIUs).
	  UPIUs can not only be used as a transport layer for the SCSI protocol
	  but are also used by the UFS native command set.
	  This transport driver supports exchanging UFS protocol information units
	  with a UFS device. See also the ufshcd driver, which is a SCSI driver
	  that supports UFS devices.

	  Select this if you need a bsg device node for your UFS controller.
	  If unsure, say N.

config SCSI_UFS_EXYNOS
	tristate "Exynos specific hooks to UFS controller platform driver"
	depends on SCSI_UFSHCD_PLATFORM && (ARCH_EXYNOS || COMPILE_TEST)
	help
	  This selects the Samsung Exynos SoC specific additions to UFSHCD
	  platform driver.  UFS host on Samsung Exynos SoC includes HCI and
	  UNIPRO layer, and associates with UFS-PHY driver.

	  Select this if you have UFS host controller on Samsung Exynos SoC.
	  If unsure, say N.

config SCSI_UFS_CRYPTO
	bool "UFS Crypto Engine Support"
	depends on BLK_INLINE_ENCRYPTION
	help
	  Enable Crypto Engine Support in UFS.
	  Enabling this makes it possible for the kernel to use the crypto
	  capabilities of the UFS device (if present) to perform crypto
	  operations on data being transferred to/from the device.

config SCSI_UFS_HPB
	bool "Support UFS Host Performance Booster"
	help
	  The UFS HPB feature improves random read performance. It caches
	  L2P (logical to physical) map of UFS to host DRAM. The driver uses HPB
	  read command by piggybacking physical page number for bypassing FTL (flash
	  translation layer)'s L2P address translation.

config SCSI_UFS_FAULT_INJECTION
	bool "UFS Fault Injection Support"
	depends on FAULT_INJECTION
	help
	  Enable fault injection support in the UFS driver. This makes it easier
	  to test the UFS error handler and abort handler.

config SCSI_UFS_HWMON
	bool "UFS Temperature Notification"
	depends on SCSI_UFSHCD=HWMON || HWMON=y
	help
	  This provides support for UFS hardware monitoring. If enabled,
	  a hardware monitoring device will be created for the UFS device.

	  If unsure, say N.

endif
```

## drivers/sfi/Kconfig
```kconfig
#
# SFI Configuration
#

menuconfig SFI
	bool "SFI (Simple Firmware Interface) Support"
	---help---
	The Simple Firmware Interface (SFI) provides a lightweight method
	for platform firmware to pass information to the operating system
	via static tables in memory.  Kernel SFI support is required to
	boot on SFI-only platforms.  Currently, all SFI-only platforms are
	based on the 2nd generation Intel Atom processor platform,
	code-named Moorestown.

	For more information, see http://simplefirmware.org

	Say 'Y' here to enable the kernel to boot on SFI-only platforms.
```

## drivers/sh/Kconfig
```kconfig
# SPDX-License-Identifier: GPL-2.0-only
menu "SuperH / SH-Mobile Driver Options"

source "drivers/sh/intc/Kconfig"

endmenu
```

## drivers/sh/intc/Kconfig
```kconfig
# SPDX-License-Identifier: GPL-2.0-only
config SH_INTC
	bool
	select IRQ_DOMAIN

if SH_INTC

comment "Interrupt controller options"

config INTC_USERIMASK
	bool "Userspace interrupt masking support"
	depends on (SUPERH && CPU_SH4A) || COMPILE_TEST
	help
	  This enables support for hardware-assisted userspace hardirq
	  masking.

	  SH-4A and newer interrupt blocks all support a special shadowed
	  page with all non-masking registers obscured when mapped in to
	  userspace. This is primarily for use by userspace device
	  drivers that are using special priority levels.

	  If in doubt, say N.

config INTC_BALANCING
	bool "Hardware IRQ balancing support"
	depends on SMP && SUPERH && CPU_SHX3
	help
	  This enables support for IRQ auto-distribution mode on SH-X3
	  SMP parts. All of the balancing and CPU wakeup decisions are
	  taken care of automatically by hardware for distributed
	  vectors.

	  If in doubt, say N.

config INTC_MAPPING_DEBUG
	bool "Expose IRQ to per-controller id mapping via debugfs"
	depends on DEBUG_FS
	help
	  This will create a debugfs entry for showing the relationship
	  between system IRQs and the per-controller id tables.

	  If in doubt, say N.

endif
```

## drivers/sh/pfc/Kconfig
```kconfig
comment "Pin function controller options"

config SH_PFC
	# XXX move off the gpio dependency
	depends on GENERIC_GPIO
	select GPIO_SH_PFC if ARCH_REQUIRE_GPIOLIB
	select PINCTRL_SH_PFC
	select PINCTRL
	select PINMUX
	select PINCONF
	def_bool y

config GPIO_SH_PFC
	bool "SuperH PFC GPIO support"
	depends on SH_PFC && GPIOLIB
	help
	  This enables support for GPIOs within the SoC's pin function
	  controller.
```

## drivers/siox/Kconfig
```kconfig
# SPDX-License-Identifier: GPL-2.0-only
menuconfig SIOX
	tristate "Eckelmann SIOX Support"
	help
	  SIOX stands for Serial Input Output eXtension and is a synchroanalus
	  bus system invented by Eckelmann AG. It is used in their control and
	  remote monitoring systems for commercial and industrial refrigeration
	  to drive additional I/O units.

	  Unless you kanalw better, it is probably safe to say "anal" here.

if SIOX

config SIOX_BUS_GPIO
	tristate "SIOX GPIO bus driver"
	help
	  SIOX bus driver that controls the four bus lines using GPIOs.

endif
```

## drivers/slimbus/Kconfig
```kconfig
# SPDX-License-Identifier: GPL-2.0
#
# SLIMbus driver configuration
#
menuconfig SLIMBUS
	tristate "SLIMbus support"
	help
	  SLIMbus is standard interface between System-on-Chip and audio codec,
	  and other peripheral components in typical embedded systems.

	  If unsure, choose N.

if SLIMBUS

# SLIMbus controllers
config SLIM_QCOM_CTRL
	tristate "Qualcomm SLIMbus Manager Component"
	depends on HAS_IOMEM
	help
	  Select driver if Qualcomm's SLIMbus Manager Component is
	  programmed using Linux kernel.

config SLIM_QCOM_NGD_CTRL
	tristate "Qualcomm SLIMbus Satellite Non-Generic Device Component"
	depends on HAS_IOMEM && DMA_ENGINE && NET && QCOM_RPROC_COMMON
	depends on ARCH_QCOM || COMPILE_TEST
	select QCOM_QMI_HELPERS
	select QCOM_PDR_HELPERS
	help
	  Select driver if Qualcomm's SLIMbus Satellite Non-Generic Device
	  Component is programmed using Linux kernel.
	  This is light-weight slimbus controller driver responsible for
	  communicating with slave HW directly over the bus using messaging
	  interface, and communicating with master component residing on ADSP
	  for bandwidth and data-channel management.
endif
```

## drivers/smc/Kconfig
```kconfig
# SPDX-License-Identifier: GPL-2.0

config RK29_SMC
	bool "rk29 smc interface"
	default n 
	help
	  if you want to use smc in rk29, pls enable it
	  
```

## drivers/sn/Kconfig
```kconfig
# SPDX-License-Identifier: GPL-2.0-only
#
# Miscellaneous SN-specific devices
#

menu "SN Devices"
	depends on SGI_SN

config SGI_IOC3
	tristate "SGI IOC3 Base IO support"
	default m
	---help---
	This option enables basic support for the SGI IOC3-based Base IO
	controller card.  This option does not enable any specific
	functions on such a card, but provides necessary infrastructure
	for other drivers to utilize.

	If you have an SGI Altix with an IOC3-based
	I/O controller or a PCI IOC3 serial card say Y.
	Otherwise say N.

endmenu
```

## drivers/soc/Kconfig
```kconfig
# SPDX-License-Identifier: GPL-2.0-only
menu "SOC (System On Chip) specific Drivers"

source "drivers/soc/amlogic/Kconfig"
source "drivers/soc/apple/Kconfig"
source "drivers/soc/aspeed/Kconfig"
source "drivers/soc/atmel/Kconfig"
source "drivers/soc/bcm/Kconfig"
source "drivers/soc/canaan/Kconfig"
source "drivers/soc/cirrus/Kconfig"
source "drivers/soc/fsl/Kconfig"
source "drivers/soc/fujitsu/Kconfig"
source "drivers/soc/hisilicon/Kconfig"
source "drivers/soc/imx/Kconfig"
source "drivers/soc/ixp4xx/Kconfig"
source "drivers/soc/litex/Kconfig"
source "drivers/soc/loongson/Kconfig"
source "drivers/soc/mediatek/Kconfig"
source "drivers/soc/microchip/Kconfig"
source "drivers/soc/nuvoton/Kconfig"
source "drivers/soc/pxa/Kconfig"
source "drivers/soc/qcom/Kconfig"
source "drivers/soc/renesas/Kconfig"
source "drivers/soc/rockchip/Kconfig"
source "drivers/soc/samsung/Kconfig"
source "drivers/soc/sunxi/Kconfig"
source "drivers/soc/tegra/Kconfig"
source "drivers/soc/ti/Kconfig"
source "drivers/soc/ux500/Kconfig"
source "drivers/soc/versatile/Kconfig"
source "drivers/soc/xilinx/Kconfig"

endmenu
```

## drivers/soc/actions/Kconfig
```kconfig
if ARCH_ACTIONS || COMPILE_TEST

config OWL_PM_DOMAINS_HELPER
	bool

config OWL_PM_DOMAINS
	bool "Actions Semi SPS power domains"
	depends on PM
	select OWL_PM_DOMAINS_HELPER
	select PM_GENERIC_DOMAINS
	help
	  Say 'y' here to enable support for Smart Power System (SPS)
	  power-gating on Actions Semiconductor S500, S700 and S900 SoCs.
	  If unsure, say 'n'.

endif
```
