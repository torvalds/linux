## drivers/scsi/libsas/Kconfig
```kconfig
# SPDX-License-Identifier: GPL-2.0-only
#
# Kernel configuration file for the SAS Class
#
# Copyright (C) 2005 Adaptec, Inc.  All rights reserved.
# Copyright (C) 2005 Luben Tuikov <luben_tuikov@adaptec.com>
#

config SCSI_SAS_LIBSAS
	tristate "SAS Domain Transport Attributes"
	depends on SCSI
	select SCSI_SAS_ATTRS
	select BLK_DEV_BSGLIB
	help
	  This provides transport specific helpers for SAS drivers which
	  use the domain device construct (like the aic94xxx).

config SCSI_SAS_ATA
	bool "ATA support for libsas (requires libata)"
	depends on SCSI_SAS_LIBSAS
	depends on ATA = y || ATA = SCSI_SAS_LIBSAS
	help
		Builds in ATA support into libsas.  Will necessitate
		the loading of libata along with libsas.

config SCSI_SAS_HOST_SMP
	bool "Support for SMP interpretation for SAS hosts"
	default y
	depends on SCSI_SAS_LIBSAS
	help
		Allows sas hosts to receive SMP frames.  Selecting this
		option builds an SMP interpreter into libsas.  Say
		N here if you want to save the few kb this consumes.
```

## drivers/scsi/megaraid/Kconfig.megaraid
```kconfig
config MEGARAID_NEWGEN
	bool "LSI Logic New Generation RAID Device Drivers"
	depends on PCI && SCSI
	help
	LSI Logic RAID Device Drivers

config MEGARAID_MM
	tristate "LSI Logic Management Module (New Driver)"
	depends on PCI && SCSI && MEGARAID_NEWGEN
	help
	Management Module provides ioctl, sysfs support for LSI Logic
	RAID controllers.
	To compile this driver as a module, choose M here: the
	module will be called megaraid_mm


config MEGARAID_MAILBOX
	tristate "LSI Logic MegaRAID Driver (New Driver)"
	depends on PCI && SCSI && MEGARAID_MM
	help
	List of supported controllers

	OEM	Product Name		VID :DID :SVID:SSID
	---	------------		---- ---- ---- ----
	Dell PERC3/QC			101E:1960:1028:0471
	Dell PERC3/DC			101E:1960:1028:0493
	Dell PERC3/SC			101E:1960:1028:0475
	Dell PERC3/Di			1028:000E:1028:0123
	Dell PERC4/SC			1000:1960:1028:0520
	Dell PERC4/DC			1000:1960:1028:0518
	Dell PERC4/QC			1000:0407:1028:0531
	Dell PERC4/Di			1028:000F:1028:014A
	Dell PERC 4e/Si			1028:0013:1028:016c
	Dell PERC 4e/Di			1028:0013:1028:016d
	Dell PERC 4e/Di			1028:0013:1028:016e
	Dell PERC 4e/Di			1028:0013:1028:016f
	Dell PERC 4e/Di			1028:0013:1028:0170
	Dell PERC 4e/DC			1000:0408:1028:0002
	Dell PERC 4e/SC			1000:0408:1028:0001
	LSI MegaRAID SCSI 320-0		1000:1960:1000:A520
	LSI MegaRAID SCSI 320-1		1000:1960:1000:0520
	LSI MegaRAID SCSI 320-2		1000:1960:1000:0518
	LSI MegaRAID SCSI 320-0X	1000:0407:1000:0530
	LSI MegaRAID SCSI 320-2X	1000:0407:1000:0532
	LSI MegaRAID SCSI 320-4X	1000:0407:1000:0531
	LSI MegaRAID SCSI 320-1E	1000:0408:1000:0001
	LSI MegaRAID SCSI 320-2E	1000:0408:1000:0002
	LSI MegaRAID SATA 150-4		1000:1960:1000:4523
	LSI MegaRAID SATA 150-6		1000:1960:1000:0523
	LSI MegaRAID SATA 300-4X	1000:0409:1000:3004
	LSI MegaRAID SATA 300-8X	1000:0409:1000:3008
	INTEL RAID Controller SRCU42X	1000:0407:8086:0532
	INTEL RAID Controller SRCS16	1000:1960:8086:0523
	INTEL RAID Controller SRCU42E	1000:0408:8086:0002
	INTEL RAID Controller SRCZCRX	1000:0407:8086:0530
	INTEL RAID Controller SRCS28X	1000:0409:8086:3008
	INTEL RAID Controller SROMBU42E	1000:0408:8086:3431
	INTEL RAID Controller SROMBU42E	1000:0408:8086:3499
	INTEL RAID Controller SRCU51L	1000:1960:8086:0520
	FSC MegaRAID PCI Express ROMB	1000:0408:1734:1065
	ACER MegaRAID ROMB-2E		1000:0408:1025:004D
	NEC MegaRAID PCI Express ROMB	1000:0408:1033:8287

	To compile this driver as a module, choose M here: the
	module will be called megaraid_mbox

config MEGARAID_LEGACY
	tristate "LSI Logic Legacy MegaRAID Driver"
	depends on PCI && SCSI
	help
	This driver supports the LSI MegaRAID 418, 428, 438, 466, 762, 490
	and 467 SCSI host adapters. This driver also support the all U320
	RAID controllers

	To compile this driver as a module, choose M here: the
	module will be called megaraid

config MEGARAID_SAS
	tristate "LSI Logic MegaRAID SAS RAID Module"
	depends on PCI && SCSI
	help
	Module for LSI Logic's SAS based RAID controllers.
	To compile this driver as a module, choose 'm' here.
	Module will be called megaraid_sas
```

## drivers/scsi/mpi3mr/Kconfig
```kconfig
# SPDX-License-Identifier: GPL-2.0-or-later

config SCSI_MPI3MR
	tristate "Broadcom MPI3 Storage Controller Device Driver"
	depends on PCI && SCSI
	select BLK_DEV_BSGLIB
	select SCSI_SAS_ATTRS
	help
	MPI3 based Storage & RAID Controllers Driver.
```

## drivers/scsi/mpt2sas/Kconfig
```kconfig
#
# Kernel configuration file for the MPT2SAS
#
# This code is based on drivers/scsi/mpt2sas/Kconfig
# Copyright (C) 2007-2008  LSI Corporation
#  (mailto:DL-MPTFusionLinux@lsi.com)

# This program is free software; you can redistribute it and/or
# modify it under the terms of the GNU General Public License
# as published by the Free Software Foundation; either version 2
# of the License, or (at your option) any later version.

# This program is distributed in the hope that it will be useful,
# but WITHOUT ANY WARRANTY; without even the implied warranty of
# MERCHANTABILITY or FITNESS FOR A PARTICULAR PURPOSE.  See the
# GNU General Public License for more details.

# NO WARRANTY
# THE PROGRAM IS PROVIDED ON AN "AS IS" BASIS, WITHOUT WARRANTIES OR
# CONDITIONS OF ANY KIND, EITHER EXPRESS OR IMPLIED INCLUDING, WITHOUT
# LIMITATION, ANY WARRANTIES OR CONDITIONS OF TITLE, NON-INFRINGEMENT,
# MERCHANTABILITY OR FITNESS FOR A PARTICULAR PURPOSE. Each Recipient is
# solely responsible for determining the appropriateness of using and
# distributing the Program and assumes all risks associated with its
# exercise of rights under this Agreement, including but not limited to
# the risks and costs of program errors, damage to or loss of data,
# programs or equipment, and unavailability or interruption of operations.

# DISCLAIMER OF LIABILITY
# NEITHER RECIPIENT NOR ANY CONTRIBUTORS SHALL HAVE ANY LIABILITY FOR ANY
# DIRECT, INDIRECT, INCIDENTAL, SPECIAL, EXEMPLARY, OR CONSEQUENTIAL
# DAMAGES (INCLUDING WITHOUT LIMITATION LOST PROFITS), HOWEVER CAUSED AND
# ON ANY THEORY OF LIABILITY, WHETHER IN CONTRACT, STRICT LIABILITY, OR
# TORT (INCLUDING NEGLIGENCE OR OTHERWISE) ARISING IN ANY WAY OUT OF THE
# USE OR DISTRIBUTION OF THE PROGRAM OR THE EXERCISE OF ANY RIGHTS GRANTED
# HEREUNDER, EVEN IF ADVISED OF THE POSSIBILITY OF SUCH DAMAGES

# You should have received a copy of the GNU General Public License
# along with this program; if not, write to the Free Software
# Foundation, Inc., 51 Franklin Street, Fifth Floor, Boston, MA  02110-1301,
# USA.

config SCSI_MPT2SAS
	tristate "LSI MPT Fusion SAS 2.0 Device Driver"
	depends on PCI && SCSI
	select SCSI_SAS_ATTRS
	---help---
	This driver supports PCI-Express SAS 6Gb/s Host Adapters.

config SCSI_MPT2SAS_MAX_SGE
	int "LSI MPT Fusion Max number of SG Entries (16 - 128)"
	depends on PCI && SCSI && SCSI_MPT2SAS
	default "128"
	range 16 128
	---help---
	This option allows you to specify the maximum number of scatter-
	gather entries per I/O. The driver default is 128, which matches
	SAFE_PHYS_SEGMENTS.  However, it may decreased down to 16.
	Decreasing this parameter will reduce memory requirements
	on a per controller instance.

config SCSI_MPT2SAS_LOGGING
	bool "LSI MPT Fusion logging facility"
	depends on PCI && SCSI && SCSI_MPT2SAS
	---help---
	This turns on a logging facility.
```

## drivers/scsi/mvsas/Kconfig
```kconfig
# SPDX-License-Identifier: GPL-2.0-only
#
# Kernel configuration file for 88SE64XX/88SE94XX SAS/SATA driver.
#
# Copyright 2007 Red Hat, Inc.
# Copyright 2008 Marvell. <kewei@marvell.com>
# Copyright 2009-2011 Marvell. <yuxiangl@marvell.com>
#

config SCSI_MVSAS
	tristate "Marvell 88SE64XX/88SE94XX SAS/SATA support"
	depends on PCI && HAS_IOPORT
	select SCSI_SAS_LIBSAS
	select FW_LOADER
	help
		This driver supports Marvell's SAS/SATA 3Gb/s PCI-E 88SE64XX and 6Gb/s
		PCI-E 88SE94XX chip based host adapters.

config SCSI_MVSAS_DEBUG
	bool "Compile in debug mode"
	default y
	depends on SCSI_MVSAS
	help
		Compiles the 88SE64XX/88SE94XX driver in debug mode.  In debug mode,
		the driver prints some messages to the console.
config SCSI_MVSAS_TASKLET
	bool "Support for interrupt tasklet"
	default n
	depends on SCSI_MVSAS
	help
		Compiles the 88SE64xx/88SE94xx driver in interrupt tasklet mode.In this mode,
		the interrupt will schedule a tasklet.
```

## drivers/scsi/osd/Kconfig
```kconfig
#
# Kernel configuration file for the OSD scsi protocol
#
# Copyright (C) 2008 Panasas Inc.  All rights reserved.
#
# Authors:
#   Boaz Harrosh <bharrosh@panasas.com>
#   Benny Halevy <bhalevy@panasas.com>
#
# This program is free software; you can redistribute it and/or modify
# it under the terms of the GNU General Public version 2 License as
# published by the Free Software Foundation
#
# FIXME: SCSI_OSD_INITIATOR should select CONFIG (HMAC) SHA1 somehow.
#        How is it done properly?
#

config SCSI_OSD_INITIATOR
	tristate "OSD-Initiator library"
	depends on SCSI
	help
		Enable the OSD-Initiator library (libosd.ko).
		NOTE: You must also select CRYPTO_SHA1 + CRYPTO_HMAC and their
		dependencies

config SCSI_OSD_ULD
	tristate "OSD Upper Level driver"
	depends on SCSI_OSD_INITIATOR
	help
		Build a SCSI upper layer driver that exports /dev/osdX devices
		to user-mode for testing and controlling OSD devices. It is also
		needed by exofs, for mounting an OSD based file system.

config SCSI_OSD_DPRINT_SENSE
    int "(0-2) When sense is returned, DEBUG print all sense descriptors"
    default 1
    depends on SCSI_OSD_INITIATOR
    help
        When a CHECK_CONDITION status is returned from a target, and a
        sense-buffer is retrieved, turning this on will dump a full
        sense-decoding message. Setting to 2 will also print recoverable
        errors that might be regularly returned for some filesystem
        operations.

config SCSI_OSD_DEBUG
	bool "Compile All OSD modules with lots of DEBUG prints"
	default n
	depends on SCSI_OSD_INITIATOR
	help
		OSD Code is populated with lots of OSD_DEBUG(..) printouts to
		dmesg. Enable this if you found a bug and you want to help us
		track the problem (see also MAINTAINERS). Setting this will also
		force SCSI_OSD_DPRINT_SENSE=2.
```

## drivers/scsi/pcmcia/Kconfig
```kconfig
# SPDX-License-Identifier: GPL-2.0-only
#
# PCMCIA SCSI adapter configuration
#

menuconfig SCSI_LOWLEVEL_PCMCIA
	bool "PCMCIA SCSI adapter support"
	depends on SCSI!=n && PCMCIA!=n

# drivers have problems when build in, so require modules
if SCSI_LOWLEVEL_PCMCIA && SCSI && PCMCIA && m

config PCMCIA_AHA152X
	tristate "Adaptec AHA152X PCMCIA support"
	select SCSI_SPI_ATTRS
	help
	  Say Y here if you intend to attach this type of PCMCIA SCSI host
	  adapter to your computer.

	  To compile this driver as a module, choose M here: the
	  module will be called aha152x_cs.

config PCMCIA_FDOMAIN
	tristate "Future Domain PCMCIA support"
	select SCSI_FDOMAIN
	help
	  Say Y here if you intend to attach this type of PCMCIA SCSI host
	  adapter to your computer.

	  To compile this driver as a module, choose M here: the
	  module will be called fdomain_cs.

config PCMCIA_NINJA_SCSI
	tristate "NinjaSCSI-3 / NinjaSCSI-32Bi (16bit) PCMCIA support"
	depends on !64BIT
	help
	  If you intend to attach this type of PCMCIA SCSI host adapter to
	  your computer, say Y here and read
	  <file:Documentation/scsi/NinjaSCSI.txt>.

	  Supported cards:

	  NinjaSCSI-3: (version string: "WBT","NinjaSCSI-3","R1.0")
	    IO-DATA     PCSC-FP
	    ALPHA DATA  AD-PCS201
	    CyQ've      SFC-201  
	    LOGITECH    LPM-SCSI2E
	    Pioneer PCR-PR24's card
	    I-O DATA CDPS-PX24's card (PCSC-F)
	    Panasonic KXL-RW10AN CD-RW's card
	    etc.

	  NinjaSCSI-32Bit (in 16bit mode):
	    [Workbit (version string: "WORKBIT","UltraNinja-16","1")]
	    Jazz SCP050
	    [I-O DATA (OEM) (version string: "IO DATA","CBSC16       ","1")]
	    I-O DATA CBSC-II
	    [Kyusyu Matsushita Kotobuki (OEM)
               (version string: "KME    ","SCSI-CARD-001","1")]
	    KME KXL-820AN's card
	    HP M820e CDRW's card
	    etc.

	  To compile this driver as a module, choose M here: the
	  module will be called nsp_cs.

config PCMCIA_QLOGIC
	tristate "Qlogic PCMCIA support"
	help
	  Say Y here if you intend to attach this type of PCMCIA SCSI host
	  adapter to your computer.

	  To compile this driver as a module, choose M here: the
	  module will be called qlogic_cs.

config PCMCIA_SYM53C500
	tristate "Symbios 53c500 PCMCIA support"
	help
	  Say Y here if you have a New Media Bus Toaster or other PCMCIA
	  SCSI adapter based on the Symbios 53c500 controller.

	  To compile this driver as a module, choose M here: the
	  module will be called sym53c500_cs.

endif # SCSI_LOWLEVEL_PCMCIA
```

## drivers/scsi/qedf/Kconfig
```kconfig
# SPDX-License-Identifier: GPL-2.0-only
config QEDF
	tristate "QLogic QEDF 25/40/100Gb FCoE Initiator Driver Support"
	depends on PCI && SCSI
	depends on QED
        depends on LIBFC
        depends on LIBFCOE
	select QED_LL2
	select QED_FCOE
	help
	This driver supports FCoE offload for the QLogic FastLinQ
	41000 Series Converged Network Adapters.
```

## drivers/scsi/qedi/Kconfig
```kconfig
# SPDX-License-Identifier: GPL-2.0-only
config QEDI
	tristate "QLogic QEDI 25/40/100Gb iSCSI Initiator Driver Support"
	depends on PCI && SCSI && UIO
	depends on QED
	select SCSI_ISCSI_ATTRS
	select QED_LL2
	select QED_OOO
	select QED_ISCSI
	select ISCSI_BOOT_SYSFS
	---help---
	This driver supports iSCSI offload for the QLogic FastLinQ
	41000 Series Converged Network Adapters.
```

## drivers/scsi/qla2xxx/Kconfig
```kconfig
config SCSI_QLA_FC
	tristate "QLogic QLA2XXX Fibre Channel Support"
	depends on PCI && SCSI
	depends on SCSI_FC_ATTRS
	select FW_LOADER
	---help---
	This qla2xxx driver supports all QLogic Fibre Channel
	PCI and PCIe host adapters.

	By default, firmware for the ISP parts will be loaded
	via the Firmware Loader interface.

	ISP               Firmware Filename
	----------        -----------------
	21xx              ql2100_fw.bin
	22xx              ql2200_fw.bin
	2300, 2312, 6312  ql2300_fw.bin
	2322, 6322        ql2322_fw.bin
	24xx, 54xx        ql2400_fw.bin
	25xx              ql2500_fw.bin

	Upon request, the driver caches the firmware image until
	the driver is unloaded.

	Firmware images can be retrieved from:

		http://ldriver.qlogic.com/firmware/

	They are also included in the linux-firmware tree as well.

config TCM_QLA2XXX
	tristate "TCM_QLA2XXX fabric module for QLogic 24xx+ series target mode HBAs"
	depends on SCSI_QLA_FC && TARGET_CORE
	depends on LIBFC
	select BTREE
	default n
	---help---
	Say Y here to enable the TCM_QLA2XXX fabric module for QLogic 24xx+ series target mode HBAs

if TCM_QLA2XXX
config TCM_QLA2XXX_DEBUG
	bool "TCM_QLA2XXX fabric module DEBUG mode for QLogic 24xx+ series target mode HBAs"
	default n
	---help---
	Say Y here to enable the TCM_QLA2XXX fabric module DEBUG for QLogic 24xx+ series target mode HBAs
	This will include code to enable the SCSI command jammer
endif
```

## drivers/scsi/qla4xxx/Kconfig
```kconfig
# SPDX-License-Identifier: GPL-2.0-only
config SCSI_QLA_ISCSI
	tristate "QLogic ISP4XXX and ISP82XX host adapter family support"
	depends on PCI && SCSI && NET
	select SCSI_ISCSI_ATTRS
	select ISCSI_BOOT_SYSFS
	help
	This driver supports the QLogic 40xx (ISP4XXX), 8022 (ISP82XX)
	and 8032 (ISP83XX) iSCSI host adapter family.
```
