## drivers/clk/actions/Kconfig
```kconfig
# SPDX-License-Identifier: GPL-2.0-only
config CLK_ACTIONS
	bool "Clock driver for Actions Semi SoCs"
	depends on ARCH_ACTIONS || COMPILE_TEST
	select REGMAP_MMIO
	select RESET_CONTROLLER
	default ARCH_ACTIONS

if CLK_ACTIONS

# SoC Drivers

config CLK_OWL_S500
	bool "Support for the Actions Semi OWL S500 clocks"
	depends on ARCH_ACTIONS || COMPILE_TEST
	default ARCH_ACTIONS

config CLK_OWL_S700
	bool "Support for the Actions Semi OWL S700 clocks"
	depends on (ARM64 && ARCH_ACTIONS) || COMPILE_TEST
	default ARM64 && ARCH_ACTIONS

config CLK_OWL_S900
	bool "Support for the Actions Semi OWL S900 clocks"
	depends on (ARM64 && ARCH_ACTIONS) || COMPILE_TEST
	default ARM64 && ARCH_ACTIONS

endif
```

## drivers/clk/analogbits/Kconfig
```kconfig
# SPDX-License-Identifier: GPL-2.0-only
config CLK_ANALOGBITS_WRPLL_CLN28HPC
	tristate
```

## drivers/clk/aspeed/Kconfig
```kconfig
# SPDX-License-Identifier: GPL-2.0-only

config COMMON_CLK_ASPEED
        bool "Clock driver for Aspeed BMC SoCs"
        depends on ARCH_ASPEED || COMPILE_TEST
        default ARCH_ASPEED
        select MFD_SYSCON
        select RESET_CONTROLLER
        help
          This driver supports the SoC clocks on the Aspeed BMC platforms.

          The G4 and G5 series, including the ast2400 and ast2500, are supported
          by this driver.

config COMMON_CLK_AST2700
        bool "Clock driver for AST2700 SoC"
        depends on ARCH_ASPEED || COMPILE_TEST
        help
          This driver provides support for clock on AST2700 SoC.
          The driver is responsible for managing the various clocks required
          by the peripherals and cores within the AST2700.
```

## drivers/clk/baikal-t1/Kconfig
```kconfig
# SPDX-License-Identifier: GPL-2.0-only
config CLK_BAIKAL_T1
	bool "Baikal-T1 Clocks Control Unit interface"
	depends on (MIPS_BAIKAL_T1 && OF) || COMPILE_TEST
	default MIPS_BAIKAL_T1
	help
	  Clocks Control Unit is the core of Baikal-T1 SoC System Controller
	  responsible for the chip subsystems clocking and resetting. It
	  consists of multiple global clock domains, which can be reset by
	  means of the CCU control registers. These domains and devices placed
	  in them are fed with clocks generated by a hierarchy of PLLs,
	  configurable and fixed clock dividers. Enable this option to be able
	  to select Baikal-T1 CCU PLLs and Dividers drivers.

if CLK_BAIKAL_T1

config CLK_BT1_CCU_PLL
	bool "Baikal-T1 CCU PLLs support"
	select MFD_SYSCON
	default MIPS_BAIKAL_T1
	help
	  Enable this to support the PLLs embedded into the Baikal-T1 SoC
	  System Controller. These are five PLLs placed at the root of the
	  clocks hierarchy, right after an external reference oscillator
	  (normally of 25MHz). They are used to generate high frequency
	  signals, which are either directly wired to the consumers (like
	  CPUs, DDR, etc.) or passed over the clock dividers to be only
	  then used as an individual reference clock of a target device.

config CLK_BT1_CCU_DIV
	bool "Baikal-T1 CCU Dividers support"
	select MFD_SYSCON
	default MIPS_BAIKAL_T1
	help
	  Enable this to support the CCU dividers used to distribute clocks
	  between AXI-bus and system devices coming from CCU PLLs of Baikal-T1
	  SoC. CCU dividers can be either configurable or with fixed divider,
	  either gateable or ungateable. Some of the CCU dividers can be as well
	  used to reset the domains they're supplying clock to.

config CLK_BT1_CCU_RST
	bool "Baikal-T1 CCU Resets support"
	select RESET_CONTROLLER
	select MFD_SYSCON
	default MIPS_BAIKAL_T1
	help
	  Enable this to support the CCU reset blocks responsible for the
	  AXI-bus and some subsystems reset. These are mainly the
	  self-deasserted reset controls but there are several lines which
	  can be directly asserted/de-asserted (PCIe and DDR sub-domains).

endif
```

## drivers/clk/bcm/Kconfig
```kconfig
# SPDX-License-Identifier: GPL-2.0-only

config CLK_BCM2711_DVP
	tristate "Broadcom BCM2711 DVP support"
	depends on ARCH_BCM2835 ||COMPILE_TEST
	depends on COMMON_CLK
	default ARCH_BCM2835
	select RESET_CONTROLLER
	select RESET_SIMPLE
	help
	  Enable common clock framework support for the Broadcom BCM2711
	  DVP Controller.

config CLK_BCM2835
	bool "Broadcom BCM2835 clock support"
	depends on ARCH_BCM2835 || ARCH_BRCMSTB || COMPILE_TEST
	depends on COMMON_CLK
	default ARCH_BCM2835 || ARCH_BRCMSTB
	help
	  Enable common clock framework support for Broadcom BCM2835
	  SoCs.

config CLK_BCM_63XX
	bool "Broadcom BCM63xx clock support"
	depends on ARCH_BCM_63XX || COMPILE_TEST
	select COMMON_CLK_IPROC
	default ARCH_BCM_63XX
	help
	  Enable common clock framework support for Broadcom BCM63xx DSL SoCs
	  based on the ARM architecture

config CLK_BCM_63XX_GATE
	bool "Broadcom BCM63xx gated clock support"
	depends on BMIPS_GENERIC || COMPILE_TEST
	default BMIPS_GENERIC
	help
	  Enable common clock framework support for Broadcom BCM63xx DSL SoCs
	  based on the MIPS architecture

config CLK_BCM_KONA
	bool "Broadcom Kona CCU clock support"
	depends on ARCH_BCM_MOBILE || COMPILE_TEST
	default ARCH_BCM_MOBILE
	help
	  Enable common clock framework support for Broadcom SoCs
	  using "Kona" style clock control units, including those
	  in the BCM281xx and BCM21664 families.

config COMMON_CLK_IPROC
	bool
	help
	  Enable common clock framework support for Broadcom SoCs
	  based on the iProc architecture

config CLK_BCM_CYGNUS
	bool "Broadcom Cygnus clock support"
	depends on ARCH_BCM_CYGNUS || COMPILE_TEST
	select COMMON_CLK_IPROC
	default ARCH_BCM_CYGNUS
	help
	  Enable common clock framework support for the Broadcom Cygnus SoC

config CLK_BCM_HR2
	bool "Broadcom Hurricane 2 clock support"
	depends on ARCH_BCM_HR2 || COMPILE_TEST
	select COMMON_CLK_IPROC
	default ARCH_BCM_HR2
	help
	  Enable common clock framework support for the Broadcom Hurricane 2
	  SoC

config CLK_BCM_NSP
	bool "Broadcom Northstar/Northstar Plus clock support"
	depends on ARCH_BCM_5301X || ARCH_BCM_NSP || COMPILE_TEST
	select COMMON_CLK_IPROC
	default ARCH_BCM_5301X || ARCH_BCM_NSP
	help
	  Enable common clock framework support for the Broadcom Northstar and
	  Northstar Plus SoCs

config CLK_BCM_NS2
	bool "Broadcom Northstar 2 clock support"
	depends on ARCH_BCM_IPROC || COMPILE_TEST
	select COMMON_CLK_IPROC
	default ARCH_BCM_IPROC
	help
	  Enable common clock framework support for the Broadcom Northstar 2 SoC

config CLK_BCM_SR
	bool "Broadcom Stingray clock support"
	depends on ARCH_BCM_IPROC || COMPILE_TEST
	select COMMON_CLK_IPROC
	default ARCH_BCM_IPROC
	help
	  Enable common clock framework support for the Broadcom Stingray SoC

config CLK_RASPBERRYPI
	tristate "Raspberry Pi firmware based clock support"
	depends on RASPBERRYPI_FIRMWARE || (COMPILE_TEST && !RASPBERRYPI_FIRMWARE)
	help
	  Enable common clock framework support for Raspberry Pi's firmware
	  dependent clocks
```

## drivers/clk/hisilicon/Kconfig
```kconfig
# SPDX-License-Identifier: GPL-2.0-only
config COMMON_CLK_HI3516CV300
	tristate "HI3516CV300 Clock Driver"
	depends on ARCH_HISI || COMPILE_TEST
	select RESET_HISI
	default ARCH_HISI
	help
	  Build the clock driver for hi3516cv300.

config COMMON_CLK_HI3519
	tristate "Hi3519 Clock Driver"
	depends on ARCH_HISI || COMPILE_TEST
	select RESET_HISI
	default ARCH_HISI
	help
	  Build the clock driver for hi3519.

config COMMON_CLK_HI3559A
	bool "Hi3559A Clock Driver"
	depends on ARCH_HISI || COMPILE_TEST
	select RESET_HISI
	default ARCH_HISI
	help
	  Build the clock driver for hi3559a.

config COMMON_CLK_HI3660
	bool "Hi3660 Clock Driver"
	depends on ARCH_HISI || COMPILE_TEST
	default ARCH_HISI
	help
	  Build the clock driver for hi3660.

config COMMON_CLK_HI3670
	bool "Hi3670 Clock Driver"
	depends on ARCH_HISI || COMPILE_TEST
	default ARCH_HISI
	help
	  Build the clock driver for hi3670.

config COMMON_CLK_HI3798CV200
	tristate "Hi3798CV200 Clock Driver"
	depends on ARCH_HISI || COMPILE_TEST
	select RESET_HISI
	default ARCH_HISI
	help
	  Build the clock driver for hi3798cv200.

config COMMON_CLK_HI6220
	bool "Hi6220 Clock Driver"
	depends on ARCH_HISI || COMPILE_TEST
	default ARCH_HISI
	help
	  Build the Hisilicon Hi6220 clock driver based on the common clock framework.

config RESET_HISI
	bool "HiSilicon Reset Controller Driver"
	depends on ARCH_HISI || COMPILE_TEST
	select RESET_CONTROLLER
	help
	  Build reset controller driver for HiSilicon device chipsets.

config STUB_CLK_HI6220
	bool "Hi6220 Stub Clock Driver" if EXPERT
	depends on (COMMON_CLK_HI6220 || COMPILE_TEST)
	depends on MAILBOX
	default COMMON_CLK_HI6220
	help
	  Build the Hisilicon Hi6220 stub clock driver.

config STUB_CLK_HI3660
	bool "Hi3660 Stub Clock Driver" if EXPERT
	depends on (COMMON_CLK_HI3660 || COMPILE_TEST)
	depends on MAILBOX
	default COMMON_CLK_HI3660
	help
	  Build the Hisilicon Hi3660 stub clock driver.
```

## drivers/clk/imgtec/Kconfig
```kconfig
config COMMON_CLK_BOSTON
	bool "Clock driver for MIPS Boston boards"
	depends on MIPS || COMPILE_TEST
	select MFD_SYSCON
	---help---
	  Enable this to support the system & CPU clocks on the MIPS Boston
	  development board from Imagination Technologies. These are simple
	  fixed rate clocks whose rate is determined by reading a platform
	  provided register.
```

## drivers/clk/imx/Kconfig
```kconfig
# SPDX-License-Identifier: GPL-2.0
# common clock support for NXP i.MX SoC family.
config MXC_CLK
	tristate "IMX clock"
	depends on ARCH_MXC || COMPILE_TEST

config MXC_CLK_SCU
	tristate

config CLK_IMX1
	def_bool SOC_IMX1
	select MXC_CLK

config CLK_IMX25
	def_bool SOC_IMX25
	select MXC_CLK

config CLK_IMX27
	def_bool SOC_IMX27
	select MXC_CLK

config CLK_IMX31
	def_bool SOC_IMX31
	select MXC_CLK

config CLK_IMX35
	def_bool SOC_IMX35
	select MXC_CLK

config CLK_IMX5
	def_bool SOC_IMX5
	select MXC_CLK

config CLK_IMX6Q
	def_bool SOC_IMX6Q
	select MXC_CLK

config CLK_IMX6SL
	def_bool SOC_IMX6SL
	select MXC_CLK

config CLK_IMX6SLL
	def_bool SOC_IMX6SLL
	select MXC_CLK

config CLK_IMX6SX
	def_bool SOC_IMX6SX
	select MXC_CLK

config CLK_IMX6UL
	def_bool SOC_IMX6UL
	select MXC_CLK

config CLK_IMX7D
	def_bool SOC_IMX7D
	select MXC_CLK

config CLK_IMX7ULP
	def_bool SOC_IMX7ULP
	select MXC_CLK

config CLK_VF610
	def_bool SOC_VF610
	select MXC_CLK

config CLK_IMX8MM
	tristate "IMX8MM CCM Clock Driver"
	depends on ARCH_MXC || COMPILE_TEST
	select MXC_CLK
	help
	    Build the driver for i.MX8MM CCM Clock Driver

config CLK_IMX8MN
	tristate "IMX8MN CCM Clock Driver"
	depends on ARCH_MXC || COMPILE_TEST
	select MXC_CLK
	help
	    Build the driver for i.MX8MN CCM Clock Driver

config CLK_IMX8MP
	tristate "IMX8MP CCM Clock Driver"
	depends on ARCH_MXC || COMPILE_TEST
	select MXC_CLK
	help
	    Build the driver for i.MX8MP CCM Clock Driver

config CLK_IMX8MQ
	tristate "IMX8MQ CCM Clock Driver"
	depends on ARCH_MXC || COMPILE_TEST
	select MXC_CLK
	help
	    Build the driver for i.MX8MQ CCM Clock Driver

config CLK_IMX8QXP
	tristate "IMX8QXP SCU Clock"
	depends on (ARCH_MXC && ARM64) || COMPILE_TEST
	depends on IMX_SCU && HAVE_ARM_SMCCC
	select MXC_CLK_SCU
	select MXC_CLK
	help
	  Build the driver for IMX8QXP SCU based clocks.

config CLK_IMX8ULP
	tristate "IMX8ULP CCM Clock Driver"
	depends on ARCH_MXC || COMPILE_TEST
	select MXC_CLK
	help
	    Build the driver for i.MX8ULP CCM Clock Driver

config CLK_IMX93
	tristate "IMX93 CCM Clock Driver"
	depends on ARCH_MXC || COMPILE_TEST
	select MXC_CLK
	help
	    Build the driver for i.MX93 CCM Clock Driver

config CLK_IMXRT1050
	tristate "IMXRT1050 CCM Clock Driver"
	depends on SOC_IMXRT
	select MXC_CLK
	help
	    Build the driver for i.MXRT1050 CCM Clock Driver
```

## drivers/clk/ingenic/Kconfig
```kconfig
# SPDX-License-Identifier: GPL-2.0-only
menu "Ingenic SoCs drivers"
	depends on MIPS || COMPILE_TEST

config INGENIC_CGU_COMMON
	bool

config INGENIC_CGU_JZ4740
	bool "Ingenic JZ4740 CGU driver"
	default MACH_JZ4740
	select INGENIC_CGU_COMMON
	help
	  Support the clocks provided by the CGU hardware on Ingenic JZ4740
	  and compatible SoCs.

	  If building for a JZ4740 SoC, you want to say Y here.

config INGENIC_CGU_JZ4725B
	bool "Ingenic JZ4725B CGU driver"
	default MACH_JZ4725B
	select INGENIC_CGU_COMMON
	help
	  Support the clocks provided by the CGU hardware on Ingenic JZ4725B
	  and compatible SoCs.

	  If building for a JZ4725B SoC, you want to say Y here.

config INGENIC_CGU_JZ4760
	bool "Ingenic JZ4760 CGU driver"
	default MACH_JZ4760
	select INGENIC_CGU_COMMON
	help
	  Support the clocks provided by the CGU hardware on Ingenic JZ4760
	  and compatible SoCs.

	  If building for a JZ4760 SoC, you want to say Y here.

config INGENIC_CGU_JZ4770
	bool "Ingenic JZ4770 CGU driver"
	default MACH_JZ4770
	select INGENIC_CGU_COMMON
	help
	  Support the clocks provided by the CGU hardware on Ingenic JZ4770
	  and compatible SoCs.

	  If building for a JZ4770 SoC, you want to say Y here.

config INGENIC_CGU_JZ4780
	bool "Ingenic JZ4780 CGU driver"
	default MACH_JZ4780
	select INGENIC_CGU_COMMON
	help
	  Support the clocks provided by the CGU hardware on Ingenic JZ4780
	  and compatible SoCs.

	  If building for a JZ4780 SoC, you want to say Y here.

config INGENIC_CGU_X1000
	bool "Ingenic X1000 CGU driver"
	default MACH_X1000
	select INGENIC_CGU_COMMON
	help
	  Support the clocks provided by the CGU hardware on Ingenic X1000
	  and compatible SoCs.

	  If building for a X1000 SoC, you want to say Y here.

config INGENIC_CGU_X1830
	bool "Ingenic X1830 CGU driver"
	default MACH_X1830
	select INGENIC_CGU_COMMON
	help
	  Support the clocks provided by the CGU hardware on Ingenic X1830
	  and compatible SoCs.

	  If building for a X1830 SoC, you want to say Y here.

config INGENIC_TCU_CLK
	bool "Ingenic JZ47xx TCU clocks driver"
	default MACH_INGENIC
	select MFD_SYSCON
	help
	  Support the clocks of the Timer/Counter Unit (TCU) of the Ingenic
	  JZ47xx SoCs.

endmenu
```

## drivers/clk/keystone/Kconfig
```kconfig
# SPDX-License-Identifier: GPL-2.0-only
config COMMON_CLK_KEYSTONE
	tristate "Clock drivers for Keystone based SOCs"
	depends on (ARCH_KEYSTONE || COMPILE_TEST) && OF
	---help---
	  Supports clock drivers for Keystone based SOCs. These SOCs have local
	  a power sleep control module that gate the clock to the IPs and PLLs.

config TI_SCI_CLK
	tristate "TI System Control Interface clock drivers"
	depends on (ARCH_KEYSTONE || ARCH_K3 || COMPILE_TEST) && OF
	depends on TI_SCI_PROTOCOL
	default ARCH_KEYSTONE
	---help---
	  This adds the clock driver support over TI System Control Interface.
	  If you wish to use clock resources from the PMMC firmware, say Y.
	  Otherwise, say N.

config TI_SCI_CLK_PROBE_FROM_FW
	bool "Probe available clocks from firmware"
	depends on TI_SCI_CLK
	default n
	help
	  Forces the TI SCI clock driver to probe available clocks from the
	  firmware. By default, only the used clocks are probed from DT.
	  This is mostly only useful for debugging purposes, and will
	  increase the boot time of the device. If you want the clocks probed
	  from firmware, say Y. Otherwise, say N.

config TI_SYSCON_CLK
	tristate "Syscon based clock driver for K2/K3 SoCs"
	depends on ARCH_KEYSTONE || ARCH_K3 || COMPILE_TEST
	default ARCH_KEYSTONE || ARCH_K3
	help
	  This adds clock driver support for syscon based gate
	  clocks on TI's K2 and K3 SoCs.
```
