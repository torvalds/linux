## drivers/char/tpm/st33zp24/Kconfig
```kconfig
config TCG_TIS_ST33ZP24
	tristate
	---help---
	  STMicroelectronics ST33ZP24 core driver. It implements the core
	  TPM1.2 logic and hooks into the TPM kernel APIs. Physical layers will
	  register against it.

	  To compile this driver as a module, choose m here. The module will be called
	  tpm_st33zp24.

config TCG_TIS_ST33ZP24_I2C
	tristate "STMicroelectronics TPM Interface Specification 1.2 Interface (I2C)"
	depends on I2C
	select TCG_TIS_ST33ZP24
	---help---
	  This module adds support for the STMicroelectronics TPM security chip
	  ST33ZP24 with i2c interface.
	  To compile this driver as a module, choose M here; the module will be
	  called tpm_st33zp24_i2c.

config TCG_TIS_ST33ZP24_SPI
	tristate "STMicroelectronics TPM Interface Specification 1.2 Interface (SPI)"
	depends on SPI
	select TCG_TIS_ST33ZP24
	---help---
	  This module adds support for the STMicroelectronics TPM security chip
	  ST33ZP24 with spi interface.
	  To compile this driver as a module, choose M here; the module will be
	  called tpm_st33zp24_spi.
```

## drivers/char/xillybus/Kconfig
```kconfig
# SPDX-License-Identifier: GPL-2.0-only
#
# Xillybus devices
#

config XILLYBUS_CLASS
	tristate

config XILLYBUS
	tristate "Xillybus generic FPGA interface"
	depends on PCI || OF
	select CRC32
	select XILLYBUS_CLASS
	help
	  Xillybus is a generic interface for peripherals designed on
	  programmable logic (FPGA). The driver probes the hardware for
	  its capabilities, and creates device files accordingly.

	  If unsure, say N.

if XILLYBUS

config XILLYBUS_PCIE
	tristate "Xillybus over PCIe"
	depends on PCI_MSI
	help
	  Set to M if you want Xillybus to use PCI Express for communicating
	  with the FPGA. The module will be called xillybus_pcie.

config XILLYBUS_OF
	tristate "Xillybus over Device Tree"
	depends on OF && HAS_DMA && HAS_IOMEM
	help
	  Set to M if you want Xillybus to find its resources from the
	  Open Firmware Flattened Device Tree. If the target is an embedded
	  system, say M. The module will be called xillybus_of.

endif # if XILLYBUS

# XILLYUSB doesn't depend on XILLYBUS

config XILLYUSB
	tristate "XillyUSB: Xillybus generic FPGA interface for USB"
	depends on USB
	select CRC32
	select XILLYBUS_CLASS
	help
	  XillyUSB is the Xillybus variant which uses USB for communicating
	  with the FPGA.

	  Set to M if you want Xillybus to use USB for communicating with
	  the FPGA. The module will be called xillyusb.
```

## drivers/cir/Kconfig
```kconfig
# SPDX-License-Identifier: GPL-2.0
#
# CIR class/drivers configuration
#


menu "CIR support"
 config RK_CIR
	tristate "CIR support"
	help
	  if you want use ir remote function , pls enable it
 
choice  
	depends on RK_CIR
	prompt "CIR module name"
config BU92747GUW_CIR
	bool "bu92747guw cir"
endchoice

endmenu
```
