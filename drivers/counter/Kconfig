## drivers/crypto/chelsio/Kconfig
```kconfig
# SPDX-License-Identifier: GPL-2.0-only
config CRYPTO_DEV_CHELSIO
	tristate "Chelsio Crypto Co-processor Driver"
	depends on CHELSIO_T4
	select CRYPTO_LIB_AES
	select CRYPTO_LIB_GF128MUL
	select CRYPTO_LIB_SHA1
	select CRYPTO_LIB_SHA256
	select CRYPTO_LIB_SHA512
	select CRYPTO_AUTHENC
	help
	  The Chelsio Crypto Co-processor driver for T6 adapters.

	  For general information about Chelsio and our products, visit
	  our website at <http://www.chelsio.com>.

	  For customer support, please visit our customer support page at
	  <http://www.chelsio.com/support.html>.

	  Please send feedback to <linux-bugs@chelsio.com>.

	  To compile this driver as a module, choose M here: the module
	  will be called chcr.
```

## drivers/crypto/dwc-spacc/Kconfig
```kconfig
# SPDX-License-Identifier: GPL-2.0-only

config CRYPTO_DEV_SPACC
	tristate "Support for dw_spacc Security protocol accelerators"
	depends on HAS_DMA
	default m

	help
	  This enables support for the HASH/CRYP/AEAD hw accelerator which can be found
	  on dw_spacc IP.

config CRYPTO_DEV_SPACC_CIPHER
	bool "Enable CIPHER functionality"
	depends on CRYPTO_DEV_SPACC
	default y
	select CRYPTO_SKCIPHER
	select CRYPTO_LIB_DES
	select CRYPTO_AES
	select CRYPTO_CBC
	select CRYPTO_ECB
	select CRYPTO_CTR
	select CRYPTO_XTS
	select CRYPTO_CTS
	select CRYPTO_OFB
	select CRYPTO_CFB
	select CRYPTO_SM4_GENERIC
	select CRYPTO_CHACHA20

	help
	  Say y to enable Cipher functionality of SPACC.

config CRYPTO_DEV_SPACC_HASH
	bool "Enable HASH functionality"
	depends on CRYPTO_DEV_SPACC
	default y
	select CRYPTO_HASH
	select CRYPTO_SHA1
	select CRYPTO_MD5
	select CRYPTO_SHA256
	select CRYPTO_SHA512
	select CRYPTO_HMAC
	select CRYPTO_SM3
	select CRYPTO_CMAC
	select CRYPTO_MICHAEL_MIC
	select CRYPTO_XCBC
	select CRYPTO_AES
	select CRYPTO_SM4_GENERIC

	help
	  Say y to enable Hash functionality of SPACC.

config CRYPTO_DEV_SPACC_AEAD
	bool "Enable AEAD functionality"
	depends on CRYPTO_DEV_SPACC
	default y
	select CRYPTO_AEAD
	select CRYPTO_AUTHENC
	select CRYPTO_AES
	select CRYPTO_SM4_GENERIC
	select CRYPTO_CHACHAPOLY1305
	select CRYPTO_GCM
	select CRYPTO_CCM

	help
	  Say y to enable AEAD functionality of SPACC.

config CRYPTO_DEV_SPACC_AUTODETECT
	bool "Enable Autodetect functionality"
	depends on CRYPTO_DEV_SPACC
	default y
	help
	  Say y to enable Autodetect functionality

config CRYPTO_DEV_SPACC_DEBUG_TRACE_IO
	bool "Enable Trace MMIO reads/writes stats"
	depends on CRYPTO_DEV_SPACC
	default n
	help
	  Say y to enable Trace MMIO reads/writes stats.
	  To Debug and trace IO register read/write opration

config CRYPTO_DEV_SPACC_DEBUG_TRACE_DDT
	bool "Enable Trace DDT entries stats"
	default n
	depends on CRYPTO_DEV_SPACC
	help
	  Say y to enable Enable Trace DDT entries stats.
	  To Debug and trace DDT opration

config CRYPTO_DEV_SPACC_SECURE_MODE
	bool "Enable Spacc secure mode stats"
	default n
	depends on CRYPTO_DEV_SPACC
	help
	  Say y to enable Spacc secure modes stats.
```

## drivers/crypto/hisilicon/Kconfig
```kconfig
# SPDX-License-Identifier: GPL-2.0

config CRYPTO_DEV_HISI_SEC
	tristate "Support for Hisilicon SEC crypto block cipher accelerator"
	select CRYPTO_SKCIPHER
	select CRYPTO_ALGAPI
	select CRYPTO_LIB_DES
	select SG_SPLIT
	depends on ARM64 || COMPILE_TEST
	depends on HAS_IOMEM
	help
	  Support for Hisilicon SEC Engine in Hip06 and Hip07

	  To compile this as a module, choose M here: the module
	  will be called hisi_sec.

config CRYPTO_DEV_HISI_SEC2
	tristate "Support for HiSilicon SEC2 crypto block cipher accelerator"
	select CRYPTO_SKCIPHER
	select CRYPTO_ALGAPI
	select CRYPTO_LIB_DES
	select CRYPTO_DEV_HISI_QM
	select CRYPTO_AEAD
	select CRYPTO_AUTHENC
	select CRYPTO_HMAC
	select CRYPTO_SHA1
	select CRYPTO_SHA256
	select CRYPTO_SHA512
	select CRYPTO_SM4_GENERIC
	depends on PCI_MSI
	depends on UACCE || UACCE=n
	depends on ARM64 || (COMPILE_TEST && 64BIT)
	depends on ACPI
	help
	  Support for HiSilicon SEC Engine of version 2 in crypto subsystem.
	  It provides AES, SM4, and 3DES algorithms with ECB
	  CBC, and XTS cipher mode, and AEAD algorithms.

	  To compile this as a module, choose M here: the module
          will be called hisi_sec2.

config CRYPTO_DEV_HISI_QM
	tristate
	depends on ARM64 || COMPILE_TEST
	depends on PCI_MSI
	depends on UACCE || UACCE=n
	depends on ACPI
	help
	  HiSilicon accelerator engines use a common queue management
	  interface. Specific engine driver may use this module.

config CRYPTO_DEV_HISI_ZIP
	tristate "Support for HiSilicon ZIP accelerator"
	depends on PCI_MSI
	depends on ARM64 || (COMPILE_TEST && 64BIT)
	depends on !CPU_BIG_ENDIAN || COMPILE_TEST
	depends on UACCE || UACCE=n
	depends on ACPI
	select CRYPTO_DEV_HISI_QM
	help
	  Support for HiSilicon ZIP Driver

config CRYPTO_DEV_HISI_HPRE
	tristate "Support for HISI HPRE accelerator"
	depends on PCI_MSI
	depends on UACCE || UACCE=n
	depends on ARM64 || (COMPILE_TEST && 64BIT)
	depends on ACPI
	select CRYPTO_DEV_HISI_QM
	select CRYPTO_DH
	select CRYPTO_RSA
	select CRYPTO_CURVE25519
	select CRYPTO_ECDH
	help
	  Support for HiSilicon HPRE(High Performance RSA Engine)
	  accelerator, which can accelerate RSA and DH algorithms.

config CRYPTO_DEV_HISI_TRNG
	tristate "Support for HISI TRNG Driver"
	depends on ARM64 && ACPI
	select HW_RANDOM
	select CRYPTO_RNG
	help
	  Support for HiSilicon TRNG Driver.
```
