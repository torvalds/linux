## drivers/crypto/allwinner/Kconfig
```kconfig
config CRYPTO_DEV_ALLWINNER
	bool "Support for Allwinner cryptographic offloader"
	depends on ARCH_SUNXI || COMPILE_TEST
	default y if ARCH_SUNXI
	help
	  Say Y here to get to see options for Allwinner hardware crypto devices

config CRYPTO_DEV_SUN4I_SS
	tristate "Support for Allwinner Security System cryptographic accelerator"
	depends on ARCH_SUNXI
	depends on PM
	depends on CRYPTO_DEV_ALLWINNER
	select CRYPTO_MD5
	select CRYPTO_SHA1
	select CRYPTO_AES
	select CRYPTO_LIB_DES
	select CRYPTO_SKCIPHER
	help
	  Some Allwinner SoC have a crypto accelerator named
	  Security System. Select this if you want to use it.
	  The Security System handle AES/DES/3DES ciphers in CBC mode
	  and SHA1 and MD5 hash algorithms.

	  To compile this driver as a module, choose M here: the module
	  will be called sun4i-ss.

config CRYPTO_DEV_SUN4I_SS_PRNG
	bool "Support for Allwinner Security System PRNG"
	depends on CRYPTO_DEV_SUN4I_SS
	select CRYPTO_RNG
	help
	  Select this option if you want to provide kernel-side support for
	  the Pseudo-Random Number Generator found in the Security System.

config CRYPTO_DEV_SUN8I_CE
	tristate "Support for Allwinner Crypto Engine cryptographic offloader"
	select CRYPTO_SKCIPHER
	select CRYPTO_ENGINE
	select CRYPTO_ECB
	select CRYPTO_CBC
	select CRYPTO_AES
	select CRYPTO_DES
	depends on CRYPTO_DEV_ALLWINNER
	depends on PM
	help
	  Select y here to have support for the crypto Engine availlable on
	  Allwinner SoC H2+, H3, H5, H6, R40 and A64.
	  The Crypto Engine handle AES/3DES ciphers in ECB/CBC mode.

	  To compile this driver as a module, choose M here: the module
	  will be called sun8i-ce.

config CRYPTO_DEV_SUN8I_CE_DEBUG
	bool "Enable sun8i-ce stats"
	depends on CRYPTO_DEV_SUN8I_CE
	depends on DEBUG_FS
	help
	  Say y to enable sun8i-ce debug stats.
	  This will create /sys/kernel/debug/sun8i-ce/stats for displaying
	  the number of requests per flow and per algorithm.

config CRYPTO_DEV_SUN8I_CE_HASH
	bool "Enable support for hash on sun8i-ce"
	depends on CRYPTO_DEV_SUN8I_CE
	select MD5
	select SHA1
	select SHA256
	select SHA512
	help
	  Say y to enable support for hash algorithms.

config CRYPTO_DEV_SUN8I_CE_PRNG
	bool "Support for Allwinner Crypto Engine PRNG"
	depends on CRYPTO_DEV_SUN8I_CE
	select CRYPTO_RNG
	help
	  Select this option if you want to provide kernel-side support for
	  the Pseudo-Random Number Generator found in the Crypto Engine.

config CRYPTO_DEV_SUN8I_CE_TRNG
	bool "Support for Allwinner Crypto Engine TRNG"
	depends on CRYPTO_DEV_SUN8I_CE
	select HW_RANDOM
	help
	  Select this option if you want to provide kernel-side support for
	  the True Random Number Generator found in the Crypto Engine.

config CRYPTO_DEV_SUN8I_SS
	tristate "Support for Allwinner Security System cryptographic offloader"
	select CRYPTO_SKCIPHER
	select CRYPTO_ENGINE
	select CRYPTO_ECB
	select CRYPTO_CBC
	select CRYPTO_AES
	select CRYPTO_DES
	depends on CRYPTO_DEV_ALLWINNER
	depends on PM
	help
	  Select y here to have support for the Security System available on
	  Allwinner SoC A80, A83T.
	  The Security System handle AES/3DES ciphers in ECB/CBC mode.

	  To compile this driver as a module, choose M here: the module
	  will be called sun8i-ss.

config CRYPTO_DEV_SUN8I_SS_DEBUG
	bool "Enable sun8i-ss stats"
	depends on CRYPTO_DEV_SUN8I_SS
	depends on DEBUG_FS
	help
	  Say y to enable sun8i-ss debug stats.
	  This will create /sys/kernel/debug/sun8i-ss/stats for displaying
	  the number of requests per flow and per algorithm.

config CRYPTO_DEV_SUN8I_SS_PRNG
	bool "Support for Allwinner Security System PRNG"
	depends on CRYPTO_DEV_SUN8I_SS
	select CRYPTO_RNG
	help
	  Select this option if you want to provide kernel-side support for
	  the Pseudo-Random Number Generator found in the Security System.

config CRYPTO_DEV_SUN8I_SS_HASH
	bool "Enable support for hash on sun8i-ss"
	depends on CRYPTO_DEV_SUN8I_SS
	select MD5
	select SHA1
	select SHA256
	help
	  Say y to enable support for hash algorithms.
```

## drivers/crypto/amlogic/Kconfig
```kconfig
config CRYPTO_DEV_AMLOGIC_GXL
	tristate "Support for amlogic cryptographic offloader"
	default y if ARCH_MESON
	select CRYPTO_BLKCIPHER
	select CRYPTO_ENGINE
	select CRYPTO_ECB
	select CRYPTO_CBC
	select CRYPTO_AES
	help
	  Select y here to have support for the cryptographic offloader
	  available on Amlogic GXL SoC.
	  This hardware handles AES ciphers in ECB/CBC mode.

	  To compile this driver as a module, choose M here: the module
	  will be called amlogic-gxl-crypto.

config CRYPTO_DEV_AMLOGIC_GXL_DEBUG
	bool "Enable amlogic stats"
	depends on CRYPTO_DEV_AMLOGIC_GXL
	depends on DEBUG_FS
	help
	  Say y to enable amlogic-crypto debug stats.
	  This will create /sys/kernel/debug/gxl-crypto/stats for displaying
	  the number of requests per flow and per algorithm.
```

## drivers/crypto/aspeed/Kconfig
```kconfig
config CRYPTO_DEV_ASPEED
	bool "Support for Aspeed cryptographic engine driver"
	depends on ARCH_ASPEED || COMPILE_TEST
	select CRYPTO_ENGINE
	help
	  Say Y here to get to see options for Aspeed hardware crypto devices

if CRYPTO_DEV_ASPEED

config CRYPTO_DEV_ASPEED_DEBUG
	bool "Enable Aspeed crypto debug messages"
	help
	  Print Aspeed crypto debugging messages if you use this
	  option to ask for those messages.
	  Avoid enabling this option for production build to
	  minimize driver timing.

config CRYPTO_DEV_ASPEED_HACE
	tristate "Enable Aspeed Hash & Crypto Engine (HACE) Engine"
	help
	  Hash and Crypto Engine (HACE) is designed to accelerate the
	  throughput of hash data digest, encryption and decryption.

	  Select y here to have support for the cryptographic driver
	  available on Aspeed SoC.

config CRYPTO_DEV_ASPEED_HACE_HASH
	bool "Enable Aspeed Hash & Crypto Engine (HACE) hash"
	depends on CRYPTO_DEV_ASPEED_HACE
	select CRYPTO_SHA1
	select CRYPTO_SHA256
	select CRYPTO_SHA512
	select CRYPTO_HMAC
	help
	  Select here to enable Aspeed Hash & Crypto Engine (HACE)
	  hash driver.
	  Supports multiple message digest standards, including
	  SHA-1, SHA-224, SHA-256, SHA-384, SHA-512, and so on.

config CRYPTO_DEV_ASPEED_HACE_CRYPTO
	bool "Enable Aspeed Hash & Crypto Engine (HACE) crypto"
	depends on CRYPTO_DEV_ASPEED_HACE
	select CRYPTO_AES
	select CRYPTO_DES
	select CRYPTO_ECB
	select CRYPTO_CBC
	select CRYPTO_CFB
	select CRYPTO_OFB
	select CRYPTO_CTR
	help
	  Select here to enable Aspeed Hash & Crypto Engine (HACE)
	  crypto driver.
	  Supports AES/DES symmetric-key encryption and decryption
	  with ECB/CBC/CFB/OFB/CTR options.

config CRYPTO_DEV_ASPEED_ACRY
	tristate "Enable Aspeed ACRY RSA Engine"
	depends on MACH_ASPEED_G6
	select CRYPTO_RSA
	help
	  Select here to enable Aspeed ECC/RSA Engine (ACRY)
	  RSA driver.
	  Supports 256 bits to 4096 bits RSA encryption/decryption
	  and signature/verification.

config CRYPTO_DEV_ASPEED_RSSS
	tristate "Enable Aspeed RSSS Engine"
	depends on MACH_ASPEED_G7
	select CRYPTO_RSA
	select CRYPTO_SHA3
	select CRYPTO_SM3
	select CRYPTO_SM4
	help
	  Select here to enable Aspeed RSSS Engine driver.
	  Supports RSA 512 to 4096 bits encryption/decryption and
	  signature/verification, SHA3-224/256/384/512 and XOF of
	  SHAKE 128/256, SM3 Hash crypto, SM4 ECB/CBC/CFB/OFB/CTR
	  cryptographic algorithms.
	  It's a new hardware design from ast2700 for simply SRAM
	  layout.

config CRYPTO_DEV_ASPEED_ECDSA
	tristate "Enable Aspeed ECDSA Engine"
	depends on MACH_ASPEED_G7
	select CRYPTO_ECC
	select CRYPTO_ECDSA
	select CRYPTO_AKCIPHER
	help
	  Select here to enable Aspeed ECC Engine for ECDSA driver.
	  Supports ECDSA (Elliptic Curve Digital Signature Algorithm)
	  using curves P-256, P-384.
	  Only signature verification is implemented.

endif #CRYPTO_DEV_ASPEED
```

## drivers/crypto/caam/Kconfig
```kconfig
# SPDX-License-Identifier: GPL-2.0
config CRYPTO_DEV_FSL_CAAM_COMMON
	tristate

config CRYPTO_DEV_FSL_CAAM_CRYPTO_API_DESC
	tristate

config CRYPTO_DEV_FSL_CAAM_AHASH_API_DESC
	tristate

config CRYPTO_DEV_FSL_CAAM
	tristate "Freescale CAAM-Multicore platform driver backend"
	depends on FSL_SOC || ARCH_MXC || ARCH_LAYERSCAPE
	select SOC_BUS
	select CRYPTO_DEV_FSL_CAAM_COMMON
	help
	  Enables the driver module for Freescale's Cryptographic Accelerator
	  and Assurance Module (CAAM), also known as the SEC version 4 (SEC4).
	  This module creates job ring devices, and configures h/w
	  to operate as a DPAA component automatically, depending
	  on h/w feature availability.

	  To compile this driver as a module, choose M here: the module
	  will be called caam.

if CRYPTO_DEV_FSL_CAAM

config CRYPTO_DEV_FSL_CAAM_DEBUG
	bool "Enable debug output in CAAM driver"
	help
	  Selecting this will enable printing of various debug
	  information in the CAAM driver.

menuconfig CRYPTO_DEV_FSL_CAAM_JR
	tristate "Freescale CAAM Job Ring driver backend"
	default y
	help
	  Enables the driver module for Job Rings which are part of
	  Freescale's Cryptographic Accelerator
	  and Assurance Module (CAAM). This module adds a job ring operation
	  interface.

	  To compile this driver as a module, choose M here: the module
	  will be called caam_jr.

if CRYPTO_DEV_FSL_CAAM_JR

config CRYPTO_DEV_FSL_CAAM_RINGSIZE
	int "Job Ring size"
	range 2 9
	default "9"
	help
	  Select size of Job Rings as a power of 2, within the
	  range 2-9 (ring size 4-512).
	  Examples:
		2 => 4
		3 => 8
		4 => 16
		5 => 32
		6 => 64
		7 => 128
		8 => 256
		9 => 512

config CRYPTO_DEV_FSL_CAAM_INTC
	bool "Job Ring interrupt coalescing"
	help
	  Enable the Job Ring's interrupt coalescing feature.

	  Note: the driver already provides adequate
	  interrupt coalescing in software.

config CRYPTO_DEV_FSL_CAAM_INTC_COUNT_THLD
	int "Job Ring interrupt coalescing count threshold"
	depends on CRYPTO_DEV_FSL_CAAM_INTC
	range 1 255
	default 255
	help
	  Select number of descriptor completions to queue before
	  raising an interrupt, in the range 1-255. Note that a selection
	  of 1 functionally defeats the coalescing feature, and a selection
	  equal or greater than the job ring size will force timeouts.

config CRYPTO_DEV_FSL_CAAM_INTC_TIME_THLD
	int "Job Ring interrupt coalescing timer threshold"
	depends on CRYPTO_DEV_FSL_CAAM_INTC
	range 1 65535
	default 2048
	help
	  Select number of bus clocks/64 to timeout in the case that one or
	  more descriptor completions are queued without reaching the count
	  threshold. Range is 1-65535.

config CRYPTO_DEV_FSL_CAAM_CRYPTO_API
	bool "Register algorithm implementations with the Crypto API"
	default y
	select CRYPTO_DEV_FSL_CAAM_CRYPTO_API_DESC
	select CRYPTO_AEAD
	select CRYPTO_AUTHENC
	select CRYPTO_BLKCIPHER
	select CRYPTO_DES
	help
	  Selecting this will offload crypto for users of the
	  scatterlist crypto API (such as the linux native IPSec
	  stack) to the SEC4 via job ring.

config CRYPTO_DEV_FSL_CAAM_CRYPTO_API_QI
	bool "Queue Interface as Crypto API backend"
	depends on FSL_DPAA && NET
	default y
	select CRYPTO_DEV_FSL_CAAM_CRYPTO_API_DESC
	select CRYPTO_AUTHENC
	select CRYPTO_BLKCIPHER
	help
	  Selecting this will use CAAM Queue Interface (QI) for sending
	  & receiving crypto jobs to/from CAAM. This gives better performance
	  than job ring interface when the number of cores are more than the
	  number of job rings assigned to the kernel. The number of portals
	  assigned to the kernel should also be more than the number of
	  job rings.

config CRYPTO_DEV_FSL_CAAM_AHASH_API
	bool "Register hash algorithm implementations with Crypto API"
	default y
	select CRYPTO_DEV_FSL_CAAM_AHASH_API_DESC
	select CRYPTO_HASH
	help
	  Selecting this will offload ahash for users of the
	  scatterlist crypto API to the SEC4 via job ring.

config CRYPTO_DEV_FSL_CAAM_PKC_API
        bool "Register public key cryptography implementations with Crypto API"
        default y
        select CRYPTO_RSA
        help
          Selecting this will allow SEC Public key support for RSA.
          Supported cryptographic primitives: encryption, decryption,
          signature and verification.

config CRYPTO_DEV_FSL_CAAM_RNG_API
	bool "Register caam device for hwrng API"
	default y
	select CRYPTO_RNG
	select HW_RANDOM
	help
	  Selecting this will register the SEC4 hardware rng to
	  the hw_random API for suppying the kernel entropy pool.

endif # CRYPTO_DEV_FSL_CAAM_JR

endif # CRYPTO_DEV_FSL_CAAM

config CRYPTO_DEV_FSL_DPAA2_CAAM
	tristate "QorIQ DPAA2 CAAM (DPSECI) driver"
	depends on FSL_MC_DPIO
	depends on NETDEVICES
	select CRYPTO_DEV_FSL_CAAM_COMMON
	select CRYPTO_DEV_FSL_CAAM_CRYPTO_API_DESC
	select CRYPTO_DEV_FSL_CAAM_AHASH_API_DESC
	select CRYPTO_BLKCIPHER
	select CRYPTO_AUTHENC
	select CRYPTO_AEAD
	select CRYPTO_HASH
	help
	  CAAM driver for QorIQ Data Path Acceleration Architecture 2.
	  It handles DPSECI DPAA2 objects that sit on the Management Complex
	  (MC) fsl-mc bus.

	  To compile this as a module, choose M here: the module
	  will be called dpaa2_caam.
```

## drivers/crypto/cavium/cpt/Kconfig
```kconfig
# SPDX-License-Identifier: GPL-2.0-only
#
# Cavium crypto device configuration
#

config CRYPTO_DEV_CPT
	tristate

config CAVIUM_CPT
	tristate "Cavium Cryptographic Accelerator driver"
	depends on ARCH_THUNDER || COMPILE_TEST
	depends on PCI_MSI && 64BIT
	select CRYPTO_DEV_CPT
	help
	  Support for Cavium CPT block found in octeon-tx series of
	  processors.

	  To compile this as a module, choose M here.
```

## drivers/crypto/cavium/nitrox/Kconfig
```kconfig
# SPDX-License-Identifier: GPL-2.0-only
#
# Cavium NITROX Crypto Device configuration
#
config CRYPTO_DEV_NITROX
	tristate
	select CRYPTO_SKCIPHER
	select CRYPTO_AES
	select CRYPTO_LIB_DES
	select FW_LOADER

config CRYPTO_DEV_NITROX_CNN55XX
	tristate "Support for Cavium CNN55XX driver"
	depends on PCI_MSI && 64BIT
	select CRYPTO_DEV_NITROX
	help
	  Support for Cavium NITROX family CNN55XX driver
	  for accelerating crypto workloads.

	  To compile this as a module, choose M here: the module
	  will be called n5pf.
```

## drivers/crypto/ccp/Kconfig
```kconfig
# SPDX-License-Identifier: GPL-2.0-only
config CRYPTO_DEV_CCP_DD
	tristate "Secure Processor device driver"
	depends on CPU_SUP_AMD || ARM64
	default m
	help
	  Provides AMD Secure Processor device driver.
	  If you choose 'M' here, this module will be called ccp.

config CRYPTO_DEV_SP_CCP
	bool "Cryptographic Coprocessor device"
	default y
	depends on CRYPTO_DEV_CCP_DD
	select HW_RANDOM
	select DMA_ENGINE
	select DMADEVICES
	select CRYPTO_SHA1
	select CRYPTO_SHA256
	help
	  Provides the support for AMD Cryptographic Coprocessor (CCP) device
	  which can be used to offload encryption operations such as SHA, AES
	  and more.

config CRYPTO_DEV_CCP_CRYPTO
	tristate "Encryption and hashing offload support"
	default m
	depends on CRYPTO_DEV_CCP_DD
	depends on CRYPTO_DEV_SP_CCP
	select CRYPTO_HASH
	select CRYPTO_BLKCIPHER
	select CRYPTO_AUTHENC
	select CRYPTO_RSA
	help
	  Support for using the cryptographic API with the AMD Cryptographic
	  Coprocessor. This module supports offload of SHA and AES algorithms.
	  If you choose 'M' here, this module will be called ccp_crypto.

config CRYPTO_DEV_SP_PSP
	bool "Platform Security Processor (PSP) device"
	default y
	depends on CRYPTO_DEV_CCP_DD && X86_64
	help
	 Provide support for the AMD Platform Security Processor (PSP).
	 The PSP is a dedicated processor that provides support for key
	 management commands in Secure Encrypted Virtualization (SEV) mode,
	 along with software-based Trusted Execution Environment (TEE) to
	 enable third-party trusted applications.
```
