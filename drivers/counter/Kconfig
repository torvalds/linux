## drivers/cpuidle/Kconfig.arm
```kconfig
# SPDX-License-Identifier: GPL-2.0-only
#
# ARM CPU Idle drivers
#
config ARM_CPUIDLE
	bool "Generic ARM CPU idle Driver"
	depends on ARM
	select DT_IDLE_STATES
	select CPU_IDLE_MULTIPLE_DRIVERS
	help
	  Select this to enable generic cpuidle driver for ARM.
	  It provides a generic idle driver whose idle states are configured
	  at run-time through DT nodes. The CPUidle suspend backend is
	  initialized by calling the CPU operations init idle hook
	  provided by architecture code.

config ARM_PSCI_CPUIDLE
	bool "PSCI CPU idle Driver"
	depends on ARM_PSCI_FW
	select DT_IDLE_STATES
	select CPU_IDLE_MULTIPLE_DRIVERS
	help
	  Select this to enable PSCI firmware based CPUidle driver for ARM.
	  It provides an idle driver that is capable of detecting and
	  managing idle states through the PSCI firmware interface.

config ARM_PSCI_CPUIDLE_DOMAIN
	bool "PSCI CPU idle Domain"
	depends on ARM_PSCI_CPUIDLE
	depends on PM_GENERIC_DOMAINS_OF
	select DT_IDLE_GENPD
	default y
	help
	  Select this to enable the PSCI based CPUidle driver to use PM domains,
	  which is needed to support the hierarchical DT based layout of the
	  idle states.

config ARM_BIG_LITTLE_CPUIDLE
	bool "Support for ARM big.LITTLE processors"
	depends on ARCH_VEXPRESS_TC2_PM || ARCH_EXYNOS || COMPILE_TEST
	depends on MCPM && !ARM64
	select ARM_CPU_SUSPEND
	select CPU_IDLE_MULTIPLE_DRIVERS
	select DT_IDLE_STATES
	help
	  Select this option to enable CPU idle driver for big.LITTLE based
	  ARM systems. Driver manages CPUs coordination through MCPM and
	  define different C-states for little and big cores through the
	  multiple CPU idle drivers infrastructure.

config ARM_CLPS711X_CPUIDLE
	bool "CPU Idle Driver for CLPS711X processors"
	depends on ARCH_CLPS711X && !ARM64 || COMPILE_TEST
	help
	  Select this to enable cpuidle on Cirrus Logic CLPS711X SOCs.

config ARM_HIGHBANK_CPUIDLE
	bool "CPU Idle Driver for Calxeda processors"
	depends on ARM_PSCI && !ARM64
	select ARM_CPU_SUSPEND
	help
	  Select this to enable cpuidle on Calxeda processors.

config ARM_KIRKWOOD_CPUIDLE
	bool "CPU Idle Driver for Marvell Kirkwood SoCs"
	depends on (MACH_KIRKWOOD || COMPILE_TEST) && !ARM64
	help
	  This adds the CPU Idle driver for Marvell Kirkwood SoCs.

config ARM_ZYNQ_CPUIDLE
	bool "CPU Idle Driver for Xilinx Zynq processors"
	depends on (ARCH_ZYNQ || COMPILE_TEST) && !ARM64
	help
	  Select this to enable cpuidle on Xilinx Zynq processors.

config ARM_U8500_CPUIDLE
	bool "Cpu Idle Driver for the ST-E u8500 processors"
	depends on ARCH_U8500 && !ARM64
	help
	  Select this to enable cpuidle for ST-E u8500 processors.

config ARM_AT91_CPUIDLE
	bool "Cpu Idle Driver for the AT91 processors"
	default y
	depends on (ARCH_AT91 || COMPILE_TEST) && !ARM64
	help
	  Select this to enable cpuidle for AT91 processors.

config ARM_EXYNOS_CPUIDLE
	bool "Cpu Idle Driver for the Exynos processors"
	depends on (ARCH_EXYNOS || COMPILE_TEST) && !ARM64
	select ARCH_NEEDS_CPU_IDLE_COUPLED if SMP
	help
	  Select this to enable cpuidle for Exynos processors.

config ARM_MVEBU_V7_CPUIDLE
	bool "CPU Idle Driver for mvebu v7 family processors"
	depends on (ARCH_MVEBU || COMPILE_TEST) && !ARM64
	help
	  Select this to enable cpuidle on Armada 370, 38x and XP processors.

config ARM_TEGRA_CPUIDLE
	bool "CPU Idle Driver for NVIDIA Tegra SoCs"
	depends on (ARCH_TEGRA || COMPILE_TEST) && !ARM64 && MMU
	depends on ARCH_SUSPEND_POSSIBLE
	select ARCH_NEEDS_CPU_IDLE_COUPLED if SMP
	select ARM_CPU_SUSPEND
	help
	  Select this to enable cpuidle for NVIDIA Tegra20/30/114/124 SoCs.

config ARM_QCOM_SPM_CPUIDLE
	bool "CPU Idle Driver for Qualcomm Subsystem Power Manager (SPM)"
	depends on (ARCH_QCOM || COMPILE_TEST) && !ARM64 && MMU
	depends on ARCH_SUSPEND_POSSIBLE
	select ARM_CPU_SUSPEND
	select CPU_IDLE_MULTIPLE_DRIVERS
	select DT_IDLE_STATES
	select QCOM_SCM
	select QCOM_SPM
	help
	  Select this to enable cpuidle for Qualcomm processors.
	  The Subsystem Power Manager (SPM) controls low power modes for the
	  CPU and L2 cores. It interface with various system drivers to put
	  the cores in low power modes.
```

## drivers/cpuidle/Kconfig.arm64
```kconfig
#
# ARM64 CPU Idle drivers
#

config ARM64_CPUIDLE
	bool "Generic ARM64 CPU idle Driver"
	select ARM64_CPU_SUSPEND
	select DT_IDLE_STATES
	help
	  Select this to enable generic cpuidle driver for ARM64.
	  It provides a generic idle driver whose idle states are configured
	  at run-time through DT nodes. The CPUidle suspend backend is
	  initialized by calling the CPU operations init idle hook
	  provided by architecture code.
```

## drivers/cpuidle/Kconfig.mips
```kconfig
#
# MIPS CPU Idle Drivers
#
config MIPS_CPS_CPUIDLE
	bool "CPU Idle driver for MIPS CPS platforms"
	depends on CPU_IDLE && MIPS_CPS
	depends on SYS_SUPPORTS_MIPS_CPS
	select ARCH_NEEDS_CPU_IDLE_COUPLED if MIPS_MT || CPU_MIPSR6
	select GENERIC_CLOCKEVENTS_BROADCAST if SMP
	select MIPS_CPS_PM
	default y
	help
	  Select this option to enable processor idle state management
	  through cpuidle for systems built around the MIPS Coherent
	  Processing System (CPS) architecture. In order to make use of
	  the deepest idle states you will need to ensure that you are
	  also using the CONFIG_MIPS_CPS SMP implementation.
```

## drivers/cpuidle/Kconfig.powerpc
```kconfig
# SPDX-License-Identifier: GPL-2.0-only
#
# POWERPC CPU Idle Drivers
#
config PSERIES_CPUIDLE
	bool "Cpuidle driver for pSeries platforms"
	depends on CPU_IDLE
	depends on PPC_PSERIES
	default y
	help
	  Select this option to enable processor idle state management
	  through cpuidle subsystem.

config POWERNV_CPUIDLE
	bool "Cpuidle driver for powernv platforms"
	depends on CPU_IDLE
	depends on PPC_POWERNV
	default y
	help
	  Select this option to enable processor idle state management
	  through cpuidle subsystem.
```

## drivers/cpuidle/Kconfig.riscv
```kconfig
# SPDX-License-Identifier: GPL-2.0-only
#
# RISC-V CPU Idle drivers
#

config RISCV_SBI_CPUIDLE
	bool "RISC-V SBI CPU idle Driver"
	depends on RISCV_SBI
	select DT_IDLE_STATES
	select CPU_IDLE_MULTIPLE_DRIVERS
	select DT_IDLE_GENPD if PM_GENERIC_DOMAINS_OF
	help
	  Select this option to enable RISC-V SBI firmware based CPU idle
	  driver for RISC-V systems. This drivers also supports hierarchical
	  DT based layout of the idle state.
```

## drivers/cpuidle/Kconfig.s390
```kconfig
# SPDX-License-Identifier: GPL-2.0-only
#
# S390 CPU Idle drivers
#

config S390_CPUIDLE
	bool "S390 CPU idle driver"
	default y
	help
	  Select this option to enable processor idle state management
	  through cpuidle subsystem.
```

## drivers/cpuquiet/Kconfig
```kconfig
menu "CPUQUIET Framework"

config CPUQUIET_FRAMEWORK
	bool "Cpuquiet framework"
	help
	  Cpuquiet implements pluggable policies for forcing cpu cores into a
	  quiescent state. Appropriate policies will save power without hurting
	  performance.


if CPUQUIET_FRAMEWORK

config CPUQUIET_STATS
	bool "per CPU statistics"
	default n
	help
	  Enable up/down count and total time plugged statistics per CPU. These
	  depend on correct driver input for reliability

	  If in doubt say N.

config CPUQUIET_GOVERNOR_USERSPACE
	bool "userspace"
	default y
	help
	  Manual control of the number of CPUs online.
	  This governor allows userspace to control the number of online CPUs.

	  If in doubt say Y.

config CPUQUIET_GOVERNOR_BALANCED
	bool "balanced"
	default y
	depends on CPU_FREQ
	help
	  Scale the number of CPUs online depending on the CPU load.
	  This governor will scale the number of CPUs online depending on the
	  CPU load and the number of runnable threads.

	  If in doubt say Y.

config CPUQUIET_GOVERNOR_RUNNABLE
	bool "runnable threads"
	default y
	help
	  Scale the number of CPUs online depending on the number of runnable
	  threads.  This governor will scale the number of CPUs online depending
	  on the number of runnable threads.

	  If in doubt say Y.

choice
	prompt "Default CPUQuiet governor"
	default CPUQUIET_DEFAULT_GOV_USERSPACE
	help
	  This option sets which CPUQuiet governor shall be loaded at
	  startup. If in doubt, select 'userspace'.

config CPUQUIET_DEFAULT_GOV_USERSPACE
	bool "userspace"
	select CPUQUIET_GOVERNOR_USERSPACE
	help
	  Use the CPUQuiet governor 'userspace' as default.

config CPUQUIET_DEFAULT_GOV_BALANCED
	bool "balanced"
	select CPUQUIET_GOVERNOR_BALANCED
	depends on CPU_FREQ
	help
	  Use the CPUQuiet governor 'balanced' as default.

config CPUQUIET_DEFAULT_GOV_RUNNABLE
	bool "runnable threads"
	select CPUQUIET_GOVERNOR_RUNNABLE
	help
	  Use the CPUQuiet governor 'runnable threads' as default.

endchoice

endif
endmenu
```
