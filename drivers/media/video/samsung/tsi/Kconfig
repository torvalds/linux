## drivers/media/video/samsung/tsi/Kconfig
```kconfig
#
# Configuration for rotator
#

config VIDEO_TSI
	bool "Samsung Transport Stream Interface"
	depends on VIDEO_SAMSUNG && (CPU_EXYNOS4210 || CPU_S5PC100 || CPU_S5PC110 || CPU_S5PV210 || CPU_S5PV310)
	default n
	---help---
	  This is a Transport Stream Interface for Samsung  S5PC110.

config VIDEO_TSI_DEBUG
	bool "print TSI debug message"
	depends on VIDEO_TSI
	default n
config TSI_LIST_DEBUG
	bool "print TSI list debug message"
	depends on VIDEO_TSI
	default n
```

## drivers/media/video/samsung/tvout/Kconfig
```kconfig
#
# Configuration for TV driver
#

config VIDEO_TVOUT
	bool "Samsung TVOUT Driver"
	depends on VIDEO_SAMSUNG
	default y
	---help---
	  This is a TVOUT driver for Samsung S5P platform

choice
depends on VIDEO_TVOUT
prompt "Select default audio channel"
default VIDEO_TVOUT_2CH_AUDIO
config VIDEO_TVOUT_2CH_AUDIO
	bool "2ch audio mode"
	depends on VIDEO_TVOUT
	---help---
	  TV out supports 2 channel audio

config VIDEO_TVOUT_5_1CH_AUDIO
	bool "5.1ch audio mode"
	depends on VIDEO_TVOUT
	---help---
	  TV out supports 5.1 channel audio
endchoice

config HDMI_CEC
	bool "HDMI CEC driver support."
	depends on VIDEO_TVOUT && ARCH_EXYNOS4
	default y
	---help---
	  This is a HDMI CEC driver for Samsung S5P platform.
	  Check dev node (major 10, minor 242)

config HDMI_HPD
	bool "HDMI HPD driver support."
	depends on VIDEO_TVOUT && ARCH_EXYNOS4
	default y
	---help---
	  This is a HDMI HPD driver for Samsung S5P platform.
	  Check dev node (major 10, minor 243)

config HDMI_14A_3D
	bool "HDMI 14A driver support."
	depends on VIDEO_TVOUT && ARCH_EXYNOS4 && CPU_EXYNOS4212
	default y
	---help---
	  This is a HDMI 1.4A 3D driver for Samsung S5P platform.

config HDMI_PHY_32N
	bool "HDMI PHY 32N driver support."
	depends on VIDEO_TVOUT && HDMI_14A_3D && ARCH_EXYNOS4
	default y
	---help---
	  This is a HDMI PHY version for Samsung S5P platform.

config ANALOG_TVENC
	bool "Analog driver support."
	depends on VIDEO_TVOUT && ARCH_EXYNOS4 && CPU_EXYNOS4210
	default y
	---help---
	  This is a analog TVENC driver for Samsung S5P platform.

config VPLL_USE_FOR_TVENC
	bool "VPLL use for TVENC."
	depends on VIDEO_TVOUT && ANALOG_TVENC && ARCH_EXYNOS4
	default n
	---help---
	  This is a VPLL use of TVENC for Samsung S5P platform.

config TV_FB
	bool "TVOUT frame buffer driver support."
	select FB_CFB_FILLRECT
	select FB_CFB_COPYAREA
	select FB_CFB_IMAGEBLIT

	depends on VIDEO_TVOUT && FB && ARCH_EXYNOS4
	default y
	---help---

config USER_ALLOC_TVOUT
	bool "Support pre allocated frame buffer memory."
	depends on VIDEO_TVOUT && TV_FB
	default y
	---help---
	  TV Driver doesn't allocate memory for frame buffer.
	  So, before enabling TV out, the frame buffer should be allocated.

config TV_FB_NUM
	int "Index of TVOUT frame buffer"
	depends on VIDEO_TVOUT && TV_FB && !USER_ALLOC_TVOUT
	default 5
	---help---

config TV_DEBUG
	bool "TVOUT driver debug message"
	depends on VIDEO_TVOUT
	default n

config VP_DEBUG
	bool "Video Processor debug message"
	depends on TV_DEBUG
	default n

config MIXER_DEBUG
	bool "Mixer debug message"
	depends on TV_DEBUG
	default n

config HDMI_DEBUG
	bool "HDMI debug message"
	depends on TV_DEBUG
	default n

config SDO_DEBUG
	bool "SDO(Composite) debug message"
	depends on TV_DEBUG
	default n

config HDCP_DEBUG
	bool "HDCP debug message"
	depends on TV_DEBUG
	default n

config CEC_DEBUG
	bool "CEC debug message"
	depends on TV_DEBUG
	default n

config HPD_DEBUG
	bool "HPD debug message"
	depends on TV_DEBUG
	default n
```

## drivers/media/video/samsung/ump/Kconfig
```kconfig
#
## S3C Multimedia Mali configuration
##
#
# For UMP
config VIDEO_UMP
	bool "Enable UMP(Unified Memory Provider)"
	default y
	---help---
		This enables UMP memory provider

config UMP_VCM_ALLOC
	depends on VIDEO_UMP && VCM
	default y
        bool "Enable ump-vcm(virtual contiguous memory) memory"
        help
          Use VCM(virtual-contiguous-memory) to allocate physical memory.

choice
depends on VIDEO_UMP
prompt "UMP MEMEMORY OPTION"
default UMP_OSMEM_ONLY 
config UMP_DED_ONLY
  bool "ump dedicated memory only"
   ---help---
       This enables UMP dedicated memory only option
config UMP_OSMEM_ONLY
   bool "ump OS memory only"
   ---help---
       This enables UMP OS memory only option
config UMP_VCM_ONLY
   bool "ump VCM memory"
   ---help---
       This enables UMP VCM memory only option

endchoice
config UMP_MEM_SIZE
int "UMP Memory Size"
   depends on VIDEO_UMP 
   default "512"
   ---help---
       This value is dedicated memory size of UMP (unit is MByte).
# For UMP_DEBUG
config VIDEO_UMP_DEBUG
	bool "Enables debug messages"
	depends on VIDEO_UMP
	default n
	help
	  This enables UMP driver debug messages.
```

## drivers/media/video/smiapp/Kconfig
```kconfig
config VIDEO_SMIAPP
	tristate "SMIA++/SMIA sensor support"
	depends on I2C && VIDEO_V4L2 && VIDEO_V4L2_SUBDEV_API && HAVE_CLK
	select VIDEO_SMIAPP_PLL
	---help---
	  This is a generic driver for SMIA++/SMIA camera modules.
```

## drivers/media/video/sn9c102/Kconfig
```kconfig
config USB_SN9C102
	tristate "USB SN9C10x PC Camera Controller support"
	depends on USB && VIDEO_DEV
	---help---
	  Say Y here if you want support for cameras based on SONiX SN9C101,
	  SN9C102 or SN9C103 PC Camera Controllers.

	  See <file:Documentation/usb/sn9c102.txt> for more informations.

	  To compile this driver as a module, choose M here: the
	  module will be called sn9c102.
```

## drivers/media/video/sun3i/Kconfig
```kconfig
config VIDEO_DECODER_SUN3I
	tristate "sun3i video decoder support"
	depends on VIDEO_SUN3I_CEDAR
	default y
	---help---
	  This is the driver for sun3i video decoder, including h264/
	  mpeg4/mpeg2/vc1/rmvb.
	  To compile this driver as a module, choose M here: the
	  module will be called cedar_dev.

config VIDEO_AVS_COUNTER
	tristate "sun3i av-sync counter support"
	depends on VIDEO_SUN3I_CEDAR
	default n
	---help---
	  This is the driver for sun3i av-sync counter.
	  To compile this driver as a module, choose M here: the
	  module will be called avs_dev.
```

## drivers/media/video/sun4i/Kconfig
```kconfig
config VIDEO_DECODER_SUN4I
	tristate "sun4i video decoder support"
	depends on VIDEO_SUN4I_CEDAR
	default y
	---help---
	  This is the driver for sun4i video decoder, including h264/
	  mpeg4/mpeg2/vc1/rmvb. 
	  To compile this driver as a module, choose M here: the
	  module will be called cedar_dev.

config VIDEO_AVS_COUNTER
	tristate "sun4i av-sync counter support"
	depends on VIDEO_SUN4I_CEDAR
	default n
	---help---
	  This is the driver for sun4i av-sync counter.
	  To compile this driver as a module, choose M here: the
	  module will be called avs_dev.
```

## drivers/media/video/sun4i_csi/Kconfig
```kconfig
config CSI_DEV_SEL
	tristate

config CSI0_SUN4I
	tristate "CSI0 v4l2 driver for sun4i"
	default m
	depends on CSI_DEV_SEL&&I2C && VIDEO_DEV && VIDEO_V4L2
	select VIDEOBUF_DMA_CONTIG

config CSI1_SUN4I
	tristate "CSI1 v4l2 driver for sun4i"
	default m
	depends on CSI_DEV_SEL&&I2C && VIDEO_DEV && VIDEO_V4L2
	select VIDEOBUF_DMA_CONTIG

config CSI_OV7670
	tristate "OmniVision OV7670 sensor support"
	depends on I2C && VIDEO_V4L2
	select	CSI_DEV_SEL
	---help---
	  This is a Video4Linux2 sensor-level driver for the OmniVision
	  OV7670 VGA camera.

config CSI_GT2005
	tristate "GalaxyCore GT2005 2M sensor support"
	depends on I2C && VIDEO_V4L2
	select	CSI_DEV_SEL
	---help---
	  This is a Video4Linux2 sensor-level driver for the GalaxyCore
	  GT2005 2M camera.

config CSI_GC0308
	tristate "GalaxyCore GC0308 VGA sensor support"
	depends on I2C && VIDEO_V4L2
	select	CSI_DEV_SEL
	---help---
	  This is a Video4Linux2 sensor-level driver for the GalaxyCore
	  GC0308 VGA camera.

config CSI_HI704
	tristate "HYNIX HI704 VGA sensor support"
	depends on I2C && VIDEO_V4L2
	select	CSI_DEV_SEL
	---help---
	  This is a Video4Linux2 sensor-level driver for the Hynix
	  HI704 VGA camera.

config CSI_SP0838
	tristate "Superpix SP0838 VGA sensor support"
	depends on I2C && VIDEO_V4L2
	select	CSI_DEV_SEL
	---help---
	  This is a Video4Linux2 sensor-level driver for the Superpix
	  SP0838 VGA camera.

config CSI_MT9M112
	tristate "Micron MT9M112 UXGA sensor support"
	depends on I2C && VIDEO_V4L2
	select	CSI_DEV_SEL
	---help---
	  This is a Video4Linux2 sensor-level driver for the Micron
	  MT9M112 UXGA camera.

config CSI_MT9M113
	tristate "Micron MT9M113 SXGA sensor support"
	depends on I2C && VIDEO_V4L2
	select	CSI_DEV_SEL
	---help---
	  This is a Video4Linux2 sensor-level driver for the Micron
	  MT9M113 SXGA camera.

config CSI_OV2655
	tristate "OmniVision OV2655 UXGA sensor support"
	depends on I2C && VIDEO_V4L2
	select	CSI_DEV_SEL
	---help---
	  This is a Video4Linux2 sensor-level driver for the MOmniVision
	  OV2655 UXGA camera.

config CSI_HI253
	tristate "Hynix HI253 UXGA sensor support"
	depends on I2C && VIDEO_V4L2
	select	CSI_DEV_SEL
	---help---
	  This is a Video4Linux2 sensor-level driver for the Hynix
	  HI253 UXGA camera.

config CSI_MT9D112
	tristate "Micron MT9D112 UXGA sensor support"
	depends on I2C && VIDEO_V4L2
	select	CSI_DEV_SEL
	---help---
	  This is a Video4Linux2 sensor-level driver for the Micron
	  MT9D112 UXGA camera.

config CSI_GC0307
	tristate "GalaxyCore GC0307 VGA sensor support"
	depends on I2C && VIDEO_V4L2
	select	CSI_DEV_SEL
	---help---
	  This is a Video4Linux2 sensor-level driver for the GalaxyCore
	  GC0307 VGA camera.

config CSI_OV5640
	tristate "OmniVision OV5640 5M sensor support"
	depends on I2C && VIDEO_V4L2
	select	CSI_DEV_SEL
	---help---
	  This is a Video4Linux2 sensor-level driver for the OmniVision
	  OV5640 5M camera.
```

## drivers/media/video/sun5i/Kconfig
```kconfig
config VIDEO_DECODER_SUN5I
	tristate "sun5i video decoder support"
	depends on VIDEO_SUN5I_CEDAR
	default y
	---help---
	  This is the driver for sun4i video decoder, including h264/
	  mpeg4/mpeg2/vc1/rmvb.
	  To compile this driver as a module, choose M here: the
	  module will be called cedar_dev.

config VIDEO_AVS_COUNTER
	tristate "sun5i av-sync counter support"
	depends on VIDEO_SUN5I_CEDAR
	default n
	---help---
	  This is the driver for sun4i av-sync counter.
	  To compile this driver as a module, choose M here: the
	  module will be called avs_dev.
```

## drivers/media/video/sunxi/Kconfig
```kconfig
config VIDEO_DECODER_SUNXI
	tristate "sunxi video decoder support"
	depends on VIDEO_SUNXI_CEDAR
	default m
	---help---
	  This is the driver for sunxi video decoder, including h264/
	  mpeg4/mpeg2/vc1/rmvb.
	  To compile this driver as a module, choose M here: the
	  module will be called cedar_dev.

config VIDEO_AVS_COUNTER
	tristate "sunxi av-sync counter support"
	depends on VIDEO_SUNXI_CEDAR
	default n
	---help---
	  This is the driver for sunxi av-sync counter.
	  To compile this driver as a module, choose M here: the
	  module will be called avs_dev.
```

## drivers/media/video/tegra/Kconfig
```kconfig
source "drivers/media/video/tegra/avp/Kconfig"

config TEGRA_CAMERA
        bool "Enable support for tegra camera/isp hardware"
        depends on ARCH_TEGRA
        default y
        help
          Enables support for the Tegra camera interface

          If unsure, say Y
```

## drivers/media/video/tegra/avp/Kconfig
```kconfig
config TEGRA_RPC
	bool "Enable support for Tegra RPC"
	depends on ARCH_TEGRA
	default y
	help
	  Enables support for the RPC mechanism necessary for the Tegra
	  multimedia framework. It is both used to communicate locally on the
	  CPU between multiple multimedia components as well as to communicate
	  with the AVP for offloading media decode.

	  Exports the local tegra RPC interface on device node
	  /dev/tegra_rpc. Also provides tegra fd based semaphores needed by
	  the tegra multimedia framework.

	  If unsure, say Y

config TEGRA_AVP
	bool "Enable support for the AVP multimedia offload engine"
	depends on ARCH_TEGRA && TEGRA_RPC
	default y
	help
	  Enables support for the multimedia offload engine used by Tegra
	  multimedia framework.

	  If unsure, say Y
```

## drivers/media/video/tlg2300/Kconfig
```kconfig
config VIDEO_TLG2300
	tristate "Telegent TLG2300 USB video capture support"
	depends on VIDEO_DEV && I2C && INPUT && SND && DVB_CORE
	select VIDEO_TUNER
	select VIDEO_TVEEPROM
	select VIDEO_IR
	select VIDEOBUF_VMALLOC
	select SND_PCM
	select VIDEOBUF_DVB

	---help---
	  This is a video4linux driver for Telegent tlg2300 based TV cards.
	  The driver supports V4L2, DVB-T and radio.

	  To compile this driver as a module, choose M here: the
	  module will be called poseidon
```

## drivers/media/video/usbvideo/Kconfig
```kconfig
config VIDEO_USBVIDEO
	tristate

config USB_VICAM
	tristate "USB 3com HomeConnect (aka vicam) support (EXPERIMENTAL)"
	depends on VIDEO_V4L1 && EXPERIMENTAL
	select VIDEO_USBVIDEO
	---help---
	  Say Y here if you have 3com homeconnect camera (vicam).

	  To compile this driver as a module, choose M here: the
	  module will be called vicam.
```

## drivers/media/video/usbvision/Kconfig
```kconfig
config VIDEO_USBVISION
	tristate "USB video devices based on Nogatech NT1003/1004/1005"
	depends on I2C && VIDEO_V4L2
	select MEDIA_TUNER
	select VIDEO_SAA711X if VIDEO_HELPER_CHIPS_AUTO
	---help---
	  There are more than 50 different USB video devices based on
	  NT1003/1004/1005 USB Bridges. This driver enables using those
	  devices.

	  To compile this driver as a module, choose M here: the
	  module will be called usbvision.
```

## drivers/media/video/uvc/Kconfig
```kconfig
config USB_VIDEO_CLASS
	tristate "USB Video Class (UVC)"
	---help---
	  Support for the USB Video Class (UVC).  Currently only video
	  input devices, such as webcams, are supported.

	  For more information see: <http://linux-uvc.berlios.de/>

config USB_VIDEO_CLASS_INPUT_EVDEV
	bool "UVC input events device support"
	default y
	depends on USB_VIDEO_CLASS=INPUT || INPUT=y
	---help---
	  This option makes USB Video Class devices register an input device
	  to report button events.

	  If you are in doubt, say Y.
```

## drivers/media/video/zc0301/Kconfig
```kconfig
config USB_ZC0301
	tristate "USB ZC0301[P] webcam support (DEPRECATED)"
	depends on VIDEO_V4L2
	default n
	---help---
	  This driver is DEPRECATED please use the gspca zc3xx module
	  instead.

	  Say Y here if you want support for cameras based on the ZC0301 or
	  ZC0301P Image Processors and Control Chips.

	  See <file:Documentation/video4linux/zc0301.txt> for more info.

	  To compile this driver as a module, choose M here: the
	  module will be called zc0301.
```
