## drivers/media/video/ivtv/Kconfig
```kconfig
config VIDEO_IVTV
	tristate "Conexant cx23416/cx23415 MPEG encoder/decoder support"
	depends on VIDEO_V4L1 && VIDEO_V4L2 && PCI && I2C && EXPERIMENTAL
	select I2C_ALGOBIT
	select FW_LOADER
	select VIDEO_IR
	select VIDEO_TUNER
	select VIDEO_TVEEPROM
	select VIDEO_CX2341X
	select VIDEO_CX25840
	select VIDEO_MSP3400
	select VIDEO_SAA711X
	select VIDEO_SAA7127
	select VIDEO_TVAUDIO
	select VIDEO_CS53L32A
	select VIDEO_M52790
	select VIDEO_WM8775
	select VIDEO_WM8739
	select VIDEO_VP27SMPX
	select VIDEO_UPD64031A
	select VIDEO_UPD64083
	---help---
	  This is a video4linux driver for Conexant cx23416 or cx23415 based
	  PCI personal video recorder devices.

	  This is used in devices such as the Hauppauge PVR-150/250/350/500
	  cards. There is a driver homepage at <http://www.ivtvdriver.org>.

	  To compile this driver as a module, choose M here: the
	  module will be called ivtv.

config VIDEO_FB_IVTV
	tristate "Conexant cx23415 framebuffer support"
	depends on VIDEO_IVTV && FB && EXPERIMENTAL
	select FB_CFB_FILLRECT
	select FB_CFB_COPYAREA
	select FB_CFB_IMAGEBLIT
	---help---
	  This is a framebuffer driver for the Conexant cx23415 MPEG
	  encoder/decoder.

	  This is used in the Hauppauge PVR-350 card. There is a driver
	  homepage at <http://www.ivtvdriver.org>.

	  To compile this driver as a module, choose M here: the
	  module will be called ivtvfb.
```

## drivers/media/video/m5mols/Kconfig
```kconfig
config VIDEO_M5MOLS
	tristate "Fujitsu M-5MOLS 8MP sensor support"
	depends on I2C && VIDEO_V4L2 && VIDEO_V4L2_SUBDEV_API &&\
	(VIDEO_S5P_MIPI_CSIS || VIDEO_EXYNOS_MIPI_CSIS)
	---help---
	  This driver supports Fujitsu M-5MOLS camera sensor with ISP
```

## drivers/media/video/marvell-ccic/Kconfig
```kconfig
config VIDEO_CAFE_CCIC
	tristate "Marvell 88ALP01 (Cafe) CMOS Camera Controller support"
	depends on PCI && I2C && VIDEO_V4L2
	select VIDEO_OV7670
	---help---
	  This is a video4linux2 driver for the Marvell 88ALP01 integrated
	  CMOS camera controller.  This is the controller found on first-
	  generation OLPC systems.
```

## drivers/media/video/mhl/Kconfig
```kconfig
#
# mhl drivers configuration
#

menu "Mhl(sii9244) device support"


config SAMSUNG_MHL
        bool "Enable Sii9244 MHL Chip Driver"
        default n
        ---help---
          support Sii9244 MHL Chip Driver


config SAMSUNG_USE_11PIN_CONNECTOR
	bool "11pin micro-usb connector support"
	default n
	---help---
	  use 11pin micro usb connector instead of 5pin

config SAMSUNG_SMARTDOCK
	bool "smartdock support"
	default n

config SAMSUNG_WORKAROUND_HPD_GLANCE
	bool "To avoid some effect of MHL's HPD glitch"
	depends on (SAMSUNG_MHL || MHL_SII9234) && (CPU_EXYNOS4210 || CPU_EXYNOS4212 || CPU_EXYNOS4412)
	default y

config SAMSUNG_MHL_UNPOWERED
	bool "Use source vbus for mhl dongle if no external power"
	depends on (SAMSUNG_MHL || MHL_SII9234)
	default n
endmenu
```

## drivers/media/video/mv9335/Kconfig
```kconfig
# SPDX-License-Identifier: GPL-2.0
#
#  Fujitsu camera isp chip: m6moj.
#
choice
	prompt "Camera Sensor attached to mv9335"
	depends on SOC_CAMERA_MV9335
	default n
config MV9335_OV5650
	tristate "mv9335 attached ov5650"
	help
	Choose Y here if you have this this sensor and it is attach to mv9335
endchoice
```

## drivers/media/video/omap/Kconfig
```kconfig
config VIDEO_OMAP2_VOUT
	tristate "OMAP2/OMAP3 V4L2-Display driver"
	depends on ARCH_OMAP2 || ARCH_OMAP3
	select VIDEOBUF_GEN
	select VIDEOBUF_DMA_CONTIG
	select OMAP2_DSS
	select OMAP2_VRAM
	select OMAP2_VRFB
	default n
	---help---
	  V4L2 Display driver support for OMAP2/3 based boards.
```

## drivers/media/video/pvrusb2/Kconfig
```kconfig
config VIDEO_PVRUSB2
	tristate "Hauppauge WinTV-PVR USB2 support"
	depends on VIDEO_V4L2 && I2C
	depends on VIDEO_MEDIA	# Avoids pvrusb = Y / DVB = M
	select VIDEO_TUNER
	select VIDEO_TVEEPROM
	select VIDEO_CX2341X
	select VIDEO_SAA711X
	select VIDEO_CX25840
	select VIDEO_MSP3400
	select VIDEO_WM8775
	select VIDEO_CS53L32A
	---help---
	  This is a video4linux driver for Conexant 23416 based
	  usb2 personal video recorder devices.

	  To compile this driver as a module, choose M here: the
	  module will be called pvrusb2

config VIDEO_PVRUSB2_SYSFS
	bool "pvrusb2 sysfs support (EXPERIMENTAL)"
	default y
	depends on VIDEO_PVRUSB2 && SYSFS && EXPERIMENTAL
	---help---
	  This option enables the operation of a sysfs based
	  interface for query and control of the pvrusb2 driver.

	  This is not generally needed for v4l applications,
	  although certain applications are optimized to take
	  advantage of this feature.

	  If you are in doubt, say Y.

	  Note: This feature is experimental and subject to change.

config VIDEO_PVRUSB2_DVB
	bool "pvrusb2 ATSC/DVB support (EXPERIMENTAL)"
	default y
	depends on VIDEO_PVRUSB2 && DVB_CORE && EXPERIMENTAL
	select DVB_LGDT330X if !DVB_FE_CUSTOMISE
	select DVB_S5H1409 if !DVB_FE_CUSTOMISE
	select DVB_S5H1411 if !DVB_FE_CUSTOMISE
	select DVB_TDA10048 if !DVB_FE_CUSTOMIZE
	select MEDIA_TUNER_TDA18271 if !DVB_FE_CUSTOMIZE
	select MEDIA_TUNER_SIMPLE if !MEDIA_TUNER_CUSTOMIZE
	select MEDIA_TUNER_TDA8290 if !DVB_FE_CUSTOMIZE
	---help---

	  This option enables a DVB interface for the pvrusb2 driver.
	  If your device does not support digital television, this
	  feature will have no affect on the driver's operation.

	  If you are in doubt, say Y.

config VIDEO_PVRUSB2_DEBUGIFC
	bool "pvrusb2 debug interface"
	depends on VIDEO_PVRUSB2_SYSFS
	---help---
	  This option enables the inclusion of a debug interface
	  in the pvrusb2 driver, hosted through sysfs.

	  You do not need to select this option unless you plan
	  on debugging the driver or performing a manual firmware
	  extraction.

	  If you are in doubt, say N.
```

## drivers/media/video/pwc/Kconfig
```kconfig
config USB_PWC
	tristate "USB Philips Cameras"
	depends on USB && VIDEO_V4L1
	---help---
	  Say Y or M here if you want to use one of these Philips & OEM
	  webcams:
	   * Philips PCA645, PCA646
	   * Philips PCVC675, PCVC680, PCVC690
	   * Philips PCVC720/40, PCVC730, PCVC740, PCVC750
	   * Askey VC010
	   * Logitech QuickCam Pro 3000, 4000, 'Zoom', 'Notebook Pro'
	     and 'Orbit'/'Sphere'
	   * Samsung MPC-C10, MPC-C30
	   * Creative Webcam 5, Pro Ex
	   * SOTEC Afina Eye
	   * Visionite VCS-UC300, VCS-UM100

	  The PCA635, PCVC665 and PCVC720/20 are not supported by this driver
	  and never will be, but the 665 and 720/20 are supported by other
	  drivers.

	  See <file:Documentation/usb/philips.txt> for more information and
	  installation instructions.

	  The built-in microphone is enabled by selecting USB Audio support.

	  To compile this driver as a module, choose M here: the
	  module will be called pwc.
```

## drivers/media/video/rk29xx/Kconfig
```kconfig
# SPDX-License-Identifier: GPL-2.0
config VIDEO_RK29XX_VOUT
	tristate "RK29XX V4L2-Display driver"
	depends on ARCH_RK29
	default n
	---help---
	  V4L2 Display driver support for RK29XX based boards.
```

## drivers/media/video/rk_camsys/Kconfig
```kconfig
config CAMSYS_DRV
	tristate "camsys driver "
	default n
	
menu "RockChip camera system driver"
	depends on CAMSYS_DRV
	
source "drivers/media/video/rk_camsys/ext_flashled_drv/Kconfig"
	
config CAMSYS_MRV
	tristate "camsys driver for marvin isp "
	default n
	---help---

config CAMSYS_CIF
	tristate "camsys driver for cif "
	default n
	---help---

endmenu	  
```

## drivers/media/video/rk_camsys/ext_flashled_drv/Kconfig
```kconfig
config FLASHLIGHT
	bool "Flashlight Support"
	default n
	help
	  This option enables the led sysfs class in /sys/class/flashlight.

config LEDS_RT8547
	bool "LED Support for RT8547"
	select RT_FLASH_LED
	default n
	help
	  This option enabled support for RT8547 LED drivers

config LEDS_RT8547_DBG
	bool "LED RT8547 Debug Info"
	depends on LEDS_RT8547
	default n
	help
	  This option enabled RT8547 LED drivers debug option

config RT_FLASH_LED
	bool "Richtek flash LED driver support"
	depends on FLASHLIGHT
	default n
	help
	  Say Y here to enable Richtek's flash LED driver HAL architecture
```

## drivers/media/video/s5k4ecgx/Kconfig
```kconfig
config VIDEO_S5K4ECGX
	tristate "S5K4ECGX supporting camera driver"
	depends on I2C && VIDEO_V4L2 && VIDEO_V4L2_SUBDEV_API &&\
	(VIDEO_S5P_MIPI_CSIS || VIDEO_EXYNOS_MIPI_CSIS)
	---help---
	  This driver supports S5K4ECGX sensor.
```

## drivers/media/video/s5p-fimc/Kconfig
```kconfig
config VIDEO_SAMSUNG_S5P_FIMC
	bool "Samsung S5P/EXYNOS SoC camera interface driver (experimental)"
	depends on VIDEO_V4L2 && VIDEO_V4L2_SUBDEV_API && PLAT_S5P && PM_RUNTIME
	depends on EXPERIMENTAL
	help
	  Say Y here to enable camera host interface devices for
	  Samsung S5P and EXYNOS SoC series.

if VIDEO_SAMSUNG_S5P_FIMC

config VIDEO_S5P_FIMC
	tristate "S5P/EXYNOS4 FIMC/CAMIF camera interface driver"
	depends on I2C
	select VIDEOBUF2_DMA_CONTIG
	select V4L2_MEM2MEM_DEV
	help
	  This is a V4L2 driver for Samsung S5P and EXYNOS4 SoC camera host
	  interface and video postprocessor (FIMC and FIMC-LITE) devices.

	  To compile this driver as a module, choose M here: the
	  module will be called s5p-fimc.

config VIDEO_S5P_MIPI_CSIS
	tristate "S5P/EXYNOS MIPI-CSI2 receiver (MIPI-CSIS) driver"
	depends on REGULATOR
	help
	  This is a V4L2 driver for Samsung S5P and EXYNOS4 SoC MIPI-CSI2
	  receiver (MIPI-CSIS) devices.

	  To compile this driver as a module, choose M here: the
	  module will be called s5p-csis.

if ARCH_EXYNOS

config VIDEO_EXYNOS_FIMC_LITE
	tristate "EXYNOS FIMC-LITE camera interface driver"
	depends on I2C
	select VIDEOBUF2_DMA_CONTIG
	help
	  This is a V4L2 driver for Samsung EXYNOS4/5 SoC FIMC-LITE camera
	  host interface.

	  To compile this driver as a module, choose M here: the
	  module will be called exynos-fimc-lite.
endif

endif # VIDEO_SAMSUNG_S5P_FIMC
```

## drivers/media/video/s5p-tv/Kconfig
```kconfig
# drivers/media/video/s5p-tv/Kconfig
#
# Copyright (c) 2010-2011 Samsung Electronics Co., Ltd.
#	http://www.samsung.com/
# Tomasz Stanislawski <t.stanislaws@samsung.com>
#
# Licensed under GPL

config VIDEO_SAMSUNG_S5P_TV
	bool "Samsung TV driver for S5P platform (experimental)"
	depends on PLAT_S5P
	depends on EXPERIMENTAL
	default n
	---help---
	  Say Y here to enable selecting the TV output devices for
	  Samsung S5P platform.

if VIDEO_SAMSUNG_S5P_TV

config VIDEO_SAMSUNG_S5P_HDMI
	tristate "Samsung HDMI Driver"
	depends on VIDEO_V4L2
	depends on VIDEO_SAMSUNG_S5P_TV
	select VIDEO_SAMSUNG_S5P_HDMIPHY
	help
	  Say Y here if you want support for the HDMI output
	  interface in S5P Samsung SoC. The driver can be compiled
	  as module. It is an auxiliary driver, that exposes a V4L2
	  subdev for use by other drivers. This driver requires
	  hdmiphy driver to work correctly.

config VIDEO_SAMSUNG_S5P_HDMI_DEBUG
	bool "Enable debug for HDMI Driver"
	depends on VIDEO_SAMSUNG_S5P_HDMI
	default n
	help
	  Enables debugging for HDMI driver.

config VIDEO_SAMSUNG_S5P_HDMIPHY
	tristate "Samsung HDMIPHY Driver"
	depends on VIDEO_DEV && VIDEO_V4L2 && I2C
	depends on VIDEO_SAMSUNG_S5P_TV
	help
	  Say Y here if you want support for the physical HDMI
	  interface in S5P Samsung SoC. The driver can be compiled
	  as module. It is an I2C driver, that exposes a V4L2
	  subdev for use by other drivers.

endif # VIDEO_SAMSUNG_S5P_TV
```

## drivers/media/video/saa7134/Kconfig
```kconfig
config VIDEO_SAA7134
	tristate "Philips SAA7134 support"
	depends on VIDEO_DEV && PCI && I2C
	select VIDEOBUF_DMA_SG
	select VIDEO_TUNER
	select VIDEO_TVEEPROM
	select CRC32
	select VIDEO_SAA6588 if VIDEO_HELPER_CHIPS_AUTO
	---help---
	  This is a video4linux driver for Philips SAA713x based
	  TV cards.

	  To compile this driver as a module, choose M here: the
	  module will be called saa7134.

config VIDEO_SAA7134_ALSA
	tristate "Philips SAA7134 DMA audio support"
	depends on VIDEO_SAA7134 && SND
	select SND_PCM
	---help---
	  This is a video4linux driver for direct (DMA) audio in
	  Philips SAA713x based TV cards using ALSA

	  To compile this driver as a module, choose M here: the
	  module will be called saa7134-alsa.

config VIDEO_SAA7134_RC
	bool "Philips SAA7134 Remote Controller support"
	depends on RC_CORE
	depends on VIDEO_SAA7134
	default y
	---help---
	  Enables Remote Controller support on saa7134 driver.

config VIDEO_SAA7134_DVB
	tristate "DVB/ATSC Support for saa7134 based TV cards"
	depends on VIDEO_SAA7134 && DVB_CORE
	select VIDEOBUF_DVB
	select DVB_PLL if !DVB_FE_CUSTOMISE
	select DVB_MT352 if !DVB_FE_CUSTOMISE
	select DVB_TDA1004X if !DVB_FE_CUSTOMISE
	select DVB_NXT200X if !DVB_FE_CUSTOMISE
	select DVB_TDA10086 if !DVB_FE_CUSTOMISE
	select DVB_TDA826X if !DVB_FE_CUSTOMISE
	select DVB_ISL6421 if !DVB_FE_CUSTOMISE
	select DVB_ISL6405 if !DVB_FE_CUSTOMISE
	select MEDIA_TUNER_TDA827X if !MEDIA_TUNER_CUSTOMISE
	select MEDIA_TUNER_SIMPLE if !MEDIA_TUNER_CUSTOMISE
	select DVB_ZL10036 if !DVB_FE_CUSTOMISE
	select DVB_MT312 if !DVB_FE_CUSTOMISE
	select DVB_LNBP21 if !DVB_FE_CUSTOMISE
	select DVB_ZL10353 if !DVB_FE_CUSTOMISE
	select DVB_LGDT3305 if !DVB_FE_CUSTOMISE
	select DVB_TDA10048 if !DVB_FE_CUSTOMISE
	select MEDIA_TUNER_TDA18271 if !MEDIA_TUNER_CUSTOMISE
	select MEDIA_TUNER_TDA8290 if !MEDIA_TUNER_CUSTOMISE
	select DVB_ZL10039 if !DVB_FE_CUSTOMISE
	---help---
	  This adds support for DVB cards based on the
	  Philips saa7134 chip.

	  To compile this driver as a module, choose M here: the
	  module will be called saa7134-dvb.
```

## drivers/media/video/saa7164/Kconfig
```kconfig
config VIDEO_SAA7164
	tristate "NXP SAA7164 support"
	depends on DVB_CORE && PCI && I2C
	select I2C_ALGOBIT
	select FW_LOADER
	select VIDEO_TUNER
	select VIDEO_TVEEPROM
	select VIDEOBUF_DVB
	select DVB_TDA10048 if !DVB_FE_CUSTOMISE
	select DVB_S5H1411 if !DVB_FE_CUSTOMISE
	select MEDIA_TUNER_TDA18271 if !MEDIA_TUNER_CUSTOMISE
	---help---
	  This is a video4linux driver for NXP SAA7164 based
	  TV cards.

	  To compile this driver as a module, choose M here: the
	  module will be called saa7164
```
