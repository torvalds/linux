## drivers/media/video/samsung/Kconfig
```kconfig
config VIDEO_SAMSUNG
	bool "Samsung Multimedia Devices"
	depends on VIDEO_CAPTURE_DRIVERS && VIDEO_V4L2
	select VIDEO_FIXED_MINOR_RANGES
	default n
	help
	  This is a representative video4linux configuration for Samsung multimedia devices.

config VIDEO_SAMSUNG_V4L2
	bool "V4L2 API for digital camera to be contributed by samsung"
	depends on VIDEO_DEV && VIDEO_SAMSUNG
	default n
	help
	  This feature is for new V4L2 APIs all about digital camera

if CPU_EXYNOS4210 || CPU_EXYNOS4212 || CPU_EXYNOS4412
	source "drivers/media/video/samsung/fimc/Kconfig"
	source "drivers/media/video/samsung/tvout/Kconfig"
	source "drivers/media/video/samsung/mfc5x/Kconfig"
endif

config VIDEO_FIMG2D
	bool
	depends on VIDEO_SAMSUNG
	default n

config VIDEO_FIMG2D_DEBUG
	bool
	depends on VIDEO_FIMG2D
	default n

if ARCH_EXYNOS5
source "drivers/media/video/samsung/fimg2d3x/Kconfig"
source "drivers/media/video/samsung/fimg2d4x/Kconfig"
endif

if ARCH_EXYNOS4
source "drivers/media/video/samsung/fimg2d3x-exynos4/Kconfig"
source "drivers/media/video/samsung/fimg2d4x-exynos4/Kconfig"
endif


if CPU_EXYNOS4210
	source "drivers/media/video/samsung/jpeg/Kconfig"
endif

if CPU_EXYNOS4212 || CPU_EXYNOS4412 || CPU_EXYNOS5250
	source "drivers/media/video/samsung/jpeg_v2x/Kconfig"
endif

if VIDEO_SAMSUNG
comment "Reserved memory configurations"
config VIDEO_SAMSUNG_USE_DMA_MEM
	bool "Use common contigouse dma memory for Multimedia devices"
	depends on SLP

config VIDEO_SAMSUNG_MEMSIZE_DMA
	int "Memory size in kbytes for DMA"
	depends on VIDEO_SAMSUNG_USE_DMA_MEM
	default "5120"

config VIDEO_SAMSUNG_MEMSIZE_FIMC0
	int "Memory size in kbytes for FIMC0"
	depends on VIDEO_FIMC || VIDEO_SAMSUNG_S5P_FIMC
	default "5120"

config VIDEO_SAMSUNG_MEMSIZE_FIMC1
	int "Memory size in kbytes for FIMC1"
	depends on VIDEO_FIMC || VIDEO_SAMSUNG_S5P_FIMC
	default "5120"

config VIDEO_SAMSUNG_MEMSIZE_FIMC2
	int "Memory size in kbytes for FIMC2"
	depends on VIDEO_FIMC || VIDEO_SAMSUNG_S5P_FIMC
	default "5120"

config VIDEO_SAMSUNG_MEMSIZE_FIMC3
	int "Memory size in kbytes for FIMC3"
	depends on VIDEO_FIMC || VIDEO_SAMSUNG_S5P_FIMC
	default "0"

config VIDEO_SAMSUNG_MEMSIZE_MFC
	int "Memory size in kbytes for MFC"
	depends on VIDEO_MFC5X && (VIDEO_MFC_MEM_PORT_COUNT = 1) && (!EXYNOS_CONTENT_PATH_PROTECTION)
	default "65536"

config VIDEO_SAMSUNG_MEMSIZE_MFC0
	int "Memory size in kbytes for MFC port0"
	depends on VIDEO_MFC5X && (VIDEO_MFC_MEM_PORT_COUNT = 2) && (!EXYNOS_CONTENT_PATH_PROTECTION)
	default "41984"

config VIDEO_SAMSUNG_MEMSIZE_MFC1
	int "Memory size in kbytes for MFC port1"
	depends on VIDEO_MFC5X && (VIDEO_MFC_MEM_PORT_COUNT = 2) && (!EXYNOS_CONTENT_PATH_PROTECTION)
	default "41984"

config VIDEO_SAMSUNG_MEMSIZE_MFC_SECURE
	int "Memory size in kbytes for MFC Secure"
	depends on VIDEO_MFC5X && EXYNOS_CONTENT_PATH_PROTECTION
	default "41984"

config VIDEO_SAMSUNG_MEMSIZE_MFC_NORMAL
	int "Memory size in kbytes for MFC Normal"
	depends on VIDEO_MFC5X && EXYNOS_CONTENT_PATH_PROTECTION
	default "41984"

config VIDEO_SAMSUNG_MEMSIZE_JPEG
	int "Memory size in kbytes for JPEG"
	depends on VIDEO_JPEG || (VIDEO_JPEG_V2X && (CPU_EXYNOS4212 || CPU_EXYNOS4412))
	default "40960"

config VIDEO_SAMSUNG_MEMSIZE_TVOUT
	int "Memory size in kbytes for TVOUT"
	depends on VIDEO_TVOUT
	default "16384"
endif

config VIDEO_MALI_R2P4
	bool "Use Mali r2p4 version"
	depends on VIDEO_SAMSUNG
	default n
	help
	  Use Mali r2p4 version

config VIDEO_MALI_R3P2
	bool "Use Mali r3p2 version"
	depends on VIDEO_SAMSUNG
	default n
	help
	  Use Mali r3p2 version

if VIDEO_MALI_R2P4
	source "drivers/media/video/samsung/ump/Kconfig"
	source "drivers/media/video/samsung/mali/Kconfig"
endif

if VIDEO_MALI_R3P2
	source "drivers/media/video/samsung/ump_r3p2/Kconfig"
	source "drivers/media/video/samsung/mali_r3p2/Kconfig"
endif
```

## drivers/media/video/samsung/fimc/Kconfig
```kconfig
config VIDEO_FIMC
	bool "Samsung Camera Interface (FIMC) driver"
	depends on VIDEO_SAMSUNG && ARCH_EXYNOS4
	select VIDEO_IPC if ARCH_S5PV210
	default n
	help
	  This is a video4linux driver for Samsung FIMC device.

choice
depends on VIDEO_FIMC
prompt "Select CSC Range config"
default VIDEO_FIMC_RANGE_NARROW
config VIDEO_FIMC_RANGE_NARROW
	bool "Narrow"
	depends on VIDEO_FIMC && (ARCH_S5PV210 || ARCH_EXYNOS4)
	---help---
	  RGB <-> YUV Color Conversion Narrow Range Equation

config VIDEO_FIMC_RANGE_WIDE
	bool "Wide"
	depends on VIDEO_FIMC && (ARCH_S5PV210 || ARCH_EXYNOS4)
	---help---
	  RGB <-> YUV Color Conversion Wide Range Equation
endchoice

config VIDEO_IPC
	bool

config VIDEO_FIMC_DEBUG
	bool "FIMC driver debug messages"
	depends on VIDEO_FIMC

config VIDEO_FIMC_MIPI
	bool "MIPI-CSI2 Slave Interface support"
	depends on VIDEO_FIMC && (ARCH_S5PV210 || ARCH_EXYNOS4)
	default y

choice
depends on VIDEO_FIMC
prompt "Select Output Mode"
default VIDEO_FIMC_DMA_AUTO
config VIDEO_FIMC_DMA_AUTO
        bool "DMA AUTO MODE"
        depends on VIDEO_FIMC
        help
          This enables support for FIMC1 DMA AUTO mode

config VIDEO_FIMC_FIFO
        bool "FIFO MODE"
        depends on VIDEO_FIMC
        help
          This enables support for FIMC1 FIFO mode

endchoice
```

## drivers/media/video/samsung/fimg2d3x/Kconfig
```kconfig
# drivers/media/video/samsung/fimg2d3x/Kconfig
#
# Copyright (c) 2010 Samsung Electronics Co., Ltd.
#	http://www.samsung.com/
#
# Licensed under GPLv2

config VIDEO_FIMG2D3X
	bool "Samsung Graphics 2D Driver"
	select VIDEO_FIMG2D
	depends on VIDEO_SAMSUNG && CPU_EXYNOS4210
	default n
	---help---
	  This is a graphics 2D (FIMG2D 3.x) driver for Samsung ARM based SoC.

config VIDEO_FIMG2D3X_DEBUG
	bool "Enables FIMG2D debug messages"
	depends on VIDEO_FIMG2D3X
	default n
	---help---
	  This enables FIMG2D driver debug messages.
```

## drivers/media/video/samsung/fimg2d4x-exynos4/Kconfig
```kconfig
# drivers/media/video/samsung/fimg2d4x/Kconfig
#
# Copyright (c) 2011 Samsung Electronics Co., Ltd.
#	http://www.samsung.com/
#
# Licensed under GPLv2

config VIDEO_FIMG2D4X
	bool "Samsung Graphics 2D Driver"
	select VIDEO_FIMG2D
	depends on VIDEO_SAMSUNG && (CPU_EXYNOS4212 || CPU_EXYNOS4412 || CPU_EXYNOS5250)
	default n
	---help---
	  This is a graphics 2D (FIMG2D 4.x) driver for Samsung ARM based SoC.

config VIDEO_FIMG2D4X_DEBUG
	bool "Enables FIMG2D debug messages"
	select VIDEO_FIMG2D_DEBUG
	depends on VIDEO_FIMG2D4X
	default n
	---help---
	  This enables FIMG2D driver debug messages.
```

## drivers/media/video/samsung/jpeg/Kconfig
```kconfig
#
# Configuration for JPEG
#

config VIDEO_JPEG
	bool "Samsung JPEG driver"
	depends on VIDEO_SAMSUNG
	default n
	---help---
	  This is a JPEG for Samsung S5PV210 or S5PV310

config VIDEO_JPEG_DEBUG
	bool "print JPEG debug message"
	depends on VIDEO_JPEG
	default n
```

## drivers/media/video/samsung/jpeg_v2x/Kconfig
```kconfig
#
# Configuration for JPEG
#

config VIDEO_JPEG_V2X
	bool "Samsung JPEG_v2.x driver"
	depends on VIDEO_SAMSUNG
	default n
	depends on VIDEO_DEV && VIDEO_V4L2
	select V4L2_MEM2MEM_DEV
	---help---
	  This is a Samsung JPEG H/W driver for V2.x
choice
	prompt "JPEG V2X VERSION"
	default S5P_JPEG_V2_1
	depends on VIDEO_JPEG_V2X
	---help---
	  Select version of JPEG driver

config JPEG_V2_1
	bool "JPEG 2.1"
	---help---
	  Use JPEG 2.1 Pegasus/Gaia evt 0.0

config JPEG_V2_2
	bool "JPEG 2.2"
	---help---
	  Use JPEG 2.2 Gaia evt 1.0
endchoice
```

## drivers/media/video/samsung/mali/Kconfig
```kconfig
#
## S3C Multimedia Mali configuration
##
#
# For Mali
config VIDEO_MALI400MP
	bool "Enable MALI integration"
	depends on VIDEO_SAMSUNG
	default y
	---help---
                This enables MALI integration in the multimedia device driver

choice
depends on VIDEO_MALI400MP
prompt "MALI MEMORY OPTION"
default MALI_OSMEM_ONLY
config MALI_DED_ONLY
  bool "mali dedicated memory only"
   ---help---
       This enables MALI dedicated memory only option
config MALI_DED_MMU
  bool "mali dedicated memory with mmu enable"
   ---help---
       This enables MALI dedicated memory with mmu enable option
config MALI_OSMEM_ONLY
   bool "mali OS memory only"
   ---help---
       This enables MALI OS memory only option
config MALI_DED_OSMEM
   bool "mali dedicated memory and OS memory"
   ---help---
       This enables MALI dedicated memory and OS memory option

endchoice
config MALI_MEM_SIZE
int "Dedicated Memory Size"
   depends on VIDEO_MALI400MP && (MALI_DED_ONLY || MALI_DED_MMU || MALI_DED_OSMEM)
   default "128"
   ---help---
       This value is dedicated memory size of Mali GPU(unit is MByte).


# For DEBUG
config VIDEO_MALI400MP_DEBUG
	bool "Enables debug messages"
	depends on VIDEO_MALI400MP
	default n
	help
	  This enables Mali driver debug messages.

config VIDEO_MALI400MP_STREAMLINE_PROFILING
	bool "Enables mali streamline profiling"
	depends on VIDEO_MALI400MP
	default n
	help
	  This enables Mali streamline profiling.

config VIDEO_MALI400MP_DVFS
	bool "Enables DVFS"
	depends on VIDEO_MALI400MP && PM 
	default y
	help
	  This enables Mali driver DVFS.

config MALI_OVERCLOCK_533
	bool "Overclock mali GPU to 533Mhz" 
	default n
	help
		Adds an extra step to Mali Gpu to 533Mhz. 1.075V

config MALI_OVERCLOCK_640
	bool "Overclock mali GPU to 640Mhz" 
	default n
	help
		Adds an extra step to Mali Gpu to 640Mhz. 1.125V

config MALI_OVERCLOCK_733
	bool "Overclock mali GPU to 733Mhz" 
	default n
	help
		Adds an extra step to Mali Gpu to 733Mhz. 1.175V

config MALI_OVERCLOCK_800
	bool "Overclock mali GPU to 800Mhz" 
	default n
	help
		Adds an extra step to Mali Gpu to 800Mhz. 1.2V
```

## drivers/media/video/samsung/mali_r3p2/Kconfig
```kconfig
config MALI400
	tristate "Mali-300/400/450 support"
	depends on ARM
	select DMA_SHARED_BUFFER
	---help---
	  This enables support for the ARM Mali-300, Mali-400, and Mali-450
	  GPUs.

	  To compile this driver as a module, choose M here: the module will be
	  called mali.

config MALI400_DEBUG
	bool "Enable debug in Mali driver"
	depends on MALI400
	---help---
	  This enabled extra debug checks and messages in the Mali driver.

config MALI400_PROFILING
	bool "Enable Mali profiling"
	depends on MALI400
	select TRACEPOINTS
	default y
	---help---
	  This enables gator profiling of Mali GPU events.

config MALI400_INTERNAL_PROFILING
	bool "Enable internal Mali profiling API"
	depends on MALI400_PROFILING
	default n
	---help---
	  This enables the internal legacy Mali profiling API.

config MALI400_UMP
	bool "Enable UMP support"
	depends on MALI400
	---help---
	  This enables support for the UMP memory sharing API in the Mali driver.

config MALI_OVERCLOCK_533  
        bool "Overclock mali GPU to 533Mhz"
        default n
        help
                Adds an extra step to Mali Gpu to 533Mhz. 1.075V

config MALI_OVERCLOCK_640
        bool "Overclock mali GPU to 640Mhz"
        default n
        help
                Adds an extra step to Mali Gpu to 640Mhz. 1.125V

config MALI_OVERCLOCK_733
        bool "Overclock mali GPU to 733Mhz"
        default n
        help
                Adds an extra step to Mali Gpu to 733Mhz. 1.175V

config MALI_OVERCLOCK_800
        bool "Overclock mali GPU to 800Mhz"
        default n
        help
                Adds an extra step to Mali Gpu to 800Mhz. 1.2V
```

## drivers/media/video/samsung/mfc5x/Kconfig
```kconfig
#
# Configuration for Multi Format Codecs (MFC)
#
config VIDEO_MFC5X
	bool "Samsung MFC (Multi Format Codec - FIMV 5.x) Driver"
	depends on USE_LEGACY_MFC
	default n
	---help---
	  This is a Samsung Multi Format Codecs (MFC) FIMV V5.x

config VIDEO_MFC_MAX_INSTANCE
	int "Maximum size of MFC instance (1-4)"
	range 1 4
	depends on VIDEO_MFC5X
	default 4

config VIDEO_MFC_MEM_PORT_COUNT
	int "Default number of MFC memory ports (1-2)"
	range 1 2
	depends on VIDEO_MFC5X && (!EXYNOS4_CONTENT_PATH_PROTECTION)
	default 2

config VIDEO_MFC_VCM_UMP
	bool "Support UMP over VCM for MFC"
	depends on VIDEO_MFC5X && VCM_MMU && VIDEO_UMP
	default y

config VIDEO_MFC5X_DEBUG
	bool "MFC driver debug message"
	depends on VIDEO_MFC5X
	default n
```
