## drivers/media/video/cx23885/Kconfig
```kconfig
config VIDEO_CX23885
	tristate "Conexant cx23885 (2388x successor) support"
	depends on DVB_CORE && VIDEO_DEV && PCI && I2C && INPUT && SND
	select SND_PCM
	select I2C_ALGOBIT
	select VIDEO_BTCX
	select VIDEO_TUNER
	select VIDEO_TVEEPROM
	depends on RC_CORE
	select VIDEOBUF_DVB
	select VIDEOBUF_DMA_SG
	select VIDEO_CX25840
	select VIDEO_CX2341X
	select DVB_DIB7000P if !DVB_FE_CUSTOMISE
	select DVB_S5H1409 if !DVB_FE_CUSTOMISE
	select DVB_S5H1411 if !DVB_FE_CUSTOMISE
	select DVB_LGDT330X if !DVB_FE_CUSTOMISE
	select DVB_ZL10353 if !DVB_FE_CUSTOMISE
	select DVB_TDA10048 if !DVB_FE_CUSTOMISE
	select DVB_LNBP21 if !DVB_FE_CUSTOMISE
	select DVB_STV6110 if !DVB_FE_CUSTOMISE
	select DVB_CX24116 if !DVB_FE_CUSTOMISE
	select DVB_STV0900 if !DVB_FE_CUSTOMISE
	select DVB_DS3000 if !DVB_FE_CUSTOMISE
	select DVB_STV0367 if !DVB_FE_CUSTOMISE
	select MEDIA_TUNER_MT2131 if !MEDIA_TUNER_CUSTOMISE
	select MEDIA_TUNER_XC2028 if !MEDIA_TUNER_CUSTOMISE
	select MEDIA_TUNER_TDA8290 if !MEDIA_TUNER_CUSTOMISE
	select MEDIA_TUNER_TDA18271 if !MEDIA_TUNER_CUSTOMISE
	select MEDIA_TUNER_XC5000 if !MEDIA_TUNER_CUSTOMISE
	---help---
	  This is a video4linux driver for Conexant 23885 based
	  TV cards.

	  To compile this driver as a module, choose M here: the
	  module will be called cx23885

config MEDIA_ALTERA_CI
	tristate "Altera FPGA based CI module"
	depends on VIDEO_CX23885 && DVB_CORE
	select ALTERA_STAPL
	---help---
	  An Altera FPGA CI module for NetUP Dual DVB-T/C RF CI card.

	  To compile this driver as a module, choose M here: the
	  module will be called altera-ci
```

## drivers/media/video/cx25840/Kconfig
```kconfig
config VIDEO_CX25840
	tristate "Conexant CX2584x audio/video decoders"
	depends on VIDEO_V4L2 && I2C && EXPERIMENTAL
	select FW_LOADER
	---help---
	  Support for the Conexant CX2584x audio/video decoders.

	  To compile this driver as a module, choose M here: the
	  module will be called cx25840
```

## drivers/media/video/cx88/Kconfig
```kconfig
config VIDEO_CX88
	tristate "Conexant 2388x (bt878 successor) support"
	depends on VIDEO_DEV && PCI && I2C && INPUT
	select I2C_ALGOBIT
	select FW_LOADER
	select VIDEO_BTCX
	select VIDEOBUF_DMA_SG
	select MEDIA_TUNER
	select VIDEO_TVEEPROM
	select VIDEO_IR
	select VIDEO_WM8775 if VIDEO_HELPER_CHIPS_AUTO
	---help---
	  This is a video4linux driver for Conexant 2388x based
	  TV cards.

	  To compile this driver as a module, choose M here: the
	  module will be called cx8800

config VIDEO_CX88_ALSA
	tristate "Conexant 2388x DMA audio support"
	depends on VIDEO_CX88 && SND && EXPERIMENTAL
	select SND_PCM
	---help---
	  This is a video4linux driver for direct (DMA) audio on
	  Conexant 2388x based TV cards using ALSA.

	  It only works with boards with function 01 enabled.
	  To check if your board supports, use lspci -n.
	  If supported, you should see 14f1:8801 or 14f1:8811
	  PCI device.

	  To compile this driver as a module, choose M here: the
	  module will be called cx88-alsa.

config VIDEO_CX88_BLACKBIRD
	tristate "Blackbird MPEG encoder support (cx2388x + cx23416)"
	depends on VIDEO_CX88
	select VIDEO_CX2341X
	---help---
	  This adds support for MPEG encoder cards based on the
	  Blackbird reference design, using the Conexant 2388x
	  and 23416 chips.

	  To compile this driver as a module, choose M here: the
	  module will be called cx88-blackbird.

config VIDEO_CX88_DVB
	tristate "DVB/ATSC Support for cx2388x based TV cards"
	depends on VIDEO_CX88 && DVB_CORE
	select VIDEOBUF_DVB
	select DVB_PLL if !DVB_FE_CUSTOMISE
	select DVB_MT352 if !DVB_FE_CUSTOMISE
	select DVB_ZL10353 if !DVB_FE_CUSTOMISE
	select DVB_OR51132 if !DVB_FE_CUSTOMISE
	select DVB_CX22702 if !DVB_FE_CUSTOMISE
	select DVB_LGDT330X if !DVB_FE_CUSTOMISE
	select DVB_NXT200X if !DVB_FE_CUSTOMISE
	select DVB_CX24123 if !DVB_FE_CUSTOMISE
	select DVB_ISL6421 if !DVB_FE_CUSTOMISE
	select MEDIA_TUNER_SIMPLE if !DVB_FE_CUSTOMISE
	select DVB_S5H1411 if !DVB_FE_CUSTOMISE
	---help---
	  This adds support for DVB/ATSC cards based on the
	  Conexant 2388x chip.

	  To compile this driver as a module, choose M here: the
	  module will be called cx88-dvb.

config VIDEO_CX88_VP3054
	tristate "VP-3054 Secondary I2C Bus Support"
	default m
	depends on VIDEO_CX88_DVB && DVB_MT352
	---help---
	  This adds DVB-T support for cards based on the
	  Conexant 2388x chip and the MT352 demodulator,
	  which also require support for the VP-3054
	  Secondary I2C bus, such at DNTV Live! DVB-T Pro.
```

## drivers/media/video/davinci/Kconfig
```kconfig
config DISPLAY_DAVINCI_DM646X_EVM
	tristate "DM646x EVM Video Display"
	depends on VIDEO_DEV && MACH_DAVINCI_DM6467_EVM
	select VIDEOBUF_DMA_CONTIG
	select VIDEO_DAVINCI_VPIF
	select VIDEO_ADV7343
	select VIDEO_THS7303
	help
	  Support for DM6467 based display device.

	  To compile this driver as a module, choose M here: the
	  module will be called vpif_display.

config CAPTURE_DAVINCI_DM646X_EVM
	tristate "DM646x EVM Video Capture"
	depends on VIDEO_DEV && MACH_DAVINCI_DM6467_EVM
	select VIDEOBUF_DMA_CONTIG
	select VIDEO_DAVINCI_VPIF
	help
	  Support for DM6467 based capture device.

	  To compile this driver as a module, choose M here: the
	  module will be called vpif_capture.

config VIDEO_DAVINCI_VPIF
	tristate "DaVinci VPIF Driver"
	depends on DISPLAY_DAVINCI_DM646X_EVM
	help
	  Support for DaVinci VPIF Driver.

	  To compile this driver as a module, choose M here: the
	  module will be called vpif.

config VIDEO_VPSS_SYSTEM
	tristate "VPSS System module driver"
	depends on ARCH_DAVINCI
	help
	  Support for vpss system module for video driver

config VIDEO_VPFE_CAPTURE
	tristate "VPFE Video Capture Driver"
	depends on VIDEO_V4L2 && (ARCH_DAVINCI || ARCH_OMAP3)
	select VIDEOBUF_DMA_CONTIG
	help
	  Support for DMx/AMx VPFE based frame grabber. This is the
	  common V4L2 module for following DMx/AMx SoCs from Texas
	  Instruments:- DM6446, DM365, DM355 & AM3517/05.

	  To compile this driver as a module, choose M here: the
	  module will be called vpfe-capture.

config VIDEO_DM6446_CCDC
	tristate "DM6446 CCDC HW module"
	depends on VIDEO_VPFE_CAPTURE
	select VIDEO_VPSS_SYSTEM
	default y
	help
	   Enables DaVinci CCD hw module. DaVinci CCDC hw interfaces
	   with decoder modules such as TVP5146 over BT656 or
	   sensor module such as MT9T001 over a raw interface. This
	   module configures the interface and CCDC/ISIF to do
	   video frame capture from slave decoders.

	   To compile this driver as a module, choose M here: the
	   module will be called vpfe.

config VIDEO_DM355_CCDC
	tristate "DM355 CCDC HW module"
	depends on ARCH_DAVINCI_DM355 && VIDEO_VPFE_CAPTURE
	select VIDEO_VPSS_SYSTEM
	default y
	help
	   Enables DM355 CCD hw module. DM355 CCDC hw interfaces
	   with decoder modules such as TVP5146 over BT656 or
	   sensor module such as MT9T001 over a raw interface. This
	   module configures the interface and CCDC/ISIF to do
	   video frame capture from a slave decoders

	   To compile this driver as a module, choose M here: the
	   module will be called vpfe.

config VIDEO_ISIF
	tristate "ISIF HW module"
	depends on ARCH_DAVINCI_DM365 && VIDEO_VPFE_CAPTURE
	select VIDEO_VPSS_SYSTEM
	default y
	help
	   Enables ISIF hw module. This is the hardware module for
	   configuring ISIF in VPFE to capture Raw Bayer RGB data  from
	   a image sensor or YUV data from a YUV source.

	   To compile this driver as a module, choose M here: the
	   module will be called vpfe.

config VIDEO_DM644X_VPBE
	tristate "DM644X VPBE HW module"
	depends on ARCH_DAVINCI_DM644x
	select VIDEO_VPSS_SYSTEM
	select VIDEOBUF_DMA_CONTIG
	help
	    Enables VPBE modules used for display on a DM644x
	    SoC.

	    To compile this driver as a module, choose M here: the
	    module will be called vpbe.


config VIDEO_VPBE_DISPLAY
	tristate "VPBE V4L2 Display driver"
	depends on ARCH_DAVINCI_DM644x
	select VIDEO_DM644X_VPBE
	help
	    Enables VPBE V4L2 Display driver on a DM644x device

	    To compile this driver as a module, choose M here: the
	    module will be called vpbe_display.
```

## drivers/media/video/em28xx/Kconfig
```kconfig
config VIDEO_EM28XX
	tristate "Empia EM28xx USB video capture support"
	depends on VIDEO_DEV && I2C && INPUT
	select VIDEO_TUNER
	select VIDEO_TVEEPROM
	select VIDEO_IR
	select VIDEOBUF_VMALLOC
	select VIDEO_SAA711X if VIDEO_HELPER_CHIPS_AUTO
	select VIDEO_TVP5150 if VIDEO_HELPER_CHIPS_AUTO
	select VIDEO_MSP3400 if VIDEO_HELPER_CHIPS_AUTO
	select VIDEO_MT9V011 if VIDEO_HELPER_CHIPS_AUTO

	---help---
	  This is a video4linux driver for Empia 28xx based TV cards.

	  To compile this driver as a module, choose M here: the
	  module will be called em28xx

config VIDEO_EM28XX_ALSA
	depends on VIDEO_EM28XX && SND
	select SND_PCM
	tristate "Empia EM28xx ALSA audio module"
	---help---
	  This is an ALSA driver for some Empia 28xx based TV cards.

	  This is not required for em2800/em2820/em2821 boards. However,
	  newer em28xx devices uses Vendor Class for audio, instead of
	  implementing the USB Audio Class. For those chips, this module
	  will enable digital audio.

	  To compile this driver as a module, choose M here: the
	  module will be called em28xx-alsa

config VIDEO_EM28XX_DVB
	tristate "DVB/ATSC Support for em28xx based TV cards"
	depends on VIDEO_EM28XX && DVB_CORE
	select DVB_LGDT330X if !DVB_FE_CUSTOMISE
	select DVB_ZL10353 if !DVB_FE_CUSTOMISE
	select DVB_TDA10023 if !DVB_FE_CUSTOMISE
	select VIDEOBUF_DVB
	---help---
	  This adds support for DVB cards based on the
	  Empiatech em28xx chips.
```

## drivers/media/video/et61x251/Kconfig
```kconfig
config USB_ET61X251
	tristate "USB ET61X[12]51 PC Camera Controller support"
	depends on USB && VIDEO_DEV
	---help---
	  Say Y here if you want support for cameras based on Etoms ET61X151
	  or ET61X251 PC Camera Controllers.

	  See <file:Documentation/video4linux/et61x251.txt> for more info.

	  This driver uses the Video For Linux API. You must say Y or M to
	  "Video For Linux" to use this driver.

	  To compile this driver as a module, choose M here: the
	  module will be called et61x251.
```

## drivers/media/video/exynos/Kconfig
```kconfig
#
# Exynos multimedia device drivers
#
config VIDEO_EXYNOS
	bool "Exynos Multimedia Devices"
	depends on ARCH_EXYNOS4 || ARCH_EXYNOS5
	default n
	select VIDEO_FIXED_MINOR_RANGES
	help
	  This is a representative exynos multimedia device.

if VIDEO_EXYNOS
	source "drivers/media/video/exynos/mdev/Kconfig"
	source "drivers/media/video/exynos/fimc-lite/Kconfig"
	source "drivers/media/video/exynos/mipi-csis/Kconfig"
	source "drivers/media/video/exynos/gsc/Kconfig"
	source "drivers/media/video/exynos/scaler/Kconfig"
	source "drivers/media/video/exynos/jpeg/Kconfig"
	source "drivers/media/video/exynos/jpeg_hx/Kconfig"
	source "drivers/media/video/exynos/fimg2d/Kconfig"
	source "drivers/media/video/exynos/mfc/Kconfig"
	source "drivers/media/video/exynos/tv/Kconfig"
	source "drivers/media/video/exynos/rotator/Kconfig"
	source "drivers/media/video/exynos/fimc-is-mc2/Kconfig"

config VIDEO_EXYNOS5_FIMC_IS_SENSOR
	bool "Exynos FIMC-IS-SENSOR driver"
	depends on VIDEO_EXYNOS || VIDEO_EXYNOS5_FIMC_IS
	select MEDIA_EXYNOS
	default n
	help
	  This is a v4l2 driver for exynos FIMC-IS-SENSOR device.
endif

config MEDIA_EXYNOS
	bool
	help
	  Compile mdev to use exynos5 media device driver.
```

## drivers/media/video/exynos/fimc-is-mc/Kconfig
```kconfig
config VIDEO_EXYNOS5_FIMC_IS
	bool "Exynos FIMC-IS (Image Subsystem) driver"
	depends on VIDEO_EXYNOS && ARCH_EXYNOS5
	select MEDIA_EXYNOS
	default n
	help
	  This is a v4l2 driver for exynos FIMC-IS device.
```

## drivers/media/video/exynos/fimc-is-sensor/Kconfig
```kconfig
config VIDEO_S5K6B2
	bool "S5K6B2 2MP sensor support"
	depends on VIDEO_V4L2 && ((VIDEO_FIMC_MIPI || VIDEO_S5P_MIPI_CSIS) && VIDEO_EXYNOS_FIMC_IS) || VIDEO_EXYNOS5_FIMC_IS
	---help---
	  This driver supports S5K6B2 camera sensor for vision mode

choice
depends on VIDEO_S5K6B2
prompt "MIPI Camera port for S5K6B2"
default S5K6B2_CSI_E
config S5K6B2_CSI_C
	bool "CSI Camera A port"
	depends on (VIDEO_FIMC_MIPI || VIDEO_S5P_MIPI_CSIS || VIDEO_EXYNOS5_FIMC_IS)
	help
	  This enables CSI A port for 6B2 sensor
	  CSI is camera sensor interface
	  currenly there is A and B
	  This is only for internal ISP, FIMC-IS
config S5K6B2_CSI_D
	bool "CSI Camera B port"
	depends on (VIDEO_FIMC_MIPI || VIDEO_S5P_MIPI_CSIS || VIDEO_EXYNOS5_FIMC_IS)
	help
	  This enables CSI B port for 6B2 sensor
	  CSI is camera sensor interface
	  currenly there is A and B
	  This is only for internal ISP, FIMC-IS
config S5K6B2_CSI_E
	bool "CSI Camera C port"
	depends on ((VIDEO_FIMC_MIPI || VIDEO_S5P_MIPI_CSIS || VIDEO_EXYNOS5_FIMC_IS) && SOC_EXYNOS5410)
	help
	  This enables CSI C port for 6B2 sensor
	  CSI is camera sensor interface
	  currenly there is A, B and C
	  This is only for internal ISP, FIMC-IS
endchoice

choice
depends on (VIDEO_S5K6B2 && VIDEO_EXYNOS5_FIMC_IS)
prompt "Camera position for S5K6B2"
default S5K6B2_POSITION_FRONT
config S5K6B2_POSITION_FRONT
	bool "front camera"
	depends on VIDEO_EXYNOS5_FIMC_IS
	help
	  This set as front camera
config S5K6B2_POSITION_REAR
	bool "rear camera"
	depends on VIDEO_EXYNOS5_FIMC_IS
	help
	  This set as rear camera
endchoice

config VISION_MODE
	bool "Enable Vision mode"
	depends on (VIDEO_FIMC_MIPI || VIDEO_S5P_MIPI_CSIS ||\
			VIDEO_EXYNOS_MIPI_CSIS) && VIDEO_S5K6B2 &&\
			VIDEO_EXYNOS5_FIMC_IS_SENSOR
	---help---
	  This enables support for Vision mode
```

## drivers/media/video/exynos/fimc-is/Kconfig
```kconfig
config VIDEO_EXYNOS_FIMC_IS
	bool "Exynos FIMC-IS (Image Subsystem) driver"
	depends on VIDEO_EXYNOS && ARCH_EXYNOS4
	default n
	help
	  This is a v4l2 subdev driver for samsung FIMC-IS device.
config VIDEO_EXYNOS_FIMC_IS_BAYER
	bool "Enable FIMC-IS bayer write"
	depends on VIDEO_EXYNOS_FIMC_IS
	default n
	help
	  Enable to write bayer output image.
```

## drivers/media/video/exynos/fimc-lite/Kconfig
```kconfig
config VIDEO_EXYNOS_FIMC_LITE
	bool "Exynos Camera Interface(FIMC-Lite) driver"
	depends on VIDEO_EXYNOS && (ARCH_EXYNOS4 || ARCH_EXYNOS5)
	select MEDIA_EXYNOS
	default n
	help
	  This is a v4l2 driver for exynos camera interface device.

if VIDEO_EXYNOS_FIMC_LITE && VIDEOBUF2_CMA_PHYS
comment "Reserved memory configurations"
config VIDEO_SAMSUNG_MEMSIZE_FLITE0
	int "Memory size in kbytes for FLITE0"
	default "10240"

config VIDEO_SAMSUNG_MEMSIZE_FLITE1
	int "Memory size in kbytes for FLITE1"
	default "10240"
endif
```

## drivers/media/video/exynos/fimg2d/Kconfig
```kconfig
# drivers/media/video/exynos/fimg2d/Kconfig
#
# Copyright (c) 2011 Samsung Electronics Co., Ltd.
#	http://www.samsung.com/
#
# Licensed under GPLv2

config VIDEO_EXYNOS_FIMG2D
	bool "Samsung Graphics 2D Driver"
	depends on VIDEO_EXYNOS && (ARCH_EXYNOS4 || ARCH_EXYNOS5)
	default n
	---help---
	  This is a graphics 2D driver for Samsung ARM based SoC.

config FIMG2D_CCI_SNOOP
	bool "Enables CCI snoop control"
	depends on VIDEO_EXYNOS_FIMG2D && EXYNOS5_CCI
	default n
	---help---
	  This enables CCI snoop control for cache coherency.
```

## drivers/media/video/exynos/gsc/Kconfig
```kconfig
config VIDEO_EXYNOS_GSCALER
	bool "Exynos G-Scaler driver"
	depends on VIDEO_EXYNOS
	select MEDIA_EXYNOS
	select V4L2_MEM2MEM_DEV
	default n
	help
	  This is a v4l2 driver for exynos G-Scaler device.

if VIDEO_EXYNOS_GSCALER && VIDEOBUF2_CMA_PHYS
comment "Reserved memory configurations"
config VIDEO_SAMSUNG_MEMSIZE_GSC0
	int "Memory size in kbytes for GSC0"
	default "5120"

config VIDEO_SAMSUNG_MEMSIZE_GSC1
	int "Memory size in kbytes for GSC1"
	default "5120"

config VIDEO_SAMSUNG_MEMSIZE_GSC2
	int "Memory size in kbytes for GSC2"
	default "5120"

config VIDEO_SAMSUNG_MEMSIZE_GSC3
	int "Memory size in kbytes for GSC3"
	default "5120"
endif
```
