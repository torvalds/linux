## drivers/media/video/exynos/jpeg/Kconfig
```kconfig
#
# Configuration for JPEG
#

config VIDEO_EXYNOS_JPEG
	bool "Samsung JPEG_v2.x driver"
	depends on VIDEO_EXYNOS
	default n
	depends on VIDEO_DEV && VIDEO_V4L2
	select V4L2_MEM2MEM_DEV
	---help---
	  This is a Samsung JPEG H/W driver for V2.x
```

## drivers/media/video/exynos/jpeg_hx/Kconfig
```kconfig
#
# Configuration for JPEG
#

config VIDEO_EXYNOS_JPEG_HX
	bool "Samsung JPEG_hx driver"
	depends on VIDEO_EXYNOS
	default n
	depends on VIDEO_DEV && VIDEO_V4L2
	select VIDEOBUF2_DMA_CONTIG
	select V4L2_MEM2MEM_DEV
	---help---
	  This is a Samsung JPEG H/W driver for hx
```

## drivers/media/video/exynos/mdev/Kconfig
```kconfig
config EXYNOS_MEDIA_DEVICE
	bool
	depends on MEDIA_EXYNOS
	select MEDIA_CONTROLLER
	select VIDEO_V4L2_SUBDEV_API
	default y
	help
	  This is a v4l2 driver for exynos media device.
```

## drivers/media/video/exynos/mfc/Kconfig
```kconfig
config VIDEO_EXYNOS_MFC
	bool "Exynos MFC Driver"
	depends on VIDEO_EXYNOS
	select VIDEOBUF2_CORE
	select EXYNOS_MFC_V6
	---help---
	  MFC driver for V4L2.

choice
depends on VIDEO_EXYNOS_MFC
prompt "MFC version"
default EXYNOS_MFC_V6
config EXYNOS_MFC_V5
prompt "MFC version 5"
	bool
	depends on ARCH_EXYNOS4

config EXYNOS_MFC_V6
prompt "MFC version 6"
	bool
	depends on ARCH_EXYNOS5
endchoice
```

## drivers/media/video/exynos/mipi-csis/Kconfig
```kconfig
config VIDEO_EXYNOS_MIPI_CSIS
	bool "Exynos MIPI-CSIS driver"
	depends on VIDEO_EXYNOS && VIDEO_EXYNOS_FIMC_LITE &&\
		(ARCH_EXYNOS4 || ARCH_EXYNOS5)
	select MEDIA_EXYNOS
	default n
	help
	  This is a v4l2 driver for exynos mipi-csis interface device.
```

## drivers/media/video/exynos/rotator/Kconfig
```kconfig
config VIDEO_EXYNOS_ROTATOR
	bool "Exynos image rotator driver"
	depends on VIDEO_EXYNOS && (ARCH_EXYNOS4 || ARCH_EXYNOS5)
	select V4L2_MEM2MEM_DEV
	default n
	help
	  This is a v4l2 driver for EXYNOS Image Rotator device.
```

## drivers/media/video/exynos/scaler/Kconfig
```kconfig
config VIDEO_EXYNOS_SCALER
	bool "EXYNOS Scaler Driver"
	depends on VIDEO_EXYNOS && ARCH_EXYNOS5
	select V4L2_MEM2MEM_DEV
	default n
	help
	  This is a v4l2 driver for EXYNOS Scaler device.
```

## drivers/media/video/exynos/tv/Kconfig
```kconfig
# drivers/media/video/s5p-tv/Kconfig
#
# Copyright (c) 2010-2011 Samsung Electronics Co., Ltd.
#	http://www.samsung.com/
# Tomasz Stanislawski <t.stanislaws@samsung.com>
#
# Licensed under GPL

comment "Exynos TV support"

config VIDEO_EXYNOS_TV
	bool "Samsung TV driver for S5P platform (experimental)"
	depends on PLAT_S5P
	depends on EXPERIMENTAL
	select MEDIA_EXYNOS
	select VIDEO_EXYNOS_HDMI
	select VIDEO_EXYNOS_MIXER
	default n
	---help---
	  Say Y here to enable selecting the TV output devices for
	  Samsung S5P platform.

if VIDEO_EXYNOS_TV

config VIDEO_EXYNOS_HDMI
	tristate "Samsung HDMI Driver"
	depends on VIDEO_V4L2
	depends on VIDEO_EXYNOS_TV
	depends on SWITCH
	select FB_MODE_HELPERS
	help
	  Say Y here if you want support for the HDMI output
	  interface in S5P Samsung SoC. The driver can be compiled
	  as module. It is an auxiliary driver, that exposes a V4L2
	  subdev for use by other drivers. This driver requires
	  hdmiphy driver to work correctly.

config VIDEO_EXYNOS_HDMI_AUDIO_I2S
	bool "Enable HDMI audio using I2S path"
	depends on VIDEO_EXYNOS_HDMI
	depends on SND_SAMSUNG_I2S
	default y
	help
	  Enables HDMI audio through I2S path.

config VIDEO_EXYNOS_HDMI_AUDIO_SPDIF
	bool "Enable HDMI audio using SPDIF path"
	depends on VIDEO_EXYNOS_HDMI
	depends on SND_SOC_SAMSUNG_SMDK_SPDIF
	default n
	help
	  Enables HDMI audio through SPDIF path.

config VIDEO_EXYNOS_HDMI_DEBUG
	bool "Enable debug for HDMI Driver"
	depends on VIDEO_EXYNOS_HDMI
	default n
	help
	  Enables debugging for HDMI driver.

config VIDEO_EXYNOS_HDMIPHY
	tristate "Samsung HDMIPHY Driver"
	depends on VIDEO_DEV && VIDEO_V4L2 && I2C
	depends on VIDEO_EXYNOS_TV
	depends on CPU_EXYNOS4210 || CPU_EXYNOS4212 || CPU_EXYNOS4412 || CPU_EXYNOS5250
	help
	  Say Y here if you want support for the physical HDMI
	  interface in S5P Samsung SoC. The driver can be compiled
	  as module. It is an I2C driver, that exposes a V4L2
	  subdev for use by other drivers.

config VIDEO_EXYNOS_SDO
	tristate "Samsung Analog TV Driver"
	depends on VIDEO_DEV && VIDEO_V4L2
	depends on VIDEO_EXYNOS_TV
	depends on CPU_EXYNOS4210
	help
	  Say Y here if you want support for the analog TV output
	  interface in S5P Samsung SoC. The driver can be compiled
	  as module. It is an auxiliary driver, that exposes a V4L2
	  subdev for use by other drivers. This driver requires
	  hdmiphy driver to work correctly.

config VIDEO_EXYNOS_MIXER
	tristate "Samsung Mixer and Video Processor Driver"
	depends on VIDEO_DEV && VIDEO_V4L2
	depends on VIDEO_EXYNOS_TV
	select VIDEOBUF2_DMA_CONTIG
	help
	  Say Y here if you want support for the Mixer in Samsung S5P SoCs.
	  This device produce image data to one of output interfaces.

config VIDEO_EXYNOS_FB2
    bool "Vedio buffer2 enable"
    depends on !ANDROID_PARANOID_NETWORK
	select VIDEOBUF2_FB
    help
      Say Y hear if you want support for videobuf-fb2.	  

config VIDEO_EXYNOS_HDMI_CEC
	tristate "Samsung HDMI CEC Driver"
	depends on VIDEO_DEV && VIDEO_V4L2 && I2C
	depends on VIDEO_EXYNOS_TV
	help
	  Say Y here if you want support for the HDMI CEC
	  interface in S5P Samsung SoC. The driver can be compiled
	  as module.

config VIDEO_SAMSUNG_MEMSIZE_TV
	int "Memory size in kbytes for TV"
	depends on VIDEO_EXYNOS_MIXER && VIDEOBUF2_CMA_PHYS
	default "16200"

config VIDEO_EXYNOS_MIXER_DEBUG
	bool "Enable debug for Mixer Driver"
	depends on VIDEO_EXYNOS_MIXER
	default n
	help
	  Enables debugging for Mixer driver.

endif # VIDEO_EXYNOS_TV
```
