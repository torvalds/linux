## drivers/media/i2c/m5mols/Kconfig
```kconfig
# SPDX-License-Identifier: GPL-2.0-only
config VIDEO_M5MOLS
	tristate "Fujitsu M-5MOLS 8MP sensor support"
	depends on I2C && VIDEO_V4L2
	select MEDIA_CONTROLLER
	select VIDEO_V4L2_SUBDEV_API
	help
	  This driver supports Fujitsu M-5MOLS camera sensor with ISP
```

## drivers/media/i2c/maxim2c/Kconfig
```kconfig
# SPDX-License-Identifier: GPL-2.0-only
#
# Maxim Dual GMSL deserializer and serializer devices
#
config VIDEO_DES_MAXIM2C
	tristate "Maxim Dual GMSL deserializer support"
	depends on I2C && VIDEO_V4L2 && VIDEO_V4L2_SUBDEV_API
	depends on MEDIA_CAMERA_SUPPORT
	select V4L2_FWNODE
	help
	  This driver supports the Maxim Dual GMSL2/GMSL1 deserializer.

	  To compile this driver as a module, choose M here: the
	  module will be called maxim2c.

menu "Maxim Dual GMSL serializer devices support"
	visible if VIDEO_DES_MAXIM2C

config MAXIM2C_SER_MAX9295
	tristate "Maxim GMSL2 serializer max9295 support"
	depends on VIDEO_DES_MAXIM2C
	help
	  This driver supports the Maxim GMSL2 max9295 serializer.

	  To compile this driver as a module, choose M here: the
	  module will be called remote_max9295.

config MAXIM2C_SER_MAX96715
	tristate "Maxim GMSL1 Serializer max96715 support"
	depends on VIDEO_DES_MAXIM2C
	help
	  This driver supports the Maxim GMSL1 max96715 serializer.

	  To compile this driver as a module, choose M here: the
	  module will be called remote_max96715.

config MAXIM2C_SER_MAX96717
	tristate "Maxim GMSL2 Serializer max96717 support"
	depends on VIDEO_DES_MAXIM2C
	help
	  This driver supports the Maxim GMSL2 max96717 serializer.

	  To compile this driver as a module, choose M here: the
	  module will be called remote_max96717.

endmenu
```

## drivers/media/i2c/maxim4c/Kconfig
```kconfig
# SPDX-License-Identifier: GPL-2.0-only
#
# Maxim Quad GMSL deserializer and serializer devices
#
config VIDEO_DES_MAXIM4C
	tristate "Maxim Quad GMSL deserializer support"
	depends on I2C && VIDEO_V4L2 && VIDEO_V4L2_SUBDEV_API
	depends on MEDIA_CAMERA_SUPPORT
	select V4L2_FWNODE
	help
	  This driver supports the Maxim Quad GMSL2/GMSL1 deserializer.

	  To compile this driver as a module, choose M here: the
	  module will be called maxim4c.

menu "Maxim Quad GMSL serializer devices support"
	visible if VIDEO_DES_MAXIM4C

config MAXIM4C_SER_MAX9295
	tristate "Maxim GMSL2 serializer max9295 support"
	depends on VIDEO_DES_MAXIM4C
	help
	  This driver supports the Maxim GMSL2 max9295 serializer.

	  To compile this driver as a module, choose M here: the
	  module will be called remote_max9295.

config MAXIM4C_SER_MAX96715
	tristate "Maxim GMSL1 Serializer max96715 support"
	depends on VIDEO_DES_MAXIM4C
	help
	  This driver supports the Maxim GMSL1 max96715 serializer.

	  To compile this driver as a module, choose M here: the
	  module will be called remote_max96715.

config MAXIM4C_SER_MAX96717
	tristate "Maxim GMSL2 Serializer max96717 support"
	depends on VIDEO_DES_MAXIM4C
	help
	  This driver supports the Maxim GMSL2 max96717 serializer.

	  To compile this driver as a module, choose M here: the
	  module will be called remote_max96717.

endmenu
```

## drivers/media/i2c/rk628/Kconfig
```kconfig
# SPDX-License-Identifier: GPL-2.0-only
config VIDEO_RK628
	tristate
	help
	  Support for the Rockchip RK628 HDMI to MIPI CSI-2/BT1120 bridge.

	  To compile this driver as a module, choose M here: the
	  module will be called video-rk628.

config VIDEO_RK628_CSI
	tristate "Rockchip RK628_CSI decoder"
	depends on VIDEO_V4L2 && I2C && VIDEO_V4L2_SUBDEV_API
	select HDMI
	select V4L2_FWNODE
	select VIDEO_RK628
	help
	  Support for the Rockchip RK628 HDMI to MIPI CSI-2 bridge.

	  To compile this driver as a module, choose M here: the
	  module will be called rk628-csi.

config VIDEO_RK628_BT1120
	tristate "Rockchip RK628_BT1120 decoder"
	depends on VIDEO_V4L2 && I2C && VIDEO_V4L2_SUBDEV_API
	select HDMI
	select V4L2_FWNODE
	select VIDEO_RK628
	help
	  Support for the Rockchip RK628 HDMI to BT1120 bridge.

	  To compile this driver as a module, choose M here: the
	  module will be called rk628-bt1120.
```

## drivers/media/i2c/smiapp/Kconfig
```kconfig
# SPDX-License-Identifier: GPL-2.0-only
config VIDEO_SMIAPP
	tristate "SMIA++/SMIA sensor support"
	depends on I2C && VIDEO_V4L2 && HAVE_CLK
	select MEDIA_CONTROLLER
	select VIDEO_V4L2_SUBDEV_API
	select VIDEO_SMIAPP_PLL
	select V4L2_FWNODE
	help
	  This is a generic driver for SMIA++/SMIA camera modules.
```

## drivers/media/i2c/soc_camera/Kconfig
```kconfig
comment "soc_camera sensor drivers"

config SOC_CAMERA_MT9M111
	tristate "legacy soc_camera mt9m111, mt9m112 and mt9m131 support"
	depends on SOC_CAMERA && I2C
	select VIDEO_MT9M111
	help
	  This driver supports MT9M111, MT9M112 and MT9M131 cameras from
	  Micron/Aptina.
	  This is the legacy configuration which shouldn't be used anymore,
	  while VIDEO_MT9M111 should be used instead.

config SOC_CAMERA_MT9V022
	tristate "mt9v022 and mt9v024 support"
	depends on SOC_CAMERA && I2C
	help
	  This driver supports MT9V022 cameras from Micron

config SOC_CAMERA_OV5642
	tristate "ov5642 camera support"
	depends on SOC_CAMERA && I2C
	help
	  This is a V4L2 camera driver for the OmniVision OV5642 sensor

config SOC_CAMERA_OV9740
	tristate "ov9740 camera support"
	depends on SOC_CAMERA && I2C
	help
	  This is a ov9740 camera driver

config SOC_CAMERA_RJ54N1
	tristate "rj54n1cb0c support"
	depends on SOC_CAMERA && I2C
	help
	  This is a rj54n1cb0c video driver
```

## drivers/media/i2c/soc_camera/rockchip/Kconfig
```kconfig
# SPDX-License-Identifier: GPL-2.0
config VIDEO_OV8858
	tristate "ov8858 driver adapt to rockchip cif isp platform"
	depends on VIDEO_V4L2 && VIDEO_RK_CIF_ISP10 && I2C
	default n
	---help---
	  This is ov8858 camera driver adapt to rockchip cif isp platform.

config VIDEO_OV2710
	tristate "ov2710 driver adapt to rockchip cif isp platform"
	depends on VIDEO_V4L2 && VIDEO_RK_CIF_ISP10 && I2C
	default n
	---help---
	  This is ov2710 camera driver adapt to rockchip cif isp platform.

config VIDEO_OV4689
	tristate "ov4689 driver adapt to rockchip cif isp platform"
	depends on VIDEO_V4L2 && VIDEO_RK_CIF_ISP10 && I2C
	default n
	---help---
	  This is OV4689 camera driver adapt to rockchip cif isp platform.

config VIDEO_IMX323
	tristate "imx323 driver adapt to rockchip cif isp platform"
	depends on VIDEO_V4L2 && VIDEO_RK_CIF_ISP10 && I2C
	default n
	---help---
	  This is imx323 camera driver adapt to rockchip cif isp platform.

config VIDEO_OV7750
	tristate "ov7750 driver adapt to rockchip cif isp platform"
	depends on VIDEO_V4L2 && VIDEO_RK_CIF_ISP10 && I2C
	default n
	---help---
	  This is ov7750 camera driver adapt to rockchip cif isp platform.

config VIDEO_TC358749XBG
	tristate "tc358749xbg driver adapt to rockchip cif isp platform"
	depends on VIDEO_V4L2 && VIDEO_RK_CIF_ISP10 && I2C
	default n
	---help---
	  This is tc358749xbg hdmi video driver adapt to rockchip cif isp platform.

config VIDEO_ADV7181
	tristate "adv7181 driver adapt to rockchip cif isp platform"
	depends on VIDEO_V4L2 && VIDEO_RK_CIF_ISP10 && I2C
	default n
	---help---
	  This is adv7181 cvbs video driver adapt to rockchip cif isp platform.

config VIDEO_OV7675
	tristate "ov7675 driver adapt to rockchip cif isp platform"
	depends on VIDEO_V4L2 && VIDEO_RK_CIF_ISP10 && I2C
	default n
	---help---
	  This is ov7675 camera driver adapt to rockchip cif isp platform.

config VIDEO_NT99230
	tristate "nt99230 driver adapt to rockchip cif isp platform"
	depends on VIDEO_V4L2 && VIDEO_RK_CIF_ISP10 && I2C
	default n
	---help---
	  This is nt99230 hdmi video driver adapt to rockchip cif isp platform.

config VIDEO_OV13850
	tristate "ov13850 driver adapt to rockchip cif isp platform"
	depends on VIDEO_V4L2 && VIDEO_RK_CIF_ISP10 && I2C
	default n
	---help---
	  This is ov13850 camera driver adapt to rockchip cif isp platform.

config VIDEO_OV9750
	tristate "ov9750 driver adapt to rockchip cif isp platform"
	depends on VIDEO_V4L2 && VIDEO_RK_CIF_ISP10 && I2C
	default n
	---help---
	  This is ov9750 camera driver adapt to rockchip cif isp platform.
```

## drivers/media/mc/Kconfig
```kconfig
# SPDX-License-Identifier: GPL-2.0

#
# Media controller
#

config MEDIA_CONTROLLER_DVB
	bool "Enable Media controller for DVB (EXPERIMENTAL)"
	depends on MEDIA_CONTROLLER && DVB_CORE
	help
	  Enable the media controller API support for DVB.

	  This is currently experimental.
```

## drivers/media/mdtv/Kconfig
```kconfig
#
# Mobile Digital TV device configuration
#

config MDTV_SIANO_STELLAR_USB
	tristate "Siano SMS10xx USB dongle support"
	default m
	---help---
	  Choose Y here if you have USB dongle with SMS10xx chipset.

	  Further documentation on this driver can be found on the WWW at
	  <http://www.siano-ms.com/>.

	  To compile this driver as a module, choose M here: the
	  modules will be called smschar and smsnet.
```

## drivers/media/mmc/Kconfig
```kconfig
# SPDX-License-Identifier: GPL-2.0-only
source "drivers/media/mmc/siano/Kconfig"
```

## drivers/media/mmc/siano/Kconfig
```kconfig
# SPDX-License-Identifier: GPL-2.0-only
#
# Siaanal Mobile Silicon Digital TV device configuration
#
comment "MMC/SDIO DVB adapters"
	depends on DVB_CORE && HAS_DMA && MMC

config SMS_SDIO_DRV
	tristate "Siaanal SMS1xxx based MDTV via SDIO interface"
	depends on DVB_CORE && HAS_DMA
	depends on MMC
	depends on !RC_CORE || RC_CORE
	select MEDIA_COMMON_OPTIONS
	select SMS_SIAANAL_MDTV
	help
	  Choose if you would like to have Siaanal's support for SDIO interface
```

## drivers/media/pci/Kconfig
```kconfig
# SPDX-License-Identifier: GPL-2.0-only

if PCI

menuconfig MEDIA_PCI_SUPPORT
	bool "Media PCI Adapters"
	help
	  Enable media drivers for PCI/PCIe bus.
	  If you have such devices, say Y.

if MEDIA_PCI_SUPPORT

if MEDIA_CAMERA_SUPPORT
	comment "Media capture support"

source "drivers/media/pci/meye/Kconfig"
source "drivers/media/pci/solo6x10/Kconfig"
source "drivers/media/pci/sta2x11/Kconfig"
source "drivers/media/pci/tw5864/Kconfig"
source "drivers/media/pci/tw68/Kconfig"
source "drivers/media/pci/tw686x/Kconfig"

endif

if MEDIA_ANALOG_TV_SUPPORT
	comment "Media capture/analog TV support"

source "drivers/media/pci/dt3155/Kconfig"
source "drivers/media/pci/ivtv/Kconfig"
source "drivers/media/pci/saa7146/Kconfig"

endif

if MEDIA_ANALOG_TV_SUPPORT || MEDIA_DIGITAL_TV_SUPPORT
	comment "Media capture/analog/hybrid TV support"

source "drivers/media/pci/bt8xx/Kconfig"
source "drivers/media/pci/cobalt/Kconfig"
source "drivers/media/pci/cx18/Kconfig"
source "drivers/media/pci/cx23885/Kconfig"
source "drivers/media/pci/cx25821/Kconfig"
source "drivers/media/pci/cx88/Kconfig"
source "drivers/media/pci/saa7134/Kconfig"
source "drivers/media/pci/saa7164/Kconfig"

endif

if MEDIA_DIGITAL_TV_SUPPORT
	comment "Media digital TV PCI Adapters"

source "drivers/media/pci/b2c2/Kconfig"
source "drivers/media/pci/ddbridge/Kconfig"
source "drivers/media/pci/dm1105/Kconfig"
source "drivers/media/pci/mantis/Kconfig"
source "drivers/media/pci/netup_unidvb/Kconfig"
source "drivers/media/pci/ngene/Kconfig"
source "drivers/media/pci/pluto2/Kconfig"
source "drivers/media/pci/pt1/Kconfig"
source "drivers/media/pci/pt3/Kconfig"
source "drivers/media/pci/smipcie/Kconfig"
source "drivers/media/pci/ttpci/Kconfig"

endif

config VIDEO_PCI_SKELETON
	tristate "Skeleton PCI V4L2 driver"
	depends on SAMPLES
	depends on MEDIA_TEST_SUPPORT
	depends on PCI && VIDEO_DEV
	select VIDEOBUF2_MEMOPS
	select VIDEOBUF2_DMA_CONTIG
	help
	  Enable build of the skeleton PCI driver, used as a reference
	  when developing new drivers.

source "drivers/media/pci/intel/ipu3/Kconfig"

endif #MEDIA_PCI_SUPPORT
endif #PCI
```

## drivers/media/pci/b2c2/Kconfig
```kconfig
config DVB_B2C2_FLEXCOP_PCI
	tristate "Technisat/B2C2 Air/Sky/Cable2PC PCI"
	depends on DVB_CORE && I2C
	help
	  Support for the Air/Sky/CableStar2 PCI card (DVB/ATSC) by Technisat/B2C2.

	  Say Y if you own such a device and want to use it.

config DVB_B2C2_FLEXCOP_PCI_DE
	bool "Enable de for the B2C2 FlexCop drivers"
	depends on DVB_B2C2_FLEXCOP_PCI
	select DVB_B2C2_FLEXCOP_DE
	help
	  Say Y if you want to enable the module option to control de messages
	  of all B2C2 FlexCop drivers.
```

## drivers/media/pci/bt8xx/Kconfig
```kconfig
config VIDEO_BT848
	tristate "BT848 Video For Linux"
	depends on VIDEO_DEV && PCI && I2C && VIDEO_V4L2
	select I2C_ALGOBIT
	select VIDEOBUF_DMA_SG
	depends on RC_CORE
	depends on MEDIA_RADIO_SUPPORT
	select VIDEO_TUNER
	select VIDEO_TVEEPROM
	select VIDEO_MSP3400 if MEDIA_SUBDRV_AUTOSELECT
	select VIDEO_TVAUDIO if MEDIA_SUBDRV_AUTOSELECT
	select VIDEO_TDA7432 if MEDIA_SUBDRV_AUTOSELECT
	select VIDEO_SAA6588 if MEDIA_SUBDRV_AUTOSELECT
	select RADIO_ADAPTERS
	select RADIO_TEA575X
	---help---
	  Support for BT848 based frame grabber/overlay boards. This includes
	  the Miro, Hauppauge and STB boards. Please read the material in
	  <file:Documentation/media/v4l-drivers/bttv.rst> for more information.

	  To compile this driver as a module, choose M here: the
	  module will be called bttv.

config DVB_BT8XX
	tristate "DVB/ATSC Support for bt878 based TV cards"
	depends on DVB_CORE && PCI && I2C && VIDEO_BT848
	select DVB_MT352 if MEDIA_SUBDRV_AUTOSELECT
	select DVB_SP887X if MEDIA_SUBDRV_AUTOSELECT
	select DVB_NXT6000 if MEDIA_SUBDRV_AUTOSELECT
	select DVB_CX24110 if MEDIA_SUBDRV_AUTOSELECT
	select DVB_OR51211 if MEDIA_SUBDRV_AUTOSELECT
	select DVB_LGDT330X if MEDIA_SUBDRV_AUTOSELECT
	select DVB_ZL10353 if MEDIA_SUBDRV_AUTOSELECT
	select MEDIA_TUNER_SIMPLE if MEDIA_SUBDRV_AUTOSELECT
	help
	  Support for PCI cards based on the Bt8xx PCI bridge. Examples are
	  the Nebula cards, the Pinnacle PCTV cards, the Twinhan DST cards,
	  the pcHDTV HD2000 cards, the DViCO FusionHDTV Lite cards, and
	  some AVerMedia cards.

	  Since these cards have no MPEG decoder onboard, they transmit
	  only compressed MPEG data over the PCI bus, so you need
	  an external software decoder to watch TV on your computer.

	  Say Y if you own such a device and want to use it.
```

## drivers/media/pci/cobalt/Kconfig
```kconfig
# SPDX-License-Identifier: GPL-2.0-only
config VIDEO_COBALT
	tristate "Cisco Cobalt support"
	depends on VIDEO_DEV && I2C
	depends on PCI_MSI && MTD_COMPLEX_MAPPINGS
	depends on (GPIOLIB && DRM_I2C_ADV7511=n) || COMPILE_TEST
	depends on SND
	depends on MTD
	select MEDIA_CONTROLLER
	select VIDEO_V4L2_SUBDEV_API
	select I2C_ALGOBIT
	select SND_PCM
	select VIDEO_ADV7604
	select VIDEO_ADV7511
	select VIDEO_ADV7842
	select VIDEOBUF2_DMA_SG
	help
	  This is a video4linux driver for the Cisco PCIe Cobalt card.

	  This board is sadly not available outside of Cisco, but it is
	  very useful as an example of a real driver that uses all the
	  latest frameworks and APIs.

	  To compile this driver as a module, choose M here: the
	  module will be called cobalt.
```

## drivers/media/pci/cx18/Kconfig
```kconfig
config VIDEO_CX18
	tristate "Conexant cx23418 MPEG encoder support"
	depends on VIDEO_V4L2 && DVB_CORE && PCI && I2C
	select I2C_ALGOBIT
	select VIDEOBUF_VMALLOC
	depends on RC_CORE
	select VIDEO_TUNER
	select VIDEO_TVEEPROM
	select VIDEO_CX2341X
	select VIDEO_CS5345
	select DVB_S5H1409 if MEDIA_SUBDRV_AUTOSELECT
	select MEDIA_TUNER_MXL5005S if MEDIA_SUBDRV_AUTOSELECT
	select DVB_S5H1411 if MEDIA_SUBDRV_AUTOSELECT
	select MEDIA_TUNER_TDA18271 if MEDIA_SUBDRV_AUTOSELECT
	select MEDIA_TUNER_TDA8290 if MEDIA_SUBDRV_AUTOSELECT
	---help---
	  This is a video4linux driver for Conexant cx23418 based
	  PCI combo video recorder devices.

	  This is used in devices such as the Hauppauge HVR-1600
	  cards.

	  To compile this driver as a module, choose M here: the
	  module will be called cx18.

config VIDEO_CX18_ALSA
	tristate "Conexant 23418 DMA audio support"
	depends on VIDEO_CX18 && SND
	select SND_PCM
	---help---
	  This is a video4linux driver for direct (DMA) audio on
	  Conexant 23418 based TV cards using ALSA.

	  To compile this driver as a module, choose M here: the
	  module will be called cx18-alsa.
```
