## drivers/media/pci/sta2x11/Kconfig
```kconfig
# SPDX-License-Identifier: GPL-2.0-only
config STA2X11_VIP
	tristate "STA2X11 VIP Video For Linux"
	depends on PCI && VIDEO_DEV && VIRT_TO_BUS && I2C
	depends on STA2X11 || COMPILE_TEST
	select GPIOLIB if MEDIA_SUBDRV_AUTOSELECT
	select VIDEO_ADV7180 if MEDIA_SUBDRV_AUTOSELECT
	select VIDEOBUF2_DMA_CONTIG
	select MEDIA_CONTROLLER
	select VIDEO_V4L2_SUBDEV_API
	help
	  Say Y for support for STA2X11 VIP (Video Input Port) capture
	  device.

	  To compile this driver as a module, choose M here: the
	  module will be called sta2x11_vip.
```

## drivers/media/pci/ttpci/Kconfig
```kconfig
# SPDX-License-Identifier: GPL-2.0-only
config DVB_BUDGET_CORE
	tristate "SAA7146 DVB cards (aka Budget, Nova-PCI)"
	depends on DVB_CORE && PCI && I2C
	select VIDEO_SAA7146
	select TTPCI_EEPROM
	help
	  Support for simple SAA7146 based DVB cards
	  (so called Budget- or Nova-PCI cards) without onboard
	  MPEG2 decoder.

config DVB_BUDGET
	tristate "Budget cards"
	depends on DVB_BUDGET_CORE && I2C
	select DVB_STV0299 if MEDIA_SUBDRV_AUTOSELECT
	select DVB_VES1X93 if MEDIA_SUBDRV_AUTOSELECT
	select DVB_VES1820 if MEDIA_SUBDRV_AUTOSELECT
	select DVB_L64781 if MEDIA_SUBDRV_AUTOSELECT
	select DVB_TDA8083 if MEDIA_SUBDRV_AUTOSELECT
	select DVB_S5H1420 if MEDIA_SUBDRV_AUTOSELECT
	select DVB_TDA10086 if MEDIA_SUBDRV_AUTOSELECT
	select DVB_TDA826X if MEDIA_SUBDRV_AUTOSELECT
	select DVB_LNBP21 if MEDIA_SUBDRV_AUTOSELECT
	select DVB_TDA1004X if MEDIA_SUBDRV_AUTOSELECT
	select DVB_ISL6423 if MEDIA_SUBDRV_AUTOSELECT
	select DVB_STV090x if MEDIA_SUBDRV_AUTOSELECT
	select DVB_STV6110x if MEDIA_SUBDRV_AUTOSELECT
	help
	  Support for simple SAA7146 based DVB cards (so called Budget-
	  or Nova-PCI cards) without onboard MPEG2 decoder, and without
	  analog inputs or an onboard Common Interface connector.

	  Say Y if you own such a card and want to use it.

	  To compile this driver as a module, choose M here: the
	  module will be called budget.

config DVB_BUDGET_CI
	tristate "Budget cards with onboard CI connector"
	depends on DVB_BUDGET_CORE && I2C
	select DVB_STV0297 if MEDIA_SUBDRV_AUTOSELECT
	select DVB_STV0299 if MEDIA_SUBDRV_AUTOSELECT
	select DVB_TDA1004X if MEDIA_SUBDRV_AUTOSELECT
	select DVB_STB0899 if MEDIA_SUBDRV_AUTOSELECT
	select DVB_STB6100 if MEDIA_SUBDRV_AUTOSELECT
	select DVB_LNBP21 if MEDIA_SUBDRV_AUTOSELECT
	select DVB_STV0288 if MEDIA_SUBDRV_AUTOSELECT
	select DVB_STB6000 if MEDIA_SUBDRV_AUTOSELECT
	select DVB_TDA10023 if MEDIA_SUBDRV_AUTOSELECT
	select MEDIA_TUNER_TDA827X if MEDIA_SUBDRV_AUTOSELECT
	depends on RC_CORE
	help
	  Support for simple SAA7146 based DVB cards
	  (so called Budget- or Nova-PCI cards) without onboard
	  MPEG2 decoder, but with onboard Common Interface connector.

	  Note: The Common Interface is not yet supported by this driver
	  due to lack of information from the vendor.

	  Say Y if you own such a card and want to use it.

	  To compile this driver as a module, choose M here: the
	  module will be called budget-ci.

config DVB_BUDGET_AV
	tristate "Budget cards with analog video inputs"
	depends on DVB_BUDGET_CORE && I2C
	select VIDEO_SAA7146_VV
	depends on VIDEO_DEV	# dependencies of VIDEO_SAA7146_VV
	select DVB_PLL if MEDIA_SUBDRV_AUTOSELECT
	select DVB_STV0299 if MEDIA_SUBDRV_AUTOSELECT
	select DVB_TDA1004X if MEDIA_SUBDRV_AUTOSELECT
	select DVB_TDA10021 if MEDIA_SUBDRV_AUTOSELECT
	select DVB_TDA10023 if MEDIA_SUBDRV_AUTOSELECT
	select DVB_STB0899 if MEDIA_SUBDRV_AUTOSELECT
	select DVB_TDA8261 if MEDIA_SUBDRV_AUTOSELECT
	select DVB_TUA6100 if MEDIA_SUBDRV_AUTOSELECT
	help
	  Support for simple SAA7146 based DVB cards
	  (so called Budget- or Nova-PCI cards) without onboard
	  MPEG2 decoder, but with one or more analog video inputs.

	  Say Y if you own such a card and want to use it.

	  To compile this driver as a module, choose M here: the
	  module will be called budget-av.
```

## drivers/media/pci/tw5864/Kconfig
```kconfig
# SPDX-License-Identifier: GPL-2.0-only
config VIDEO_TW5864
	tristate "Techwell TW5864 video/audio grabber and encoder"
	depends on VIDEO_DEV && PCI
	select VIDEOBUF2_DMA_CONTIG
	help
	  Support for boards based on Techwell TW5864 chip which provides
	  multichannel video & audio grabbing and encoding (H.264, MJPEG,
	  ADPCM G.726).

	  To compile this driver as a module, choose M here: the
	  module will be called tw5864.
```

## drivers/media/pci/tw68/Kconfig
```kconfig
# SPDX-License-Identifier: GPL-2.0-only
config VIDEO_TW68
	tristate "Techwell tw68x Video For Linux"
	depends on VIDEO_DEV && PCI
	select VIDEOBUF2_DMA_SG
	help
	  Support for Techwell tw68xx based frame grabber boards.

	  To compile this driver as a module, choose M here: the
	  module will be called tw68.
```

## drivers/media/pci/tw686x/Kconfig
```kconfig
# SPDX-License-Identifier: GPL-2.0-only
config VIDEO_TW686X
	tristate "Intersil/Techwell TW686x video capture cards"
	depends on PCI && VIDEO_DEV && SND
	select VIDEOBUF2_VMALLOC
	select VIDEOBUF2_DMA_CONTIG
	select VIDEOBUF2_DMA_SG
	select SND_PCM
	help
	  Support for Intersil/Techwell TW686x-based frame grabber cards.

	  Currently supported chips:
	  - TW6864 (4 video channels),
	  - TW6865 (4 video channels, not tested, second generation chip),
	  - TW6868 (8 video channels but only 4 first channels using
	    built-in video decoder are supported, not tested),
	  - TW6869 (8 video channels, second generation chip).

	  To compile this driver as a module, choose M here: the module
	  will be named tw686x.
```

## drivers/media/pci/zoran/Kconfig
```kconfig
config VIDEO_ZORAN
	tristate "Zoran ZR36057/36067 Video For Linux (Deprecated)"
	depends on PCI && I2C_ALGOBIT && VIDEO_DEV
	depends on !ALPHA
	depends on DEBUG_FS
	select VIDEOBUF2_DMA_CONTIG
	select VIDEO_ADV7170 if VIDEO_ZORAN_LML33R10
	select VIDEO_ADV7175 if VIDEO_ZORAN_DC10 || VIDEO_ZORAN_DC30
	select VIDEO_BT819 if VIDEO_ZORAN_LML33
	select VIDEO_BT856 if VIDEO_ZORAN_LML33 || VIDEO_ZORAN_AVS6EYES
	select VIDEO_BT866 if VIDEO_ZORAN_AVS6EYES
	select VIDEO_KS0127 if VIDEO_ZORAN_AVS6EYES
	select VIDEO_SAA711X if VIDEO_ZORAN_BUZ || VIDEO_ZORAN_LML33R10
	select VIDEO_SAA7110 if VIDEO_ZORAN_DC10
	select VIDEO_SAA7185 if VIDEO_ZORAN_BUZ
	select VIDEO_VPX3220 if VIDEO_ZORAN_DC30
	help
	  Say Y for support for MJPEG capture cards based on the Zoran
	  36057/36067 PCI controller chipset. This includes the Iomega
	  Buz, Pinnacle DC10+ and the Linux Media Labs LML33. There is
	  a driver homepage at <http://mjpeg.sf.net/driver-zoran/>. For
	  more information, check <file:Documentation/driver-api/media/drivers/zoran.rst>.

	  To compile this driver as a module, choose M here: the
	  module will be called zr36067.

config VIDEO_ZORAN_DC30
	bool "Pinnacle/Miro DC30(+) support"
	depends on VIDEO_ZORAN
	help
	  Support for the Pinnacle/Miro DC30(+) MJPEG capture/playback
	  card. This also supports really old DC10 cards based on the
	  zr36050 MJPEG codec and zr36016 VFE.

config VIDEO_ZORAN_ZR36060
	bool "Zoran ZR36060"
	depends on VIDEO_ZORAN
	help
	  Say Y to support Zoran boards based on 36060 chips.
	  This includes Iomega Buz, Pinnacle DC10, Linux media Labs 33
	  and 33 R10 and AverMedia 6 boards.

config VIDEO_ZORAN_BUZ
	bool "Iomega Buz support"
	depends on VIDEO_ZORAN_ZR36060
	help
	  Support for the Iomega Buz MJPEG capture/playback card.

config VIDEO_ZORAN_DC10
	bool "Pinnacle/Miro DC10(+) support"
	depends on VIDEO_ZORAN_ZR36060
	help
	  Support for the Pinnacle/Miro DC10(+) MJPEG capture/playback
	  card.

config VIDEO_ZORAN_LML33
	bool "Linux Media Labs LML33 support"
	depends on VIDEO_ZORAN_ZR36060
	help
	  Support for the Linux Media Labs LML33 MJPEG capture/playback
	  card.

config VIDEO_ZORAN_LML33R10
	bool "Linux Media Labs LML33R10 support"
	depends on VIDEO_ZORAN_ZR36060
	help
	  support for the Linux Media Labs LML33R10 MJPEG capture/playback
	  card.

config VIDEO_ZORAN_AVS6EYES
	bool "AverMedia 6 Eyes support"
	depends on VIDEO_ZORAN_ZR36060
	help
	  Support for the AverMedia 6 Eyes video surveillance card.
```

## drivers/media/platform/Kconfig
```kconfig
# SPDX-License-Identifier: GPL-2.0-only
#
# Platform drivers
#	Most drivers here are currently for webcam support

menuconfig MEDIA_PLATFORM_DRIVERS
	bool "Media platform devices"
	default "y"
	help
	  Say Y here to enable support for platform-specific media drivers.

if MEDIA_PLATFORM_DRIVERS

config V4L_PLATFORM_DRIVERS
	bool "V4L platform devices"
	help
	  Say Y here to enable support for platform-specific V4L drivers.

config SDR_PLATFORM_DRIVERS
	bool "SDR platform devices"
	depends on MEDIA_SDR_SUPPORT
	help
	  Say Y here to enable support for platform-specific SDR Drivers.

config DVB_PLATFORM_DRIVERS
	bool "DVB platform devices"
	depends on MEDIA_DIGITAL_TV_SUPPORT
	help
	  Say Y here to enable support for platform-specific Digital TV drivers.

config V4L_MEM2MEM_DRIVERS
	bool "Memory-to-memory multimedia devices"
	depends on VIDEO_DEV
	help
	  Say Y here to enable selecting drivers for V4L devices that
	  use system memory for both source and destination buffers, as opposed
	  to capture and output drivers, which use memory buffers for just
	  one of those.

# Ancillary drivers

config VIDEO_MEM2MEM_DEINTERLACE
	tristate "Deinterlace support"
	depends on V4L_MEM2MEM_DRIVERS
	depends on VIDEO_DEV
	depends on HAS_DMA
	select VIDEOBUF2_DMA_CONTIG
	select V4L2_MEM2MEM_DEV
	help
	    Generic deinterlacing V4L2 driver.

config VIDEO_MUX
	tristate "Video Multiplexer"
	depends on V4L_PLATFORM_DRIVERS
	select MULTIPLEXER
	depends on VIDEO_DEV && OF
	select MEDIA_CONTROLLER
	select VIDEO_V4L2_SUBDEV_API
	select REGMAP
	select V4L2_FWNODE
	help
	  This driver provides support for N:1 video bus multiplexers.

# Platform drivers - Please keep it alphabetically sorted
source "drivers/media/platform/allegro-dvt/Kconfig"
source "drivers/media/platform/amlogic/Kconfig"
source "drivers/media/platform/amphion/Kconfig"
source "drivers/media/platform/aspeed/Kconfig"
source "drivers/media/platform/atmel/Kconfig"
source "drivers/media/platform/cadence/Kconfig"
source "drivers/media/platform/chips-media/Kconfig"
source "drivers/media/platform/intel/Kconfig"
source "drivers/media/platform/marvell/Kconfig"
source "drivers/media/platform/mediatek/Kconfig"
source "drivers/media/platform/microchip/Kconfig"
source "drivers/media/platform/nvidia/Kconfig"
source "drivers/media/platform/nxp/Kconfig"
source "drivers/media/platform/qcom/Kconfig"
source "drivers/media/platform/renesas/Kconfig"
source "drivers/media/platform/rockchip/Kconfig"
source "drivers/media/platform/samsung/Kconfig"
source "drivers/media/platform/st/Kconfig"
source "drivers/media/platform/sunxi/Kconfig"
source "drivers/media/platform/ti/Kconfig"
source "drivers/media/platform/verisilicon/Kconfig"
source "drivers/media/platform/via/Kconfig"
source "drivers/media/platform/xilinx/Kconfig"

endif # MEDIA_PLATFORM_DRIVERS
```

## drivers/media/platform/am437x/Kconfig
```kconfig
# SPDX-License-Identifier: GPL-2.0-only
config VIDEO_AM437X_VPFE
	tristate "TI AM437x VPFE video capture driver"
	depends on VIDEO_V4L2 && VIDEO_V4L2_SUBDEV_API
	depends on SOC_AM43XX || COMPILE_TEST
	select VIDEOBUF2_DMA_CONTIG
	select V4L2_FWNODE
	help
	   Support for AM437x Video Processing Front End based Video
	   Capture Driver.

	   To compile this driver as a module, choose M here. The module
	   will be called am437x-vpfe.
```

## drivers/media/platform/amd/Kconfig
```kconfig
# SPDX-License-Identifier: GPL-2.0+

source "drivers/media/platform/amd/isp4/Kconfig"
```
