## drivers/media/pci/intel/Kconfig
```kconfig
# SPDX-License-Identifier: GPL-2.0-only

source "drivers/media/pci/intel/ipu3/Kconfig"
source "drivers/media/pci/intel/ipu6/Kconfig"
source "drivers/media/pci/intel/ivsc/Kconfig"

config IPU_BRIDGE
	tristate "Intel IPU Bridge"
	depends on ACPI || COMPILE_TEST
	depends on I2C
	help
	  The IPU bridge is a helper library for Intel IPU drivers to
	  function on systems shipped with Windows.

	  Currently used by the ipu3-cio2 and atomisp drivers.

	  Supported systems include:

	  - Microsoft Surface models (except Surface Pro 3)
	  - The Lenovo Miix line (for example the 510, 520, 710 and 720)
	  - Dell 7285
```

## drivers/media/pci/intel/ipu3/Kconfig
```kconfig
# SPDX-License-Identifier: GPL-2.0-only
config VIDEO_IPU3_CIO2
	tristate "Intel ipu3-cio2 driver"
	depends on VIDEO_DEV && PCI
	depends on ACPI || COMPILE_TEST
	depends on X86
	select MEDIA_CONTROLLER
	select VIDEO_V4L2_SUBDEV_API
	select V4L2_FWNODE
	select VIDEOBUF2_DMA_SG

	help
	  This is the Intel IPU3 CIO2 CSI-2 receiver unit, found in Intel
	  Skylake and Kaby Lake SoCs and used for capturing images and
	  video from a camera sensor.

	  Say Y or M here if you have a Skylake/Kaby Lake SoC with MIPI CSI-2
	  connected camera.
	  The module will be called ipu3-cio2.

config CIO2_BRIDGE
	bool "IPU3 CIO2 Sensors Bridge"
	depends on VIDEO_IPU3_CIO2 && ACPI
	help
	  This extension provides an API for the ipu3-cio2 driver to create
	  connections to cameras that are hidden in the SSDB buffer in ACPI.
	  It can be used to enable support for cameras in detachable / hybrid
	  devices that ship with Windows.

	  Say Y here if your device is a detachable / hybrid laptop that comes
	  with Windows installed by the OEM, for example:

		- Microsoft Surface models (except Surface Pro 3)
		- The Lenovo Miix line (for example the 510, 520, 710 and 720)
		- Dell 7285

	  If in doubt, say N here.
```

## drivers/media/pci/intel/ivsc/Kconfig
```kconfig
# SPDX-License-Identifier: GPL-2.0-only
# Copyright (C) 2023, Intel Corporation. All rights reserved.

config INTEL_VSC
	tristate "Intel Visual Sensing Controller"
	depends on INTEL_MEI && ACPI && VIDEO_DEV
	depends on IPU_BRIDGE || !IPU_BRIDGE
	select MEDIA_CONTROLLER
	select VIDEO_V4L2_SUBDEV_API
	select V4L2_FWNODE
	help
	  This adds support for Intel Visual Sensing Controller (IVSC).

	  The IVSC support is split into two devices, ACE (Algorithm
	  Context Engine) and CSI (Camera Serial Interface), each of which
	  have their own drivers. The ACE is used to select the ownership
	  of the sensor between the IVSC and the host CPU while the CSI is
	  used to both select the routing destination for the data the
	  sensor transmits over the CSI-2 bus between the IVSC and the
	  host CPU and to configure the CSI-2 bus itself.

	  The modules will be called ivsc-ace and ivsc-csi.
```

## drivers/media/pci/ivtv/Kconfig
```kconfig
# SPDX-License-Identifier: GPL-2.0-only
config VIDEO_IVTV
	tristate "Conexant cx23416/cx23415 MPEG encoder/decoder support"
	depends on VIDEO_V4L2 && PCI && I2C
	select I2C_ALGOBIT
	depends on RC_CORE
	select VIDEO_TUNER
	select VIDEO_TVEEPROM
	select VIDEO_CX2341X
	select VIDEO_CX25840
	select VIDEO_MSP3400
	select VIDEO_SAA711X
	select VIDEO_SAA717X
	select VIDEO_SAA7127
	select VIDEO_CS53L32A
	select VIDEO_M52790
	select VIDEO_WM8775
	select VIDEO_WM8739
	select VIDEO_VP27SMPX
	select VIDEO_UPD64031A
	select VIDEO_UPD64083
	help
	  This is a video4linux driver for Conexant cx23416 or cx23415 based
	  PCI personal video recorder devices.

	  This is used in devices such as the Hauppauge PVR-150/250/350/500
	  cards.

	  To compile this driver as a module, choose M here: the
	  module will be called ivtv.

config VIDEO_IVTV_ALSA
	tristate "Conexant cx23415/cx23416 ALSA interface for PCM audio capture"
	depends on VIDEO_IVTV && SND
	select SND_PCM
	help
	  This driver provides an ALSA interface as another method for user
	  applications to obtain PCM audio data from Conexant cx23415/cx23416
	  based PCI TV cards supported by the ivtv driver.

	  The ALSA interface has much wider use in user applications performing
	  PCM audio capture, than the V4L2 "/dev/video24" PCM audio interface
	  provided by the main ivtv driver.

	  To compile this driver as a module, choose M here: the
	  module will be called ivtv-alsa.

config VIDEO_FB_IVTV
	tristate "Conexant cx23415 framebuffer support"
	depends on VIDEO_IVTV && FB
	select FB_CFB_FILLRECT
	select FB_CFB_COPYAREA
	select FB_CFB_IMAGEBLIT
	help
	  This is a framebuffer driver for the Conexant cx23415 MPEG
	  encoder/decoder.

	  This is used in the Hauppauge PVR-350 card.

	  To compile this driver as a module, choose M here: the
	  module will be called ivtvfb.

config VIDEO_FB_IVTV_FORCE_PAT
	bool "force cx23415 framebuffer init with x86 PAT enabled"
	depends on VIDEO_FB_IVTV && X86_PAT
	help
	  With PAT enabled, the cx23415 framebuffer driver does not
	  utilize write-combined caching on the framebuffer memory.
	  For this reason, the driver will by default disable itself
	  when initializied on a kernel with PAT enabled (i.e. not
	  using the nopat kernel parameter).

	  The driver is not easily upgradable to the PAT-aware
	  ioremap_wc() API since the firmware hides the address
	  ranges that should be marked write-combined from the driver.

	  With this setting enabled, the framebuffer will initialize on
	  PAT-enabled systems but the framebuffer memory will be uncached.

	  If unsure, say N.
```

## drivers/media/pci/mantis/Kconfig
```kconfig
config MANTIS_CORE
	tristate "Mantis/Hopper PCI bridge based devices"
	depends on PCI && I2C && INPUT && RC_CORE

	help
	  Support for PCI cards based on the Mantis and Hopper PCi bridge.

	  Say Y if you own such a device and want to use it.

config DVB_MANTIS
	tristate "MANTIS based cards"
	depends on MANTIS_CORE && DVB_CORE && PCI && I2C
	select DVB_MB86A16 if MEDIA_SUBDRV_AUTOSELECT
	select DVB_ZL10353 if MEDIA_SUBDRV_AUTOSELECT
	select DVB_STV0299 if MEDIA_SUBDRV_AUTOSELECT
	select DVB_LNBP21 if MEDIA_SUBDRV_AUTOSELECT
	select DVB_STB0899 if MEDIA_SUBDRV_AUTOSELECT
	select DVB_STB6100 if MEDIA_SUBDRV_AUTOSELECT
	select DVB_TDA665x if MEDIA_SUBDRV_AUTOSELECT
	select DVB_TDA10021 if MEDIA_SUBDRV_AUTOSELECT
	select DVB_TDA10023 if MEDIA_SUBDRV_AUTOSELECT
	select DVB_PLL
	help
	  Support for PCI cards based on the Mantis PCI bridge.
	  Say Y when you have a Mantis based DVB card and want to use it.

	  If unsure say N.

config DVB_HOPPER
	tristate "HOPPER based cards"
	depends on MANTIS_CORE && DVB_CORE && PCI && I2C
	select DVB_ZL10353 if MEDIA_SUBDRV_AUTOSELECT
	select DVB_PLL
	help
	  Support for PCI cards based on the Hopper  PCI bridge.
	  Say Y when you have a Hopper based DVB card and want to use it.

	  If unsure say N
```

## drivers/media/pci/meye/Kconfig
```kconfig
config VIDEO_MEYE
	tristate "Sony Vaio Picturebook Motion Eye Video For Linux"
	depends on PCI && VIDEO_V4L2
	depends on SONY_LAPTOP || COMPILE_TEST
	---help---
	  This is the video4linux driver for the Motion Eye camera found
	  in the Vaio Picturebook laptops. Please read the material in
	  <file:Documentation/video4linux/meye.txt> for more information.

	  If you say Y or M here, you need to say Y or M to "Sony Laptop
	  Extras" in the misc device section.

	  To compile this driver as a module, choose M here: the
	  module will be called meye.
```

## drivers/media/pci/mgb4/Kconfig
```kconfig
# SPDX-License-Identifier: GPL-2.0-only
config VIDEO_MGB4
	tristate "Digiteq Automotive MGB4 support"
	depends on VIDEO_DEV && PCI && I2C && DMADEVICES && SPI && MTD && IIO
	depends on COMMON_CLK
	select VIDEOBUF2_DMA_SG
	select IIO_BUFFER
	select IIO_TRIGGERED_BUFFER
	select I2C_XILINX
	select SPI_XILINX
	select MTD_SPI_NOR
	select XILINX_XDMA
	help
	  This is a video4linux driver for Digiteq Automotive MGB4 grabber
	  cards.

	  To compile this driver as a module, choose M here: the
	  module will be called mgb4.
```

## drivers/media/pci/netup_unidvb/Kconfig
```kconfig
config DVB_NETUP_UNIDVB
	tristate "NetUP Universal DVB card support"
	depends on DVB_CORE && VIDEO_DEV && PCI && I2C && SPI_MASTER
	select VIDEOBUF2_DVB
	select VIDEOBUF2_VMALLOC
	select DVB_HORUS3A if MEDIA_SUBDRV_AUTOSELECT
	select DVB_ASCOT2E if MEDIA_SUBDRV_AUTOSELECT
	select DVB_HELENE if MEDIA_SUBDRV_AUTOSELECT
	select DVB_LNBH25 if MEDIA_SUBDRV_AUTOSELECT
	select DVB_CXD2841ER if MEDIA_SUBDRV_AUTOSELECT
	---help---
	  Support for NetUP PCI express Universal DVB card.

	  Say Y when you want to support NetUP Dual Universal DVB card.
	  Card can receive two independent streams in following standards:
		DVB-S/S2, T/T2, C/C2
	  Two CI slots available for CAM modules.
```

## drivers/media/pci/ngene/Kconfig
```kconfig
config DVB_NGENE
	tristate "Micronas nGene support"
	depends on DVB_CORE && PCI && I2C
	select DVB_LNBP21 if MEDIA_SUBDRV_AUTOSELECT
	select DVB_STV6110x if MEDIA_SUBDRV_AUTOSELECT
	select DVB_STV090x if MEDIA_SUBDRV_AUTOSELECT
	select DVB_LGDT330X if MEDIA_SUBDRV_AUTOSELECT
	select DVB_DRXK if MEDIA_SUBDRV_AUTOSELECT
	select DVB_TDA18271C2DD if MEDIA_SUBDRV_AUTOSELECT
	select MEDIA_TUNER_MT2131 if MEDIA_SUBDRV_AUTOSELECT
	select DVB_STV0367 if MEDIA_SUBDRV_AUTOSELECT
	select DVB_CXD2841ER if MEDIA_SUBDRV_AUTOSELECT
	select MEDIA_TUNER_TDA18212 if MEDIA_SUBDRV_AUTOSELECT
	select DVB_STV0910 if MEDIA_SUBDRV_AUTOSELECT
	select DVB_STV6111 if MEDIA_SUBDRV_AUTOSELECT
	select DVB_LNBH25 if MEDIA_SUBDRV_AUTOSELECT
	select DVB_CXD2099 if MEDIA_SUBDRV_AUTOSELECT
	help
	  Support for Micronas PCI express cards with nGene bridge.
```

## drivers/media/pci/pluto2/Kconfig
```kconfig
# SPDX-License-Identifier: GPL-2.0-only
config DVB_PLUTO2
	tristate "Pluto2 cards"
	depends on DVB_CORE && PCI && I2C
	select I2C_ALGOBIT
	select DVB_TDA1004X
	help
	  Support for PCI cards based on the Pluto2 FPGA like the Satelco
	  Easywatch Mobile Terrestrial DVB-T Receiver.

	  Since these cards have no MPEG decoder onboard, they transmit
	  only compressed MPEG data over the PCI bus, so you need
	  an external software decoder to watch TV on your computer.

	  Say Y or M if you own such a device and want to use it.
```

## drivers/media/pci/pt1/Kconfig
```kconfig
config DVB_PT1
	tristate "PT1 cards"
	depends on DVB_CORE && PCI && I2C
	select DVB_TC90522 if MEDIA_SUBDRV_AUTOSELECT
	select DVB_PLL if MEDIA_SUBDRV_AUTOSELECT
	select MEDIA_TUNER_QM1D1B0004 if MEDIA_SUBDRV_AUTOSELECT
	help
	  Support for Earthsoft PT1 PCI cards.

	  Since these cards have no MPEG decoder onboard, they transmit
	  only compressed MPEG data over the PCI bus, so you need
	  an external software decoder to watch TV on your computer.

	  Say Y or M if you own such a device and want to use it.
```

## drivers/media/pci/pt3/Kconfig
```kconfig
# SPDX-License-Identifier: GPL-2.0-only
config DVB_PT3
	tristate "Earthsoft PT3 cards"
	depends on DVB_CORE && PCI && I2C
	select DVB_TC90522 if MEDIA_SUBDRV_AUTOSELECT
	select MEDIA_TUNER_QM1D1C0042 if MEDIA_SUBDRV_AUTOSELECT
	select MEDIA_TUNER_MXL301RF if MEDIA_SUBDRV_AUTOSELECT
	help
	  Support for Earthsoft PT3 PCIe cards.

	  Say Y or M if you own such a device and want to use it.
```

## drivers/media/pci/saa7134/Kconfig
```kconfig
# SPDX-License-Identifier: GPL-2.0-only
config VIDEO_SAA7134
	tristate "Philips SAA7134 support"
	depends on VIDEO_DEV && PCI && I2C
	select VIDEOBUF2_DMA_SG
	select VIDEO_TUNER
	select VIDEO_TVEEPROM
	select CRC32
	select VIDEO_SAA6588 if MEDIA_SUBDRV_AUTOSELECT
	select VIDEO_SAA6752HS if MEDIA_SUBDRV_AUTOSELECT
	help
	  This is a video4linux driver for Philips SAA713x based
	  TV cards.

	  To compile this driver as a module, choose M here: the
	  module will be called saa7134.

config VIDEO_SAA7134_ALSA
	tristate "Philips SAA7134 DMA audio support"
	depends on VIDEO_SAA7134 && SND
	select SND_PCM
	help
	  This is a video4linux driver for direct (DMA) audio in
	  Philips SAA713x based TV cards using ALSA

	  To compile this driver as a module, choose M here: the
	  module will be called saa7134-alsa.

config VIDEO_SAA7134_RC
	bool "Philips SAA7134 Remote Controller support"
	depends on RC_CORE
	depends on VIDEO_SAA7134
	depends on !(RC_CORE=m && VIDEO_SAA7134=y)
	default y
	help
	  Enables Remote Controller support on saa7134 driver.

config VIDEO_SAA7134_DVB
	tristate "DVB/ATSC Support for saa7134 based TV cards"
	depends on VIDEO_SAA7134 && DVB_CORE
	select VIDEOBUF2_DVB
	select DVB_PLL if MEDIA_SUBDRV_AUTOSELECT
	select DVB_MT352 if MEDIA_SUBDRV_AUTOSELECT
	select DVB_TDA1004X if MEDIA_SUBDRV_AUTOSELECT
	select DVB_NXT200X if MEDIA_SUBDRV_AUTOSELECT
	select DVB_TDA10086 if MEDIA_SUBDRV_AUTOSELECT
	select DVB_TDA826X if MEDIA_SUBDRV_AUTOSELECT
	select DVB_ISL6421 if MEDIA_SUBDRV_AUTOSELECT
	select DVB_ISL6405 if MEDIA_SUBDRV_AUTOSELECT
	select MEDIA_TUNER_TDA827X if MEDIA_SUBDRV_AUTOSELECT
	select MEDIA_TUNER_SIMPLE if MEDIA_SUBDRV_AUTOSELECT
	select DVB_ZL10036 if MEDIA_SUBDRV_AUTOSELECT
	select DVB_MT312 if MEDIA_SUBDRV_AUTOSELECT
	select DVB_LNBP21 if MEDIA_SUBDRV_AUTOSELECT
	select DVB_ZL10353 if MEDIA_SUBDRV_AUTOSELECT
	select DVB_LGDT3305 if MEDIA_SUBDRV_AUTOSELECT
	select DVB_TDA10048 if MEDIA_SUBDRV_AUTOSELECT
	select MEDIA_TUNER_TDA18271 if MEDIA_SUBDRV_AUTOSELECT
	select MEDIA_TUNER_TDA8290 if MEDIA_SUBDRV_AUTOSELECT
	select DVB_ZL10039 if MEDIA_SUBDRV_AUTOSELECT
	help
	  This adds support for DVB cards based on the
	  Philips saa7134 chip.

	  To compile this driver as a module, choose M here: the
	  module will be called saa7134-dvb.

config VIDEO_SAA7134_GO7007
	tristate "go7007 support for saa7134 based TV cards"
	depends on VIDEO_SAA7134
	depends on VIDEO_GO7007
	help
	  Enables saa7134 driver support for boards with go7007
	  MPEG encoder (WIS Voyager or compatible).
```

## drivers/media/pci/saa7164/Kconfig
```kconfig
config VIDEO_SAA7164
	tristate "NXP SAA7164 support"
	depends on DVB_CORE && VIDEO_DEV && PCI && I2C
	select I2C_ALGOBIT
	select FW_LOADER
	select VIDEO_TUNER
	select VIDEO_TVEEPROM
	select DVB_TDA10048 if MEDIA_SUBDRV_AUTOSELECT
	select DVB_S5H1411 if MEDIA_SUBDRV_AUTOSELECT
	select MEDIA_TUNER_TDA18271 if MEDIA_SUBDRV_AUTOSELECT
	help
	  This is a video4linux driver for NXP SAA7164 based
	  TV cards.

	  To compile this driver as a module, choose M here: the
	  module will be called saa7164
```

## drivers/media/pci/smipcie/Kconfig
```kconfig
config DVB_SMIPCIE
	tristate "SMI PCIe DVBSky cards"
	depends on DVB_CORE && PCI && I2C
	select I2C_ALGOBIT
	select DVB_M88DS3103 if MEDIA_SUBDRV_AUTOSELECT
	select DVB_SI2168 if MEDIA_SUBDRV_AUTOSELECT
	select MEDIA_TUNER_M88TS2022 if MEDIA_SUBDRV_AUTOSELECT
	select MEDIA_TUNER_M88RS6000T if MEDIA_SUBDRV_AUTOSELECT
	select MEDIA_TUNER_SI2157 if MEDIA_SUBDRV_AUTOSELECT
	help
	  Support for cards with SMI PCIe bridge:
	  - DVBSky S950 V3
	  - DVBSky S952 V3
	  - DVBSky T9580 V3

	  Say Y or M if you own such a device and want to use it.
	  If unsure say N.
```

## drivers/media/pci/solo6x10/Kconfig
```kconfig
config VIDEO_SOLO6X10
	tristate "Bluecherry / Softlogic 6x10 capture cards (MPEG-4/H.264)"
	depends on PCI && VIDEO_DEV && SND && I2C
	depends on HAS_DMA
	select BITREVERSE
	select FONT_SUPPORT
	select FONT_8x16
	select VIDEOBUF2_DMA_SG
	select VIDEOBUF2_DMA_CONTIG
	select SND_PCM
	select FONT_8x16
	---help---
	  This driver supports the Bluecherry H.264 and MPEG-4 hardware
	  compression capture cards and other Softlogic-based ones.

	  Following cards have been tested:
	  * Bluecherry BC-H16480A (PCIe, 16 port, H.264)
	  * Bluecherry BC-H04120A (PCIe, 4 port, H.264)
	  * Bluecherry BC-H04120A-MPCI (Mini-PCI, 4 port, H.264)
	  * Bluecherry BC-04120A (PCIe, 4 port, MPEG-4)
```
