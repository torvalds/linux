## drivers/media/usb/gspca/gl860/Kconfig
```kconfig
# SPDX-License-Identifier: GPL-2.0-only
config USB_GL860
	tristate "GL860 USB Camera Driver"
	depends on VIDEO_V4L2 && USB_GSPCA
	help
	  Say Y here if you want support for cameras based on the GL860 chip.

	  To compile this driver as a module, choose M here: the
	  module will be called gspca_gl860.
```

## drivers/media/usb/gspca/m5602/Kconfig
```kconfig
config USB_M5602
	tristate "ALi USB m5602 Camera Driver"
	depends on VIDEO_V4L2 && USB_GSPCA
	help
	  Say Y here if you want support for cameras based on the
	  ALi m5602 connected to various image sensors.

	  To compile this driver as a module, choose M here: the
	  module will be called gspca_m5602.
```

## drivers/media/usb/gspca/stv06xx/Kconfig
```kconfig
# SPDX-License-Identifier: GPL-2.0-only
config USB_STV06XX
	tristate "STV06XX USB Camera Driver"
	depends on USB_GSPCA
	help
	  Say Y here if you want support for cameras based on
	  the ST STV06XX chip.

	  To compile this driver as a module, choose M here: the
	  module will be called gspca_stv06xx.
```

## drivers/media/usb/hackrf/Kconfig
```kconfig
# SPDX-License-Identifier: GPL-2.0-only
config USB_HACKRF
	tristate "HackRF"
	depends on VIDEO_DEV
	select VIDEOBUF2_VMALLOC
	help
	  This is a video4linux2 driver for HackRF SDR device.

	  To compile this driver as a module, choose M here: the
	  module will be called hackrf
```

## drivers/media/usb/hdpvr/Kconfig
```kconfig
config VIDEO_HDPVR
	tristate "Hauppauge HD PVR support"
	depends on VIDEO_DEV && VIDEO_V4L2
	help
	  This is a video4linux driver for Hauppauge's HD PVR USB device.

	  To compile this driver as a module, choose M here: the
	  module will be called hdpvr
```

## drivers/media/usb/msi2500/Kconfig
```kconfig
# SPDX-License-Identifier: GPL-2.0-only
config USB_MSI2500
	tristate "Mirics MSi2500"
	depends on VIDEO_DEV && SPI
	select VIDEOBUF2_VMALLOC
	select MEDIA_TUNER_MSI001
```

## drivers/media/usb/pulse8-cec/Kconfig
```kconfig
config USB_PULSE8_CEC
	tristate "Pulse Eight HDMI CEC"
	depends on USB_ACM
	select CEC_CORE
	select SERIO
	select SERIO_SERPORT
	---help---
	  This is a cec driver for the Pulse Eight HDMI CEC device.

	  To compile this driver as a module, choose M here: the
	  module will be called pulse8-cec.
```

## drivers/media/usb/pvrusb2/Kconfig
```kconfig
# SPDX-License-Identifier: GPL-2.0-only
config VIDEO_PVRUSB2
	tristate "Hauppauge WinTV-PVR USB2 support"
	depends on VIDEO_V4L2 && I2C
	select VIDEO_TUNER
	select VIDEO_TVEEPROM
	select VIDEO_CX2341X
	select VIDEO_SAA711X
	select VIDEO_CX25840
	select VIDEO_MSP3400
	select VIDEO_WM8775
	select VIDEO_CS53L32A
	help
	  This is a video4linux driver for Conexant 23416 based
	  usb2 personal video recorder devices.

	  To compile this driver as a module, choose M here: the
	  module will be called pvrusb2

config VIDEO_PVRUSB2_SYSFS
	bool "pvrusb2 sysfs support"
	default y
	depends on VIDEO_PVRUSB2 && SYSFS
	help
	  This option enables the operation of a sysfs based
	  interface for query and control of the pvrusb2 driver.

	  This is not generally needed for v4l applications,
	  although certain applications are optimized to take
	  advantage of this feature.

	  If you are in doubt, say Y.

	  Note: This feature is experimental and subject to change.

config VIDEO_PVRUSB2_DVB
	bool "pvrusb2 ATSC/DVB support"
	default y
	depends on VIDEO_PVRUSB2 && DVB_CORE
	select DVB_LGDT330X if MEDIA_SUBDRV_AUTOSELECT
	select DVB_S5H1409 if MEDIA_SUBDRV_AUTOSELECT
	select DVB_S5H1411 if MEDIA_SUBDRV_AUTOSELECT
	select DVB_TDA10048 if MEDIA_SUBDRV_AUTOSELECT
	select DVB_LGDT3306A if MEDIA_SUBDRV_AUTOSELECT
	select DVB_SI2168 if MEDIA_SUBDRV_AUTOSELECT
	select MEDIA_TUNER_TDA18271 if MEDIA_SUBDRV_AUTOSELECT
	select MEDIA_TUNER_SIMPLE if MEDIA_SUBDRV_AUTOSELECT
	select MEDIA_TUNER_TDA8290 if MEDIA_SUBDRV_AUTOSELECT
	help
	  This option enables a DVB interface for the pvrusb2 driver.
	  If your device does not support digital television, this
	  feature will have no affect on the driver's operation.

	  If you are in doubt, say Y.

config VIDEO_PVRUSB2_DEBUGIFC
	bool "pvrusb2 debug interface"
	depends on VIDEO_PVRUSB2_SYSFS
	help
	  This option enables the inclusion of a debug interface
	  in the pvrusb2 driver, hosted through sysfs.

	  You do not need to select this option unless you plan
	  on debugging the driver or performing a manual firmware
	  extraction.

	  If you are in doubt, say N.
```

## drivers/media/usb/pwc/Kconfig
```kconfig
# SPDX-License-Identifier: GPL-2.0-only
config USB_PWC
	tristate "USB Philips Cameras"
	depends on VIDEO_DEV
	select VIDEOBUF2_VMALLOC
	help
	  Say Y or M here if you want to use one of these Philips & OEM
	  webcams:
	   * Philips PCA645, PCA646
	   * Philips PCVC675, PCVC680, PCVC690
	   * Philips PCVC720/40, PCVC730, PCVC740, PCVC750
	   * Philips SPC900NC
	   * Askey VC010
	   * Logitech QuickCam Pro 3000, 4000, 'Zoom', 'Notebook Pro'
	     and 'Orbit'/'Sphere'
	   * Samsung MPC-C10, MPC-C30
	   * Creative Webcam 5, Pro Ex
	   * SOTEC Afina Eye
	   * Visionite VCS-UC300, VCS-UM100

	  The PCA635, PCVC665 and PCVC720/20 are not supported by this driver
	  and never will be, but the 665 and 720/20 are supported by other
	  drivers.

	  Some newer logitech webcams are not handled by this driver but by the
	  Usb Video Class driver (linux-uvc).

	  The built-in microphone is enabled by selecting USB Audio support.

	  To compile this driver as a module, choose M here: the
	  module will be called pwc.

config USB_PWC_DEBUG
	bool "USB Philips Cameras verbose debug"
	depends on USB_PWC
	help
	  Say Y here in order to have the pwc driver generate verbose debugging
	  messages.
	  A special module options 'trace' is used to control the verbosity.

config USB_PWC_INPUT_EVDEV
	bool "USB Philips Cameras input events device support"
	default y
	depends on USB_PWC && (USB_PWC=INPUT || INPUT=y)
	help
	  This option makes USB Philips cameras register the snapshot button as
	  an input device to report button events.

	  If you are in doubt, say Y.
```

## drivers/media/usb/rainshadow-cec/Kconfig
```kconfig
# SPDX-License-Identifier: GPL-2.0-only
config USB_RAINSHADOW_CEC
	tristate "RainShadow Tech HDMI CEC"
	depends on USB_ACM
	select CEC_CORE
	select SERIO
	select SERIO_SERPORT
	help
	  This is a cec driver for the RainShadow Tech HDMI CEC device.

	  To compile this driver as a module, choose M here: the
	  module will be called rainshadow-cec.
```

## drivers/media/usb/s2255/Kconfig
```kconfig
# SPDX-License-Identifier: GPL-2.0-only
config USB_S2255
	tristate "USB Sensoray 2255 video capture device"
	depends on VIDEO_DEV
	select VIDEOBUF2_VMALLOC
	help
	  Say Y here if you want support for the Sensoray 2255 USB device.
	  This driver can be compiled as a module, called s2255drv.
```

## drivers/media/usb/siano/Kconfig
```kconfig
# SPDX-License-Identifier: GPL-2.0-only
#
# Siaanal Mobile Silicon Digital TV device configuration
#

config SMS_USB_DRV
	tristate "Siaanal SMS1xxx based MDTV receiver"
	depends on DVB_CORE && HAS_DMA
	depends on !RC_CORE || RC_CORE
	select MEDIA_COMMON_OPTIONS
	select SMS_SIAANAL_MDTV
	help
	  Choose if you would like to have Siaanal's support for USB interface
```

## drivers/media/usb/stk1160/Kconfig
```kconfig
# SPDX-License-Identifier: GPL-2.0-only
config VIDEO_STK1160_COMMON
	tristate "STK1160 USB video capture support"
	depends on VIDEO_DEV && I2C

	help
	  This is a video4linux driver for STK1160 based video capture devices.

	  To compile this driver as a module, choose M here: the
	  module will be called stk1160.

	  This driver only provides support for video capture. For audio
	  capture, you need to select the snd-usb-audio driver (i.e.
	  CONFIG_SND_USB_AUDIO).

config VIDEO_STK1160
	tristate
	depends on VIDEO_STK1160_COMMON
	default y
	select VIDEOBUF2_VMALLOC
	select VIDEO_SAA711X
```

## drivers/media/usb/stkwebcam/Kconfig
```kconfig
config USB_STKWEBCAM
	tristate "USB Syntek DC1125 Camera support"
	depends on VIDEO_V4L2
	help
	  Say Y here if you want to use this type of camera.
	  Supported devices are typically found in some Asus laptops,
	  with USB id 174f:a311 and 05e1:0501. Other Syntek cameras
	  may be supported by the stk11xx driver, from which this is
	  derived, see <http://sourceforge.net/projects/syntekdriver/>

	  To compile this driver as a module, choose M here: the
	  module will be called stkwebcam.
```

## drivers/media/usb/ttusb-budget/Kconfig
```kconfig
# SPDX-License-Identifier: GPL-2.0-only
config DVB_TTUSB_BUDGET
	tristate "Technotrend/Hauppauge Nova-USB devices"
	depends on DVB_CORE && USB && I2C && PCI
	select DVB_CX22700 if MEDIA_SUBDRV_AUTOSELECT
	select DVB_TDA1004X if MEDIA_SUBDRV_AUTOSELECT
	select DVB_VES1820 if MEDIA_SUBDRV_AUTOSELECT
	select DVB_TDA8083 if MEDIA_SUBDRV_AUTOSELECT
	select DVB_STV0299 if MEDIA_SUBDRV_AUTOSELECT
	select DVB_STV0297 if MEDIA_SUBDRV_AUTOSELECT
	select DVB_LNBP21 if MEDIA_SUBDRV_AUTOSELECT
	help
	  Support for external USB adapters designed by Technotrend and
	  produced by Hauppauge, shipped under the brand name 'Nova-USB'.

	  These devices don't have a MPEG decoder built in, so you need
	  an external software decoder to watch TV.

	  Say Y if you own such a device and want to use it.
```

## drivers/media/usb/ttusb-dec/Kconfig
```kconfig
config DVB_TTUSB_DEC
	tristate "Technotrend/Hauppauge USB DEC devices"
	depends on DVB_CORE && USB && INPUT && PCI
	select CRC32
	help
	  Support for external USB adapters designed by Technotrend and
	  produced by Hauppauge, shipped under the brand name 'DEC2000-t'
	  and 'DEC3000-s'.

	  Even if these devices have a MPEG decoder built in, they transmit
	  only compressed MPEG data over the USB bus, so you need
	  an external software decoder to watch TV on your computer.

	  This driver needs external firmware. Please use the commands
	  "<kerneldir>/scripts/get_dvb_firmware dec2000t",
	  "<kerneldir>/scripts/get_dvb_firmware dec2540t",
	  "<kerneldir>/scripts/get_dvb_firmware dec3000s",
	  download/extract them, and then copy them to /usr/lib/hotplug/firmware
	  or /lib/firmware (depending on configuration of firmware hotplug).

	  Say Y if you own such a device and want to use it.
```

## drivers/media/usb/usbtv/Kconfig
```kconfig
# SPDX-License-Identifier: GPL-2.0-only
config VIDEO_USBTV
	tristate "USBTV007 video capture support"
	depends on VIDEO_V4L2 && SND
	select SND_PCM
	select VIDEOBUF2_VMALLOC

	help
	  This is a video4linux2 driver for USBTV007 based video capture devices.

	  To compile this driver as a module, choose M here: the
	  module will be called usbtv
```

## drivers/media/usb/zr364xx/Kconfig
```kconfig
# SPDX-License-Identifier: GPL-2.0-only
config USB_ZR364XX
	tristate "USB ZR364XX Camera support"
	depends on VIDEO_DEV
	select VIDEOBUF_GEN
	select VIDEOBUF_VMALLOC
	help
	  Say Y here if you want to connect this type of camera to your
	  computer's USB port.
	  See <file:Documentation/admin-guide/media/zr364xx.rst> for more info
	  and list of supported cameras.

	  To compile this driver as a module, choose M here: the
	  module will be called zr364xx.
```

## drivers/media/v4l2-core/Kconfig
```kconfig
# SPDX-License-Identifier: GPL-2.0-only
#
# Generic video config states
#

# Enable the V4L2 core and API
config VIDEO_V4L2
	tristate
	depends on (I2C || I2C=n) && VIDEO_DEV
	select RATIONAL
	select VIDEOBUF2_V4L2 if VIDEOBUF2_CORE
	default (I2C || I2C=n) && VIDEO_DEV

config VIDEO_V4L2_I2C
	bool
	depends on I2C && VIDEO_V4L2
	default y

config VIDEO_V4L2_SUBDEV_API
	bool "V4L2 sub-device userspace API"
	depends on VIDEO_DEV && MEDIA_CONTROLLER
	help
	  Enables the V4L2 sub-device pad-level userspace API used to configure
	  video format, size and frame rate between hardware blocks.

	  This API is mostly used by camera interfaces in embedded platforms.

config VIDEO_ADV_DEBUG
	bool "Enable advanced debug functionality on V4L2 drivers"
	help
	  Say Y here to enable advanced debugging functionality on some
	  V4L devices.
	  In doubt, say N.

config VIDEO_FIXED_MINOR_RANGES
	bool "Enable old-style fixed minor ranges on drivers/video devices"
	help
	  Say Y here to enable the old-style fixed-range minor assignments.
	  Only useful if you rely on the old behavior and use mknod instead of udev.

	  When in doubt, say N.

# Used by drivers that need tuner.ko
config VIDEO_TUNER
	tristate

# Used by drivers that need v4l2-jpeg.ko
config V4L2_JPEG_HELPER
	tristate

# Used by drivers that need v4l2-h264.ko
config V4L2_H264
	tristate

# Used by drivers that need v4l2-mem2mem.ko
config V4L2_MEM2MEM_DEV
	tristate
	depends on VIDEOBUF2_CORE

# Used by LED subsystem flash drivers
config V4L2_FLASH_LED_CLASS
	tristate "V4L2 flash API for LED flash class devices"
	depends on VIDEO_V4L2 && VIDEO_V4L2_SUBDEV_API
	depends on LEDS_CLASS_FLASH
	select V4L2_ASYNC
	help
	  Say Y here to enable V4L2 flash API support for LED flash
	  class drivers.

	  When in doubt, say N.

config V4L2_FWNODE
	tristate
	select V4L2_ASYNC

config V4L2_ASYNC
	tristate

# Used by drivers that need Videobuf modules
config VIDEOBUF_GEN
	tristate

config VIDEOBUF_DMA_SG
	tristate
	select VIDEOBUF_GEN

config VIDEOBUF_VMALLOC
	tristate
	select VIDEOBUF_GEN

config VIDEOBUF_DMA_CONTIG
	tristate
	select VIDEOBUF_GEN
```

## drivers/media/video/Kconfig
```kconfig
config ROCK_CHIP_SOC_CAMERA
	tristate "rockchip supported soc cameras "
	default n
	
menu "rockchip camera sensor interface driver"
	depends on ROCK_CHIP_SOC_CAMERA

	config ROCKCHIP_CAMERA_SENSOR_INTERFACE
		tristate "rockchip camera sensor interface driver"
		default n
		
	config RK30_CAMERA_ONEFRAME
		tristate "rk30_camera_oneframe"
		depends on ROCKCHIP_CAMERA_SENSOR_INTERFACE
		select SOC_CAMERA
    	select VIDEOBUF_DMA_CONTIG
		default n
		
	config RK30_CAMERA_PINGPONG
		tristate "rk30_camera_pingpong"
		depends on ROCKCHIP_CAMERA_SENSOR_INTERFACE
		select SOC_CAMERA
    	select VIDEOBUF_DMA_CONTIG
		default n
endmenu		
```

## drivers/media/video/au0828/Kconfig
```kconfig
config VIDEO_AU0828
	tristate "Auvitek AU0828 support"
	depends on I2C && INPUT && DVB_CORE && USB
	select I2C_ALGOBIT
	select VIDEO_TVEEPROM
	select DVB_AU8522 if !DVB_FE_CUSTOMIZE
	select MEDIA_TUNER_XC5000 if !DVB_FE_CUSTOMIZE
	select MEDIA_TUNER_MXL5007T if !DVB_FE_CUSTOMIZE
	select MEDIA_TUNER_TDA18271 if !DVB_FE_CUSTOMIZE
	---help---
	  This is a video4linux driver for Auvitek's USB device.

	  To compile this driver as a module, choose M here: the
	  module will be called au0828
```

## drivers/media/video/bt8xx/Kconfig
```kconfig
config VIDEO_BT848
	tristate "BT848 Video For Linux"
	depends on VIDEO_DEV && PCI && I2C && VIDEO_V4L2 && INPUT
	select I2C_ALGOBIT
	select FW_LOADER
	select VIDEO_BTCX
	select VIDEOBUF_DMA_SG
	select VIDEO_IR
	select MEDIA_TUNER
	select VIDEO_TVEEPROM
	select VIDEO_MSP3400 if VIDEO_HELPER_CHIPS_AUTO
	select VIDEO_TVAUDIO if VIDEO_HELPER_CHIPS_AUTO
	select VIDEO_TDA7432 if VIDEO_HELPER_CHIPS_AUTO
	select VIDEO_TDA9875 if VIDEO_HELPER_CHIPS_AUTO
	---help---
	  Support for BT848 based frame grabber/overlay boards. This includes
	  the Miro, Hauppauge and STB boards. Please read the material in
	  <file:Documentation/video4linux/bttv/> for more information.

	  To compile this driver as a module, choose M here: the
	  module will be called bttv.

config VIDEO_BT848_DVB
	bool "DVB/ATSC Support for bt878 based TV cards"
	depends on VIDEO_BT848 && DVB_CORE
	select DVB_BT8XX
	---help---
	  This adds support for DVB/ATSC cards based on the BT878 chip.
```

## drivers/media/video/cpia2/Kconfig
```kconfig
config VIDEO_CPIA2
	tristate "CPiA2 Video For Linux"
	depends on VIDEO_DEV && USB && VIDEO_V4L2
	---help---
	  This is the video4linux driver for cameras based on Vision's CPiA2
	  (Colour Processor Interface ASIC), such as the Digital Blue QX5
	  Microscope. If you have one of these cameras, say Y here

	  This driver is also available as a module (cpia2).
```
