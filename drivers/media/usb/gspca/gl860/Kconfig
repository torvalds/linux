## drivers/media/video/cx18/Kconfig
```kconfig
config VIDEO_CX18
	tristate "Conexant cx23418 MPEG encoder support"
	depends on VIDEO_V4L2 && DVB_CORE && PCI && I2C && EXPERIMENTAL
	select I2C_ALGOBIT
	select FW_LOADER
	select VIDEO_IR
	select MEDIA_TUNER
	select VIDEO_TVEEPROM
	select VIDEO_CX2341X
	select VIDEO_CS5345
	select DVB_S5H1409
	---help---
	  This is a video4linux driver for Conexant cx23418 based
	  PCI combo video recorder devices.

	  This is used in devices such as the Hauppauge HVR-1600
	  cards.

	  To compile this driver as a module, choose M here: the
	  module will be called cx18.
```

## drivers/media/video/cx231xx/Kconfig
```kconfig
config VIDEO_CX231XX
	tristate "Conexant cx231xx USB video capture support"
	depends on VIDEO_DEV && I2C && INPUT
	select VIDEO_TUNER
	select VIDEO_TVEEPROM
	select VIDEO_IR
	select VIDEOBUF_VMALLOC
	select VIDEO_CX25840

	---help---
	  This is a video4linux driver for Conexant 231xx USB based TV cards.

	  To compile this driver as a module, choose M here: the
	  module will be called cx231xx

config VIDEO_CX231XX_ALSA
	tristate "Conexant Cx231xx ALSA audio module"
	depends on VIDEO_CX231XX && SND
	select SND_PCM

	---help---
	  This is an ALSA driver for Cx231xx USB based TV cards.

	  To compile this driver as a module, choose M here: the
	  module will be called cx231xx-alsa

config VIDEO_CX231XX_DVB
	tristate "DVB/ATSC Support for Cx231xx based TV cards"
	depends on VIDEO_CX231XX && DVB_CORE
	select VIDEOBUF_DVB
	select MEDIA_TUNER_XC5000 if !DVB_FE_CUSTOMISE

	---help---
	  This adds support for DVB cards based on the
	  Conexant cx231xx chips.
```
