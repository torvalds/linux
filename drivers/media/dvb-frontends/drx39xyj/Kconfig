## drivers/media/dvb/ttpci/Kconfig
```kconfig
config DVB_AV7110
	tristate "AV7110 cards"
	depends on DVB_CORE && PCI
	select FW_LOADER
	select VIDEO_DEV
	select VIDEO_SAA7146_VV
	select DVB_VES1820
	select DVB_VES1X93
	select DVB_STV0299
	select DVB_TDA8083
	select DVB_SP8870
	select DVB_STV0297
	select DVB_L64781
	help
	  Support for SAA7146 and AV7110 based DVB cards as produced
	  by Fujitsu-Siemens, Technotrend, Hauppauge and others.

	  This driver only supports the fullfeatured cards with
	  onboard MPEG2 decoder.

          This driver needs an external firmware. Please use the script
          "<kerneldir>/Documentation/dvb/get_dvb_firmware av7110" to
          download/extract it, and then copy it to /usr/lib/hotplug/firmware.

	  Say Y if you own such a card and want to use it.

config DVB_AV7110_FIRMWARE
	bool "Compile AV7110 firmware into the driver"
	depends on DVB_AV7110 && !STANDALONE
	default y if DVB_AV7110=y
	help
	  The AV7110 firmware is normally loaded by the firmware hotplug manager.
	  If you want to compile the firmware into the driver you need to say
	  Y here and provide the correct path of the firmware. You need this
	  option if you want to compile the whole driver statically into the
	  kernel.

	  All other people say N.

config DVB_AV7110_FIRMWARE_FILE
	string "Full pathname of av7110 firmware file"
	depends on DVB_AV7110_FIRMWARE
	default "/usr/lib/hotplug/firmware/dvb-ttpci-01.fw"

config DVB_AV7110_OSD
	bool "AV7110 OSD support"
	depends on DVB_AV7110
	default y if DVB_AV7110=y || DVB_AV7110=m
	help
	  The AV7110 firmware provides some code to generate an OnScreenDisplay
	  on the video output. This is kind of nonstandard and not guaranteed to
	  be maintained.

	  Anyway, some popular DVB software like VDR uses this OSD to render
	  its menus, so say Y if you want to use this software.

	  All other people say N.

config DVB_BUDGET
	tristate "Budget cards"
	depends on DVB_CORE && PCI
	select VIDEO_SAA7146
	select DVB_STV0299
	select DVB_VES1X93
	select DVB_VES1820
	select DVB_L64781
	select DVB_TDA8083
	select DVB_TDA10021
	select DVB_S5H1420
	help
	  Support for simple SAA7146 based DVB cards
	  (so called Budget- or Nova-PCI cards) without onboard
	  MPEG2 decoder.

	  Say Y if you own such a card and want to use it.

	  To compile this driver as a module, choose M here: the
	  module will be called budget.

config DVB_BUDGET_CI
	tristate "Budget cards with onboard CI connector"
	depends on DVB_CORE && PCI
	select VIDEO_SAA7146
	select DVB_STV0297
	select DVB_STV0299
	select DVB_TDA1004X
	help
	  Support for simple SAA7146 based DVB cards
	  (so called Budget- or Nova-PCI cards) without onboard
	  MPEG2 decoder, but with onboard Common Interface connector.

	  Note: The Common Interface is not yet supported by this driver
	  due to lack of information from the vendor.

	  Say Y if you own such a card and want to use it.

	  To compile this driver as a module, choose M here: the
	  module will be called budget-ci.

config DVB_BUDGET_AV
	tristate "Budget cards with analog video inputs"
	depends on DVB_CORE && PCI
	select VIDEO_DEV
	select VIDEO_SAA7146_VV
	select DVB_STV0299
	select DVB_TDA1004X
	select DVB_TDA10021
	select FW_LOADER
	help
	  Support for simple SAA7146 based DVB cards
	  (so called Budget- or Nova-PCI cards) without onboard
	  MPEG2 decoder, but with one or more analog video inputs.

	  Say Y if you own such a card and want to use it.

	  To compile this driver as a module, choose M here: the
	  module will be called budget-av.

config DVB_BUDGET_PATCH
	tristate "AV7110 cards with Budget Patch"
	depends on DVB_CORE && DVB_BUDGET
	select DVB_AV7110
	select DVB_STV0299
	select DVB_VES1X93
	select DVB_TDA8083
	help
	  Support for Budget Patch (full TS) modification on
	  SAA7146+AV7110 based cards (DVB-S cards). This
	  driver doesn't use onboard MPEG2 decoder. The
	  card is driven in Budget-only mode. Card is
	  required to have loaded firmware to tune properly.
	  Firmware can be loaded by insertion and removal of
	  standard AV7110 driver prior to loading this
	  driver.

	  Say Y if you own such a card and want to use it.

	  To compile this driver as a module, choose M here: the
	  module will be called budget-patch.
```

## drivers/media/dvb/ttusb-budget/Kconfig
```kconfig
config DVB_TTUSB_BUDGET
	tristate "Technotrend/Hauppauge Nova-USB devices"
	depends on DVB_CORE && USB && I2C
	select DVB_PLL
	select DVB_CX22700 if !DVB_FE_CUSTOMISE
	select DVB_TDA1004X if !DVB_FE_CUSTOMISE
	select DVB_VES1820 if !DVB_FE_CUSTOMISE
	select DVB_TDA8083 if !DVB_FE_CUSTOMISE
	select DVB_STV0299 if !DVB_FE_CUSTOMISE
	select DVB_STV0297 if !DVB_FE_CUSTOMISE
	select DVB_LNBP21 if !DVB_FE_CUSTOMISE
	help
	  Support for external USB adapters designed by Technotrend and
	  produced by Hauppauge, shipped under the brand name 'Nova-USB'.

	  These devices don't have a MPEG decoder built in, so you need
	  an external software decoder to watch TV.

	  Say Y if you own such a device and want to use it.
```

## drivers/media/firewire/Kconfig
```kconfig
# SPDX-License-Identifier: GPL-2.0-only
if DVB_CORE && FIREWIRE
comment "FireWire (IEEE 1394) Adapters"

config DVB_FIREDTV
	tristate "FireDTV and FloppyDTV"
	help
	  Support for DVB receivers from Digital Everywhere
	  which are connected via IEEE 1394 (FireWire).

	  These devices don't have an MPEG decoder built in,
	  so you need an external software decoder to watch TV.

	  To compile this driver as a module, say M here:
	  the module will be called firedtv.

if DVB_FIREDTV

config DVB_FIREDTV_INPUT
	def_bool INPUT = y || (INPUT = m && DVB_FIREDTV = m)

endif # DVB_FIREDTV
endif # DVB_CORE && FIREWIRE
```

## drivers/media/i2c/ccs/Kconfig
```kconfig
# SPDX-License-Identifier: GPL-2.0-only
config VIDEO_CCS
	tristate "MIPI CCS/SMIA++/SMIA sensor support"
	depends on HAVE_CLK
	select VIDEO_CCS_PLL
	help
	  This is a generic driver for MIPI CCS, SMIA++ and SMIA compliant
	  camera sensors.
```

## drivers/media/i2c/cvs/Kconfig
```kconfig
# SPDX-License-Identifier: GPL-2.0-only

config VIDEO_INTEL_CVS
	tristate "Intel CVS CSI-2 bridge support"
	depends on I2C && ACPI && VIDEO_DEV
	depends on IPU_BRIDGE || !IPU_BRIDGE
	select MEDIA_CONTROLLER
	select VIDEO_V4L2_SUBDEV_API
	select V4L2_FWNODE
	help
	  This adds support for the Intel Computer Vision Sensing (CVS).

	  The driver registers a V4L2 sub-device to arbitrate CSI-2 link
	  ownership between the host and CVS firmware, and configures the
	  device for camera sensor streaming.

	  The driver can operate with full I2C transport or in a reduced
	  platform (GPIO-only) mode when I2C is unavailable.

	  Say Y to build into the kernel, or M to build as a module.
	  The module will be named intel_cvs. If unsure, say N.
```

## drivers/media/i2c/cx25840/Kconfig
```kconfig
# SPDX-License-Identifier: GPL-2.0-only
config VIDEO_CX25840
	tristate "Conexant CX2584x audio/video decoders"
	depends on VIDEO_DEV && I2C
	help
	  Support for the Conexant CX2584x audio/video decoders.

	  To compile this driver as a module, choose M here: the
	  module will be called cx25840
```

## drivers/media/i2c/et8ek8/Kconfig
```kconfig
# SPDX-License-Identifier: GPL-2.0-only
config VIDEO_ET8EK8
	tristate "ET8EK8 camera sensor support"
	help
	  This is a driver for the Toshiba ET8EK8 5 MP camera sensor.
	  It is used for example in Nokia N900 (RX-51).
```

## drivers/media/i2c/it66353/Kconfig
```kconfig
# SPDX-License-Identifier: GPL-2.0-only
config VIDEO_IT66353
	tristate "ITE IT66353 decoder"
	depends on I2C
	select HDMI
	help
	  Support for the ITE IT66353 3 in 1 out HDMI switch.

	  To compile this driver as a module, choose M here: the
	  module will be called it66353.
```
