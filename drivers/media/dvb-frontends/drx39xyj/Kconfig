## drivers/media/dvb-frontends/drx39xyj/Kconfig
```kconfig
# SPDX-License-Identifier: GPL-2.0-only
config DVB_DRX39XYJ
	tristate "Micronas DRX-J demodulator"
	depends on DVB_CORE && I2C
	default m if !MEDIA_SUBDRV_AUTOSELECT
	help
	  An ATSC 8VSB and QAM64/256 tuner module. Say Y when you want
	  to support this frontend.
```

## drivers/media/dvb/Kconfig
```kconfig
#
# DVB device configuration
#

menuconfig DVB_CAPTURE_DRIVERS
	bool "DVB/ATSC adapters"
	depends on DVB_CORE
	default y
	---help---
	  Say Y to select Digital TV adapters

if DVB_CAPTURE_DRIVERS && DVB_CORE

comment "Supported SAA7146 based PCI Adapters"
	depends on DVB_CORE && PCI && I2C
source "drivers/media/dvb/ttpci/Kconfig"

comment "Supported USB Adapters"
	depends on DVB_CORE && USB && I2C
source "drivers/media/dvb/dvb-usb/Kconfig"
source "drivers/media/dvb/dvb-usb-v2/Kconfig"
source "drivers/media/dvb/ttusb-budget/Kconfig"
source "drivers/media/dvb/ttusb-dec/Kconfig"
source "drivers/media/dvb/siano/Kconfig"

comment "Supported FlexCopII (B2C2) Adapters"
	depends on DVB_CORE && (PCI || USB) && I2C
source "drivers/media/dvb/b2c2/Kconfig"

comment "Supported BT878 Adapters"
	depends on DVB_CORE && PCI && I2C
source "drivers/media/dvb/bt8xx/Kconfig"

comment "Supported Pluto2 Adapters"
	depends on DVB_CORE && PCI && I2C
source "drivers/media/dvb/pluto2/Kconfig"

comment "Supported SDMC DM1105 Adapters"
	depends on DVB_CORE && PCI && I2C
source "drivers/media/dvb/dm1105/Kconfig"

comment "Supported Earthsoft PT1 Adapters"
	depends on DVB_CORE && PCI && I2C
source "drivers/media/dvb/pt1/Kconfig"

comment "Supported Mantis Adapters"
	depends on DVB_CORE && PCI && I2C
	source "drivers/media/dvb/mantis/Kconfig"

comment "Supported nGene Adapters"
	depends on DVB_CORE && PCI && I2C
	source "drivers/media/dvb/ngene/Kconfig"

comment "Supported ddbridge ('Octopus') Adapters"
	depends on DVB_CORE && PCI && I2C
	source "drivers/media/dvb/ddbridge/Kconfig"

endif # DVB_CAPTURE_DRIVERS
```

## drivers/media/dvb/b2c2/Kconfig
```kconfig
config DVB_B2C2_FLEXCOP
	tristate "Technisat/B2C2 FlexCopII(b) and FlexCopIII adapters"
	depends on DVB_CORE && I2C
	select DVB_STV0299
	select DVB_MT352
	select DVB_MT312
	select DVB_NXT200X
	select DVB_STV0297
	select DVB_BCM3510
	select DVB_LGDT330X
	help
	  Support for the digital TV receiver chip made by B2C2 Inc. included in
	  Technisats PCI cards and USB boxes.

	  Say Y if you own such a device and want to use it.

config DVB_B2C2_FLEXCOP_PCI
	tristate "Technisat/B2C2 Air/Sky/Cable2PC PCI"
	depends on DVB_B2C2_FLEXCOP && PCI && I2C
	help
	  Support for the Air/Sky/CableStar2 PCI card (DVB/ATSC) by Technisat/B2C2.

	  Say Y if you own such a device and want to use it.

config DVB_B2C2_FLEXCOP_USB
	tristate "Technisat/B2C2 Air/Sky/Cable2PC USB"
	depends on DVB_B2C2_FLEXCOP && USB && I2C
	help
	  Support for the Air/Sky/Cable2PC USB1.1 box (DVB/ATSC) by Technisat/B2C2,

	  Say Y if you own such a device and want to use it.

config DVB_B2C2_FLEXCOP_DEBUG
	bool "Enable debug for the B2C2 FlexCop drivers"
	depends on DVB_B2C2_FLEXCOP
	help
	  Say Y if you want to enable the module option to control debug messages
	  of all B2C2 FlexCop drivers.
```

## drivers/media/dvb/bt8xx/Kconfig
```kconfig
config DVB_BT8XX
	tristate "BT8xx based PCI cards"
	depends on DVB_CORE && PCI && I2C && VIDEO_BT848
	select DVB_MT352 if !DVB_FE_CUSTOMISE
	select DVB_SP887X if !DVB_FE_CUSTOMISE
	select DVB_NXT6000 if !DVB_FE_CUSTOMISE
	select DVB_CX24110 if !DVB_FE_CUSTOMISE
	select DVB_OR51211 if !DVB_FE_CUSTOMISE
	select DVB_LGDT330X if !DVB_FE_CUSTOMISE
	select DVB_ZL10353 if !DVB_FE_CUSTOMISE
	select MEDIA_TUNER_SIMPLE if !MEDIA_TUNER_CUSTOMISE
	help
	  Support for PCI cards based on the Bt8xx PCI bridge. Examples are
	  the Nebula cards, the Pinnacle PCTV cards, the Twinhan DST cards,
	  the pcHDTV HD2000 cards, the DViCO FusionHDTV Lite cards, and
	  some AVerMedia cards.

	  Since these cards have no MPEG decoder onboard, they transmit
	  only compressed MPEG data over the PCI bus, so you need
	  an external software decoder to watch TV on your computer.

	  Say Y if you own such a device and want to use it.
```

## drivers/media/dvb/cinergyT2/Kconfig
```kconfig
config DVB_CINERGYT2
	tristate "Terratec CinergyT2/qanu USB2 DVB-T receiver"
	depends on DVB_CORE && USB && INPUT
	help
	  Support for "TerraTec CinergyT2" USB2.0 Highspeed DVB Receivers

	  Say Y if you own such a device and want to use it.


config DVB_CINERGYT2_TUNING
	bool "sophisticated fine-tuning for CinergyT2 cards"
	depends on DVB_CINERGYT2
	help
	  Here you can fine-tune some parameters of the CinergyT2 driver.

	  Normally you don't need to touch this, but in exotic setups you
	  may fine-tune your setup and adjust e.g. DMA buffer sizes for
	  a particular application.


config DVB_CINERGYT2_STREAM_URB_COUNT
	int "Number of queued USB Request Blocks for Highspeed Stream Transfers"
	depends on DVB_CINERGYT2_TUNING
	default "32"
	help
	  USB Request Blocks for Highspeed Stream transfers are scheduled in
	  a queue for the Host Controller.

	  Usually the default value is a safe choice.

	  You may increase this number if you are using this device in a
	  Server Environment with many high-traffic USB Highspeed devices
	  sharing the same USB bus.


config DVB_CINERGYT2_STREAM_BUF_SIZE
	int "Size of URB Stream Buffers for Highspeed Transfers"
	depends on DVB_CINERGYT2_TUNING
	default "512"
	help
	  Should be a multiple of native buffer size of 512 bytes.
	  Default value is a safe choice.

	  You may increase this number if you are using this device in a
	  Server Environment with many high-traffic USB Highspeed devices
	  sharing the same USB bus.


config DVB_CINERGYT2_QUERY_INTERVAL
	int "Status update interval [milliseconds]"
	depends on DVB_CINERGYT2_TUNING
	default "250"
	help
	  This is the interval for status readouts from the demodulator.
	  You may try lower values if you need more responsive signal quality
	  measurements.

	  Please keep in mind that these updates cause traffic on the tuner
	  control bus and thus may or may not affect reception sensitivity.

	  The default value should be a safe choice for common applications.


config DVB_CINERGYT2_ENABLE_RC_INPUT_DEVICE
	bool "Register the onboard IR Remote Control Receiver as Input Device"
	depends on DVB_CINERGYT2_TUNING
	default y
	help
	  Enable this option if you want to use the onboard Infrared Remote
	  Control Receiver as Linux-Input device.

	  Right now only the keycode table for the default Remote Control
	  delivered with the device is supported, please see the driver
	  source code to find out how to add support for other controls.


config DVB_CINERGYT2_RC_QUERY_INTERVAL
	int "Infrared Remote Controller update interval [milliseconds]"
	depends on DVB_CINERGYT2_TUNING && DVB_CINERGYT2_ENABLE_RC_INPUT_DEVICE
	default "50"
	help
	  If you have a very fast-repeating remote control you can try lower
	  values, for normal consumer receivers the default value should be
	  a safe choice.
```

## drivers/media/dvb/ddbridge/Kconfig
```kconfig
config DVB_DDBRIDGE
	tristate "Digital Devices bridge support"
	depends on DVB_CORE && PCI && I2C
	select DVB_LNBP21 if !DVB_FE_CUSTOMISE
	select DVB_STV6110x if !DVB_FE_CUSTOMISE
	select DVB_STV090x if !DVB_FE_CUSTOMISE
	select DVB_DRXK if !DVB_FE_CUSTOMISE
	select DVB_TDA18271C2DD if !DVB_FE_CUSTOMISE
	---help---
	  Support for cards with the Digital Devices PCI express bridge:
	  - Octopus PCIe Bridge
	  - Octopus mini PCIe Bridge
	  - Octopus LE
	  - DuoFlex S2 Octopus
	  - DuoFlex CT Octopus
	  - cineS2(v6)

	  Say Y if you own such a card and want to use it.
```

## drivers/media/dvb/dibusb/Kconfig
```kconfig
config DVB_DIBUSB
	tristate "DiBcom USB DVB-T devices (see help for a complete device list)"
	depends on DVB_CORE && USB
	select FW_LOADER
	select DVB_DIB3000MB
	select DVB_DIB3000MC
	select DVB_MT352
	help
	  Support for USB 1.1 and 2.0 DVB-T devices based on reference designs made by
	  DiBcom (http://www.dibcom.fr) and C&E.

	  Devices supported by this driver:

	    TwinhanDTV USB-Ter (VP7041)
		TwinhanDTV Magic Box (VP7041e)
	    KWorld/JetWay/ADSTech V-Stream XPERT DTV - DVB-T USB1.1 and USB2.0
	    Hama DVB-T USB-Box
	    DiBcom reference devices (non-public)
	    Ultima Electronic/Artec T1 USB TVBOX
	    Compro Videomate DVB-U2000 - DVB-T USB
	    Grandtec DVB-T USB
	    Avermedia AverTV DVBT USB
	    Artec T1 USB1.1 and USB2.0 boxes
	    Yakumo/Typhoon DVB-T USB2.0
	    Hanftek UMT-010 USB2.0
	    Hauppauge WinTV NOVA-T USB2

	  The VP7041 seems to be identical to "CTS Portable" (Chinese
	  Television System).

	  These devices can be understood as budget ones, they "only" deliver
	  (a part of) the MPEG2 transport stream.

	  A firmware is needed to get the device working. See Documentation/dvb/README.dibusb
	  details.

	  Say Y if you own such a device and want to use it. You should build it as
	  a module.

config DVB_DIBUSB_MISDESIGNED_DEVICES
	bool "Enable support for some misdesigned (see help) devices, which identify with wrong IDs"
	depends on DVB_DIBUSB
	help
	  Somehow Artec/Ultima Electronic forgot to program the eeprom of some of their
	  USB1.1/USB2.0 devices.
	  So comes that they identify with the default Vendor and Product ID of the Cypress
	  CY7C64613 (AN2235) or Cypress FX2.

	  Affected device IDs:
	    0x0574:0x2235 (Artec T1 USB1.1, cold)
	    0x04b4:0x8613 (Artec T1 USB2.0, cold)
	    0x0574:0x1002 (Artec T1 USB2.0, warm)
	    0x0574:0x2131 (aged DiBcom USB1.1 test device)

	  Say Y if your device has one of the mentioned IDs.

config DVB_DIBCOM_DEBUG
	bool "Enable extended debug support for DiBcom USB device"
	depends on DVB_DIBUSB
	help
	  Say Y if you want to enable debuging. See modinfo dvb-dibusb for
	  debug levels.
```

## drivers/media/dvb/dm1105/Kconfig
```kconfig
config DVB_DM1105
	tristate "SDMC DM1105 based PCI cards"
	depends on DVB_CORE && PCI && I2C
	depends on INPUT
	select DVB_PLL if !DVB_FE_CUSTOMISE
	select DVB_STV0299 if !DVB_FE_CUSTOMISE
	select DVB_STV0288 if !DVB_FE_CUSTOMISE
	select DVB_STB6000 if !DVB_FE_CUSTOMISE
	select DVB_CX24116 if !DVB_FE_CUSTOMISE
	select DVB_SI21XX if !DVB_FE_CUSTOMISE
	select DVB_DS3000 if !DVB_FE_CUSTOMISE
	select VIDEO_IR
	help
	  Support for cards based on the SDMC DM1105 PCI chip like
	  DvbWorld 2002

	  Since these cards have no MPEG decoder onboard, they transmit
	  only compressed MPEG data over the PCI bus, so you need
	  an external software decoder to watch TV on your computer.

	  Say Y or M if you own such a device and want to use it.
```

## drivers/media/dvb/dvb-core/Kconfig
```kconfig
config DVB_CORE
	tristate "DVB for Linux"
	depends on NET && INET
	select CRC32
	help
	  Support Digital Video Broadcasting hardware.  Enable this if you
	  own a DVB adapter and want to use it or if you compile Linux for
	  a digital SetTopBox.

	  DVB core utility functions for device handling, software fallbacks etc.
	  Say Y when you have a DVB card and want to use it. Say Y if your want
	  to build your drivers outside the kernel, but need the DVB core. All
	  in-kernel drivers will select this automatically if needed.

	  API specs and user tools are available from <http://www.linuxtv.org/>.

	  Please report problems regarding this driver to the LinuxDVB
	  mailing list.

	  If unsure say N.

config DVB_CORE_ATTACH
	bool "Load and attach frontend modules as needed"
	depends on DVB_CORE
	depends on MODULES
	help
	  Remove the static dependency of DVB card drivers on all
	  frontend modules for all possible card variants. Instead,
	  allow the card drivers to only load the frontend modules
	  they require. This saves several KBytes of memory.

	  Note: You will need module-init-tools v3.2 or later for this feature.

	  If unsure say Y.
```
