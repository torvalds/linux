## drivers/media/platform/amd/isp4/Kconfig
```kconfig
# SPDX-License-Identifier: GPL-2.0+

config VIDEO_AMD_ISP4_CAPTURE
	tristate "AMD ISP4 and camera driver"
	depends on DRM_AMDGPU && DRM_AMD_ISP
	depends on HAS_DMA
	depends on VIDEO_DEV
	select VIDEOBUF2_CORE
	select VIDEOBUF2_MEMOPS
	select VIDEOBUF2_V4L2
	select VIDEOBUF2_VMALLOC
	select VIDEO_V4L2_SUBDEV_API
	help
	  This is support for AMD ISP4 and camera subsystem driver.
	  Say Y here to enable the ISP4 and camera device for video capture.
	  To compile this driver as a module, choose M here. The module will
	  be called amd_isp4_capture.
```

## drivers/media/platform/amlogic/Kconfig
```kconfig
# SPDX-License-Identifier: GPL-2.0-only

comment "Amlogic media platform drivers"

source "drivers/media/platform/amlogic/meson-ge2d/Kconfig"
```

## drivers/media/platform/amlogic/c3/Kconfig
```kconfig
# SPDX-License-Identifier: GPL-2.0-only

source "drivers/media/platform/amlogic/c3/isp/Kconfig"
source "drivers/media/platform/amlogic/c3/mipi-adapter/Kconfig"
source "drivers/media/platform/amlogic/c3/mipi-csi2/Kconfig"
```

## drivers/media/platform/amlogic/c3/isp/Kconfig
```kconfig
# SPDX-License-Identifier: GPL-2.0-only

config VIDEO_C3_ISP
	tristate "Amlogic C3 Image Signal Processor (ISP) driver"
	depends on ARCH_MESON || COMPILE_TEST
	depends on VIDEO_DEV
	depends on OF
	select MEDIA_CONTROLLER
	select V4L2_FWNODE
	select VIDEO_V4L2_SUBDEV_API
	select VIDEOBUF2_DMA_CONTIG
	select VIDEOBUF2_VMALLOC
	help
	  Video4Linux2 driver for Amlogic C3 ISP pipeline.
	  The C3 ISP is used for processing raw images and
	  outputing results to memory.

	  To compile this driver as a module choose m here.
```

## drivers/media/platform/amlogic/c3/mipi-adapter/Kconfig
```kconfig
# SPDX-License-Identifier: GPL-2.0-only

config VIDEO_C3_MIPI_ADAPTER
	tristate "Amlogic C3 MIPI adapter"
	depends on ARCH_MESON || COMPILE_TEST
	depends on VIDEO_DEV
	depends on OF
	select MEDIA_CONTROLLER
	select V4L2_FWNODE
	select VIDEO_V4L2_SUBDEV_API
	help
	  Video4Linux2 driver for Amlogic C3 MIPI adapter.
	  C3 MIPI adapter mainly responsible for organizing
	  MIPI data and sending raw data to ISP pipeline.

	  To compile this driver as a module choose m here.
```

## drivers/media/platform/amlogic/c3/mipi-csi2/Kconfig
```kconfig
# SPDX-License-Identifier: GPL-2.0-only

config VIDEO_C3_MIPI_CSI2
	tristate "Amlogic C3 MIPI CSI-2 receiver"
	depends on ARCH_MESON || COMPILE_TEST
	depends on VIDEO_DEV
	depends on OF
	select MEDIA_CONTROLLER
	select V4L2_FWNODE
	select VIDEO_V4L2_SUBDEV_API
	help
	  Video4Linux2 driver for Amlogic C3 MIPI CSI-2 receiver.
	  C3 MIPI CSI-2 receiver is used to receive MIPI data from
	  image sensor.

	  To compile this driver as a module choose m here.
```

## drivers/media/platform/amlogic/meson-ge2d/Kconfig
```kconfig
config VIDEO_MESON_GE2D
	tristate "Amlogic 2D Graphic Acceleration Unit"
	depends on V4L_MEM2MEM_DRIVERS
	depends on VIDEO_DEV
	depends on ARCH_MESON || COMPILE_TEST
	select VIDEOBUF2_DMA_CONTIG
	select V4L2_MEM2MEM_DEV
	help
	  This is a v4l2 driver for Amlogic GE2D 2D graphics accelerator.
	  GE2D is a standalone 2D graphic acceleration unit, with color converter,
	  image scaling, BitBLT & alpha blending operations.

	  To compile this driver as a module choose m here.
```

## drivers/media/platform/amphion/Kconfig
```kconfig
# SPDX-License-Identifier: GPL-2.0-only

comment "Amphion drivers"

config VIDEO_AMPHION_VPU
	tristate "Amphion VPU (Video Processing Unit) Codec IP"
	depends on V4L_MEM2MEM_DRIVERS
	depends on ARCH_MXC || COMPILE_TEST
	depends on MEDIA_SUPPORT
	depends on VIDEO_DEV && MAILBOX
	select MEDIA_CONTROLLER
	select V4L2_MEM2MEM_DEV
	select VIDEOBUF2_DMA_CONTIG
	select VIDEOBUF2_VMALLOC
	help
	  Amphion VPU Codec IP contains two parts: Windsor and Malone.
	  Windsor is encoder that supports H.264, and Malone is decoder
	  that supports H.264, HEVC, and other video formats.
	  This is a V4L2 driver for NXP MXC 8Q video accelerator hardware.
	  It accelerates encoding and decoding operations on
	  various NXP SoCs.
	  To compile this driver as a module choose m here.
```

## drivers/media/platform/arm/Kconfig
```kconfig
# SPDX-License-Identifier: GPL-2.0-only

comment "ARM media platform drivers"

source "drivers/media/platform/arm/mali-c55/Kconfig"
```

## drivers/media/platform/arm/mali-c55/Kconfig
```kconfig
# SPDX-License-Identifier: GPL-2.0-only
config VIDEO_MALI_C55
	tristate "ARM Mali-C55 Image Signal Processor driver"
	depends on ARCH_VEXPRESS || ARCH_RENESAS || COMPILE_TEST
	depends on V4L_PLATFORM_DRIVERS
	depends on VIDEO_DEV && OF
	select GENERIC_PHY_MIPI_DPHY
	select MEDIA_CONTROLLER
	select V4L2_FWNODE
	select V4L2_ISP
	select VIDEO_V4L2_SUBDEV_API
	select VIDEOBUF2_DMA_CONTIG
	select VIDEOBUF2_VMALLOC
	help
	  Enable this to support Arm's Mali-C55 Image Signal Processor.

	  To compile this driver as a module, choose M here: the module
	  will be called mali-c55.
```

## drivers/media/platform/aspeed/Kconfig
```kconfig
# SPDX-License-Identifier: GPL-2.0-only

comment "Aspeed media platform drivers"

config VIDEO_ASPEED
	tristate "Aspeed AST2400 and AST2500 Video Engine driver"
	depends on V4L_PLATFORM_DRIVERS
	depends on VIDEO_DEV
	select VIDEOBUF2_DMA_CONTIG
	help
	  Support for the Aspeed Video Engine (VE) embedded in the Aspeed
	  AST2400 and AST2500 SOCs. The VE can capture and compress video data
	  from digital or analog sources.
```

## drivers/media/platform/atmel/Kconfig
```kconfig
# SPDX-License-Identifier: GPL-2.0-only

comment "Atmel media platform drivers"

config VIDEO_ATMEL_ISI
	tristate "ATMEL Image Sensor Interface (ISI) support"
	depends on V4L_PLATFORM_DRIVERS
	depends on VIDEO_DEV && OF
	depends on ARCH_AT91 || COMPILE_TEST
	select VIDEOBUF2_DMA_CONTIG
	select V4L2_FWNODE
	help
	  This module makes the ATMEL Image Sensor Interface available
	  as a v4l2 device.
```

## drivers/media/platform/blackfin/Kconfig
```kconfig
config VIDEO_BLACKFIN_CAPTURE
	tristate "Blackfin Video Capture Driver"
	depends on VIDEO_V4L2 && BLACKFIN && I2C
	depends on HAS_DMA
	select VIDEOBUF2_DMA_CONTIG
	help
	  V4L2 bridge driver for Blackfin video capture device.
	  Choose PPI or EPPI as its interface.

	  To compile this driver as a module, choose M here: the
	  module will be called bfin_capture.

config VIDEO_BLACKFIN_PPI
	tristate
	depends on VIDEO_BLACKFIN_CAPTURE
	default VIDEO_BLACKFIN_CAPTURE
```

## drivers/media/platform/broadcom/Kconfig
```kconfig
# SPDX-License-Identifier: GPL-2.0

config VIDEO_BCM2835_UNICAM
	tristate "Broadcom BCM283x/BCM271x Unicam video capture driver"
	depends on ARCH_BCM2835 || COMPILE_TEST
	depends on COMMON_CLK && PM
	depends on VIDEO_DEV
	select MEDIA_CONTROLLER
	select V4L2_FWNODE
	select VIDEO_V4L2_SUBDEV_API
	select VIDEOBUF2_DMA_CONTIG
	help
	  Say Y here to enable support for the BCM283x/BCM271x CSI-2 receiver.
	  This is a V4L2 driver that controls the CSI-2 receiver directly,
	  independently from the VC4 firmware.

	  To compile this driver as a module, choose M here. The module will be
	  called bcm2835-unicam.
```

## drivers/media/platform/cadence/Kconfig
```kconfig
# SPDX-License-Identifier: GPL-2.0-only

comment "Cadence media platform drivers"

config VIDEO_CADENCE_CSI2RX
	tristate "Cadence MIPI-CSI2 RX Controller"
	depends on VIDEO_DEV
	select MEDIA_CONTROLLER
	select VIDEO_V4L2_SUBDEV_API
	select V4L2_FWNODE
	select GENERIC_PHY
	select GENERIC_PHY_MIPI_DPHY
	help
	  Support for the Cadence MIPI CSI2 Receiver controller.

	  To compile this driver as a module, choose M here: the module will be
	  called cdns-csi2rx.

config VIDEO_CADENCE_CSI2TX
	tristate "Cadence MIPI-CSI2 TX Controller"
	depends on VIDEO_DEV
	select MEDIA_CONTROLLER
	select VIDEO_V4L2_SUBDEV_API
	select V4L2_FWNODE
	help
	  Support for the Cadence MIPI CSI2 Transceiver controller.

	  To compile this driver as a module, choose M here: the module will be
	  called cdns-csi2tx.
```

## drivers/media/platform/chips-media/Kconfig
```kconfig
# SPDX-License-Identifier: GPL-2.0-only

comment "Chips&Media media platform drivers"

source "drivers/media/platform/chips-media/coda/Kconfig"
source "drivers/media/platform/chips-media/wave5/Kconfig"
```

## drivers/media/platform/chips-media/wave5/Kconfig
```kconfig
# SPDX-License-Identifier: GPL-2.0
config VIDEO_WAVE_VPU
	tristate "Chips&Media Wave Codec Driver"
	depends on V4L_MEM2MEM_DRIVERS
	depends on VIDEO_DEV && OF
	depends on ARCH_K3 || COMPILE_TEST
	select VIDEOBUF2_DMA_CONTIG
	select VIDEOBUF2_VMALLOC
	select V4L2_MEM2MEM_DEV
	help
	  Chips&Media stateful encoder and decoder driver.
	  The driver supports HEVC and H264 formats.
	  To compile this driver as modules, choose M here: the
	  modules will be called wave5.
```

## drivers/media/platform/davinci/Kconfig
```kconfig
config VIDEO_DAVINCI_VPIF_DISPLAY
	tristate "TI DaVinci VPIF V4L2-Display driver"
	depends on VIDEO_V4L2
	depends on ARCH_DAVINCI || COMPILE_TEST
	depends on HAS_DMA
	depends on I2C
	select VIDEOBUF2_DMA_CONTIG
	select VIDEO_ADV7343 if MEDIA_SUBDRV_AUTOSELECT
	select VIDEO_THS7303 if MEDIA_SUBDRV_AUTOSELECT
	help
	  Enables Davinci VPIF module used for display devices.
	  This module is used for display on TI DM6467/DA850/OMAPL138
	  SoCs.

	  To compile this driver as a module, choose M here. There will
	  be two modules called vpif.ko and vpif_display.ko

config VIDEO_DAVINCI_VPIF_CAPTURE
	tristate "TI DaVinci VPIF video capture driver"
	depends on VIDEO_V4L2
	depends on ARCH_DAVINCI || COMPILE_TEST
	depends on HAS_DMA
	depends on I2C
	select VIDEOBUF2_DMA_CONTIG
	help
	  Enables Davinci VPIF module used for capture devices.
	  This module is used for capture on TI DM6467/DA850/OMAPL138
	  SoCs.

	  To compile this driver as a module, choose M here. There will
	  be two modules called vpif.ko and vpif_capture.ko

config VIDEO_DM6446_CCDC
	tristate "TI DM6446 CCDC video capture driver"
	depends on VIDEO_V4L2
	depends on ARCH_DAVINCI || COMPILE_TEST
	depends on HAS_DMA
	depends on I2C
	select VIDEOBUF_DMA_CONTIG
	help
	   Enables DaVinci CCD hw module. DaVinci CCDC hw interfaces
	   with decoder modules such as TVP5146 over BT656 or
	   sensor module such as MT9T001 over a raw interface. This
	   module configures the interface and CCDC/ISIF to do
	   video frame capture from slave decoders.

	   To compile this driver as a module, choose M here. There will
	   be three modules called vpfe_capture.ko, vpss.ko and dm644x_ccdc.ko

config VIDEO_DM355_CCDC
	tristate "TI DM355 CCDC video capture driver"
	depends on VIDEO_V4L2
	depends on ARCH_DAVINCI || COMPILE_TEST
	depends on HAS_DMA
	depends on I2C
	select VIDEOBUF_DMA_CONTIG
	help
	   Enables DM355 CCD hw module. DM355 CCDC hw interfaces
	   with decoder modules such as TVP5146 over BT656 or
	   sensor module such as MT9T001 over a raw interface. This
	   module configures the interface and CCDC/ISIF to do
	   video frame capture from a slave decoders

	   To compile this driver as a module, choose M here. There will
	   be three modules called vpfe_capture.ko, vpss.ko and dm355_ccdc.ko

config VIDEO_DM365_ISIF
	tristate "TI DM365 ISIF video capture driver"
	depends on VIDEO_V4L2 && ARCH_DAVINCI
	depends on HAS_DMA
	depends on I2C
	select VIDEOBUF_DMA_CONTIG
	help
	   Enables ISIF hw module. This is the hardware module for
	   configuring ISIF in VPFE to capture Raw Bayer RGB data from
	   a image sensor or YUV data from a YUV source.

	   To compile this driver as a module, choose M here. There will
	   be three modules called vpfe_capture.ko, vpss.ko and isif.ko

config VIDEO_DAVINCI_VPBE_DISPLAY
	tristate "TI DaVinci VPBE V4L2-Display driver"
	depends on VIDEO_V4L2 && ARCH_DAVINCI
	depends on HAS_DMA
	depends on I2C
	select VIDEOBUF2_DMA_CONTIG
	help
	    Enables Davinci VPBE module used for display devices.
	    This module is used for display on TI DM644x/DM365/DM355
	    based display devices.

	    To compile this driver as a module, choose M here. There will
	    be five modules created called vpss.ko, vpbe.ko, vpbe_osd.ko,
	    vpbe_venc.ko and vpbe_display.ko
```

## drivers/media/platform/exynos4-is/Kconfig
```kconfig
config VIDEO_SAMSUNG_EXYNOS4_IS
	bool "Samsung S5P/EXYNOS4 SoC series Camera Subsystem driver"
	depends on VIDEO_V4L2 && VIDEO_V4L2_SUBDEV_API && PM_RUNTIME
	depends on (PLAT_S5P || ARCH_EXYNOS)
	help
	  Say Y here to enable camera host interface devices for
	  Samsung S5P and EXYNOS SoC series.

if VIDEO_SAMSUNG_EXYNOS4_IS

config VIDEO_EXYNOS4_IS_COMMON
       tristate

config VIDEO_S5P_FIMC
	tristate "S5P/EXYNOS4 FIMC/CAMIF camera interface driver"
	depends on I2C
	select VIDEOBUF2_DMA_CONTIG
	select V4L2_MEM2MEM_DEV
	select MFD_SYSCON if OF
	select VIDEO_EXYNOS4_IS_COMMON
	help
	  This is a V4L2 driver for Samsung S5P and EXYNOS4 SoC camera host
	  interface and video postprocessor (FIMC) devices.

	  To compile this driver as a module, choose M here: the
	  module will be called s5p-fimc.

config VIDEO_S5P_MIPI_CSIS
	tristate "S5P/EXYNOS MIPI-CSI2 receiver (MIPI-CSIS) driver"
	depends on REGULATOR
	select GENERIC_PHY
	help
	  This is a V4L2 driver for Samsung S5P and EXYNOS4 SoC MIPI-CSI2
	  receiver (MIPI-CSIS) devices.

	  To compile this driver as a module, choose M here: the
	  module will be called s5p-csis.

if SOC_EXYNOS4212 || SOC_EXYNOS4412 || SOC_EXYNOS5250

config VIDEO_EXYNOS_FIMC_LITE
	tristate "EXYNOS FIMC-LITE camera interface driver"
	depends on I2C
	select VIDEOBUF2_DMA_CONTIG
	select VIDEO_EXYNOS4_IS_COMMON
	help
	  This is a V4L2 driver for Samsung EXYNOS4/5 SoC FIMC-LITE camera
	  host interface.

	  To compile this driver as a module, choose M here: the
	  module will be called exynos-fimc-lite.
endif

config VIDEO_EXYNOS4_FIMC_IS
	tristate "EXYNOS4x12 FIMC-IS (Imaging Subsystem) driver"
	select VIDEOBUF2_DMA_CONTIG
	depends on OF
	select FW_LOADER
	help
	  This is a V4L2 driver for Samsung EXYNOS4x12 SoC series
	  FIMC-IS (Imaging Subsystem).

	  To compile this driver as a module, choose M here: the
	  module will be called exynos4-fimc-is.

endif # VIDEO_SAMSUNG_EXYNOS4_IS
```

## drivers/media/platform/imagination/Kconfig
```kconfig
# SPDX-License-Identifier: GPL-2.0
config VIDEO_E5010_JPEG_ENC
	tristate "Imagination E5010 JPEG Encoder Driver"
	depends on VIDEO_DEV
	select VIDEOBUF2_DMA_CONTIG
	select VIDEOBUF2_VMALLOC
	select V4L2_MEM2MEM_DEV
	help
	  This is a video4linux2 M2M driver for Imagination E5010 JPEG encoder,
	  which supports JPEG and MJPEG baseline encoding of YUV422 and YUV420
	  semiplanar video formats, with resolution ranging from 64x64 to 8K x 8K
	  pixels. The module will be named as e5010_jpeg_enc.
```

## drivers/media/platform/imx-jpeg/Kconfig
```kconfig
# SPDX-License-Identifier: GPL-2.0
config VIDEO_IMX8_JPEG
	tristate "IMX8 JPEG Encoder/Decoder"
	depends on ARCH_MXC || COMPILE_TEST
	depends on VIDEO_DEV && VIDEO_V4L2
	select VIDEOBUF2_DMA_CONTIG
	select V4L2_MEM2MEM_DEV
	select V4L2_JPEG_HELPER
	help
	  This is a video4linux2 driver for the i.MX8 QXP/QM integrated
	  JPEG encoder/decoder.
```

## drivers/media/platform/imx/Kconfig
```kconfig
# SPDX-License-Identifier: GPL-2.0-only

menuconfig VIDEO_IMX
	bool "V4L2 capture drivers for NXP i.MX devices"
	depends on ARCH_MXC || COMPILE_TEST
	depends on VIDEO_DEV && VIDEO_V4L2
	help
	  Say yes here to enable support for capture drivers on i.MX SoCs.
	  Support for the single SoC features are selectable in the sub-menu
	  options.

if VIDEO_IMX

config VIDEO_IMX_MIPI_CSIS
	tristate "MIPI CSI-2 CSIS receiver found on i.MX7 and i.MX8 models"
	select MEDIA_CONTROLLER
	select V4L2_FWNODE
	select VIDEO_V4L2_SUBDEV_API
	default n
	help
	  Video4Linux2 sub-device driver for the MIPI CSI-2 CSIS receiver
	  v3.3/v3.6.3 found on some i.MX7 and i.MX8 SoCs.

endif # VIDEO_IMX
```
