## drivers/media/platform/intel/Kconfig
```kconfig
# SPDX-License-Identifier: GPL-2.0-only

comment "Intel media platform drivers"

config VIDEO_PXA27x
	tristate "PXA27x Quick Capture Interface driver"
	depends on V4L_PLATFORM_DRIVERS
	depends on VIDEO_DEV
	depends on PXA27x || COMPILE_TEST
	select VIDEOBUF2_DMA_SG
	select SG_SPLIT
	select V4L2_FWNODE
	help
	  This is a v4l2 driver for the PXA27x Quick Capture Interface
```

## drivers/media/platform/marvell-ccic/Kconfig
```kconfig
config VIDEO_CAFE_CCIC
	tristate "Marvell 88ALP01 (Cafe) CMOS Camera Controller support"
	depends on PCI && I2C && VIDEO_V4L2
	select VIDEO_OV7670
	select VIDEOBUF2_VMALLOC
	select VIDEOBUF2_DMA_CONTIG
	select VIDEOBUF2_DMA_SG
	---help---
	  This is a video4linux2 driver for the Marvell 88ALP01 integrated
	  CMOS camera controller.  This is the controller found on first-
	  generation OLPC systems.

config VIDEO_MMP_CAMERA
	tristate "Marvell Armada 610 integrated camera controller support"
	depends on I2C && VIDEO_V4L2
	depends on ARCH_MMP || COMPILE_TEST
	select VIDEO_OV7670
	select I2C_GPIO
	select VIDEOBUF2_VMALLOC
	select VIDEOBUF2_DMA_CONTIG
	select VIDEOBUF2_DMA_SG
	---help---
	  This is a Video4Linux2 driver for the integrated camera
	  controller found on Marvell Armada 610 application
	  processors (and likely beyond).  This is the controller found
	  in OLPC XO 1.75 systems.
```

## drivers/media/platform/mediatek/Kconfig
```kconfig
# SPDX-License-Identifier: GPL-2.0-only

comment "Mediatek media platform drivers"

source "drivers/media/platform/mediatek/jpeg/Kconfig"
source "drivers/media/platform/mediatek/mdp/Kconfig"
source "drivers/media/platform/mediatek/vcodec/Kconfig"
source "drivers/media/platform/mediatek/vpu/Kconfig"
source "drivers/media/platform/mediatek/mdp3/Kconfig"
```
