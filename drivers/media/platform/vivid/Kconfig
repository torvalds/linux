## drivers/media/platform/vivid/Kconfig
```kconfig
config VIDEO_VIVID
	tristate "Virtual Video Test Driver"
	depends on VIDEO_DEV && VIDEO_V4L2 && !SPARC32 && !SPARC64 && FB
	select FONT_SUPPORT
	select FONT_8x16
	select FB_CFB_FILLRECT
	select FB_CFB_COPYAREA
	select FB_CFB_IMAGEBLIT
	select MEDIA_CEC_EDID
	select VIDEOBUF2_VMALLOC
	select VIDEO_V4L2_TPG
	default n
	---help---
	  Enables a virtual video driver. This driver emulates a webcam,
	  TV, S-Video and HDMI capture hardware, including VBI support for
	  the SDTV inputs. Also video output, VBI output, radio receivers,
	  transmitters and software defined radio capture is emulated.

	  It is highly configurable and is ideal for testing applications.
	  Error injection is supported to test rare errors that are hard
	  to reproduce in real hardware.

	  Say Y here if you want to test video apps or debug V4L devices.
	  When in doubt, say N.

config VIDEO_VIVID_CEC
	bool "Enable CEC emulation support"
	depends on VIDEO_VIVID && MEDIA_CEC
	---help---
	  When selected the vivid module will emulate the optional
	  HDMI CEC feature.

config VIDEO_VIVID_MAX_DEVS
	int "Maximum number of devices"
	depends on VIDEO_VIVID
	default "64"
	---help---
	  This allows you to specify the maximum number of devices supported
	  by the vivid driver.
```

## drivers/media/platform/xilinx/Kconfig
```kconfig
# SPDX-License-Identifier: GPL-2.0

comment "Xilinx media platform drivers"

config VIDEO_XILINX
	tristate "Xilinx Video IP (EXPERIMENTAL)"
	depends on V4L_PLATFORM_DRIVERS
	depends on VIDEO_DEV  && OF && HAS_DMA
	select MEDIA_CONTROLLER
	select VIDEO_V4L2_SUBDEV_API
	select VIDEOBUF2_DMA_CONTIG
	select V4L2_FWNODE
	help
	  Driver for Xilinx Video IP Pipelines

config VIDEO_XILINX_CSI2RXSS
	depends on VIDEO_XILINX
	tristate "Xilinx CSI-2 Rx Subsystem"
	help
	  Driver for Xilinx MIPI CSI-2 Rx Subsystem. This is a V4L sub-device
	  based driver that takes input from CSI-2 Tx source and converts
	  it into an AXI4-Stream.

config VIDEO_XILINX_TPG
	tristate "Xilinx Video Test Pattern Generator"
	depends on VIDEO_XILINX
	select VIDEO_XILINX_VTC
	help
	   Driver for the Xilinx Video Test Pattern Generator

config VIDEO_XILINX_VTC
	tristate "Xilinx Video Timing Controller"
	depends on VIDEO_XILINX
	help
	   Driver for the Xilinx Video Timing Controller
```
