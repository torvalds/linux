## drivers/media/rc/img-ir/Kconfig
```kconfig
config IR_IMG
	tristate "ImgTec IR Decoder"
	depends on RC_CORE
	depends on METAG || MIPS || COMPILE_TEST
	select IR_IMG_HW if !IR_IMG_RAW
	help
	   Say Y or M here if you want to use the ImgTec infrared decoder
	   functionality found in SoCs such as TZ1090.

config IR_IMG_RAW
	bool "Raw decoder"
	depends on IR_IMG
	help
	   Say Y here to enable the raw mode driver which passes raw IR signal
	   changes to the IR raw decoders for software decoding. This is much
	   less reliable (due to lack of timestamps) and consumes more
	   processing power than using hardware decode, but can be useful for
	   testing, debug, and to make more protocols available.

config IR_IMG_HW
	bool "Hardware decoder"
	depends on IR_IMG
	help
	   Say Y here to enable the hardware decode driver which decodes the IR
	   signals in hardware. This is more reliable, consumes less processing
	   power since only a single interrupt is received for each scancode,
	   and allows an IR scancode to be used as a wake event.

config IR_IMG_NEC
	bool "NEC protocol support"
	depends on IR_IMG_HW
	help
	   Say Y here to enable support for the NEC, extended NEC, and 32-bit
	   NEC protocols in the ImgTec infrared decoder block.

config IR_IMG_JVC
	bool "JVC protocol support"
	depends on IR_IMG_HW
	help
	   Say Y here to enable support for the JVC protocol in the ImgTec
	   infrared decoder block.

config IR_IMG_SONY
	bool "Sony protocol support"
	depends on IR_IMG_HW
	help
	   Say Y here to enable support for the Sony protocol in the ImgTec
	   infrared decoder block.

config IR_IMG_SHARP
	bool "Sharp protocol support"
	depends on IR_IMG_HW
	help
	   Say Y here to enable support for the Sharp protocol in the ImgTec
	   infrared decoder block.

config IR_IMG_SANYO
	bool "Sanyo protocol support"
	depends on IR_IMG_HW
	help
	   Say Y here to enable support for the Sanyo protocol (used by Sanyo,
	   Aiwa, Chinon remotes) in the ImgTec infrared decoder block.

config IR_IMG_RC5
	bool "Philips RC5 protocol support"
	depends on IR_IMG_HW
	help
	   Say Y here to enable support for the RC5 protocol in the ImgTec
	   infrared decoder block.

config IR_IMG_RC6
	bool "Philips RC6 protocol support"
	depends on IR_IMG_HW
	help
	   Say Y here to enable support for the RC6 protocol in the ImgTec
	   infrared decoder block.
	   Note: This version only supports mode 0.
```

## drivers/media/spi/Kconfig
```kconfig
# SPDX-License-Identifier: GPL-2.0-only
if VIDEO_V4L2

comment "SPI I2C drivers auto-selected by 'Autoselect ancillary drivers'"
	depends on MEDIA_HIDE_ANCILLARY_SUBDRV && SPI

menu "SPI helper chips"
	visible if !MEDIA_HIDE_ANCILLARY_SUBDRV

config VIDEO_GS1662
	tristate "Gennum Serializers video"
	depends on SPI && VIDEO_V4L2
	select MEDIA_CONTROLLER
	select VIDEO_V4L2_SUBDEV_API
	help
	  Enable the GS1662 driver which serializes video streams.

config VIDEO_ROCKCHIP_PREISP
	tristate "Rockchip Image Signal Pre-processing driver"
	depends on VIDEO_V4L2 && VIDEO_V4L2_SUBDEV_API && SPI_MASTER
	depends on ARCH_ROCKCHIP || COMPILE_TEST
	select V4L2_FWNODE
	default n
	help
	  Support for Pre-isp on the rockchip SoC.

endmenu

endif

if SPI
menu "Media SPI Adapters"

config CXD2880_SPI_DRV
	tristate "Sony CXD2880 SPI support"
	depends on DVB_CORE && SPI
	default m if !MEDIA_SUBDRV_AUTOSELECT
	help
	  Choose if you would like to have SPI interface support for Sony CXD2880.

endmenu

endif
```

## drivers/media/test-drivers/Kconfig
```kconfig
# SPDX-License-Identifier: GPL-2.0-only

menuconfig V4L_TEST_DRIVERS
	bool "V4L test drivers"
	depends on VIDEO_DEV

if V4L_TEST_DRIVERS

config VIDEO_VIM2M
	tristate "Virtual Memory-to-Memory Driver"
	depends on VIDEO_DEV
	select VIDEOBUF2_VMALLOC
	select V4L2_MEM2MEM_DEV
	select MEDIA_CONTROLLER
	help
	  This is a virtual test device for the memory-to-memory driver
	  framework.

source "drivers/media/test-drivers/vicodec/Kconfig"
source "drivers/media/test-drivers/vimc/Kconfig"
source "drivers/media/test-drivers/vivid/Kconfig"
source "drivers/media/test-drivers/visl/Kconfig"

endif #V4L_TEST_DRIVERS

menuconfig DVB_TEST_DRIVERS
	bool "DVB test drivers"
	depends on DVB_CORE && MEDIA_SUPPORT && I2C
	help
	  Enables DVB test drivers.

	  This enables the DVB test drivers. They are meant as an aid for
	  DVB device driver writers and developers working on userspace
	  media applications.

if DVB_TEST_DRIVERS

source "drivers/media/test-drivers/vidtv/Kconfig"

endif #DVB_TEST_DRIVERS
```

## drivers/media/test-drivers/vicodec/Kconfig
```kconfig
# SPDX-License-Identifier: GPL-2.0-only
config VIDEO_VICODEC
	tristate "Virtual Codec Driver"
	depends on VIDEO_DEV
	select VIDEOBUF2_VMALLOC
	select V4L2_MEM2MEM_DEV
	select MEDIA_CONTROLLER
	select MEDIA_CONTROLLER_REQUEST_API
	help
	  Driver for a Virtual Codec

	  This driver can be compared to the vim2m driver for emulating
	  a video device node that exposes an emulated hardware codec.

	  When in doubt, say N.
```

## drivers/media/test-drivers/vidtv/Kconfig
```kconfig
# SPDX-License-Identifier: GPL-2.0-only
config DVB_VIDTV
	tristate "Virtual DVB Driver (vidtv)"
	depends on DVB_CORE && MEDIA_SUPPORT && I2C
	help
	  The virtual DVB test driver serves as a reference DVB driver and helps
	  validate the existing APIs in the media subsystem. It can also aid developers
	  working on userspace applications.


	  When in doubt, say N.
```

## drivers/media/test-drivers/visl/Kconfig
```kconfig
# SPDX-License-Identifier: GPL-2.0+
config VIDEO_VISL
	tristate "Virtual Stateless Decoder Driver (visl)"
	depends on VIDEO_DEV
	select FONT_SUPPORT
	select FONT_8x16
	select VIDEOBUF2_VMALLOC
	select V4L2_MEM2MEM_DEV
	select MEDIA_CONTROLLER
	select MEDIA_CONTROLLER_REQUEST_API
	select VIDEO_V4L2_TPG
	help

	  A virtual stateless decoder device for uAPI development purposes.

	  A userspace implementation can use visl to run a decoding loop even
	  when no hardware is available or when the kernel uAPI for the codec
	  has not been upstreamed yet. This can reveal bugs at an early stage.

	  When in doubt, say N.

config VISL_DEBUGFS
	bool "Enable debugfs for visl"
	depends on VIDEO_VISL
	depends on DEBUG_FS

	help
	  Choose Y to dump the bitstream buffers through debugfs.
	  When in doubt, say N.
```

## drivers/media/test-drivers/vivid/Kconfig
```kconfig
# SPDX-License-Identifier: GPL-2.0-only
config VIDEO_VIVID
	tristate "Virtual Video Test Driver"
	depends on VIDEO_DEV && !SPARC32 && !SPARC64
	depends on HAS_DMA
	select FONT_SUPPORT
	select FONT_8x16
	select VIDEOBUF2_VMALLOC
	select VIDEOBUF2_DMA_CONTIG
	select VIDEO_V4L2_TPG
	select MEDIA_CONTROLLER
	help
	  Enables a virtual video driver. This driver emulates a webcam,
	  TV, S-Video and HDMI capture hardware, including VBI support for
	  the SDTV inputs. Also video output, VBI output, radio receivers,
	  transmitters and software defined radio capture is emulated.

	  It is highly configurable and is ideal for testing applications.
	  Error injection is supported to test rare errors that are hard
	  to reproduce in real hardware.

	  Say Y here if you want to test video apps or debug V4L devices.
	  When in doubt, say N.

config VIDEO_VIVID_CEC
	bool "Enable CEC emulation support"
	depends on VIDEO_VIVID
	select CEC_CORE
	help
	  When selected the vivid module will emulate the optional
	  HDMI CEC feature.

config VIDEO_VIVID_OSD
	bool "Enable Framebuffer for testing Output Overlay"
	depends on VIDEO_VIVID && FB
	default y
	select FB_IOMEM_HELPERS
	help
	  When selected the vivid module will emulate a Framebuffer for
	  testing Output Overlay.

config VIDEO_VIVID_MAX_DEVS
	int "Maximum number of devices"
	depends on VIDEO_VIVID
	default "64"
	help
	  This allows you to specify the maximum number of devices supported
	  by the vivid driver.
```

## drivers/media/tuners/Kconfig
```kconfig
config MEDIA_ATTACH
	bool "Load and attach frontend and tuner driver modules as needed"
	depends on MEDIA_ANALOG_TV_SUPPORT || MEDIA_DIGITAL_TV_SUPPORT || MEDIA_RADIO_SUPPORT
	depends on MODULES
	default y if !EXPERT
	help
	  Remove the static dependency of DVB card drivers on all
	  frontend modules for all possible card variants. Instead,
	  allow the card drivers to only load the frontend modules
	  they require.

	  Also, tuner module will automatically load a tuner driver
	  when needed, for analog mode.

	  This saves several KBytes of memory.

	  Note: You will need module-init-tools v3.2 or later for this feature.

	  If unsure say Y.

# Analog TV tuners, auto-loaded via tuner.ko
config MEDIA_TUNER
	tristate
	depends on (MEDIA_ANALOG_TV_SUPPORT || MEDIA_RADIO_SUPPORT) && I2C
	default y
	select MEDIA_TUNER_XC2028 if MEDIA_SUBDRV_AUTOSELECT
	select MEDIA_TUNER_XC5000 if MEDIA_SUBDRV_AUTOSELECT
	select MEDIA_TUNER_XC4000 if MEDIA_SUBDRV_AUTOSELECT
	select MEDIA_TUNER_MT20XX if MEDIA_SUBDRV_AUTOSELECT
	select MEDIA_TUNER_TDA8290 if MEDIA_SUBDRV_AUTOSELECT
	select MEDIA_TUNER_TEA5761 if MEDIA_SUBDRV_AUTOSELECT && MEDIA_RADIO_SUPPORT && EXPERIMENTAL
	select MEDIA_TUNER_TEA5767 if MEDIA_SUBDRV_AUTOSELECT && MEDIA_RADIO_SUPPORT
	select MEDIA_TUNER_SIMPLE if MEDIA_SUBDRV_AUTOSELECT
	select MEDIA_TUNER_TDA9887 if MEDIA_SUBDRV_AUTOSELECT
	select MEDIA_TUNER_MC44S803 if MEDIA_SUBDRV_AUTOSELECT

menu "Customize TV tuners"
	visible if !MEDIA_SUBDRV_AUTOSELECT
	depends on MEDIA_ANALOG_TV_SUPPORT || MEDIA_DIGITAL_TV_SUPPORT || MEDIA_RADIO_SUPPORT

config MEDIA_TUNER_SIMPLE
	tristate "Simple tuner support"
	depends on MEDIA_SUPPORT && I2C
	select MEDIA_TUNER_TDA9887
	default m if !MEDIA_SUBDRV_AUTOSELECT
	help
	  Say Y here to include support for various simple tuners.

config MEDIA_TUNER_TDA8290
	tristate "TDA 8290/8295 + 8275(a)/18271 tuner combo"
	depends on MEDIA_SUPPORT && I2C
	select MEDIA_TUNER_TDA827X
	select MEDIA_TUNER_TDA18271
	default m if !MEDIA_SUBDRV_AUTOSELECT
	help
	  Say Y here to include support for Philips TDA8290+8275(a) tuner.

config MEDIA_TUNER_TDA827X
	tristate "Philips TDA827X silicon tuner"
	depends on MEDIA_SUPPORT && I2C
	default m if !MEDIA_SUBDRV_AUTOSELECT
	help
	  A DVB-T silicon tuner module. Say Y when you want to support this tuner.

config MEDIA_TUNER_TDA18271
	tristate "NXP TDA18271 silicon tuner"
	depends on MEDIA_SUPPORT && I2C
	default m if !MEDIA_SUBDRV_AUTOSELECT
	help
	  A silicon tuner module. Say Y when you want to support this tuner.

config MEDIA_TUNER_TDA9887
	tristate "TDA 9885/6/7 analog IF demodulator"
	depends on MEDIA_SUPPORT && I2C
	default m if !MEDIA_SUBDRV_AUTOSELECT
	help
	  Say Y here to include support for Philips TDA9885/6/7
	  analog IF demodulator.

config MEDIA_TUNER_TEA5761
	tristate "TEA 5761 radio tuner (EXPERIMENTAL)"
	depends on MEDIA_SUPPORT && I2C
	depends on EXPERIMENTAL
	default m if !MEDIA_SUBDRV_AUTOSELECT
	help
	  Say Y here to include support for the Philips TEA5761 radio tuner.

config MEDIA_TUNER_TEA5767
	tristate "TEA 5767 radio tuner"
	depends on MEDIA_SUPPORT && I2C
	default m if !MEDIA_SUBDRV_AUTOSELECT
	help
	  Say Y here to include support for the Philips TEA5767 radio tuner.

config MEDIA_TUNER_MT20XX
	tristate "Microtune 2032 / 2050 tuners"
	depends on MEDIA_SUPPORT && I2C
	default m if !MEDIA_SUBDRV_AUTOSELECT
	help
	  Say Y here to include support for the MT2032 / MT2050 tuner.

config MEDIA_TUNER_MT2060
	tristate "Microtune MT2060 silicon IF tuner"
	depends on MEDIA_SUPPORT && I2C
	default m if !MEDIA_SUBDRV_AUTOSELECT
	help
	  A driver for the silicon IF tuner MT2060 from Microtune.

config MEDIA_TUNER_MT2063
	tristate "Microtune MT2063 silicon IF tuner"
	depends on MEDIA_SUPPORT && I2C
	default m if !MEDIA_SUBDRV_AUTOSELECT
	help
	  A driver for the silicon IF tuner MT2063 from Microtune.

config MEDIA_TUNER_MT2266
	tristate "Microtune MT2266 silicon tuner"
	depends on MEDIA_SUPPORT && I2C
	default m if !MEDIA_SUBDRV_AUTOSELECT
	help
	  A driver for the silicon baseband tuner MT2266 from Microtune.

config MEDIA_TUNER_MT2131
	tristate "Microtune MT2131 silicon tuner"
	depends on MEDIA_SUPPORT && I2C
	default m if !MEDIA_SUBDRV_AUTOSELECT
	help
	  A driver for the silicon baseband tuner MT2131 from Microtune.

config MEDIA_TUNER_QT1010
	tristate "Quantek QT1010 silicon tuner"
	depends on MEDIA_SUPPORT && I2C
	default m if !MEDIA_SUBDRV_AUTOSELECT
	help
	  A driver for the silicon tuner QT1010 from Quantek.

config MEDIA_TUNER_XC2028
	tristate "XCeive xc2028/xc3028 tuners"
	depends on MEDIA_SUPPORT && I2C
	default m if !MEDIA_SUBDRV_AUTOSELECT
	help
	  Say Y here to include support for the xc2028/xc3028 tuners.

config MEDIA_TUNER_XC5000
	tristate "Xceive XC5000 silicon tuner"
	depends on MEDIA_SUPPORT && I2C
	default m if !MEDIA_SUBDRV_AUTOSELECT
	help
	  A driver for the silicon tuner XC5000 from Xceive.
	  This device is only used inside a SiP called together with a
	  demodulator for now.

config MEDIA_TUNER_XC4000
	tristate "Xceive XC4000 silicon tuner"
	depends on MEDIA_SUPPORT && I2C
	default m if !MEDIA_SUBDRV_AUTOSELECT
	help
	  A driver for the silicon tuner XC4000 from Xceive.
	  This device is only used inside a SiP called together with a
	  demodulator for now.

config MEDIA_TUNER_MXL5005S
	tristate "MaxLinear MSL5005S silicon tuner"
	depends on MEDIA_SUPPORT && I2C
	default m if !MEDIA_SUBDRV_AUTOSELECT
	help
	  A driver for the silicon tuner MXL5005S from MaxLinear.

config MEDIA_TUNER_MXL5007T
	tristate "MaxLinear MxL5007T silicon tuner"
	depends on MEDIA_SUPPORT && I2C
	default m if !MEDIA_SUBDRV_AUTOSELECT
	help
	  A driver for the silicon tuner MxL5007T from MaxLinear.

config MEDIA_TUNER_MC44S803
	tristate "Freescale MC44S803 Low Power CMOS Broadband tuners"
	depends on MEDIA_SUPPORT && I2C
	default m if !MEDIA_SUBDRV_AUTOSELECT
	help
	  Say Y here to support the Freescale MC44S803 based tuners

config MEDIA_TUNER_MAX2165
	tristate "Maxim MAX2165 silicon tuner"
	depends on MEDIA_SUPPORT && I2C
	default m if !MEDIA_SUBDRV_AUTOSELECT
	help
	  A driver for the silicon tuner MAX2165 from Maxim.

config MEDIA_TUNER_TDA18218
	tristate "NXP TDA18218 silicon tuner"
	depends on MEDIA_SUPPORT && I2C
	default m if !MEDIA_SUBDRV_AUTOSELECT
	help
	  NXP TDA18218 silicon tuner driver.

config MEDIA_TUNER_FC0011
	tristate "Fitipower FC0011 silicon tuner"
	depends on MEDIA_SUPPORT && I2C
	default m if !MEDIA_SUBDRV_AUTOSELECT
	help
	  Fitipower FC0011 silicon tuner driver.

config MEDIA_TUNER_FC0012
	tristate "Fitipower FC0012 silicon tuner"
	depends on MEDIA_SUPPORT && I2C
	default m if !MEDIA_SUBDRV_AUTOSELECT
	help
	  Fitipower FC0012 silicon tuner driver.

config MEDIA_TUNER_FC0013
	tristate "Fitipower FC0013 silicon tuner"
	depends on MEDIA_SUPPORT && I2C
	default m if !MEDIA_SUBDRV_AUTOSELECT
	help
	  Fitipower FC0013 silicon tuner driver.

config MEDIA_TUNER_TDA18212
	tristate "NXP TDA18212 silicon tuner"
	depends on MEDIA_SUPPORT && I2C
	default m if !MEDIA_SUBDRV_AUTOSELECT
	help
	  NXP TDA18212 silicon tuner driver.

config MEDIA_TUNER_E4000
	tristate "Elonics E4000 silicon tuner"
	depends on MEDIA_SUPPORT && I2C
	default m if !MEDIA_SUBDRV_AUTOSELECT
	help
	  Elonics E4000 silicon tuner driver.

config MEDIA_TUNER_TUA9001
	tristate "Infineon TUA 9001 silicon tuner"
	depends on MEDIA_SUPPORT && I2C
	default m if !MEDIA_SUBDRV_AUTOSELECT
	help
	  Infineon TUA 9001 silicon tuner driver.
endmenu
```
