## drivers/media/platform/qcom/Kconfig
```kconfig
# SPDX-License-Identifier: GPL-2.0-only

comment "Qualcomm media platform drivers"

source "drivers/media/platform/qcom/camss/Kconfig"
source "drivers/media/platform/qcom/venus/Kconfig"
```

## drivers/media/platform/qcom/camss/Kconfig
```kconfig
config VIDEO_QCOM_CAMSS
	tristate "Qualcomm V4L2 Camera Subsystem driver"
	depends on V4L_PLATFORM_DRIVERS
	depends on VIDEO_DEV
	depends on (ARCH_QCOM && IOMMU_DMA) || COMPILE_TEST
	select MEDIA_CONTROLLER
	select VIDEO_V4L2_SUBDEV_API
	select VIDEOBUF2_DMA_SG
	select V4L2_FWNODE
```

## drivers/media/platform/qcom/iris/Kconfig
```kconfig
config VIDEO_QCOM_IRIS
        tristate "Qualcomm iris V4L2 decoder driver"
        depends on VIDEO_DEV
        depends on ARCH_QCOM || COMPILE_TEST
        select V4L2_MEM2MEM_DEV
        select QCOM_MDT_LOADER if ARCH_QCOM
        select QCOM_SCM
        select VIDEOBUF2_DMA_CONTIG
        help
          This is a V4L2 driver for Qualcomm iris video accelerator
          hardware. It accelerates decoding operations on various
          Qualcomm SoCs.
          To compile this driver as a module choose m here.
```

## drivers/media/platform/qcom/venus/Kconfig
```kconfig
config VIDEO_QCOM_VENUS
	tristate "Qualcomm Venus V4L2 encoder/decoder driver"
	depends on V4L_MEM2MEM_DRIVERS
	depends on VIDEO_DEV && QCOM_SMEM
	depends on (ARCH_QCOM && ARM64 && IOMMU_API) || COMPILE_TEST
	select OF_DYNAMIC if ARCH_QCOM
	select QCOM_MDT_LOADER if ARCH_QCOM
	select QCOM_SCM
	select VIDEOBUF2_DMA_CONTIG
	select V4L2_MEM2MEM_DEV
	help
	  This is a V4L2 driver for Qualcomm Venus video accelerator
	  hardware. It accelerates encoding and decoding operations
	  on various Qualcomm SoCs.
	  To compile this driver as a module choose m here.
```

## drivers/media/platform/raspberrypi/Kconfig
```kconfig
# SPDX-License-Identifier: GPL-2.0-only

comment "Raspberry Pi media platform drivers"

source "drivers/media/platform/raspberrypi/pisp_be/Kconfig"
source "drivers/media/platform/raspberrypi/rp1-cfe/Kconfig"
```

## drivers/media/platform/raspberrypi/pisp_be/Kconfig
```kconfig
config VIDEO_RASPBERRYPI_PISP_BE
	tristate "Raspberry Pi PiSP Backend (BE) ISP driver"
	depends on V4L_PLATFORM_DRIVERS
	depends on VIDEO_DEV
	depends on ARCH_BCM2835 || COMPILE_TEST
	depends on PM
	select VIDEO_V4L2_SUBDEV_API
	select MEDIA_CONTROLLER
	select VIDEOBUF2_DMA_CONTIG
	help
	  Say Y here to enable support for the PiSP Backend (BE) ISP driver.

	  To compile this driver as a module, choose M here. The module will be
	  called pisp-be.
```

## drivers/media/platform/raspberrypi/rp1-cfe/Kconfig
```kconfig
# RP1 V4L2 camera support

config VIDEO_RP1_CFE
	tristate "Raspberry Pi RP1 Camera Front End (CFE) video capture driver"
	depends on VIDEO_DEV
	depends on PM
	select VIDEO_V4L2_SUBDEV_API
	select MEDIA_CONTROLLER
	select VIDEOBUF2_DMA_CONTIG
	select V4L2_FWNODE
	help
	  Say Y here to enable support for the Raspberry Pi RP1 Camera Front End.

	  To compile this driver as a module, choose M here. The module will be
	  called rp1-cfe.
```
