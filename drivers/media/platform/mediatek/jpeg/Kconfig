## drivers/media/platform/mediatek/jpeg/Kconfig
```kconfig
# SPDX-License-Identifier: GPL-2.0-only
config VIDEO_MEDIATEK_JPEG
	tristate "Mediatek JPEG Codec driver"
	depends on V4L_MEM2MEM_DRIVERS
	depends on MTK_IOMMU_V1 || MTK_IOMMU || COMPILE_TEST
	depends on VIDEO_DEV
	depends on ARCH_MEDIATEK || COMPILE_TEST
	depends on MTK_SMI || (COMPILE_TEST && MTK_SMI=n)
	select VIDEOBUF2_DMA_CONTIG
	select V4L2_MEM2MEM_DEV
	help
	  Mediatek jpeg codec driver provides HW capability to decode
	  JPEG format

	  To compile this driver as a module, choose M here: the
	  module will be called mtk-jpeg
```

## drivers/media/platform/mediatek/mdp/Kconfig
```kconfig
# SPDX-License-Identifier: GPL-2.0-only
config VIDEO_MEDIATEK_MDP
	tristate "Mediatek MDP driver"
	depends on V4L_MEM2MEM_DRIVERS
	depends on MTK_IOMMU || COMPILE_TEST
	depends on VIDEO_DEV
	depends on ARCH_MEDIATEK || COMPILE_TEST
	depends on MTK_SMI || (COMPILE_TEST && MTK_SMI=n)
	select VIDEOBUF2_DMA_CONTIG
	select V4L2_MEM2MEM_DEV
	select VIDEO_MEDIATEK_VPU
	help
	    It is a v4l2 driver and present in Mediatek MT8173 SoCs.
	    The driver supports for scaling and color space conversion.

	    To compile this driver as a module, choose M here: the
	    module will be called mtk-mdp.
```

## drivers/media/platform/mediatek/mdp3/Kconfig
```kconfig
# SPDX-License-Identifier: GPL-2.0-only
config VIDEO_MEDIATEK_MDP3
	tristate "MediaTek MDP v3 driver"
	depends on MTK_IOMMU || COMPILE_TEST
	depends on VIDEO_DEV
	depends on HAS_DMA
	depends on REMOTEPROC
	depends on MTK_MMSYS
	depends on MTK_CMDQ
	depends on MTK_SCP
	select VIDEOBUF2_DMA_CONTIG
	select V4L2_MEM2MEM_DEV
	default n
	help
	    It is a v4l2 driver and present in MediaTek MT8183 SoC.
	    The driver supports scaling and color space conversion.

	    To compile this driver as a module, choose M here: the
	    module will be called mtk-mdp3.
```

## drivers/media/platform/mediatek/vcodec/Kconfig
```kconfig
# SPDX-License-Identifier: GPL-2.0-only
config VIDEO_MEDIATEK_VCODEC_SCP
	bool

config VIDEO_MEDIATEK_VCODEC_VPU
	bool

config VIDEO_MEDIATEK_VCODEC
	tristate "Mediatek Video Codec driver"
	depends on V4L_MEM2MEM_DRIVERS
	depends on MTK_IOMMU || COMPILE_TEST
	depends on VIDEO_DEV
	depends on ARCH_MEDIATEK || COMPILE_TEST
	depends on VIDEO_MEDIATEK_VPU || MTK_SCP
	# The two following lines ensure we have the same state ("m" or "y") as
	# our dependencies, to avoid missing symbols during link.
	depends on VIDEO_MEDIATEK_VPU || !VIDEO_MEDIATEK_VPU
	depends on MTK_SCP || !MTK_SCP
	depends on MTK_SMI || (COMPILE_TEST && MTK_SMI=n)
	select VIDEOBUF2_DMA_CONTIG
	select V4L2_MEM2MEM_DEV
	select VIDEO_MEDIATEK_VCODEC_VPU if VIDEO_MEDIATEK_VPU
	select VIDEO_MEDIATEK_VCODEC_SCP if MTK_SCP
	select V4L2_H264
	select MEDIA_CONTROLLER
	select MEDIA_CONTROLLER_REQUEST_API
	help
	  Mediatek video codec driver provides HW capability to
	  encode and decode in a range of video formats on MT8173
	  and MT8183.

	  Note that support for MT8173 requires VIDEO_MEDIATEK_VPU to
	  also be selected. Support for MT8183 depends on MTK_SCP.

	  To compile this driver as modules, choose M here: the
	  modules will be called mtk-vcodec-dec and mtk-vcodec-enc.
```

## drivers/media/platform/mediatek/vpu/Kconfig
```kconfig
# SPDX-License-Identifier: GPL-2.0-only

config VIDEO_MEDIATEK_VPU
	tristate "Mediatek Video Processor Unit"
	depends on V4L_MEM2MEM_DRIVERS
	depends on VIDEO_DEV
	depends on ARCH_MEDIATEK || COMPILE_TEST
	help
	    This driver provides downloading VPU firmware and
	    communicating with VPU. This driver for hw video
	    codec embedded in Mediatek's MT8173 SOCs. It is able
	    to handle video decoding/encoding in a range of formats.

	    To compile this driver as a module, choose M here: the
	    module will be called mtk-vpu.
```

## drivers/media/platform/microchip/Kconfig
```kconfig
# SPDX-License-Identifier: GPL-2.0-only

comment "Microchip Technology, Inc. media platform drivers"

config VIDEO_MICROCHIP_ISC
	tristate "Microchip Image Sensor Controller (ISC) support"
	depends on V4L_PLATFORM_DRIVERS
	depends on VIDEO_DEV && COMMON_CLK
	depends on ARCH_AT91 || COMPILE_TEST
	select MEDIA_CONTROLLER
	select VIDEO_V4L2_SUBDEV_API
	select VIDEOBUF2_DMA_CONTIG
	select REGMAP_MMIO
	select V4L2_FWNODE
	select VIDEO_MICROCHIP_ISC_BASE
	help
	   This module makes the Microchip Image Sensor Controller available
	   as a v4l2 device.

	   To compile this driver as a module, choose M here: the
	   module will be called microchip-isc.

config VIDEO_MICROCHIP_XISC
	tristate "Microchip eXtended Image Sensor Controller (XISC) support"
	depends on V4L_PLATFORM_DRIVERS
	depends on VIDEO_DEV && COMMON_CLK
	depends on ARCH_AT91 || COMPILE_TEST
	select VIDEOBUF2_DMA_CONTIG
	select REGMAP_MMIO
	select V4L2_FWNODE
	select VIDEO_MICROCHIP_ISC_BASE
	select MEDIA_CONTROLLER
	select VIDEO_V4L2_SUBDEV_API
	help
	   This module makes the Microchip eXtended Image Sensor Controller
	   available as a v4l2 device.

	   To compile this driver as a module, choose M here: the
	   module will be called microchip-xisc.

config VIDEO_MICROCHIP_ISC_BASE
	tristate
	default n
	help
	  Microchip ISC and XISC common code base.

config VIDEO_MICROCHIP_CSI2DC
	tristate "Microchip CSI2 Demux Controller"
	depends on V4L_PLATFORM_DRIVERS
	depends on VIDEO_DEV && COMMON_CLK && OF
	depends on ARCH_AT91 || COMPILE_TEST
	select MEDIA_CONTROLLER
	select VIDEO_V4L2_SUBDEV_API
	select V4L2_FWNODE
	help
	  CSI2 Demux Controller driver. CSI2DC is a helper chip
	  that converts IDI interface byte stream to a parallel pixel stream.
	  It supports various RAW formats as input.

	  To compile this driver as a module, choose M here: the
	  module will be called microchip-csi2dc.
```

## drivers/media/platform/msm/Kconfig
```kconfig
# SPDX-License-Identifier: GPL-2.0-only

source "drivers/media/platform/msm/npu/Kconfig"
```

## drivers/media/platform/msm/npu/Kconfig
```kconfig
# SPDX-License-Identifier: GPL-2.0-only
config VIRTIO_NPU
	tristate "Virtio MSM Neural Processing Unit support"
	depends on VIRTIO
	help
	  This is the virtual frontend driver for Neural Processing Unit
	  which provides acceleration for neural network processing.
	  This driver is based on virtio.
	  Say Y if you want to support virtual NPU.

config MSM_NPU
	tristate "QTI MSM Neural Processing Unit support"
	depends on ARCH_QCOM
	help
	  Enable support for Neural Processing Unit
	  for specific QTI chipsets.
	  This module serves as the common driver
	  for npu which provides acceleration for neural
	  network processing.
```

## drivers/media/platform/mxc/capture/Kconfig
```kconfig
if VIDEO_MXC_CAPTURE
config VIDEO_V4L2_MXC_INT_DEVICE
       tristate

menu "MXC Camera/V4L2 PRP Features support"
config VIDEO_MXC_IPU_CAMERA
	bool
	select VIDEO_V4L2_MXC_INT_DEVICE
	depends on VIDEO_MXC_CAPTURE && MXC_IPU
	default y

config MXC_CAMERA_OV5640
        tristate "OmniVision ov5640 camera support"
        depends on !VIDEO_MXC_EMMA_CAMERA && I2C
        ---help---
          If you plan to use the ov5640 Camera with your MXC system, say Y here.

config MXC_CAMERA_OV5642
	tristate "OmniVision ov5642 camera support"
	depends on !VIDEO_MXC_EMMA_CAMERA && I2C
	---help---
	  If you plan to use the ov5642 Camera with your MXC system, say Y here.

config MXC_CAMERA_OV5640_MIPI
	tristate "OmniVision ov5640 camera support using mipi"
	depends on !VIDEO_MXC_EMMA_CAMERA && I2C
	---help---
	  If you plan to use the ov5640 Camera with mipi interface in your MXC system, say Y here.

config MXC_TVIN_ADV7180
	tristate "Analog Device adv7180 TV Decoder Input support"
	depends on !VIDEO_MXC_EMMA_CAMERA && I2C
	---help---
	  If you plan to use the adv7180 video decoder with your MXC system, say Y here.

choice
	prompt "Select Overlay Rounting"
	default MXC_IPU_DEVICE_QUEUE_SDC
	depends on VIDEO_MXC_IPU_CAMERA && FB_MXC_SYNC_PANEL

config MXC_IPU_DEVICE_QUEUE_SDC
	tristate "Queue ipu device for overlay library"
	depends on VIDEO_MXC_IPU_CAMERA
	---help---
	  Use case CSI->MEM->IPU DEVICE->SDC:
		Images from sensor will be frist recieved in memory,then
		queue to ipu device for processing if needed, and displaying
		it on synchronous display with SDC use case.

config MXC_IPU_PRP_VF_SDC
	bool "Pre-Processor VF SDC library"
	depends on VIDEO_MXC_IPU_CAMERA
	---help---
	  Use case PRP_VF_SDC:
		Preprocessing image from smart sensor for viewfinder and
		displaying it on synchronous display with SDC use case.
		If SDC BG is selected, Rotation will not be supported.
		CSI -> IC (PRP VF) -> MEM
		MEM -> IC (ROT) -> MEM
		MEM -> SDC (FG/BG)

endchoice

config MXC_IPU_PRP_ENC
	tristate "Pre-processor Encoder library"
	depends on VIDEO_MXC_IPU_CAMERA
	default y
	---help---
	  Use case PRP_ENC:
		Preprocessing image from smart sensor for encoder.
		CSI -> IC (PRP ENC) -> MEM

config MXC_IPU_CSI_ENC
	tristate "IPU CSI Encoder library"
	depends on VIDEO_MXC_IPU_CAMERA
	default y
	---help---
	  Use case IPU_CSI_ENC:
		Get raw image with CSI from smart sensor for encoder.
		CSI -> MEM
endmenu

endif
```

## drivers/media/platform/mxc/output/Kconfig
```kconfig
config VIDEO_MXC_IPU_OUTPUT
	tristate "IPU v4l2 output support"
	depends on VIDEO_MXC_OUTPUT && MXC_IPU
	---help---
	This is the video4linux2 driver for IPU post processing video output.

config VIDEO_MXC_PXP_V4L2
        tristate "MXC PxP V4L2 driver"
        depends on VIDEO_DEV && VIDEO_V4L2
        select VIDEOBUF_DMA_CONTIG
        ---help---
          This is a video4linux driver for the Freescale PxP
          (Pixel Pipeline). This module supports output overlay of
          the MXC framebuffer on a video stream.

          To compile this driver as a module, choose M here.
```

## drivers/media/platform/mxc/subdev/Kconfig
```kconfig
if VIDEO_MXC_CAPTURE

config VIDEO_MXC_CSI_CAMERA
	tristate "CSI camera support"
	depends on VIDEO_MXC_CAPTURE && VIDEO_V4L2
	---help---
	  This is the video4linux2 capture driver based on CSI module.

config MXC_CAMERA_OV5640
        tristate "OmniVision ov5640 camera support"
        depends on VIDEO_MXC_CAPTURE && I2C
        ---help---
          If you plan to use the ov5640 Camera with your MXC system, say Y here.

config MXC_VADC
	tristate "mxc VADC support"
	depends on VIDEO_MXC_CAPTURE && VIDEO_V4L2
	---help---
		If you plan to use the VADC with your MXC system, say Y here.

config MXC_MIPI_CSI
	tristate "mxc mipi csi driver"
	depends on VIDEO_MXC_CAPTURE && VIDEO_V4L2
	---help---
	  This is a V4L2 driver for i.MX7D SoC MIPI-CSI2 receiver devices.

config MXC_CAMERA_OV5640_MIPI
	tristate "OmniVision ov5640 camera support using mipi"
	depends on MXC_MIPI_CSI && I2C
	---help---
	  If you plan to use the ov5640 Camera with mipi interface in your MXC system, say Y here.

config MXC_CAMERA_OV5647_MIPI
	tristate "OmniVision ov5647 camera support using mipi"
	depends on MXC_MIPI_CSI && I2C
	---help---
	  If you plan to use the ov5647 Camera with mipi interface in your MXC system, say Y here.
endif
```

## drivers/media/platform/nuvoton/Kconfig
```kconfig
# SPDX-License-Identifier: GPL-2.0-only

comment "Nuvoton media platform drivers"

config VIDEO_NPCM_VCD_ECE
	tristate "Nuvoton NPCM Video Capture/Encode Engine driver"
	depends on V4L_PLATFORM_DRIVERS && VIDEO_DEV
	depends on ARCH_NPCM || COMPILE_TEST
	select VIDEOBUF2_DMA_CONTIG
	help
	  Support for the Video Capture/Differentiation Engine (VCD) and
	  Encoding Compression Engine (ECE) present on Nuvoton NPCM SoCs.
	  The VCD can capture a frame from digital video input and compare
	  two frames in memory, and then the ECE can compress the frame
	  data into HEXTILE format.
```

## drivers/media/platform/nvidia/Kconfig
```kconfig
# SPDX-License-Identifier: GPL-2.0-only

comment "NVidia media platform drivers"

source "drivers/media/platform/nvidia/tegra-vde/Kconfig"
```

## drivers/media/platform/nvidia/tegra-vde/Kconfig
```kconfig
config VIDEO_TEGRA_VDE
	tristate "NVIDIA Tegra Video Decoder Engine driver"
	depends on V4L_MEM2MEM_DRIVERS
	depends on ARCH_TEGRA || COMPILE_TEST
	depends on VIDEO_DEV
	select DMA_SHARED_BUFFER
	select IOMMU_IOVA
	select MEDIA_CONTROLLER
	select SRAM
	select VIDEOBUF2_DMA_CONTIG
	select VIDEOBUF2_DMA_SG
	select V4L2_H264
	select V4L2_MEM2MEM_DEV
	help
	   Support for the NVIDIA Tegra video decoder unit.
	   To compile this driver as a module choose m here.
```

## drivers/media/platform/nxp/Kconfig
```kconfig
# SPDX-License-Identifier: GPL-2.0-only

# V4L drivers

comment "NXP media platform drivers"

config VIDEO_IMX7_CSI
	tristate "NXP CSI Bridge driver"
	depends on ARCH_MXC || COMPILE_TEST
	depends on HAS_DMA
	depends on VIDEO_DEV
	select MEDIA_CONTROLLER
	select V4L2_FWNODE
	select VIDEOBUF2_DMA_CONTIG
	select VIDEO_V4L2_SUBDEV_API
	help
	  Driver for the NXP Camera Sensor Interface (CSI) Bridge. This device
	  is found in the i.MX6UL/L, i.MX7 and i.MX8M[MQ] SoCs.

config VIDEO_IMX_MIPI_CSIS
	tristate "NXP MIPI CSI-2 CSIS receiver found on i.MX7 and i.MX8 models"
	depends on ARCH_MXC || COMPILE_TEST
	depends on VIDEO_DEV
	select MEDIA_CONTROLLER
	select V4L2_FWNODE
	select VIDEO_V4L2_SUBDEV_API
	help
	  Video4Linux2 sub-device driver for the MIPI CSI-2 CSIS receiver
	  v3.3/v3.6.3 found on some i.MX7 and i.MX8 SoCs.

# mem2mem drivers

config VIDEO_IMX_PXP
	tristate "NXP i.MX Pixel Pipeline (PXP)"
	depends on V4L_MEM2MEM_DRIVERS
	depends on VIDEO_DEV && (ARCH_MXC || COMPILE_TEST)
	select VIDEOBUF2_DMA_CONTIG
	select V4L2_MEM2MEM_DEV
	help
	  The i.MX Pixel Pipeline is a memory-to-memory engine for scaling,
	  color space conversion, and rotation.

config VIDEO_MX2_EMMAPRP
	tristate "NXP MX2 eMMa-PrP support"
	depends on V4L_MEM2MEM_DRIVERS
	depends on VIDEO_DEV
	depends on SOC_IMX27 || COMPILE_TEST
	select VIDEOBUF2_DMA_CONTIG
	select V4L2_MEM2MEM_DEV
	help
	    MX2X chips have a PrP that can be used to process buffers from
	    memory to memory. Operations include resizing and format
	    conversion.

source "drivers/media/platform/nxp/dw100/Kconfig"
source "drivers/media/platform/nxp/imx-jpeg/Kconfig"
```

## drivers/media/platform/nxp/dw100/Kconfig
```kconfig
# SPDX-License-Identifier: GPL-2.0-only

config VIDEO_DW100
	tristate "NXP i.MX DW100 dewarper"
	depends on V4L_MEM2MEM_DRIVERS
	depends on VIDEO_DEV
	depends on ARCH_MXC || COMPILE_TEST
	select MEDIA_CONTROLLER
	select V4L2_MEM2MEM_DEV
	select VIDEOBUF2_DMA_CONTIG
	help
	  DW100 is a memory-to-memory engine performing geometrical
	  transformation on source images through a programmable dewarping map.

	  To compile this driver as a module, choose M here: the module
	  will be called dw100.
```

## drivers/media/platform/nxp/imx8-isi/Kconfig
```kconfig
# SPDX-License-Identifier: GPL-2.0-only

config VIDEO_IMX8_ISI
	tristate "i.MX8 Image Sensor Interface (ISI) driver"
	depends on ARCH_MXC || COMPILE_TEST
	depends on HAS_DMA && PM
	depends on VIDEO_DEV
	select MEDIA_CONTROLLER
	select V4L2_FWNODE
	select V4L2_MEM2MEM_DEV if VIDEO_IMX8_ISI_M2M
	select VIDEO_V4L2_SUBDEV_API
	select VIDEOBUF2_DMA_CONTIG
	help
	  V4L2 driver for the Image Sensor Interface (ISI) found in various
	  i.MX8 SoCs.

config VIDEO_IMX8_ISI_M2M
	bool "i.MX8 Image Sensor Interface (ISI) memory-to-memory support"
	depends on VIDEO_IMX8_ISI
	help
	  Select 'yes' here to enable support for memory-to-memory processing
	  in the ISI driver.
```

## drivers/media/platform/omap/Kconfig
```kconfig
# SPDX-License-Identifier: GPL-2.0-only
config VIDEO_OMAP2_VOUT_VRFB
	bool
	default y
	depends on VIDEO_OMAP2_VOUT && (OMAP2_VRFB || COMPILE_TEST)

config VIDEO_OMAP2_VOUT
	tristate "OMAP2/OMAP3 V4L2-Display driver"
	depends on MMU
	depends on FB_OMAP2 || (COMPILE_TEST && FB_OMAP2=n)
	depends on ARCH_OMAP2 || ARCH_OMAP3 || COMPILE_TEST
	depends on VIDEO_V4L2
	select VIDEOBUF2_DMA_CONTIG
	select OMAP2_VRFB if ARCH_OMAP2 || ARCH_OMAP3
	help
	  V4L2 Display driver support for OMAP2/3 based boards.
```
