## drivers/media/platform/ti/davinci/Kconfig
```kconfig
# SPDX-License-Identifier: GPL-2.0-only
config VIDEO_DAVINCI_VPIF_DISPLAY
	tristate "TI DaVinci VPIF V4L2-Display driver"
	depends on V4L_PLATFORM_DRIVERS
	depends on VIDEO_DEV
	depends on ARCH_DAVINCI || COMPILE_TEST
	depends on I2C
	select VIDEOBUF2_DMA_CONTIG
	select VIDEO_ADV7343 if MEDIA_SUBDRV_AUTOSELECT
	select VIDEO_THS7303 if MEDIA_SUBDRV_AUTOSELECT
	help
	  Enables Davinci VPIF module used for display devices.
	  This module is used for display on TI DM6467/DA850/OMAPL138
	  SoCs.

	  To compile this driver as a module, choose M here. There will
	  be two modules called vpif.ko and vpif_display.ko

config VIDEO_DAVINCI_VPIF_CAPTURE
	tristate "TI DaVinci VPIF video capture driver"
	depends on V4L_PLATFORM_DRIVERS
	depends on VIDEO_DEV
	depends on ARCH_DAVINCI || COMPILE_TEST
	depends on I2C
	select VIDEOBUF2_DMA_CONTIG
	select V4L2_FWNODE
	help
	  Enables Davinci VPIF module used for capture devices.
	  This module is used for capture on TI DM6467/DA850/OMAPL138
	  SoCs.

	  To compile this driver as a module, choose M here. There will
	  be two modules called vpif.ko and vpif_capture.ko
```

## drivers/media/platform/ti/omap3isp/Kconfig
```kconfig
# SPDX-License-Identifier: GPL-2.0-only
config VIDEO_OMAP3
	tristate "OMAP 3 Camera support"
	depends on V4L_PLATFORM_DRIVERS
	depends on VIDEO_DEV && I2C
	depends on (ARCH_OMAP3 && OMAP_IOMMU) || COMPILE_TEST
	depends on COMMON_CLK && OF
	select ARM_DMA_USE_IOMMU if OMAP_IOMMU
	select MEDIA_CONTROLLER
	select VIDEO_V4L2_SUBDEV_API
	select VIDEOBUF2_DMA_CONTIG
	select MFD_SYSCON
	select V4L2_FWNODE
	help
	  Driver for an OMAP 3 camera controller.

config VIDEO_OMAP3_DEBUG
	bool "OMAP 3 Camera debug messages"
	depends on VIDEO_OMAP3
	help
	  Enable debug messages on OMAP 3 camera controller driver.
```

## drivers/media/platform/via/Kconfig
```kconfig
# SPDX-License-Identifier: GPL-2.0-only

comment "VIA media platform drivers"

config VIDEO_VIA_CAMERA
	tristate "VIAFB camera controller support"
	depends on V4L_PLATFORM_DRIVERS
	depends on FB_VIA && VIDEO_DEV
	select VIDEOBUF2_DMA_SG
	select VIDEO_OV7670
	help
	   Driver support for the integrated camera controller in VIA
	   Chrome9 chipsets.  Currently only tested on OLPC xo-1.5 systems
	   with ov7670 sensors.
```

## drivers/media/platform/vicodec/Kconfig
```kconfig
config VIDEO_VICODEC
	tristate "Virtual Codec Driver"
	depends on VIDEO_DEV && VIDEO_V4L2 && VIDEO_V4L2_SUBDEV_API
	select VIDEOBUF2_VMALLOC
	select V4L2_MEM2MEM_DEV
	default n
	help
	  Driver for a Virtual Codec

	  This driver can be compared to the vim2m driver for emulating
	  a video device node that exposes an emulated hardware codec.

	  When in doubt, say N.
```

## drivers/media/platform/vimc/Kconfig
```kconfig
config VIDEO_VIMC
	tristate "Virtual Media Controller Driver (VIMC)"
	depends on VIDEO_DEV && VIDEO_V4L2 && VIDEO_V4L2_SUBDEV_API
	select VIDEOBUF2_VMALLOC
	select VIDEO_V4L2_TPG
	default n
	---help---
	  Skeleton driver for Virtual Media Controller

	  This driver can be compared to the vivid driver for emulating
	  a media node that exposes a complex media topology. The topology
	  is hard coded for now but is meant to be highly configurable in
	  the future.

	  When in doubt, say N.
```
