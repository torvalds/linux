## drivers/media/platform/st/Kconfig
```kconfig
# SPDX-License-Identifier: GPL-2.0-only

source "drivers/media/platform/st/sti/Kconfig"
source "drivers/media/platform/st/stm32/Kconfig"
```

## drivers/media/platform/st/sti/Kconfig
```kconfig
# SPDX-License-Identifier: GPL-2.0-only
source "drivers/media/platform/st/sti/bdisp/Kconfig"
source "drivers/media/platform/st/sti/c8sectpfe/Kconfig"
source "drivers/media/platform/st/sti/delta/Kconfig"
source "drivers/media/platform/st/sti/hva/Kconfig"
```

## drivers/media/platform/st/sti/bdisp/Kconfig
```kconfig
# SPDX-License-Identifier: GPL-2.0-only
config VIDEO_STI_BDISP
	tristate "STMicroelectronics BDISP 2D blitter driver"
	depends on V4L_MEM2MEM_DRIVERS
	depends on VIDEO_DEV
	depends on ARCH_STI || COMPILE_TEST
	select VIDEOBUF2_DMA_CONTIG
	select V4L2_MEM2MEM_DEV
	help
	  This v4l2 mem2mem driver is a 2D blitter for STMicroelectronics SoC.
```

## drivers/media/platform/st/sti/delta/Kconfig
```kconfig
# SPDX-License-Identifier: GPL-2.0-only
config VIDEO_STI_DELTA
	tristate "STMicroelectronics DELTA multi-format video decoder V4L2 driver"
	depends on V4L_MEM2MEM_DRIVERS
	depends on VIDEO_DEV
	depends on ARCH_STI || COMPILE_TEST
	help
		This V4L2 driver enables DELTA multi-format video decoder
		of STMicroelectronics STiH4xx SoC series allowing hardware
		decoding of various compressed video bitstream format in
		raw uncompressed format.

		Use this option to see the decoders available for such
		hardware.

		Please notice that the driver will only be built if
		at least one of the DELTA decoder below is selected.

config VIDEO_STI_DELTA_MJPEG
	bool "STMicroelectronics DELTA MJPEG support"
	default y
	depends on VIDEO_STI_DELTA
	help
		Enables DELTA MJPEG hardware support.

		To compile this driver as a module, choose M here:
		the module will be called st-delta.

config VIDEO_STI_DELTA_DRIVER
	tristate
	depends on VIDEO_STI_DELTA
	depends on VIDEO_STI_DELTA_MJPEG
	default VIDEO_STI_DELTA_MJPEG
	select VIDEOBUF2_DMA_CONTIG
	select V4L2_MEM2MEM_DEV
	select RPMSG
```

## drivers/media/platform/st/sti/hva/Kconfig
```kconfig
# SPDX-License-Identifier: GPL-2.0-only
config VIDEO_STI_HVA
	tristate "STMicroelectronics HVA multi-format video encoder V4L2 driver"
	depends on V4L_MEM2MEM_DRIVERS
	depends on VIDEO_DEV
	depends on ARCH_STI || COMPILE_TEST
	select VIDEOBUF2_DMA_CONTIG
	select V4L2_MEM2MEM_DEV
	help
	  This V4L2 driver enables HVA (Hardware Video Accelerator) multi-format
	  video encoder of STMicroelectronics SoC, allowing hardware encoding of
	  raw uncompressed formats in various compressed video bitstreams format.

	  To compile this driver as a module, choose M here:
	  the module will be called st-hva.

config VIDEO_STI_HVA_DEBUGFS
	bool "Export STMicroelectronics HVA internals in debugfs"
	depends on VIDEO_STI_HVA
	depends on DEBUG_FS
	help
	  Select this to see information about the internal state and the last
	  operation of STMicroelectronics HVA multi-format video encoder in
	  debugfs.

	  Choose N unless you know you need this.
```

## drivers/media/platform/st/stm32/Kconfig
```kconfig
# SPDX-License-Identifier: GPL-2.0-only

# V4L drivers
config VIDEO_STM32_CSI
	tristate "STM32 Camera Serial Interface (CSI) support"
	depends on V4L_PLATFORM_DRIVERS
	depends on VIDEO_DEV && OF
	depends on ARCH_STM32 || COMPILE_TEST
	select MEDIA_CONTROLLER
	select V4L2_FWNODE
	help
	  This module makes the STM32 Camera Serial Interface (CSI)
	  available as a v4l2 device.

	  To compile this driver as a module, choose M here: the module
	  will be called stm32-csi.

config VIDEO_STM32_DCMI
	tristate "STM32 Digital Camera Memory Interface (DCMI) support"
	depends on V4L_PLATFORM_DRIVERS
	depends on VIDEO_DEV && OF
	depends on ARCH_STM32 || COMPILE_TEST
	select VIDEOBUF2_DMA_CONTIG
	select MEDIA_CONTROLLER
	select V4L2_FWNODE
	help
	  This module makes the STM32 Digital Camera Memory Interface (DCMI)
	  available as a v4l2 device.

	  To compile this driver as a module, choose M here: the module
	  will be called stm32-dcmi.

config VIDEO_STM32_DCMIPP
	tristate "STM32 Digital Camera Memory Interface Pixel Processor (DCMIPP) support"
	depends on V4L_PLATFORM_DRIVERS
	depends on VIDEO_DEV
	depends on ARCH_STM32 || COMPILE_TEST
	select MEDIA_CONTROLLER
	select VIDEOBUF2_DMA_CONTIG
	select VIDEO_V4L2_SUBDEV_API
	select V4L2_FWNODE
	help
	  This module makes the STM32 Digital Camera Memory Interface
	  Pixel Processor (DCMIPP) available as a v4l2 device.

	  To compile this driver as a module, choose M here: the module
	  will be called stm32-dcmipp.

# Mem2mem drivers
config VIDEO_STM32_DMA2D
	tristate "STM32 Chrom-Art Accelerator (DMA2D)"
	depends on V4L_MEM2MEM_DRIVERS
	depends on VIDEO_DEV
	depends on ARCH_STM32 || COMPILE_TEST
	select VIDEOBUF2_DMA_CONTIG
	select V4L2_MEM2MEM_DEV
	help
	  Enables DMA2D hardware support on stm32.

	  The STM32 DMA2D is a memory-to-memory engine for pixel conversion
	  and specialized DMA dedicated to image manipulation.
```

## drivers/media/platform/starfive/Kconfig
```kconfig
#
# VIN sensor driver configuration
#

config VIN_SENSOR_OV5640
	tristate "VIN SENSOR support OV5640"
	depends on VIDEO_STF_VIN
	select V4L2_FWNODE
	default n
	help
	  Say Y here if you want to have support for VIN sensor OV5640

config VIN_SENSOR_SC2235
	tristate "VIN SENSOR support SC2235"
	depends on VIDEO_STF_VIN
	select V4L2_FWNODE
	default n
	help
	  Say Y here if you want to have support for VIN sensor SC2235

config VIN_SENSOR_OV4689
	tristate "VIN SENSOR support OV4689"
	depends on VIDEO_STF_VIN
	select V4L2_FWNODE
	default n
	help
	  Say Y here if you want to have support for VIN sensor OV4689

config VIN_SENSOR_IMX219
	tristate "VIN SENSOR support imx219"
	depends on VIDEO_STF_VIN
	select V4L2_FWNODE
	default n
	help
	  Say Y here if you want to have support for VIN sensor OV13850

config VIN_SENSOR_IMX219
	bool "VIN SENSOR support IMX219"
	depends on VIDEO_STF_VIN
	select V4L2_FWNODE
	default n
	help
	  Say Y here if you want to have support for VIN sensor IMX219
```

## drivers/media/platform/sti/Kconfig
```kconfig
# SPDX-License-Identifier: GPL-2.0-only
source "drivers/media/platform/sti/bdisp/Kconfig"
source "drivers/media/platform/sti/c8sectpfe/Kconfig"
source "drivers/media/platform/sti/delta/Kconfig"
source "drivers/media/platform/sti/hva/Kconfig"
```

## drivers/media/platform/sti/bdisp/Kconfig
```kconfig
config VIDEO_STI_BDISP
	tristate "STMicroelectronics BDISP 2D blitter driver"
	depends on VIDEO_DEV && VIDEO_V4L2
	select VIDEOBUF2_DMA_CONTIG
	select V4L2_MEM2MEM_DEV
	help
	 This v4l2 mem2mem driver is a 2D blitter for STMicroelectronics SoC.
	 To compile this driver as a module, choose M here: the module will
	 be called bdisp.ko.
```

## drivers/media/platform/sti/c8sectpfe/Kconfig
```kconfig
# SPDX-License-Identifier: GPL-2.0-only
config DVB_C8SECTPFE
	tristate "STMicroelectronics C8SECTPFE DVB support"
	depends on PINCTRL && DVB_CORE && I2C
	depends on ARCH_STI || ARCH_MULTIPLATFORM || COMPILE_TEST
	select FW_LOADER
	select DEBUG_FS
	select DVB_LNBP21 if MEDIA_SUBDRV_AUTOSELECT
	select DVB_STV090x if MEDIA_SUBDRV_AUTOSELECT
	select DVB_STB6100 if MEDIA_SUBDRV_AUTOSELECT
	select DVB_STV6110 if MEDIA_SUBDRV_AUTOSELECT
	select DVB_STV0900 if MEDIA_SUBDRV_AUTOSELECT
	select DVB_STV0367 if MEDIA_SUBDRV_AUTOSELECT
	select MEDIA_TUNER_TDA18212 if MEDIA_SUBDRV_AUTOSELECT

	help
	  This adds support for DVB front-end cards connected
	  to TS inputs of STiH407/410 SoC.

	  The driver currently supports C8SECTPFE's TS input block,
	  memdma engine, and HW PID filtering.

	  Supported DVB front-end cards are:
	  - STMicroelectronics DVB-T B2100A (STV0367 + TDA18212)
	  - STMicroelectronics DVB-S/S2 STV0903 + STV6110 + LNBP24 board

	  To compile this driver as a module, choose M here: the
	  module will be called c8sectpfe.
```

## drivers/media/platform/sunxi/Kconfig
```kconfig
# SPDX-License-Identifier: GPL-2.0

comment "Sunxi media platform drivers"

source "drivers/media/platform/sunxi/sun4i-csi/Kconfig"
source "drivers/media/platform/sunxi/sun6i-csi/Kconfig"
source "drivers/media/platform/sunxi/sun6i-mipi-csi2/Kconfig"
source "drivers/media/platform/sunxi/sun8i-a83t-mipi-csi2/Kconfig"
source "drivers/media/platform/sunxi/sun8i-di/Kconfig"
source "drivers/media/platform/sunxi/sun8i-rotate/Kconfig"
```

## drivers/media/platform/sunxi/sun4i-csi/Kconfig
```kconfig
# SPDX-License-Identifier: GPL-2.0

config VIDEO_SUN4I_CSI
	tristate "Allwinner A10 CMOS Sensor Interface Support"
	depends on V4L_PLATFORM_DRIVERS
	depends on VIDEO_DEV && COMMON_CLK  && HAS_DMA
	depends on ARCH_SUNXI || COMPILE_TEST
	select MEDIA_CONTROLLER
	select VIDEO_V4L2_SUBDEV_API
	select VIDEOBUF2_DMA_CONTIG
	select V4L2_FWNODE
	help
	  This is a V4L2 driver for the Allwinner A10 CSI

	  To compile this driver as a module, choose M here: the module
	  will be called sun4i_csi.
```

## drivers/media/platform/sunxi/sun6i-csi/Kconfig
```kconfig
# SPDX-License-Identifier: GPL-2.0-only
config VIDEO_SUN6I_CSI
	tristate "Allwinner A31 Camera Sensor Interface (CSI) Driver"
	depends on V4L_PLATFORM_DRIVERS && VIDEO_DEV
	depends on ARCH_SUNXI || COMPILE_TEST
	depends on PM && COMMON_CLK && RESET_CONTROLLER && HAS_DMA
	select MEDIA_CONTROLLER
	select VIDEO_V4L2_SUBDEV_API
	select VIDEOBUF2_DMA_CONTIG
	select V4L2_FWNODE
	select REGMAP_MMIO
	help
	   Support for the Allwinner A31 Camera Sensor Interface (CSI)
	   controller, also found on other platforms such as the A83T, H3,
	   V3/V3s or A64.
```

## drivers/media/platform/sunxi/sun6i-mipi-csi2/Kconfig
```kconfig
# SPDX-License-Identifier: GPL-2.0-only
config VIDEO_SUN6I_MIPI_CSI2
	tristate "Allwinner A31 MIPI CSI-2 Controller Driver"
	depends on V4L_PLATFORM_DRIVERS && VIDEO_DEV
	depends on ARCH_SUNXI || COMPILE_TEST
	depends on PM && COMMON_CLK && RESET_CONTROLLER
	depends on PHY_SUN6I_MIPI_DPHY
	select MEDIA_CONTROLLER
	select VIDEO_V4L2_SUBDEV_API
	select V4L2_FWNODE
	select GENERIC_PHY_MIPI_DPHY
	select REGMAP_MMIO
	help
	   Support for the Allwinner A31 MIPI CSI-2 controller, also found on
	   other platforms such as the V3/V3s.
```

## drivers/media/platform/sunxi/sun8i-a83t-mipi-csi2/Kconfig
```kconfig
# SPDX-License-Identifier: GPL-2.0-only
config VIDEO_SUN8I_A83T_MIPI_CSI2
	tristate "Allwinner A83T MIPI CSI-2 Controller and D-PHY Driver"
	depends on V4L_PLATFORM_DRIVERS && VIDEO_DEV
	depends on ARCH_SUNXI || COMPILE_TEST
	depends on PM && COMMON_CLK && RESET_CONTROLLER
	select MEDIA_CONTROLLER
	select VIDEO_V4L2_SUBDEV_API
	select V4L2_FWNODE
	select REGMAP_MMIO
	select GENERIC_PHY_MIPI_DPHY
	help
	   Support for the Allwinner A83T MIPI CSI-2 controller and D-PHY.
```

## drivers/media/platform/sunxi/sun8i-di/Kconfig
```kconfig
# SPDX-License-Identifier: GPL-2.0-only
config VIDEO_SUN8I_DEINTERLACE
	tristate "Allwinner Deinterlace driver"
	depends on V4L_MEM2MEM_DRIVERS
	depends on VIDEO_DEV
	depends on ARCH_SUNXI || COMPILE_TEST
	depends on COMMON_CLK && RESET_CONTROLLER && OF
	depends on PM
	select VIDEOBUF2_DMA_CONTIG
	select V4L2_MEM2MEM_DEV
	help
	   Support for the Allwinner deinterlace unit with scaling
	   capability found on some SoCs, like H3.
	   To compile this driver as a module choose m here.
```

## drivers/media/platform/sunxi/sun8i-rotate/Kconfig
```kconfig
# SPDX-License-Identifier: GPL-2.0-only

config VIDEO_SUN8I_ROTATE
	tristate "Allwinner DE2 rotation driver"
	depends on V4L_MEM2MEM_DRIVERS
	depends on VIDEO_DEV
	depends on ARCH_SUNXI || COMPILE_TEST
	depends on COMMON_CLK && RESET_CONTROLLER && OF
	depends on PM
	select VIDEOBUF2_DMA_CONTIG
	select V4L2_MEM2MEM_DEV
	help
	   Support for the Allwinner DE2 rotation unit.
	   To compile this driver as a module choose m here.
```

## drivers/media/platform/synopsys/Kconfig
```kconfig
# SPDX-License-Identifier: GPL-2.0-only

source "drivers/media/platform/synopsys/hdmirx/Kconfig"

config VIDEO_DW_MIPI_CSI2RX
	tristate "Synopsys DesignWare MIPI CSI-2 Receiver"
	depends on VIDEO_DEV
	depends on V4L_PLATFORM_DRIVERS
	depends on PM && COMMON_CLK
	select MEDIA_CONTROLLER
	select V4L2_FWNODE
	select VIDEO_V4L2_SUBDEV_API
	help
	  The Synopsys DesignWare MIPI CSI-2 Receiver is a CSI-2 bridge with
	  one input port and one output port. It receives the data with the
	  help of an external MIPI PHY (C-PHY or D-PHY) and passes it to e.g.,
	  the Rockchip Video Capture (VICAP) block on recent Rockchip SoCs.
	  This is a driver for this unit.

	  To compile this driver as a module, choose M here: the module
	  will be called dw-mipi-csi2rx.
```

## drivers/media/platform/synopsys/hdmirx/Kconfig
```kconfig
# SPDX-License-Identifier: GPL-2.0

config VIDEO_SYNOPSYS_HDMIRX
	tristate "Synopsys DesignWare HDMI Receiver driver"
	depends on ARCH_ROCKCHIP || COMPILE_TEST
	depends on VIDEO_DEV
	select MEDIA_CONTROLLER
	select VIDEO_V4L2_SUBDEV_API
	select VIDEOBUF2_DMA_CONTIG
	select CEC_CORE
	select HDMI
	help
	  Support for Synopsys HDMI HDMI RX Controller.
	  This driver supports HDMI 2.0 version.

	  To compile this driver as a module, choose M here. The module
	  will be called synopsys_hdmirx.

config VIDEO_SYNOPSYS_HDMIRX_LOAD_DEFAULT_EDID
	bool "Load default EDID"
	depends on VIDEO_SYNOPSYS_HDMIRX
	help
	  Preload default EDID (Extended Display Identification Data)
	  branded by Linux Foundation that exposes display modes up
	  to 4k@30Hz, which have best compatibility with HDMI transmitters.

	  Enabling this option is recommended for a non-production use-cases.
	  It will make driver usable out-of-the-box.

	  For a higher display modes you will need to load customized EDID
	  from userspace using v4l2-ctl tool or by other means.

	  Without enabling this option driver will be practically
	  non-functional until EDID will be loaded from userspace.
	  Which is a wanted behavior when using this driver in a
	  commercial product that should utilize own branded EDID.
```

## drivers/media/platform/ti/Kconfig
```kconfig
# SPDX-License-Identifier: GPL-2.0-only

comment "Texas Instruments drivers"

# TI VIDEO PORT Helper Modules
# These will be selected by VPE and VIP
config VIDEO_TI_VPDMA
	tristate

config VIDEO_TI_SC
	tristate

config VIDEO_TI_CSC
	tristate

# V4L drivers

config VIDEO_TI_CAL
	tristate "TI CAL (Camera Adaptation Layer) driver"
	depends on VIDEO_DEV
	depends on V4L_PLATFORM_DRIVERS
	select MEDIA_CONTROLLER
	select VIDEO_V4L2_SUBDEV_API
	depends on SOC_DRA7XX || ARCH_K3 || COMPILE_TEST
	select VIDEOBUF2_DMA_CONTIG
	select V4L2_FWNODE
	help
	  Support for the TI CAL (Camera Adaptation Layer) block
	  found on DRA72X SoC.
	  In TI Technical Reference Manual this module is referred as
	  Camera Interface Subsystem (CAMSS).

config VIDEO_TI_CAL_MC
	bool "Media Controller centric mode by default"
	depends on VIDEO_TI_CAL
	default n
	help
	  Enables Media Controller centric mode by default.

	  If set, CAL driver will start in Media Controller mode by
	  default. Note that this behavior can be overridden via
	  module parameter 'mc_api'.

# Mem2mem drivers

config VIDEO_TI_VPE
	tristate "TI VPE (Video Processing Engine) driver"
	depends on V4L_MEM2MEM_DRIVERS
	depends on VIDEO_DEV
	depends on SOC_DRA7XX || COMPILE_TEST
	select VIDEOBUF2_DMA_CONTIG
	select V4L2_MEM2MEM_DEV
	select VIDEO_TI_VPDMA
	select VIDEO_TI_SC
	select VIDEO_TI_CSC
	help
	  Support for the TI VPE(Video Processing Engine) block
	  found on DRA7XX SoC.

config VIDEO_TI_VPE_DEBUG
	bool "VPE debug messages"
	depends on VIDEO_TI_VPE
	help
	  Enable debug messages on VPE driver.

source "drivers/media/platform/ti/am437x/Kconfig"
source "drivers/media/platform/ti/davinci/Kconfig"
source "drivers/media/platform/ti/omap/Kconfig"
source "drivers/media/platform/ti/omap3isp/Kconfig"
```
