## drivers/media/platform/rcar-vin/Kconfig
```kconfig
# SPDX-License-Identifier: GPL-2.0
config VIDEO_RCAR_CSI2
	tristate "R-Car MIPI CSI-2 Receiver"
	depends on VIDEO_V4L2 && OF
	depends on ARCH_RENESAS || COMPILE_TEST
	select MEDIA_CONTROLLER
	select VIDEO_V4L2_SUBDEV_API
	select RESET_CONTROLLER
	select V4L2_FWNODE
	help
	  Support for Renesas R-Car MIPI CSI-2 receiver.
	  Supports R-Car Gen3 and RZ/G2 SoCs.

	  To compile this driver as a module, choose M here: the
	  module will be called rcar-csi2.

config VIDEO_RCAR_VIN
	tristate "R-Car Video Input (VIN) Driver"
	depends on VIDEO_V4L2 && OF
	depends on ARCH_RENESAS || COMPILE_TEST
	select MEDIA_CONTROLLER
	select VIDEO_V4L2_SUBDEV_API
	select VIDEOBUF2_DMA_CONTIG
	select V4L2_FWNODE
	help
	  Support for Renesas R-Car Video Input (VIN) driver.
	  Supports R-Car Gen2 and Gen3 SoCs.

	  To compile this driver as a module, choose M here: the
	  module will be called rcar-vin.
```

## drivers/media/platform/renesas/Kconfig
```kconfig
# SPDX-License-Identifier: GPL-2.0-only

comment "Renesas media platform drivers"

# V4L drivers

config VIDEO_RENESAS_CEU
	tristate "Renesas Capture Engine Unit (CEU) driver"
	depends on V4L_PLATFORM_DRIVERS
	depends on VIDEO_DEV
	depends on ARCH_SHMOBILE || ARCH_R7S72100 || COMPILE_TEST
	select VIDEOBUF2_DMA_CONTIG
	select V4L2_FWNODE
	help
	  This is a v4l2 driver for the Renesas CEU Interface

config VIDEO_RCAR_ISP
	tristate "R-Car Image Signal Processor (ISP)"
	depends on V4L_PLATFORM_DRIVERS
	depends on VIDEO_DEV && OF
	depends on ARCH_RENESAS || COMPILE_TEST
	select MEDIA_CONTROLLER
	select VIDEO_V4L2_SUBDEV_API
	select RESET_CONTROLLER
	select V4L2_FWNODE
	help
	  Support for Renesas R-Car Image Signal Processor (ISP).
	  Enable this to support the Renesas R-Car Image Signal
	  Processor (ISP).

	  To compile this driver as a module, choose M here: the
	  module will be called rcar-isp.

config VIDEO_SH_VOU
	tristate "SuperH VOU video output driver"
	depends on V4L_PLATFORM_DRIVERS
	depends on VIDEO_DEV && I2C
	depends on ARCH_SHMOBILE || COMPILE_TEST
	select VIDEOBUF2_DMA_CONTIG
	help
	  Support for the Video Output Unit (VOU) on SuperH SoCs.

source "drivers/media/platform/renesas/rcar-vin/Kconfig"

# Mem2mem drivers

config VIDEO_RENESAS_FCP
	tristate "Renesas Frame Compression Processor"
	depends on V4L_MEM2MEM_DRIVERS
	depends on ARCH_RENESAS || COMPILE_TEST
	depends on OF
	help
	  This is a driver for the Renesas Frame Compression Processor (FCP).
	  The FCP is a companion module of video processing modules in the
	  Renesas R-Car Gen3 and RZ/G2 SoCs. It handles memory access for
	  the codec, VSP and FDP modules.

	  To compile this driver as a module, choose M here: the module
	  will be called rcar-fcp.

config VIDEO_RENESAS_FDP1
	tristate "Renesas Fine Display Processor"
	depends on V4L_MEM2MEM_DRIVERS
	depends on VIDEO_DEV
	depends on ARCH_RENESAS || COMPILE_TEST
	depends on (!ARM64 && !VIDEO_RENESAS_FCP) || VIDEO_RENESAS_FCP
	select VIDEOBUF2_DMA_CONTIG
	select V4L2_MEM2MEM_DEV
	help
	  This is a V4L2 driver for the Renesas Fine Display Processor
	  providing colour space conversion, and de-interlacing features.

	  To compile this driver as a module, choose M here: the module
	  will be called rcar_fdp1.

config VIDEO_RENESAS_JPU
	tristate "Renesas JPEG Processing Unit"
	depends on V4L_MEM2MEM_DRIVERS
	depends on VIDEO_DEV
	depends on ARCH_RENESAS || COMPILE_TEST
	select VIDEOBUF2_DMA_CONTIG
	select V4L2_MEM2MEM_DEV
	help
	  This is a V4L2 driver for the Renesas JPEG Processing Unit.

	  To compile this driver as a module, choose M here: the module
	  will be called rcar_jpu.

config VIDEO_RENESAS_VSP1
	tristate "Renesas VSP1 Video Processing Engine"
	depends on V4L_MEM2MEM_DRIVERS
	depends on VIDEO_DEV
	depends on ARCH_RENESAS || COMPILE_TEST
	depends on (!ARM64 && !VIDEO_RENESAS_FCP) || VIDEO_RENESAS_FCP
	select MEDIA_CONTROLLER
	select VIDEO_V4L2_SUBDEV_API
	select VIDEOBUF2_DMA_CONTIG
	select VIDEOBUF2_VMALLOC
	help
	  This is a V4L2 driver for the Renesas VSP1 video processing engine.

	  To compile this driver as a module, choose M here: the module
	  will be called vsp1.

# SDR drivers

config VIDEO_RCAR_DRIF
	tristate "Renesas Digital Radio Interface (DRIF)"
	depends on SDR_PLATFORM_DRIVERS
	depends on VIDEO_DEV
	depends on ARCH_RENESAS || COMPILE_TEST
	select VIDEOBUF2_VMALLOC
	select V4L2_ASYNC
	help
	  Say Y if you want to enable R-Car Gen3 DRIF support. DRIF is Digital
	  Radio Interface that interfaces with an RF front end chip. It is a
	  receiver of digital data which uses DMA to transfer received data to
	  a configured location for an application to use.

	  To compile this driver as a module, choose M here; the module
	  will be called rcar_drif.
```

## drivers/media/platform/renesas/rcar-isp/Kconfig
```kconfig
# SPDX-License-Identifier: GPL-2.0

config VIDEO_RCAR_ISP
	tristate "R-Car Image Signal Processor (ISP)"
	depends on V4L_PLATFORM_DRIVERS
	depends on VIDEO_DEV && OF
	depends on ARCH_RENESAS || COMPILE_TEST
	select MEDIA_CONTROLLER
	select VIDEO_V4L2_SUBDEV_API
	select RESET_CONTROLLER
	select V4L2_FWNODE
	help
	  Support for Renesas R-Car Image Signal Processor (ISP).
	  Enable this to support the Renesas R-Car Image Signal
	  Processor (ISP).

	  To compile this driver as a module, choose M here: the
	  module will be called rcar-isp.
```

## drivers/media/platform/renesas/rcar-vin/Kconfig
```kconfig
# SPDX-License-Identifier: GPL-2.0
config VIDEO_RCAR_VIN
	tristate "R-Car Video Input (VIN) Driver"
	depends on V4L_PLATFORM_DRIVERS
	depends on VIDEO_DEV && OF
	depends on ARCH_RENESAS || COMPILE_TEST
	select MEDIA_CONTROLLER
	select VIDEO_V4L2_SUBDEV_API
	select VIDEOBUF2_DMA_CONTIG
	select V4L2_FWNODE
	help
	  Support for Renesas R-Car Video Input (VIN) driver.
	  Supports R-Car Gen{2,3} and RZ/G{1,2} SoCs.

	  To compile this driver as a module, choose M here: the
	  module will be called rcar-vin.
```

## drivers/media/platform/renesas/rzg2l-cru/Kconfig
```kconfig
# SPDX-License-Identifier: GPL-2.0

config VIDEO_RZG2L_CSI2
	tristate "RZ/G2L MIPI CSI-2 Receiver"
	depends on ARCH_RENESAS || COMPILE_TEST
	depends on V4L_PLATFORM_DRIVERS
	depends on VIDEO_DEV && OF
	select MEDIA_CONTROLLER
	select RESET_CONTROLLER
	select V4L2_FWNODE
	select VIDEO_V4L2_SUBDEV_API
	help
	  Support for Renesas RZ/G2L (and alike SoC's) MIPI CSI-2
	  Receiver driver.

	  To compile this driver as a module, choose M here: the
	  module will be called rzg2l-csi2.

config VIDEO_RZG2L_CRU
	tristate "RZ/G2L Camera Receiving Unit (CRU) Driver"
	depends on ARCH_RENESAS || COMPILE_TEST
	depends on V4L_PLATFORM_DRIVERS
	depends on VIDEO_DEV && OF
	select MEDIA_CONTROLLER
	select V4L2_FWNODE
	select VIDEOBUF2_DMA_CONTIG
	select VIDEO_V4L2_SUBDEV_API
	help
	  Support for Renesas RZ/G2L (and alike SoC's) Camera Receiving
	  Unit (CRU) driver.

	  To compile this driver as a module, choose M here: the
	  module will be called rzg2l-cru.
```

## drivers/media/platform/renesas/rzv2h-ivc/Kconfig
```kconfig
# SPDX-License-Identifier: GPL-2.0-only

config VIDEO_RZV2H_IVC
	tristate "Renesas RZ/V2H(P) Input Video Control block driver"
	depends on V4L_PLATFORM_DRIVERS
	depends on VIDEO_DEV
	depends on ARCH_RENESAS || COMPILE_TEST
	depends on OF
	depends on PM
	select VIDEOBUF2_DMA_CONTIG
	select MEDIA_CONTROLLER
	select VIDEO_V4L2_SUBDEV_API
	help
          Support for the Renesas RZ/V2H(P) Input Video Control Block
          (IVC).

          To compile this driver as a module, choose M here: the
          module will be called rzv2h-ivc.
```

## drivers/media/platform/rk-isp10/Kconfig
```kconfig
# SPDX-License-Identifier: GPL-2.0
config VIDEO_RK_CIF_ISP10
	tristate "Rockchip cif isp10 camera sensors"
	depends on VIDEO_V4L2 && I2C
	select VIDEOBUF2_CORE
	select VIDEOBUF_GEN
	select VIDEOBUF2_DMA_SG
	select VIDEOBUF2_VMALLOC
	default n

	help
	  Say Y here to enable selecting the
	  rockchip cif isp10 camera sensors
```

## drivers/media/platform/rockchip-tsp/Kconfig
```kconfig
# SPDX-License-Identifier: GPL-2.0

config ROCKCHIP_TSP
	bool "Support for Rockchip TSP"
	default n

	---help---
	  Say Y here if you want to use the Transport Stream Processing.
	  This option will add tsp module code.

	  Say N hera if you do not want to use the processor.
```

## drivers/media/platform/rockchip/Kconfig
```kconfig
# SPDX-License-Identifier: GPL-2.0-only

comment "Rockchip media platform drivers"

source "drivers/media/platform/rockchip/rga/Kconfig"
source "drivers/media/platform/rockchip/rkisp1/Kconfig"
```

## drivers/media/platform/rockchip/cif/Kconfig
```kconfig
# SPDX-License-Identifier: GPL-2.0
config VIDEO_ROCKCHIP_CIF
	tristate "Rockchip Camera Interface driver"
	depends on VIDEO_V4L2 && VIDEO_V4L2_SUBDEV_API
	depends on ARCH_ROCKCHIP || COMPILE_TEST
	depends on MEDIA_CAMERA_SUPPORT
	select VIDEOBUF2_CMA_SG
	select VIDEOBUF2_VMALLOC
	select V4L2_FWNODE
	default n
	help
	  Support for CIF on the rockchip SoCs like rk312x, rk3288.

choice
	prompt "rockchip camera sensor interface work mode"
	depends on VIDEO_ROCKCHIP_CIF
	default ROCKCHIP_CIF_WORKMODE_PINGPONG

config ROCKCHIP_CIF_WORKMODE_PINGPONG
	bool "interface works in pingpong mode"

config ROCKCHIP_CIF_WORKMODE_ONEFRAME
	bool "interface works in oneframe mode"

endchoice

choice
	prompt "rockchip rkcif device dummy buffer choice"
	depends on VIDEO_ROCKCHIP_CIF
	default ROCKCHIP_CIF_USE_DUMMY_BUF

config ROCKCHIP_CIF_USE_DUMMY_BUF
	bool "rkcif use dummy buffer"

config ROCKCHIP_CIF_USE_NONE_DUMMY_BUF
	bool "rkcif not use dummy buffer"

endchoice

config ROCKCHIP_CIF_USE_MONITOR
	bool "rkcif use monitor"
	depends on VIDEO_ROCKCHIP_CIF
	default n
	help
	  Support for CIF to monitor capture error.

config ROCKCHIP_CIF_MONITOR_MODE
	hex "rkcif monitor mode"
	default 0x1
	depends on ROCKCHIP_CIF_USE_MONITOR

config ROCKCHIP_CIF_MONITOR_START_FRAME
	hex "the frame id to start monitor"
	default 0
	depends on ROCKCHIP_CIF_USE_MONITOR

config ROCKCHIP_CIF_MONITOR_CYCLE
	hex "frame num of monitoring cycle"
	default 0x8
	depends on ROCKCHIP_CIF_USE_MONITOR

config ROCKCHIP_CIF_MONITOR_KEEP_TIME
	hex "timeout for keep monitoring after finding out error, unit(ms)"
	default 0x3e8
	depends on ROCKCHIP_CIF_USE_MONITOR

config ROCKCHIP_CIF_MONITOR_ERR_CNT
	hex "error reference val for resetting"
	default 0x5
	depends on ROCKCHIP_CIF_USE_MONITOR

config ROCKCHIP_CIF_RESET_BY_USER
	bool "rkcif reset by user"
	depends on ROCKCHIP_CIF_USE_MONITOR
	default n
	help
	  Support for CIF to reset pipe by user.
```

## drivers/media/platform/rockchip/hdmirx/Kconfig
```kconfig
# SPDX-License-Identifier: GPL-2.0

config VIDEO_ROCKCHIP_HDMIRX_CLASS
	tristate "Rockchip HDMI Receiver Devices Class Support"
	help
	  There are many hdmirx devices in Rockchip SOCs, eg.
	  rkhdmirx rk628 lut6911 it6616
	  This driver create a class for those hdmirx devices
	  And hdmirx drivers can add hdmirx properties for those
	  hdmirx devices

	  To compile this driver as a module, choose M here.

config VIDEO_ROCKCHIP_HDMIRX
	tristate "Rockchip HDMI Receiver driver"
	depends on VIDEO_V4L2
	depends on ROCKCHIP_SIP
	select MEDIA_CONTROLLER
	select VIDEO_V4L2_SUBDEV_API
	select VIDEOBUF2_DMA_CONTIG
	select HDMI
	select VIDEO_ROCKCHIP_HDMIRX_CLASS
	help
	  Support for Rockchip HDMI RX PHY and Controller.
	  This driver supports HDMI 2.0 version.

	  To compile this driver as a module, choose M here. The module
	  will be called rockchip_hdmirx.
```

## drivers/media/platform/rockchip/isp/Kconfig
```kconfig
# SPDX-License-Identifier: GPL-2.0
config VIDEO_ROCKCHIP_ISP
	tristate "Rockchip Image Signal Processing Unit driver"
	depends on VIDEO_V4L2 && VIDEO_V4L2_SUBDEV_API
	depends on ARCH_ROCKCHIP || COMPILE_TEST
	select VIDEOBUF2_DMA_CONTIG
	select VIDEOBUF2_VMALLOC
	select VIDEOBUF2_DMA_SG
	select V4L2_FWNODE
	select PHY_ROCKCHIP_MIPI_RX
	default n
	help
	  Support for ISP on the rockchip SoC.

if VIDEO_ROCKCHIP_ISP

config VIDEO_ROCKCHIP_ISP_VERSION_V1X
	bool "isp1 for rk1808 rk3288 rk3326 rk3368 rk3399"
	default y if CPU_RK1808 || CPU_RK3288 || CPU_PX30 || CPU_RK3368 || CPU_RK3399

config VIDEO_ROCKCHIP_ISP_VERSION_V20
	bool "isp20 for rv1126 and rv1109"
	default y if CPU_RV1126

config VIDEO_ROCKCHIP_ISP_VERSION_V21
	bool "isp21 for rk3566 and rk3568"
	default y if CPU_RK3568

config VIDEO_ROCKCHIP_THUNDER_BOOT_ISP
	bool "Rockchip Image Signal Processing Thunderboot helper"
	depends on ROCKCHIP_THUNDER_BOOT
	help
	  Say y if enable thunderboot helper for isp.

endif
```

## drivers/media/platform/rockchip/isp1/Kconfig
```kconfig
# SPDX-License-Identifier: GPL-2.0
config VIDEO_ROCKCHIP_RKISP1
	tristate "Rockchip Image Signal Processing V1 Unit driver"
	depends on VIDEO_V4L2 && VIDEO_V4L2_SUBDEV_API
	depends on ARCH_ROCKCHIP || COMPILE_TEST
	depends on CPU_RK1808 || CPU_RK3288 || CPU_PX30 || CPU_RK3368 || CPU_RK3399
	select VIDEOBUF2_DMA_CONTIG
	select VIDEOBUF2_VMALLOC
	select V4L2_FWNODE
	select PHY_ROCKCHIP_MIPI_RX
	default n
	help
	  Support for ISP1 on the rockchip SoC.
```

## drivers/media/platform/rockchip/ispp/Kconfig
```kconfig
# SPDX-License-Identifier: GPL-2.0
config VIDEO_ROCKCHIP_ISPP
	tristate "Rockchip Image Signal Post-Processing Unit driver"
	depends on VIDEO_V4L2 && VIDEO_V4L2_SUBDEV_API
	depends on ARCH_ROCKCHIP || COMPILE_TEST
	select VIDEOBUF2_CMA_SG
	select VIDEOBUF2_VMALLOC
	default n
	help
	  Support for ISPP on the rockchip SoC.

config VIDEO_ROCKCHIP_ISPP_FEC
	bool "Rockchip Image Signal FEC Processing helper"
	depends on VIDEO_ROCKCHIP_ISPP
	select V4L2_MEM2MEM_DEV
	default n
	help
	  Say y if enable fec independent.

if VIDEO_ROCKCHIP_ISPP

config VIDEO_ROCKCHIP_ISPP_VERSION_V10
	bool "ispp10 for rv1126 and rv1109"
	default y if CPU_RV1126

config VIDEO_ROCKCHIP_ISPP_VERSION_V20
	bool "ispp20 for rk3588"
	default y if CPU_RK3588

endif
```

## drivers/media/platform/rockchip/rga/Kconfig
```kconfig
config VIDEO_ROCKCHIP_RGA
	tristate "Rockchip Raster 2d Graphic Acceleration Unit"
	depends on V4L_MEM2MEM_DRIVERS
	depends on VIDEO_DEV
	depends on ARCH_ROCKCHIP || COMPILE_TEST
	select VIDEOBUF2_DMA_SG
	select V4L2_MEM2MEM_DEV
	help
	  This is a v4l2 driver for Rockchip SOC RGA 2d graphics accelerator.
	  Rockchip RGA is a separate 2D raster graphic acceleration unit.
	  It accelerates 2D graphics operations, such as point/line drawing,
	  image scaling, rotation, BitBLT, alpha blending and image blur/sharpness.

	  To compile this driver as a module choose m here.
```

## drivers/media/platform/rockchip/rkcif/Kconfig
```kconfig
config VIDEO_ROCKCHIP_CIF
	tristate "Rockchip Camera Interface (CIF)"
	depends on VIDEO_DEV
	depends on ARCH_ROCKCHIP || COMPILE_TEST
	depends on V4L_PLATFORM_DRIVERS
	depends on PM && COMMON_CLK
	select MEDIA_CONTROLLER
	select VIDEOBUF2_DMA_CONTIG
	select V4L2_FWNODE
	select VIDEO_V4L2_SUBDEV_API
	help
	  This is a driver for Rockchip Camera Interface (CIF). It is featured
	  in many Rockchips SoCs in different variations, such as the PX30
	  Video Input Processor (VIP, one Digital Video Port (DVP)) or the
	  RK3568 Video Capture (VICAP, one DVP, one MIPI CSI-2 receiver) unit.

	  To compile this driver as a module, choose M here: the module
	  will be called rockchip-cif.
```

## drivers/media/platform/rockchip/rkisp1/Kconfig
```kconfig
# SPDX-License-Identifier: GPL-2.0-only
config VIDEO_ROCKCHIP_ISP1
	tristate "Rockchip Image Signal Processing v1 Unit driver"
	depends on V4L_PLATFORM_DRIVERS
	depends on VIDEO_DEV && OF
	depends on ARCH_ROCKCHIP || COMPILE_TEST
	select MEDIA_CONTROLLER
	select VIDEO_V4L2_SUBDEV_API
	select VIDEOBUF2_DMA_CONTIG
	select VIDEOBUF2_VMALLOC
	select V4L2_FWNODE
	select GENERIC_PHY_MIPI_DPHY
	default n
	help
	  Enable this to support the Image Signal Processing (ISP) module
	  present in RK3399 SoCs.

	  To compile this driver as a module, choose M here: the module
	  will be called rockchip-isp1.
```
