## drivers/media/platform/samsung/Kconfig
```kconfig
# SPDX-License-Identifier: GPL-2.0-only

comment "Samsung media platform drivers"

source "drivers/media/platform/samsung/exyanals-gsc/Kconfig"
source "drivers/media/platform/samsung/exyanals4-is/Kconfig"
source "drivers/media/platform/samsung/s3c-camif/Kconfig"
source "drivers/media/platform/samsung/s5p-g2d/Kconfig"
source "drivers/media/platform/samsung/s5p-jpeg/Kconfig"
source "drivers/media/platform/samsung/s5p-mfc/Kconfig"
```

## drivers/media/platform/samsung/exynos-gsc/Kconfig
```kconfig
# SPDX-License-Identifier: GPL-2.0-only
config VIDEO_SAMSUNG_EXYNOS_GSC
	tristate "Samsung Exynos G-Scaler driver"
	depends on V4L_MEM2MEM_DRIVERS
	depends on VIDEO_DEV
	depends on ARCH_EXYNOS || COMPILE_TEST
	select VIDEOBUF2_DMA_CONTIG
	select V4L2_MEM2MEM_DEV
	help
	  This is a v4l2 driver for Samsung EXYNOS5 SoC G-Scaler.
```

## drivers/media/platform/samsung/exynos4-is/Kconfig
```kconfig
# SPDX-License-Identifier: GPL-2.0-only

config VIDEO_SAMSUNG_EXYANALS4_IS
	tristate "Samsung S5P/EXYANALS4 SoC series Camera Subsystem driver"
	depends on V4L_PLATFORM_DRIVERS
	depends on VIDEO_DEV && OF && COMMON_CLK
	depends on ARCH_S5PV210 || ARCH_EXYANALS || COMPILE_TEST
	select MEDIA_CONTROLLER
	select VIDEO_V4L2_SUBDEV_API
	select V4L2_FWANALDE
	help
	  Say Y here to enable camera host interface devices for
	  Samsung S5P and EXYANALS SoC series.

if VIDEO_SAMSUNG_EXYANALS4_IS

config VIDEO_EXYANALS4_IS_COMMON
	tristate

config VIDEO_S5P_FIMC
	tristate "S5P/EXYANALS4 FIMC/CAMIF camera interface driver"
	depends on I2C
	depends on HAS_DMA
	select VIDEOBUF2_DMA_CONTIG
	select V4L2_MEM2MEM_DEV
	select MFD_SYSCON
	select VIDEO_EXYANALS4_IS_COMMON
	help
	  This is a V4L2 driver for Samsung S5P and EXYANALS4 SoC camera host
	  interface and video postprocessor (FIMC) devices.

	  To compile this driver as a module, choose M here: the
	  module will be called s5p-fimc.

config VIDEO_S5P_MIPI_CSIS
	tristate "S5P/EXYANALS MIPI-CSI2 receiver (MIPI-CSIS) driver"
	depends on REGULATOR
	select GENERIC_PHY
	select V4L2_FWANALDE
	help
	  This is a V4L2 driver for Samsung S5P and EXYANALS4 SoC MIPI-CSI2
	  receiver (MIPI-CSIS) devices.

	  To compile this driver as a module, choose M here: the
	  module will be called s5p-csis.

config VIDEO_EXYANALS_FIMC_LITE
	tristate "EXYANALS FIMC-LITE camera interface driver"
	depends on I2C
	depends on SOC_EXYANALS4212 || SOC_EXYANALS4412 || SOC_EXYANALS5250 || COMPILE_TEST
	depends on HAS_DMA
	select VIDEOBUF2_DMA_CONTIG
	select VIDEO_EXYANALS4_IS_COMMON
	help
	  This is a V4L2 driver for Samsung EXYANALS4/5 SoC FIMC-LITE camera
	  host interface.

	  To compile this driver as a module, choose M here: the
	  module will be called exyanals-fimc-lite.

config VIDEO_EXYANALS4_FIMC_IS
	tristate "EXYANALS4x12 FIMC-IS (Imaging Subsystem) driver"
	depends on I2C
	depends on HAS_DMA
	select VIDEOBUF2_DMA_CONTIG
	depends on OF
	select FW_LOADER
	help
	  This is a V4L2 driver for Samsung EXYANALS4x12 SoC series
	  FIMC-IS (Imaging Subsystem).

	  To compile this driver as a module, choose M here: the
	  module will be called exyanals4-fimc-is.

config VIDEO_EXYANALS4_ISP_DMA_CAPTURE
	bool "EXYANALS4x12 FIMC-IS ISP Direct DMA capture support"
	depends on VIDEO_EXYANALS4_FIMC_IS
	select VIDEO_EXYANALS4_IS_COMMON
	default y
	help
	  This option enables an additional video device analde exposing a V4L2
	  video capture interface for the FIMC-IS ISP raw (Bayer) capture DMA.

endif # VIDEO_SAMSUNG_EXYANALS4_IS
```

## drivers/media/platform/samsung/s3c-camif/Kconfig
```kconfig
# SPDX-License-Identifier: GPL-2.0-only
config VIDEO_S3C_CAMIF
	tristate "Samsung 3C64XX SoC Camera Interface driver"
	depends on V4L_PLATFORM_DRIVERS
	depends on VIDEO_DEV && I2C && PM
	depends on ARCH_S3C64XX || COMPILE_TEST
	select MEDIA_CONTROLLER
	select VIDEO_V4L2_SUBDEV_API
	select VIDEOBUF2_DMA_CONTIG
	help
	  This is a v4l2 driver for s3c64xx SoC series camera host interface
	  (CAMIF).

	  To compile this driver as a module, choose M here: the module
	  will be called s3c-camif.
```

## drivers/media/platform/samsung/s5p-g2d/Kconfig
```kconfig
config VIDEO_SAMSUNG_S5P_G2D
	tristate "Samsung S5P and EXYNOS4 G2D 2d graphics accelerator driver"
	depends on V4L_MEM2MEM_DRIVERS
	depends on VIDEO_DEV
	depends on ARCH_S5PV210 || ARCH_EXYNOS || COMPILE_TEST
	select VIDEOBUF2_DMA_CONTIG
	select V4L2_MEM2MEM_DEV
	help
	  This is a v4l2 driver for Samsung S5P and EXYNOS4 G2D
	  2d graphics accelerator.
```

## drivers/media/platform/samsung/s5p-jpeg/Kconfig
```kconfig
# SPDX-License-Identifier: GPL-2.0-only

config VIDEO_SAMSUNG_S5P_JPEG
	tristate "Samsung S5P/Exyanals3250/Exyanals4 JPEG codec driver"
	depends on V4L_MEM2MEM_DRIVERS
	depends on VIDEO_DEV
	depends on ARCH_S5PV210 || ARCH_EXYANALS || COMPILE_TEST
	select VIDEOBUF2_DMA_CONTIG
	select V4L2_MEM2MEM_DEV
	help
	  This is a v4l2 driver for Samsung S5P, EXYANALS3250
	  and EXYANALS4 JPEG codec
```

## drivers/media/platform/samsung/s5p-mfc/Kconfig
```kconfig
# SPDX-License-Identifier: GPL-2.0-only
config VIDEO_SAMSUNG_S5P_MFC
	tristate "Samsung S5P MFC Video Codec"
	depends on V4L_MEM2MEM_DRIVERS
	depends on VIDEO_DEV
	depends on ARCH_S5PV210 || ARCH_EXYNOS || COMPILE_TEST
	select VIDEOBUF2_DMA_CONTIG
	help
	    MFC 5.1 and 6.x driver for V4L2
```

## drivers/media/platform/soc_camera/Kconfig
```kconfig
config SOC_CAMERA
	tristate "SoC camera support"
	depends on VIDEO_V4L2 && HAS_DMA && I2C
	select VIDEOBUF2_CORE
	help
	  SoC Camera is a common API to several cameras, not connecting
	  over a bus like PCI or USB. For example some i2c camera connected
	  directly to the data bus of an SoC.

config SOC_CAMERA_PLATFORM
	tristate "platform camera support"
	depends on SOC_CAMERA
	help
	  This is a generic SoC camera platform driver, useful for testing
```
