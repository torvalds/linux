## drivers/media/cec/platform/Kconfig
```kconfig
# SPDX-License-Identifier: GPL-2.0-only
#
# Platform drivers

config CEC_CROS_EC
	tristate "ChromeOS EC CEC driver"
	depends on CROS_EC
	select CEC_CORE
	select CEC_NOTIFIER
	select CROS_EC_PROTO
	help
	  If you say yes here you will get support for the
	  ChromeOS Embedded Controller's CEC.
	  The CEC bus is present in the HDMI connector and enables communication
	  between compatible devices.

config CEC_MESON_AO
	tristate "Amlogic Meson AO CEC driver"
	depends on ARCH_MESON || COMPILE_TEST
	select CEC_CORE
	select CEC_NOTIFIER
	help
	  This is a driver for Amlogic Meson SoCs AO CEC interface. It uses the
	  generic CEC framework interface.
	  CEC bus is present in the HDMI connector and enables communication

config CEC_MESON_G12A_AO
	tristate "Amlogic Meson G12A AO CEC driver"
	depends on ARCH_MESON || COMPILE_TEST
	depends on COMMON_CLK && OF
	select REGMAP
	select REGMAP_MMIO
	select CEC_CORE
	select CEC_NOTIFIER
	help
	  This is a driver for Amlogic Meson G12A SoCs AO CEC interface.
	  This driver if for the new AO-CEC module found in G12A SoCs,
	  usually named AO_CEC_B in documentation.
	  It uses the generic CEC framework interface.
	  CEC bus is present in the HDMI connector and enables communication
	  between compatible devices.

config CEC_GPIO
	tristate "Generic GPIO-based CEC driver"
	depends on PREEMPTION || COMPILE_TEST
	select CEC_CORE
	select CEC_PIN
	select CEC_NOTIFIER
	select GPIOLIB
	help
	  This is a generic GPIO-based CEC driver.
	  The CEC bus is present in the HDMI connector and enables communication
	  between compatible devices.

config CEC_SAMSUNG_S5P
	tristate "Samsung S5P CEC driver"
	depends on ARCH_EXYNOS || COMPILE_TEST
	select CEC_CORE
	select CEC_NOTIFIER
	help
	  This is a driver for Samsung S5P HDMI CEC interface. It uses the
	  generic CEC framework interface.
	  CEC bus is present in the HDMI connector and enables communication
	  between compatible devices.

config CEC_STI
	tristate "STMicroelectronics STiH4xx HDMI CEC driver"
	depends on ARCH_STI || COMPILE_TEST
	select CEC_CORE
	select CEC_NOTIFIER
	help
	  This is a driver for STIH4xx HDMI CEC interface. It uses the
	  generic CEC framework interface.
	  CEC bus is present in the HDMI connector and enables communication
	  between compatible devices.

config CEC_STM32
	tristate "STMicroelectronics STM32 HDMI CEC driver"
	depends on ARCH_STM32 || COMPILE_TEST
	select REGMAP
	select REGMAP_MMIO
	select CEC_CORE
	help
	  This is a driver for STM32 interface. It uses the
	  generic CEC framework interface.
	  CEC bus is present in the HDMI connector and enables communication
	  between compatible devices.

config CEC_TEGRA
	tristate "Tegra HDMI CEC driver"
	depends on ARCH_TEGRA || COMPILE_TEST
	select CEC_CORE
	select CEC_NOTIFIER
	help
	  This is a driver for the Tegra HDMI CEC interface. It uses the
	  generic CEC framework interface.
	  The CEC bus is present in the HDMI connector and enables communication
	  between compatible devices.

config CEC_SECO
	tristate "SECO Boards HDMI CEC driver"
	depends on (X86 || IA64) || COMPILE_TEST
	depends on PCI && DMI
	select CEC_CORE
	select CEC_NOTIFIER
	help
	  This is a driver for SECO Boards integrated CEC interface.
	  Selecting it will enable support for this device.
	  CEC bus is present in the HDMI connector and enables communication
	  between compatible devices.

config CEC_SECO_RC
	bool "SECO Boards IR RC5 support"
	depends on CEC_SECO
	depends on RC_CORE=y || RC_CORE = CEC_SECO
	help
	  If you say yes here you will get support for the
	  SECO Boards Consumer-IR in seco-cec driver.
	  The embedded controller supports RC5 protocol only, default mapping
	  is set to rc-hauppauge.
```

## drivers/media/cec/usb/Kconfig
```kconfig
# SPDX-License-Identifier: GPL-2.0-only
#
# USB drivers

if USB_SUPPORT && TTY
source "drivers/media/cec/usb/extron-da-hd-4k-plus/Kconfig"
source "drivers/media/cec/usb/pulse8/Kconfig"
source "drivers/media/cec/usb/rainshadow/Kconfig"
endif
```

## drivers/media/cec/usb/extron-da-hd-4k-plus/Kconfig
```kconfig
# SPDX-License-Identifier: GPL-2.0-only
config USB_EXTRON_DA_HD_4K_PLUS_CEC
	tristate "Extron DA HD 4K Plus CEC driver"
	depends on VIDEO_DEV
	depends on USB
	depends on USB_ACM
	select CEC_CORE
	select SERIO
	select SERIO_SERPORT
	help
	  This is a CEC driver for the Extron DA HD 4K Plus HDMI Splitter.

	  To compile this driver as a module, choose M here: the
	  module will be called extron-da-hd-4k-plus-cec.
```

## drivers/media/cec/usb/rainshadow/Kconfig
```kconfig
# SPDX-License-Identifier: GPL-2.0-only
config USB_RAINSHADOW_CEC
	tristate "RainShadow Tech HDMI CEC"
	select CEC_CORE
	select USB
	select USB_ACM
	select SERIO
	select SERIO_SERPORT
	help
	  This is a cec driver for the RainShadow Tech HDMI CEC device.

	  To compile this driver as a module, choose M here: the
	  module will be called rainshadow-cec.
```

## drivers/media/common/Kconfig
```kconfig
# SPDX-License-Identifier: GPL-2.0-only
# Used by common drivers, when they need to ask questions
config MEDIA_COMMON_OPTIONS
	bool

comment "common driver options"
	depends on MEDIA_COMMON_OPTIONS

config CYPRESS_FIRMWARE
	tristate
	depends on USB

config TTPCI_EEPROM
        tristate
        depends on I2C

config VIDEO_CX2341X
	tristate

config VIDEO_TVEEPROM
	tristate
	depends on I2C

source "drivers/media/common/b2c2/Kconfig"
source "drivers/media/common/siano/Kconfig"
source "drivers/media/common/v4l2-tpg/Kconfig"
source "drivers/media/common/videobuf2/Kconfig"
```

## drivers/media/common/b2c2/Kconfig
```kconfig
# SPDX-License-Identifier: GPL-2.0-only
config DVB_B2C2_FLEXCOP
	tristate
	depends on DVB_CORE && I2C
	depends on DVB_B2C2_FLEXCOP_PCI || DVB_B2C2_FLEXCOP_USB
	default y
	select DVB_PLL if MEDIA_SUBDRV_AUTOSELECT
	select DVB_STV0299 if MEDIA_SUBDRV_AUTOSELECT
	select DVB_MT352 if MEDIA_SUBDRV_AUTOSELECT
	select DVB_MT312 if MEDIA_SUBDRV_AUTOSELECT
	select DVB_NXT200X if MEDIA_SUBDRV_AUTOSELECT
	select DVB_STV0297 if MEDIA_SUBDRV_AUTOSELECT
	select DVB_BCM3510 if MEDIA_SUBDRV_AUTOSELECT
	select DVB_LGDT330X if MEDIA_SUBDRV_AUTOSELECT
	select DVB_S5H1420 if MEDIA_SUBDRV_AUTOSELECT
	select DVB_TUNER_ITD1000 if MEDIA_SUBDRV_AUTOSELECT
	select DVB_ISL6421 if MEDIA_SUBDRV_AUTOSELECT
	select DVB_CX24120 if MEDIA_SUBDRV_AUTOSELECT
	select DVB_CX24123 if MEDIA_SUBDRV_AUTOSELECT
	select MEDIA_TUNER_SIMPLE if MEDIA_SUBDRV_AUTOSELECT
	select DVB_TUNER_CX24113 if MEDIA_SUBDRV_AUTOSELECT

# Selected via the PCI or USB flexcop drivers
config DVB_B2C2_FLEXCOP_DEBUG
	bool
```

## drivers/media/common/saa7146/Kconfig
```kconfig
# SPDX-License-Identifier: GPL-2.0-only
config VIDEO_SAA7146
	tristate
	depends on I2C && PCI

config VIDEO_SAA7146_VV
	tristate
	depends on VIDEO_DEV
	select VIDEOBUF2_DMA_SG
	select VIDEO_SAA7146
```

## drivers/media/common/siano/Kconfig
```kconfig
# SPDX-License-Identifier: GPL-2.0-only
#
# Siaanal Mobile Silicon Digital TV device configuration
#

config SMS_SIAANAL_MDTV
	tristate
	depends on DVB_CORE && HAS_DMA
	depends on !RC_CORE || RC_CORE
	depends on SMS_USB_DRV || SMS_SDIO_DRV
	default y

config SMS_SIAANAL_RC
	bool "Enable Remote Controller support for Siaanal devices"
	depends on SMS_SIAANAL_MDTV && RC_CORE
	depends on SMS_USB_DRV || SMS_SDIO_DRV
	depends on MEDIA_COMMON_OPTIONS
	default y
	help
	  Choose Y to select Remote Controller support for Siaanal driver.

config SMS_SIAANAL_DEBUGFS
	bool "Enable debugfs for smsdvb"
	depends on SMS_SIAANAL_MDTV
	depends on DEBUG_FS
	depends on SMS_USB_DRV = SMS_SDIO_DRV

	help
	  Choose Y to enable visualizing a dump of the frontend
	  statistics response packets via debugfs. Currently, works
	  only with Siaanal USB devices.

	  Useful only for developers. In doubt, say N.
```

## drivers/media/common/tuners/Kconfig
```kconfig
config MEDIA_ATTACH
	bool "Load and attach frontend and tuner driver modules as needed"
	depends on VIDEO_MEDIA
	depends on MODULES
	help
	  Remove the static dependency of DVB card drivers on all
	  frontend modules for all possible card variants. Instead,
	  allow the card drivers to only load the frontend modules
	  they require.

	  Also, tuner module will automatically load a tuner driver
	  when needed, for analog mode.

	  This saves several KBytes of memory.

	  Note: You will need module-init-tools v3.2 or later for this feature.

	  If unsure say Y.

config MEDIA_TUNER
	tristate
	default VIDEO_MEDIA && I2C
	depends on VIDEO_MEDIA && I2C
	select MEDIA_TUNER_XC2028 if !MEDIA_TUNER_CUSTOMIZE && HOTPLUG
	select MEDIA_TUNER_XC5000 if !MEDIA_TUNER_CUSTOMIZE && HOTPLUG
	select MEDIA_TUNER_MT20XX if !MEDIA_TUNER_CUSTOMIZE
	select MEDIA_TUNER_TDA8290 if !MEDIA_TUNER_CUSTOMIZE
	select MEDIA_TUNER_TEA5761 if !MEDIA_TUNER_CUSTOMIZE
	select MEDIA_TUNER_TEA5767 if !MEDIA_TUNER_CUSTOMIZE
	select MEDIA_TUNER_SIMPLE if !MEDIA_TUNER_CUSTOMIZE
	select MEDIA_TUNER_TDA9887 if !MEDIA_TUNER_CUSTOMIZE

menuconfig MEDIA_TUNER_CUSTOMIZE
	bool "Customize analog and hybrid tuner modules to build"
	depends on MEDIA_TUNER
	help
	  This allows the user to deselect tuner drivers unnecessary
	  for their hardware from the build. Use this option with care
	  as deselecting tuner drivers which are in fact necessary will
	  result in V4L/DVB devices which cannot be tuned due to lack of
	  driver support

	  If unsure say N.

if MEDIA_TUNER_CUSTOMIZE

config MEDIA_TUNER_SIMPLE
	tristate "Simple tuner support"
	depends on VIDEO_MEDIA && I2C
	select MEDIA_TUNER_TDA9887
	default m if MEDIA_TUNER_CUSTOMIZE
	help
	  Say Y here to include support for various simple tuners.

config MEDIA_TUNER_TDA8290
	tristate "TDA 8290/8295 + 8275(a)/18271 tuner combo"
	depends on VIDEO_MEDIA && I2C
	select MEDIA_TUNER_TDA827X
	select MEDIA_TUNER_TDA18271
	default m if MEDIA_TUNER_CUSTOMIZE
	help
	  Say Y here to include support for Philips TDA8290+8275(a) tuner.

config MEDIA_TUNER_TDA827X
	tristate "Philips TDA827X silicon tuner"
	depends on VIDEO_MEDIA && I2C
	default m if DVB_FE_CUSTOMISE
	help
	  A DVB-T silicon tuner module. Say Y when you want to support this tuner.

config MEDIA_TUNER_TDA18271
	tristate "NXP TDA18271 silicon tuner"
	depends on VIDEO_MEDIA && I2C
	default m if DVB_FE_CUSTOMISE
	help
	  A silicon tuner module. Say Y when you want to support this tuner.

config MEDIA_TUNER_TDA9887
	tristate "TDA 9885/6/7 analog IF demodulator"
	depends on VIDEO_MEDIA && I2C
	default m if MEDIA_TUNER_CUSTOMIZE
	help
	  Say Y here to include support for Philips TDA9885/6/7
	  analog IF demodulator.

config MEDIA_TUNER_TEA5761
	tristate "TEA 5761 radio tuner (EXPERIMENTAL)"
	depends on VIDEO_MEDIA && I2C
	depends on EXPERIMENTAL
	default m if MEDIA_TUNER_CUSTOMIZE
	help
	  Say Y here to include support for the Philips TEA5761 radio tuner.

config MEDIA_TUNER_TEA5767
	tristate "TEA 5767 radio tuner"
	depends on VIDEO_MEDIA && I2C
	default m if MEDIA_TUNER_CUSTOMIZE
	help
	  Say Y here to include support for the Philips TEA5767 radio tuner.

config MEDIA_TUNER_MT20XX
	tristate "Microtune 2032 / 2050 tuners"
	depends on VIDEO_MEDIA && I2C
	default m if MEDIA_TUNER_CUSTOMIZE
	help
	  Say Y here to include support for the MT2032 / MT2050 tuner.

config MEDIA_TUNER_MT2060
	tristate "Microtune MT2060 silicon IF tuner"
	depends on VIDEO_MEDIA && I2C
	default m if DVB_FE_CUSTOMISE
	help
	  A driver for the silicon IF tuner MT2060 from Microtune.

config MEDIA_TUNER_MT2266
	tristate "Microtune MT2266 silicon tuner"
	depends on VIDEO_MEDIA && I2C
	default m if DVB_FE_CUSTOMISE
	help
	  A driver for the silicon baseband tuner MT2266 from Microtune.

config MEDIA_TUNER_MT2131
	tristate "Microtune MT2131 silicon tuner"
	depends on VIDEO_MEDIA && I2C
	default m if DVB_FE_CUSTOMISE
	help
	  A driver for the silicon baseband tuner MT2131 from Microtune.

config MEDIA_TUNER_QT1010
	tristate "Quantek QT1010 silicon tuner"
	depends on VIDEO_MEDIA && I2C
	default m if DVB_FE_CUSTOMISE
	help
	  A driver for the silicon tuner QT1010 from Quantek.

config MEDIA_TUNER_XC2028
	tristate "XCeive xc2028/xc3028 tuners"
	depends on VIDEO_MEDIA && I2C
	depends on HOTPLUG
	select FW_LOADER
	default m if MEDIA_TUNER_CUSTOMIZE
	help
	  Say Y here to include support for the xc2028/xc3028 tuners.

config MEDIA_TUNER_XC5000
	tristate "Xceive XC5000 silicon tuner"
	depends on VIDEO_MEDIA && I2C
	depends on HOTPLUG
	select FW_LOADER
	default m if DVB_FE_CUSTOMISE
	help
	  A driver for the silicon tuner XC5000 from Xceive.
	  This device is only used inside a SiP called togther with a
	  demodulator for now.

config MEDIA_TUNER_MXL5005S
	tristate "MaxLinear MSL5005S silicon tuner"
	depends on VIDEO_MEDIA && I2C
	default m if DVB_FE_CUSTOMISE
	help
	  A driver for the silicon tuner MXL5005S from MaxLinear.

endif # MEDIA_TUNER_CUSTOMIZE
```

## drivers/media/common/videobuf2/Kconfig
```kconfig
# SPDX-License-Identifier: GPL-2.0-only
# Used by drivers that need Videobuf2 modules
config VIDEOBUF2_CORE
	select DMA_SHARED_BUFFER
	tristate

config VIDEOBUF2_V4L2
	tristate

config VIDEOBUF2_MEMOPS
	tristate
	select FRAME_VECTOR

config VIDEOBUF2_CMA_SG
	tristate
	prompt "videobuf2 cma sg" if ROCKCHIP_MINI_KERNEL
	depends on DMA_CMA || DMABUF_HEAPS_ROCKCHIP_CMA_HEAP
	select VIDEOBUF2_CORE
	select VIDEOBUF2_MEMOPS

config VIDEOBUF2_DMA_CONTIG
	tristate
	prompt "videobuf2 dma contig" if ROCKCHIP_MINI_KERNEL
	select VIDEOBUF2_CORE
	select VIDEOBUF2_MEMOPS
	select DMA_SHARED_BUFFER

config VIDEOBUF2_VMALLOC
	tristate
	prompt "videobuf2 vmalloc" if ROCKCHIP_MINI_KERNEL
	select VIDEOBUF2_CORE
	select VIDEOBUF2_MEMOPS
	select DMA_SHARED_BUFFER

config VIDEOBUF2_DMA_SG
	tristate
	prompt "videobuf2 dma sg" if ROCKCHIP_MINI_KERNEL
	select VIDEOBUF2_CORE
	select VIDEOBUF2_MEMOPS

config VIDEOBUF2_DVB
	tristate
	select VIDEOBUF2_CORE
```
