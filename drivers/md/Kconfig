## drivers/md/bcache/Kconfig
```kconfig
# SPDX-License-Identifier: GPL-2.0-only

config BCACHE
	tristate "Block device as cache"
	select BLOCK_HOLDER_DEPRECATED if SYSFS
	select CRC64
	select CLOSURES
	help
	Allows a block device to be used as cache for other devices; uses
	a btree for indexing and the layout is optimized for SSDs.

	See Documentation/admin-guide/bcache.rst for details.

config BCACHE_DEBUG
	bool "Bcache debugging"
	depends on BCACHE
	help
	Don't select this option unless you're a developer

	Enables extra debugging tools, allows expensive runtime checks to be
	turned on.

config BCACHE_ASYNC_REGISTRATION
	bool "Asynchronous device registration"
	depends on BCACHE
	help
	Add a sysfs file /sys/fs/bcache/register_async. Writing registering
	device path into this file will returns immediately and the real
	registration work is handled in kernel work queue in asynchronous
	way.
```

## drivers/md/dm-pcache/Kconfig
```kconfig
config DM_PCACHE
	tristate "Persistent cache for Block Device (Experimental)"
	depends on BLK_DEV_DM
	depends on DEV_DAX
	help
	  PCACHE provides a mechanism to use persistent memory (e.g., CXL persistent memory,
	  DAX-enabled devices) as a high-performance cache layer in front of
	  traditional block devices such as SSDs or HDDs.

	  PCACHE is implemented as a kernel module that integrates with the block
	  layer and supports direct access (DAX) to persistent memory for low-latency,
	  byte-addressable caching.

	  Note: This feature is experimental and should be tested thoroughly
	  before use in production environments.

	  If unsure, say 'N'.
```

## drivers/md/dm-vdo/Kconfig
```kconfig
# SPDX-License-Identifier: GPL-2.0-only

config DM_VDO
	tristate "VDO: deduplication and compression target"
	depends on 64BIT
	depends on BLK_DEV_DM
	select DM_BUFIO
	select LZ4_COMPRESS
	select LZ4_DECOMPRESS
	help
	  This device mapper target presents a block device with
	  deduplication, compression and thin-provisioning.

	  To compile this code as a module, choose M here: the module will
	  be called dm-vdo.

	  If unsure, say N.
```

## drivers/md/persistent-data/Kconfig
```kconfig
# SPDX-License-Identifier: GPL-2.0-only
config DM_PERSISTENT_DATA
       tristate
       depends on BLK_DEV_DM
       select CRC32
       select DM_BUFIO
	help
	 Library providing immutable on-disk data structure support for
	 device-mapper targets such as the thin provisioning target.
```

## drivers/media/IR/Kconfig
```kconfig
menuconfig IR_CORE
	tristate "Infrared remote controller adapters"
	depends on INPUT
	default INPUT
	---help---
	  Enable support for Remote Controllers on Linux. This is
	  needed in order to support several video capture adapters.

	  Enable this option if you have a video capture board even
	  if you don't need IR, as otherwise, you may not be able to
	  compile the driver for your adapter.

config VIDEO_IR
	tristate
	depends on IR_CORE
	default IR_CORE

if IR_CORE

config LIRC
	tristate
	default y

	---help---
	   Enable this option to build the Linux Infrared Remote
	   Control (LIRC) core device interface driver. The LIRC
	   interface passes raw IR to and from userspace, where the
	   LIRC daemon handles protocol decoding for IR reception and
	   encoding for IR transmitting (aka "blasting").

source "drivers/media/IR/keymaps/Kconfig"

config IR_NEC_DECODER
	tristate "Enable IR raw decoder for the NEC protocol"
	depends on IR_CORE
	select BITREVERSE
	default y

	---help---
	   Enable this option if you have IR with NEC protocol, and
	   if the IR is decoded in software

config IR_RC5_DECODER
	tristate "Enable IR raw decoder for the RC-5 protocol"
	depends on IR_CORE
	select BITREVERSE
	default y

	---help---
	   Enable this option if you have IR with RC-5 protocol, and
	   if the IR is decoded in software

config IR_RC6_DECODER
	tristate "Enable IR raw decoder for the RC6 protocol"
	depends on IR_CORE
	select BITREVERSE
	default y

	---help---
	   Enable this option if you have an infrared remote control which
	   uses the RC6 protocol, and you need software decoding support.

config IR_JVC_DECODER
	tristate "Enable IR raw decoder for the JVC protocol"
	depends on IR_CORE
	select BITREVERSE
	default y

	---help---
	   Enable this option if you have an infrared remote control which
	   uses the JVC protocol, and you need software decoding support.

config IR_SONY_DECODER
	tristate "Enable IR raw decoder for the Sony protocol"
	depends on IR_CORE
	default y

	---help---
	   Enable this option if you have an infrared remote control which
	   uses the Sony protocol, and you need software decoding support.

config IR_LIRC_CODEC
	tristate "Enable IR to LIRC bridge"
	depends on IR_CORE
	depends on LIRC
	default y

	---help---
	   Enable this option to pass raw IR to and from userspace via
	   the LIRC interface.

config IR_IMON
	tristate "SoundGraph iMON Receiver and Display"
	depends on USB_ARCH_HAS_HCD
	depends on IR_CORE
	select USB
	---help---
	   Say Y here if you want to use a SoundGraph iMON (aka Antec Veris)
	   IR Receiver and/or LCD/VFD/VGA display.

	   To compile this driver as a module, choose M here: the
	   module will be called imon.

config IR_MCEUSB
	tristate "Windows Media Center Ed. eHome Infrared Transceiver"
	depends on USB_ARCH_HAS_HCD
	depends on IR_CORE
	select USB
	---help---
	   Say Y here if you want to use a Windows Media Center Edition
	   eHome Infrared Transceiver.

	   To compile this driver as a module, choose M here: the
	   module will be called mceusb.

config IR_ENE
	tristate "ENE eHome Receiver/Transciever (pnp id: ENE0100/ENE02xxx)"
	depends on PNP
	depends on IR_CORE
	---help---
	   Say Y here to enable support for integrated infrared receiver
	   /transciever made by ENE.

	   You can see if you have it by looking at lspnp output.
	   Output should include ENE0100 ENE0200 or something similiar.

	   To compile this driver as a module, choose M here: the
	   module will be called ene_ir.

config IR_STREAMZAP
	tristate "Streamzap PC Remote IR Receiver"
	depends on USB_ARCH_HAS_HCD
	depends on IR_CORE
	select USB
	---help---
	   Say Y here if you want to use a Streamzap PC Remote
	   Infrared Receiver.

	   To compile this driver as a module, choose M here: the
	   module will be called streamzap.

endif #IR_CORE
```

## drivers/media/IR/keymaps/Kconfig
```kconfig
config RC_MAP
	tristate "Compile Remote Controller keymap modules"
	depends on IR_CORE
	default y

	---help---
	   This option enables the compilation of lots of Remote
	   Controller tables. They are short tables, but if you
	   don't use a remote controller, or prefer to load the
	   tables on userspace, you should disable it.

	   The ir-keytable program, available at v4l-utils package
	   provide the tool and the same RC maps for load from
	   userspace. Its available at
			http://git.linuxtv.org/v4l-utils
```

## drivers/media/Kconfig
```kconfig
# SPDX-License-Identifier: GPL-2.0-only
#
# Multimedia device configuration
#

#
# NOTE: CEC and Remote Controller support should not depend on MEDIA_SUPPORT
#
source "drivers/media/rc/Kconfig"
source "drivers/media/cec/Kconfig"

menuconfig MEDIA_SUPPORT
	tristate "Multimedia support"
	depends on HAS_IOMEM
	help
	  If you want to use media devices, including Webcams, Video grabber
	  devices and/or TV devices, V4L2 codecs, etc, enable this option
	  and other options below.

	  Additional info and docs are available on the web at
	  <https://linuxtv.org>

if MEDIA_SUPPORT

config MEDIA_SUPPORT_FILTER
	bool "Filter media drivers"
	default y if !EMBEDDED && !EXPERT
	help
	   Configuring the media subsystem can be complex, as there are
	   hundreds of drivers and other config options.

	   This menu offers option that will help the Kernel's config
	   system to hide drivers that are out of the scope of the
	   user needs, and disabling core support for unused APIs.

	   If not selected, all non-optional media core functionality
	   needed to support media drivers will be enabled. Also, all
	   media device drivers should be shown.

config MEDIA_SUBDRV_AUTOSELECT
	bool "Autoselect ancillary drivers (tuners, sensors, i2c, spi, frontends)"
	depends on HAS_IOMEM
	select I2C
	select I2C_MUX
	default y if MEDIA_SUPPORT_FILTER
	help
	  By default, a media driver auto-selects all possible ancillary
	  devices such as tuners, sensors, video encoders/decoders and
	  frontends, that are used by any of the supported devices.

	  This is generally the right thing to do, except when there
	  are strict constraints with regards to the kernel size,
	  like on embedded systems.

	  Use this option with care, as deselecting ancillary drivers which
	  are, in fact, necessary will result in the lack of the needed
	  functionality for your device (it may not tune or may not have
	  the needed demodulators).

	  If unsure say Y.

menu "Media device types"

#
# Multimedia support - automatically enable V4L2 and DVB core
#
config MEDIA_CAMERA_SUPPORT
	bool
	prompt "Cameras and video grabbers" if MEDIA_SUPPORT_FILTER
	default y if !MEDIA_SUPPORT_FILTER
	help
	  Enable support for webcams and video grabbers.

	  Say Y when you have a webcam or a video capture grabber board.

config MEDIA_ANALOG_TV_SUPPORT
	bool
	prompt "Analog TV" if MEDIA_SUPPORT_FILTER
	default y if !MEDIA_SUPPORT_FILTER
	help
	  Enable analog TV support.

	  Say Y when you have a TV board with analog support or with a
	  hybrid analog/digital TV chipset.

	  Note: There are several DVB cards that are based on chips that
		support both analog and digital TV. Disabling this option
		will disable support for them.

config MEDIA_DIGITAL_TV_SUPPORT
	bool
	prompt "Digital TV" if MEDIA_SUPPORT_FILTER
	default y if !MEDIA_SUPPORT_FILTER
	help
	  Enable digital TV support.

	  Say Y when you have a board with digital support or a board with
	  hybrid digital TV and analog TV.

config MEDIA_RADIO_SUPPORT
	bool
	prompt "AM/FM radio receivers/transmitters" if MEDIA_SUPPORT_FILTER
	default y if !MEDIA_SUPPORT_FILTER
	help
	  Enable AM/FM radio support.

	  Additional info and docs are available on the web at
	  <https://linuxtv.org>

	  Say Y when you have a board with radio support.

	  Note: There are several TV cards that are based on chips that
		support radio reception. Disabling this option will
		disable support for them.

config MEDIA_SDR_SUPPORT
	bool
	prompt "Software defined radio" if MEDIA_SUPPORT_FILTER
	default y if !MEDIA_SUPPORT_FILTER
	help
	  Enable software defined radio support.

	  Say Y when you have a software defined radio device.

config MEDIA_PLATFORM_SUPPORT
	bool
	prompt "Platform-specific devices" if MEDIA_SUPPORT_FILTER
	default y if !MEDIA_SUPPORT_FILTER
	help
	  Enable support for complex cameras, codecs, and other hardware
	  that are integrated at the CPU, GPU or on Image Signalling Processor
	  and don't use PCI, USB or Firewire buses.

	  This is found on Embedded hardware (SoC), on V4L2 codecs and
	  on some GPU and newer CPU chipsets.

	  Say Y when you want to be able to see such devices.

config MEDIA_TEST_SUPPORT
	bool
	prompt "Test drivers" if MEDIA_SUPPORT_FILTER
	default y if !MEDIA_SUPPORT_FILTER
	help
	  Those drivers should not be used on production Kernels, but
	  can be useful on debug ones. It enables several dummy drivers
	  that simulate a real hardware. Very useful to test userspace
	  applications and to validate if the subsystem core is doesn't
	  have regressions.

	  Say Y if you want to use some virtual test driver.

	  In case of doubts, say N.
	  Say Y when you have a software defined radio device.
endmenu # media device types


menu "Media core support"
	visible if !MEDIA_SUPPORT_FILTER

config VIDEO_DEV
	tristate "Video4Linux core"
	default MEDIA_CAMERA_SUPPORT || MEDIA_ANALOG_TV_SUPPORT || MEDIA_RADIO_SUPPORT || MEDIA_SDR_SUPPORT || MEDIA_PLATFORM_SUPPORT || MEDIA_TEST_SUPPORT
	help
	  Enables the V4L2 API, used by cameras, analog TV, video grabbers,
	  radio devices and by some input devices.

config MEDIA_CONTROLLER
	bool "Media Controller API"
	default MEDIA_CAMERA_SUPPORT || MEDIA_ANALOG_TV_SUPPORT || MEDIA_DIGITAL_TV_SUPPORT || MEDIA_PLATFORM_SUPPORT
	help
	  Enable the media controller API used to query media devices internal
	  topology and configure it dynamically.

	  This API is mostly used by camera interfaces in embedded platforms.

#
# DVB Core
#	Only enables if one of DTV is selected
#

config DVB_CORE
	tristate
	depends on MEDIA_DIGITAL_TV_SUPPORT
	depends on (I2C || I2C=n)
	default MEDIA_DIGITAL_TV_SUPPORT
	select CRC32
	help
	  Enables the DVB API, used by Digital TV devices. Supports several
	  standards, including DVB, ATSC, ISDB and CMDB.

endmenu # Media core support

#
# Extra per-media API core functionality

menu "Video4Linux options"
	visible if VIDEO_DEV

source "drivers/media/v4l2-core/Kconfig"
endmenu

menu "Media controller options"
	visible if MEDIA_CONTROLLER

source "drivers/media/mc/Kconfig"
endmenu

menu "Digital TV options"
	visible if DVB_CORE

source "drivers/media/dvb-core/Kconfig"
endmenu

menu "Media drivers"

comment "Drivers filtered as selected at 'Filter media drivers'"
	depends on MEDIA_SUPPORT_FILTER

source "drivers/media/usb/Kconfig"
source "drivers/media/pci/Kconfig"
source "drivers/media/radio/Kconfig"

# Common driver options
source "drivers/media/common/Kconfig"

if MEDIA_PLATFORM_SUPPORT
source "drivers/media/platform/Kconfig"
source "drivers/media/mmc/Kconfig"
endif

if MEDIA_TEST_SUPPORT
source "drivers/media/test-drivers/Kconfig"
endif

source "drivers/media/firewire/Kconfig"

endmenu

#
# Ancillary drivers (tuners, i2c, spi, frontends)
#

config MEDIA_HIDE_ANCILLARY_SUBDRV
	bool
	depends on MEDIA_SUBDRV_AUTOSELECT && !COMPILE_TEST && !EXPERT
	default y

menu "Media ancillary drivers"

config MEDIA_ATTACH
	bool
	depends on MEDIA_ANALOG_TV_SUPPORT || MEDIA_DIGITAL_TV_SUPPORT || MEDIA_RADIO_SUPPORT
	depends on MODULES
	default MODULES

source "drivers/media/i2c/Kconfig"
source "drivers/media/spi/Kconfig"
source "drivers/media/tuners/Kconfig"
source "drivers/media/dvb-frontends/Kconfig"

endmenu

endif # MEDIA_SUPPORT
```

## drivers/media/audio/Kconfig
```kconfig
config ACE_CONFIG
	tristate "ace modlue manage clock"
	default y
	depends on AUDIO_ENGINE
```

## drivers/media/cec/Kconfig
```kconfig
# SPDX-License-Identifier: GPL-2.0-only
config CEC_CORE
	tristate

config CEC_NOTIFIER
	bool

config CEC_PIN
	bool

menu "CEC support"

config MEDIA_CEC_RC
	bool "HDMI CEC RC integration"
	depends on CEC_CORE && RC_CORE
	depends on CEC_CORE=m || RC_CORE=y
	help
	  Pass on CEC remote control messages to the RC framework.

config CEC_PIN_ERROR_INJ
	bool "Enable CEC error injection support"
	depends on CEC_PIN && DEBUG_FS
	help
	  This option enables CEC error injection using debugfs.

menuconfig MEDIA_CEC_SUPPORT
	bool
	prompt "HDMI CEC drivers"
	default y if MEDIA_SUPPORT && !MEDIA_SUPPORT_FILTER
	help
	  Enable support for HDMI CEC (Consumer Electronics Control),
	  which is an optional HDMI feature.

	  Say Y when you have an HDMI receiver, transmitter or a USB CEC
	  adapter that supports HDMI CEC.

if MEDIA_CEC_SUPPORT
source "drivers/media/cec/i2c/Kconfig"
source "drivers/media/cec/platform/Kconfig"
source "drivers/media/cec/usb/Kconfig"
endif

endmenu
```

## drivers/media/cec/i2c/Kconfig
```kconfig
# SPDX-License-Identifier: GPL-2.0
#
# I2C drivers

config CEC_CH7322
	tristate "Chrontel CH7322 CEC controller"
	depends on I2C
	select REGMAP
	select REGMAP_I2C
	select CEC_CORE
	help
	  This is a driver for the Chrontel CH7322 CEC controller. It uses the
	  generic CEC framework interface.
	  CEC bus is present in the HDMI connector and enables communication
	  between compatible devices.

config CEC_NXP_TDA9950
	tristate "NXP Semiconductors TDA9950/TDA998X HDMI CEC"
	depends on I2C
	select CEC_NOTIFIER
	select CEC_CORE
	default DRM_I2C_NXP_TDA998X
	help
	  This is a driver for the NXP TDA9950 CEC controller and for the CEC
	  controller block integrated into several NXP TDA998x HDMI encoders.
```
