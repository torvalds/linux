## drivers/crypto/starfive/Kconfig
```kconfig
#
# StarFive crypto drivers configuration
#

config CRYPTO_DEV_JH7110
	tristate "StarFive JH7110 cryptographic engine driver"
	depends on (SOC_STARFIVE && AMBA_PL08X) || COMPILE_TEST
	depends on HAS_DMA
	select CRYPTO_ENGINE
	select CRYPTO_HMAC
	select CRYPTO_SHA256
	select CRYPTO_SHA512
	select CRYPTO_SM3_GENERIC
	select CRYPTO_RSA
	select CRYPTO_AES
	select CRYPTO_CCM
	select CRYPTO_GCM
	select CRYPTO_ECB
	select CRYPTO_CBC
	select CRYPTO_CTR
	help
	  Support for StarFive JH7110 crypto hardware acceleration engine.
	  This module provides acceleration for public key algo,
	  skciphers, AEAD and hash functions.

	  If you choose 'M' here, this module will be called jh7110-crypto.
```

## drivers/crypto/stm32/Kconfig
```kconfig
# SPDX-License-Identifier: GPL-2.0-only
config CRYPTO_DEV_STM32_CRC
	tristate "Support for STM32 crc accelerators"
	depends on ARCH_STM32
	select CRYPTO_HASH
	select CRC32
	help
	  This enables support for the CRC32 hw accelerator which can be found
	  on STMicroelectronics STM32 SOC.

config CRYPTO_DEV_STM32_HASH
	tristate "Support for STM32 hash accelerators"
	depends on ARCH_STM32
	depends on HAS_DMA
	select CRYPTO_HASH
	select CRYPTO_MD5
	select CRYPTO_SHA1
	select CRYPTO_SHA256
	select CRYPTO_ENGINE
	help
	  This enables support for the HASH hw accelerator which can be found
	  on STMicroelectronics STM32 SOC.

config CRYPTO_DEV_STM32_CRYP
	tristate "Support for STM32 cryp accelerators"
	depends on ARCH_STM32
	select CRYPTO_HASH
	select CRYPTO_ENGINE
	select CRYPTO_LIB_DES
	help
	  This enables support for the CRYP (AES/DES/TDES) hw accelerator which
	  can be found on STMicroelectronics STM32 SOC.
```

## drivers/crypto/ti/Kconfig
```kconfig
# SPDX-License-Identifier: GPL-2.0-only
config CRYPTO_DEV_TI_DTHEV2
	tristate "Support for TI DTHE V2 cryptography engine"
	depends on ARCH_K3 || COMPILE_TEST
	select CRYPTO_ENGINE
	select CRYPTO_SKCIPHER
	select CRYPTO_ECB
	select CRYPTO_CBC
	help
	  This enables support for the TI DTHE V2 hw cryptography engine
	  which can be found on TI K3 SOCs. Selecting this enables use
	  of hardware offloading for cryptographic algorithms on
	  these devices, providing enhanced resistance against side-channel
	  attacks.
```

## drivers/crypto/ux500/Kconfig
```kconfig
# SPDX-License-Identifier: GPL-2.0-only
#
# Copyright (C) ST-Ericsson SA 2010
# Author: Shujuan Chen (shujuan.chen@stericsson.com)
#

config CRYPTO_DEV_UX500_CRYP
	tristate "UX500 crypto driver for CRYP block"
	depends on CRYPTO_DEV_UX500
	select CRYPTO_ALGAPI
	select CRYPTO_SKCIPHER
	select CRYPTO_LIB_DES
	help
	This selects the crypto driver for the UX500_CRYP hardware. It supports
	AES-ECB, CBC and CTR with keys sizes of 128, 192 and 256 bit sizes.

config CRYPTO_DEV_UX500_HASH
	tristate "UX500 crypto driver for HASH block"
	depends on CRYPTO_DEV_UX500
	select CRYPTO_HASH
	select CRYPTO_SHA1
	select CRYPTO_SHA256
	help
	  This selects the hash driver for the UX500_HASH hardware.
	  Depends on UX500/STM DMA if running in DMA mode.

config CRYPTO_DEV_UX500_DEBUG
	bool "Activate ux500 platform debug-mode for crypto and hash block"
	depends on CRYPTO_DEV_UX500_CRYP || CRYPTO_DEV_UX500_HASH
	help
	  Say Y if you want to add debug prints to ux500_hash and
	  ux500_cryp devices.
```

## drivers/crypto/virtio/Kconfig
```kconfig
# SPDX-License-Identifier: GPL-2.0-only
config CRYPTO_DEV_VIRTIO
	tristate "VirtIO crypto driver"
	depends on VIRTIO
	select CRYPTO_AEAD
	select CRYPTO_SKCIPHER
	select CRYPTO_ENGINE
	default m
	help
	  This driver provides support for virtio crypto device. If you
	  choose 'M' here, this module will be called virtio_crypto.
```

## drivers/crypto/vmx/Kconfig
```kconfig
config CRYPTO_DEV_VMX_ENCRYPT
	tristate "Encryption acceleration support on P8 CPU"
	depends on PPC64 && CRYPTO_DEV_VMX
	default y
	help
	  Support for VMX cryptographic acceleration instructions on Power8 CPU.
	  This module supports acceleration for AES and GHASH in hardware. If you
	  choose 'M' here, this module will be called vmx-crypto.
```

## drivers/cxl/Kconfig
```kconfig
# SPDX-License-Identifier: GPL-2.0-only
menuconfig CXL_BUS
	tristate "CXL (Compute Express Link) Devices Support"
	depends on PCI
	select FW_LOADER
	select FW_UPLOAD
	select PCI_DOE
	select FIRMWARE_TABLE
	select NUMA_KEEP_MEMINFO if NUMA_MEMBLKS
	select FWCTL if CXL_FEATURES
	help
	  CXL is a bus that is electrically compatible with PCI Express, but
	  layers three protocols on that signalling (CXL.io, CXL.cache, and
	  CXL.mem). The CXL.cache protocol allows devices to hold cachelines
	  locally, the CXL.mem protocol allows devices to be fully coherent
	  memory targets, the CXL.io protocol is equivalent to PCI Express.
	  Say 'y' to enable support for the configuration and management of
	  devices supporting these protocols.

if CXL_BUS

config CXL_PCI
	tristate "PCI manageability"
	default CXL_BUS
	help
	  The CXL specification defines a "CXL memory device" sub-class in the
	  PCI "memory controller" base class of devices. Device's identified by
	  this class code provide support for volatile and / or persistent
	  memory to be mapped into the system address map (Host-managed Device
	  Memory (HDM)).

	  Say 'y/m' to enable a driver that will attach to CXL memory expander
	  devices enumerated by the memory device class code for configuration
	  and management primarily via the mailbox interface. See Chapter 2.3
	  Type 3 CXL Device in the CXL 2.0 specification for more details.

	  If unsure say 'm'.

config CXL_MEM_RAW_COMMANDS
	bool "RAW Command Interface for Memory Devices"
	depends on CXL_PCI
	help
	  Enable CXL RAW command interface.

	  The CXL driver ioctl interface may assign a kernel ioctl command
	  number for each specification defined opcode. At any given point in
	  time the number of opcodes that the specification defines and a device
	  may implement may exceed the kernel's set of associated ioctl function
	  numbers. The mismatch is either by omission, specification is too new,
	  or by design. When prototyping new hardware, or developing / debugging
	  the driver it is useful to be able to submit any possible command to
	  the hardware, even commands that may crash the kernel due to their
	  potential impact to memory currently in use by the kernel.

	  If developing CXL hardware or the driver say Y, otherwise say N.

config CXL_ACPI
	tristate "CXL ACPI: Platform Support"
	depends on ACPI
	depends on ACPI_NUMA
	default CXL_BUS
	select ACPI_TABLE_LIB
	select ACPI_HMAT
	select CXL_PORT
	help
	  Enable support for host managed device memory (HDM) resources
	  published by a platform's ACPI CXL memory layout description.  See
	  Chapter 9.14.1 CXL Early Discovery Table (CEDT) in the CXL 2.0
	  specification, and CXL Fixed Memory Window Structures (CEDT.CFMWS)
	  (https://www.computeexpresslink.org/spec-landing). The CXL core
	  consumes these resource to publish the root of a cxl_port decode
	  hierarchy to map regions that represent System RAM, or Persistent
	  Memory regions to be managed by LIBNVDIMM.

	  If unsure say 'm'.

config CXL_PMEM
	tristate "CXL PMEM: Persistent Memory Support"
	depends on LIBNVDIMM
	default CXL_BUS
	help
	  In addition to typical memory resources a platform may also advertise
	  support for persistent memory attached via CXL. This support is
	  managed via a bridge driver from CXL to the LIBNVDIMM system
	  subsystem. Say 'y/m' to enable support for enumerating and
	  provisioning the persistent memory capacity of CXL memory expanders.

	  If unsure say 'm'.

config CXL_MEM
	tristate "CXL: Memory Expansion"
	depends on CXL_PCI
	default CXL_BUS
	help
	  The CXL.mem protocol allows a device to act as a provider of "System
	  RAM" and/or "Persistent Memory" that is fully coherent as if the
	  memory were attached to the typical CPU memory controller. This is
	  known as HDM "Host-managed Device Memory".

	  Say 'y/m' to enable a driver that will attach to CXL.mem devices for
	  memory expansion and control of HDM. See Chapter 9.13 in the CXL 2.0
	  specification for a detailed description of HDM.

	  If unsure say 'm'.

config CXL_FEATURES
	bool "CXL: Features"
	depends on CXL_PCI
	help
	  Enable support for CXL Features. A CXL device that includes a mailbox
	  supports commands that allows listing, getting, and setting of
	  optionally defined features such as memory sparing or post package
	  sparing. Vendors may define custom features for the device.

	  If unsure say 'n'

config CXL_EDAC_MEM_FEATURES
	bool "CXL: EDAC Memory Features"
	depends on EXPERT
	depends on CXL_MEM
	depends on CXL_FEATURES
	depends on EDAC >= CXL_BUS
	help
	  The CXL EDAC memory feature is optional and allows host to
	  control the EDAC memory features configurations of CXL memory
	  expander devices.

	  Say 'y' if you have an expert need to change default settings
	  of a memory RAS feature established by the platform/device.
	  Otherwise say 'n'.

config CXL_EDAC_SCRUB
	bool "Enable CXL Patrol Scrub Control (Patrol Read)"
	depends on CXL_EDAC_MEM_FEATURES
	depends on EDAC_SCRUB
	help
	  The CXL EDAC scrub control is optional and allows host to
	  control the scrub feature configurations of CXL memory expander
	  devices.

	  When enabled 'cxl_mem' and 'cxl_region' EDAC devices are
	  published with memory scrub control attributes as described by
	  Documentation/ABI/testing/sysfs-edac-scrub.

	  Say 'y' if you have an expert need to change default settings
	  of a memory scrub feature established by the platform/device
	  (e.g. scrub rates for the patrol scrub feature).
	  Otherwise say 'n'.

config CXL_EDAC_ECS
	bool "Enable CXL Error Check Scrub (Repair)"
	depends on CXL_EDAC_MEM_FEATURES
	depends on EDAC_ECS
	help
	  The CXL EDAC ECS control is optional and allows host to
	  control the ECS feature configurations of CXL memory expander
	  devices.

	  When enabled 'cxl_mem' EDAC devices are published with memory
	  ECS control attributes as described by
	  Documentation/ABI/testing/sysfs-edac-ecs.

	  Say 'y' if you have an expert need to change default settings
	  of a memory ECS feature established by the platform/device.
	  Otherwise say 'n'.

config CXL_EDAC_MEM_REPAIR
	bool "Enable CXL Memory Repair"
	depends on CXL_EDAC_MEM_FEATURES
	depends on EDAC_MEM_REPAIR
	help
	  The CXL EDAC memory repair control is optional and allows host
	  to control the memory repair features (e.g. sparing, PPR)
	  configurations of CXL memory expander devices.

	  When enabled, the memory repair feature requires an additional
	  memory of approximately 43KB to store CXL DRAM and CXL general
	  media event records.

	  When enabled 'cxl_mem' EDAC devices are published with memory
	  repair control attributes as described by
	  Documentation/ABI/testing/sysfs-edac-memory-repair.

	  Say 'y' if you have an expert need to change default settings
	  of a memory repair feature established by the platform/device.
	  Otherwise say 'n'.

config CXL_PORT
	default CXL_BUS
	tristate

config CXL_SUSPEND
	def_bool y
	depends on SUSPEND && CXL_MEM

config CXL_REGION
	bool "CXL: Region Support"
	default CXL_BUS
	# For MAX_PHYSMEM_BITS
	depends on SPARSEMEM
	select MEMREGION
	select GET_FREE_REGION
	help
	  Enable the CXL core to enumerate and provision CXL regions. A CXL
	  region is defined by one or more CXL expanders that decode a given
	  system-physical address range. For CXL regions established by
	  platform-firmware this option enables memory error handling to
	  identify the devices participating in a given interleaved memory
	  range. Otherwise, platform-firmware managed CXL is enabled by being
	  placed in the system address map and does not need a driver.

	  If unsure say 'y'

config CXL_REGION_INVALIDATION_TEST
	bool "CXL: Region Cache Management Bypass (TEST)"
	depends on CXL_REGION
	help
	  CXL Region management and security operations potentially invalidate
	  the content of CPU caches without notifying those caches to
	  invalidate the affected cachelines. The CXL Region driver attempts
	  to invalidate caches when those events occur.  If that invalidation
	  fails the region will fail to enable.  Reasons for cache
	  invalidation failure are due to the CPU not providing a cache
	  invalidation mechanism. For example usage of wbinvd is restricted to
	  bare metal x86. However, for testing purposes toggling this option
	  can disable that data integrity safety and proceed with enabling
	  regions when there might be conflicting contents in the CPU cache.

	  If unsure, or if this kernel is meant for production environments,
	  say N.

config CXL_MCE
	def_bool y
	depends on X86_MCE && MEMORY_FAILURE

endif
```

## drivers/dax/Kconfig
```kconfig
# SPDX-License-Identifier: GPL-2.0-only
config DAX_DRIVER
	select DAX
	bool

menuconfig DAX
	tristate "DAX: direct access to differentiated memory"
	select SRCU
	default m if NVDIMM_DAX

if DAX

config DEV_DAX
	tristate "Device DAX: direct access mapping device"
	depends on TRANSPARENT_HUGEPAGE
	help
	  Support raw access to differentiated (persistence, bandwidth,
	  latency...) memory via an mmap(2) capable character
	  device.  Platform firmware or a device driver may identify a
	  platform memory resource that is differentiated from the
	  baseline memory pool.  Mappings of a /dev/daxX.Y device impose
	  restrictions that make the mapping behavior deterministic.

config DEV_DAX_PMEM
	tristate "PMEM DAX: direct access to persistent memory"
	depends on LIBNVDIMM && NVDIMM_DAX && DEV_DAX
	default DEV_DAX
	help
	  Support raw access to persistent memory.  Note that this
	  driver consumes memory ranges allocated and exported by the
	  libnvdimm sub-system.

	  Say M if unsure

config DEV_DAX_HMEM
	tristate "HMEM DAX: direct access to 'specific purpose' memory"
	depends on EFI_SOFT_RESERVE
	select NUMA_KEEP_MEMINFO if (NUMA && X86)
	default DEV_DAX
	help
	  EFI 2.8 platforms, and others, may advertise 'specific purpose'
	  memory. For example, a high bandwidth memory pool. The
	  indication from platform firmware is meant to reserve the
	  memory from typical usage by default. This driver creates
	  device-dax instances for these memory ranges, and that also
	  enables the possibility to assign them to the DEV_DAX_KMEM
	  driver to override the reservation and add them to kernel
	  "System RAM" pool.

	  Say M if unsure.

config DEV_DAX_HMEM_DEVICES
	depends on NUMA_KEEP_MEMINFO # for phys_to_target_node()
	depends on DEV_DAX_HMEM && DAX=y
	def_bool y

config DEV_DAX_KMEM
	tristate "KMEM DAX: volatile-use of persistent memory"
	default DEV_DAX
	depends on DEV_DAX
	depends on MEMORY_HOTPLUG # for add_memory() and friends
	help
	  Support access to persistent, or other performance
	  differentiated memory as if it were System RAM. This allows
	  easier use of persistent memory by unmodified applications, or
	  adds core kernel memory services to heterogeneous memory types
	  (HMEM) marked "reserved" by platform firmware.

	  To use this feature, a DAX device must be unbound from the
	  device_dax driver and bound to this kmem driver on each boot.

	  Say N if unsure.

config DEV_DAX_PMEM_COMPAT
	tristate "PMEM DAX: support the deprecated /sys/class/dax interface"
	depends on m && DEV_DAX_PMEM=m
	default DEV_DAX_PMEM
	help
	  Older versions of the libdaxctl library expect to find all
	  device-dax instances under /sys/class/dax. If libdaxctl in
	  your distribution is older than v58 say M, otherwise say N.

endif
```

## drivers/dca/Kconfig
```kconfig
# SPDX-License-Identifier: GPL-2.0-only
#
# DCA server configuration
#

config DCA
	tristate
```
