## drivers/devfreq/Kconfig
```kconfig
# SPDX-License-Identifier: GPL-2.0-only
menuconfig PM_DEVFREQ
	bool "Generic Dynamic Voltage and Frequency Scaling (DVFS) support"
	select SRCU
	select PM_OPP
	help
	  A device may have a list of frequencies and voltages available.
	  devfreq, a generic DVFS framework can be registered for a device
	  in order to let the governor provided to devfreq choose an
	  operating frequency based on the device driver's policy.

	  Each device may have its own governor and policy. Devfreq can
	  reevaluate the device state periodically and/or based on the
	  notification to "nb", a notifier block, of devfreq.

	  Like some CPUs with CPUfreq, a device may have multiple clocks.
	  However, because the clock frequencies of a single device are
	  determined by the single device's state, an instance of devfreq
	  is attached to a single device and returns a "representative"
	  clock frequency of the device, which is also attached
	  to a device by 1-to-1. The device registering devfreq takes the
	  responsibility to "interpret" the representative frequency and
	  to set its every clock accordingly with the "target" callback
	  given to devfreq.

	  When OPP is used with the devfreq device, it is recommended to
	  register devfreq's nb to the OPP's notifier head.  If OPP is
	  used with the devfreq device, you may use OPP helper
	  functions defined in devfreq.h.

if PM_DEVFREQ

comment "DEVFREQ Governors"

config DEVFREQ_GOV_SIMPLE_ONDEMAND
	tristate "Simple Ondemand"
	help
	  Chooses frequency based on the recent load on the device. Works
	  similar as ONDEMAND governor of CPUFREQ does. A device with
	  Simple-Ondemand should be able to provide busy/total counter
	  values that imply the usage rate. A device may provide tuned
	  values to the governor with data field at devfreq_add_device().

config DEVFREQ_GOV_PERFORMANCE
	tristate "Performance"
	help
	  Sets the frequency at the maximum available frequency.
	  This governor always returns UINT_MAX as frequency so that
	  the DEVFREQ framework returns the highest frequency available
	  at any time.

config DEVFREQ_GOV_POWERSAVE
	tristate "Powersave"
	help
	  Sets the frequency at the minimum available frequency.
	  This governor always returns 0 as frequency so that
	  the DEVFREQ framework returns the lowest frequency available
	  at any time.

config DEVFREQ_GOV_USERSPACE
	tristate "Userspace"
	help
	  Sets the frequency at the user specified one.
	  This governor returns the user configured frequency if there
	  has been an input to /sys/devices/.../power/devfreq_set_freq.
	  Otherwise, the governor does not change the frequency
	  given at the initialization.

config DEVFREQ_GOV_PASSIVE
	tristate "Passive"
	help
	  Sets the frequency based on the frequency of its parent devfreq
	  device. This governor does not change the frequency by itself
	  through sysfs entries. The passive governor recommends that
	  devfreq device uses the OPP table to get the frequency/voltage.

comment "DEVFREQ Drivers"

config ARM_EXYNOS_BUS_DEVFREQ
	tristate "ARM Exynos Generic Memory Bus DEVFREQ Driver"
	depends on ARCH_EXYNOS || COMPILE_TEST
	select DEVFREQ_GOV_SIMPLE_ONDEMAND
	select DEVFREQ_GOV_PASSIVE
	select DEVFREQ_EVENT_EXYNOS_PPMU
	select PM_DEVFREQ_EVENT
	help
	  This adds the common DEVFREQ driver for Exynos Memory bus. Exynos
	  Memory bus has one more group of memory bus (e.g, MIF and INT block).
	  Each memory bus group could contain many memoby bus block. It reads
	  PPMU counters of memory controllers by using DEVFREQ-event device
	  and adjusts the operating frequencies and voltages with OPP support.
	  This does not yet operate with optimal voltages.

config ARM_IMX_BUS_DEVFREQ
	tristate "i.MX Generic Bus DEVFREQ Driver"
	depends on ARCH_MXC || COMPILE_TEST
	select DEVFREQ_GOV_USERSPACE
	help
	  This adds the generic DEVFREQ driver for i.MX interconnects. It
	  allows adjusting NIC/NOC frequency.

config ARM_IMX8M_DDRC_DEVFREQ
	tristate "i.MX8M DDRC DEVFREQ Driver"
	depends on (ARCH_MXC && HAVE_ARM_SMCCC) || \
		(COMPILE_TEST && HAVE_ARM_SMCCC)
	select DEVFREQ_GOV_SIMPLE_ONDEMAND
	select DEVFREQ_GOV_USERSPACE
	help
	  This adds the DEVFREQ driver for the i.MX8M DDR Controller. It allows
	  adjusting DRAM frequency.

config ARM_TEGRA_DEVFREQ
	tristate "NVIDIA Tegra30/114/124/210 DEVFREQ Driver"
	depends on ARCH_TEGRA_3x_SOC || ARCH_TEGRA_114_SOC || \
		ARCH_TEGRA_132_SOC || ARCH_TEGRA_124_SOC || \
		ARCH_TEGRA_210_SOC || \
		COMPILE_TEST
	depends on COMMON_CLK
	help
	  This adds the DEVFREQ driver for the Tegra family of SoCs.
	  It reads ACTMON counters of memory controllers and adjusts the
	  operating frequencies and voltages with OPP support.

config ARM_TEGRA20_DEVFREQ
	tristate "NVIDIA Tegra20 DEVFREQ Driver"
	depends on (TEGRA_MC && TEGRA20_EMC) || COMPILE_TEST
	depends on COMMON_CLK
	select DEVFREQ_GOV_SIMPLE_ONDEMAND
	help
	  This adds the DEVFREQ driver for the Tegra20 family of SoCs.
	  It reads Memory Controller counters and adjusts the operating
	  frequencies and voltages with OPP support.

config ARM_RK3399_DMC_DEVFREQ
	tristate "ARM RK3399 DMC DEVFREQ Driver"
	depends on (ARCH_ROCKCHIP && HAVE_ARM_SMCCC) || \
		(COMPILE_TEST && HAVE_ARM_SMCCC)
	select DEVFREQ_EVENT_ROCKCHIP_DFI
	select DEVFREQ_GOV_SIMPLE_ONDEMAND
	select PM_DEVFREQ_EVENT
	help
	  This adds the DEVFREQ driver for the RK3399 DMC(Dynamic Memory Controller).
	  It sets the frequency for the memory controller and reads the usage counts
	  from hardware.

source "drivers/devfreq/event/Kconfig"

endif # PM_DEVFREQ
```

## drivers/devfreq/event/Kconfig
```kconfig
# SPDX-License-Identifier: GPL-2.0-only
menuconfig PM_DEVFREQ_EVENT
	bool "DEVFREQ-Event device Support"
	help
	  The devfreq-event device provide the raw data and events which
	  indicate the current state of devfreq-event device. The provided
	  data from devfreq-event device is used to monitor the state of
	  device and determine the suitable size of resource to reduce the
	  wasted resource.

	  The devfreq-event device can support the various type of events
	  (e.g., raw data, utilization, latency, bandwidth). The events
	  may be used by devfreq goveranalr and other subsystem.

if PM_DEVFREQ_EVENT

config DEVFREQ_EVENT_EXYANALS_ANALCP
	tristate "Exyanals AnalC (Network On Chip) Probe DEVFREQ event Driver"
	depends on ARCH_EXYANALS || COMPILE_TEST
	select PM_OPP
	select REGMAP_MMIO
	help
	  This add the devfreq-event driver for Exyanals SoC. It provides AnalC
	  (Network on Chip) Probe counters to measure the bandwidth of AXI bus.

config DEVFREQ_EVENT_EXYANALS_PPMU
	tristate "Exyanals PPMU (Platform Performance Monitoring Unit) DEVFREQ event Driver"
	depends on ARCH_EXYANALS || COMPILE_TEST
	select PM_OPP
	help
	  This add the devfreq-event driver for Exyanals SoC. It provides PPMU
	  (Platform Performance Monitoring Unit) counters to estimate the
	  utilization of each module.

config DEVFREQ_EVENT_ROCKCHIP_DFI
	tristate "ROCKCHIP DFI DEVFREQ event Driver"
	depends on ARCH_ROCKCHIP || COMPILE_TEST
	help
	  This add the devfreq-event driver for Rockchip SoC. It provides DFI
	  (DDR Monitor Module) driver to count ddr load.

endif # PM_DEVFREQ_EVENT
```

## drivers/dibs/Kconfig
```kconfig
# SPDX-License-Identifier: GPL-2.0
config DIBS
	tristate "DIBS support"
	default n
	help
	  Direct Internal Buffer Sharing (DIBS)
	  A communication method that uses common physical (internal) memory
	  for synchronous direct access into a remote buffer.

	  Select this option to provide the abstraction layer between
	  dibs devices and dibs clients like the SMC protocol.
	  The module name is dibs.

config DIBS_LO
	bool "intra-OS shortcut with dibs loopback"
	depends on DIBS
	default n
	help
	  DIBS_LO enables the creation of an software-emulated dibs device
	  named lo which can be used for transferring data when communication
	  occurs within the same OS. This helps in convenient testing of
	  dibs clients, since dibs loopback is independent of architecture or
	  hardware.
```

## drivers/dma-buf/Kconfig
```kconfig
# SPDX-License-Identifier: GPL-2.0-only
menu "DMABUF options"

config SYNC_FILE
	bool "Explicit Synchronization Framework"
	default n
	select DMA_SHARED_BUFFER
	help
	  The Sync File Framework adds explicit synchronization via
	  userspace. It enables send/receive 'struct dma_fence' objects to/from
	  userspace via Sync File fds for synchronization between drivers via
	  userspace components. It has been ported from Android.

	  The first and main user for this is graphics in which a fence is
	  associated with a buffer. When a job is submitted to the GPU a fence
	  is attached to the buffer and is transferred via userspace, using Sync
	  Files fds, to the DRM driver for example. More details at
	  Documentation/driver-api/sync_file.rst.

config SW_SYNC
	bool "Sync File Validation Framework"
	default n
	depends on SYNC_FILE
	depends on DEBUG_FS
	help
	  A sync object driver that uses a 32bit counter to coordinate
	  synchronization.  Useful when there is no hardware primitive backing
	  the synchronization.

	  WARNING: improper use of this can result in deadlocking kernel
	  drivers from userspace. Intended for test and debug only.

config UDMABUF
	bool "userspace dmabuf misc driver"
	default n
	depends on DMA_SHARED_BUFFER
	depends on MEMFD_CREATE || COMPILE_TEST
	depends on MMU
	select VMAP_PFN
	help
	  A driver to let userspace turn memfd regions into dma-bufs.
	  Qemu can use this to create host dmabufs for guest framebuffers.

config DMABUF_MOVE_NOTIFY
	bool "Move notify between drivers (EXPERIMENTAL)"
	default n
	depends on DMA_SHARED_BUFFER
	help
	  Don't pin buffers if the dynamic DMA-buf interface is available on
	  both the exporter as well as the importer. This fixes a security
	  problem where userspace is able to pin unrestricted amounts of memory
	  through DMA-buf.
	  This is marked experimental because we don't yet have a consistent
	  execution context and memory management between drivers.

config DMABUF_DEBUG
	bool "DMA-BUF debug checks"
	depends on DMA_SHARED_BUFFER
	default y if DMA_API_DEBUG
	help
	  This option enables additional checks for DMA-BUF importers and
	  exporters. Specifically it validates that importers do not peek at the
	  underlying struct page when they import a buffer.

config DMABUF_SELFTESTS
	tristate "Selftests for the dma-buf interfaces"
	default n
	depends on DMA_SHARED_BUFFER

menuconfig DMABUF_HEAPS
	bool "DMA-BUF Userland Memory Heaps"
	select DMA_SHARED_BUFFER
	help
	  Choose this option to enable the DMA-BUF userland memory heaps.
	  This options creates per heap chardevs in /dev/dma_heap/ which
	  allows userspace to allocate dma-bufs that can be shared
	  between drivers.

menuconfig DMABUF_SYSFS_STATS
	bool "DMA-BUF sysfs statistics (DEPRECATED)"
	depends on DMA_SHARED_BUFFER
	help
	   Choose this option to enable DMA-BUF sysfs statistics
	   in location /sys/kernel/dmabuf/buffers.

	   /sys/kernel/dmabuf/buffers/<inode_number> will contain
	   statistics for the DMA-BUF with the unique inode number
	   <inode_number>.

	   This option is deprecated and should sooner or later be removed.
	   Android is the only user of this and it turned out that this resulted
	   in quite some performance problems.

source "drivers/dma-buf/heaps/Kconfig"

endmenu
```

## drivers/dma-buf/heaps/Kconfig
```kconfig
config DMABUF_HEAPS_SYSTEM
	tristate "DMA-BUF System Heap"
	depends on DMABUF_HEAPS
	help
	  Choose this option to enable the system dmabuf heap. The system heap
	  is backed by pages from the buddy allocator. If in doubt, say Y.

config DMABUF_HEAPS_SYSTEM_CC_SHARED
	bool "DMA-BUF System Heap for decrypted CoCo VMs"
	depends on DMABUF_HEAPS && ARCH_HAS_MEM_ENCRYPT && DMABUF_HEAPS_SYSTEM=y
	help
	  Choose this option to enable the system_cc_shared dmabuf heap. This
	  allows allocating shared (decrypted) memory for confidential computing
	  (CoCo) VMs.

config DMABUF_HEAPS_CMA
	tristate "DMA-BUF CMA Heap"
	depends on DMABUF_HEAPS && DMA_CMA
	help
	  Choose this option to enable dma-buf CMA heap. This heap is backed
	  by the Contiguous Memory Allocator (CMA). If your system has these
	  regions, you should say Y here.
```
