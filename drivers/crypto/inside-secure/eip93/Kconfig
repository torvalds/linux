## drivers/crypto/inside-secure/eip93/Kconfig
```kconfig
# SPDX-License-Identifier: GPL-2.0
config CRYPTO_DEV_EIP93
	tristate "Support for EIP93 crypto HW accelerators"
	depends on SOC_MT7621 || ARCH_AIROHA ||COMPILE_TEST
	select CRYPTO_LIB_AES
	select CRYPTO_LIB_DES
	select CRYPTO_SKCIPHER
	select CRYPTO_AEAD
	select CRYPTO_AUTHENC
	select CRYPTO_MD5
	select CRYPTO_SHA1
	select CRYPTO_SHA256
	help
	  EIP93 have various crypto HW accelerators. Select this if
	  you want to use the EIP93 modules for any of the crypto algorithms.

	  If the IP supports it, this provide offload for AES - ECB, CBC and
	  CTR crypto. Also provide DES and 3DES ECB and CBC.

	  Also provide AEAD authenc(hmac(x), cipher(y)) for supported algo.
```

## drivers/crypto/intel/Kconfig
```kconfig
# SPDX-License-Identifier: GPL-2.0

source "drivers/crypto/intel/keembay/Kconfig"
source "drivers/crypto/intel/ixp4xx/Kconfig"
source "drivers/crypto/intel/qat/Kconfig"
```

## drivers/crypto/intel/iaa/Kconfig
```kconfig
config CRYPTO_DEV_IAA_CRYPTO
	tristate "Support for Intel(R) IAA Compression Accelerator"
	depends on CRYPTO_DEFLATE
	depends on INTEL_IDXD
	default n
	help
	  This driver supports acceleration for compression and
	  decompression with the Intel Analytics Accelerator (IAA)
	  hardware using the cryptographic API.  If you choose 'M'
	  here, the module will be called iaa_crypto.

config CRYPTO_DEV_IAA_CRYPTO_STATS
	bool "Enable Intel(R) IAA Compression Accelerator Statistics"
	depends on CRYPTO_DEV_IAA_CRYPTO
	default n
	help
	  Enable statistics for the IAA compression accelerator.
	  These include per-device and per-workqueue statistics in
	  addition to global driver statistics.
```

## drivers/crypto/intel/ixp4xx/Kconfig
```kconfig
config CRYPTO_DEV_IXP4XX
	tristate "Driver for IXP4xx crypto hardware acceleration"
	depends on (ARCH_IXP4XX || COMPILE_TEST) && IXP4XX_QMGR && IXP4XX_NPE
	select CRYPTO_AES
	select CRYPTO_DES
	select CRYPTO_ECB
	select CRYPTO_CBC
	select CRYPTO_CTR
	select CRYPTO_LIB_DES
	select CRYPTO_AEAD
	select CRYPTO_AUTHENC
	select CRYPTO_SKCIPHER
	help
	  Driver for the IXP4xx NPE crypto engine.
```

## drivers/crypto/intel/qat/Kconfig
```kconfig
# SPDX-License-Identifier: GPL-2.0-only
config CRYPTO_DEV_QAT
	tristate
	select CRYPTO_AEAD
	select CRYPTO_AUTHENC
	select CRYPTO_SKCIPHER
	select CRYPTO_AKCIPHER
	select CRYPTO_DH
	select CRYPTO_RSA
	select CRYPTO_LIB_AES
	select CRYPTO_LIB_SHA1
	select CRYPTO_LIB_SHA256
	select CRYPTO_LIB_SHA512
	select FW_LOADER
	select CRC8

config CRYPTO_DEV_QAT_DH895xCC
	tristate "Support for Intel(R) DH895xCC"
	depends on PCI && (!CPU_BIG_ENDIAN || COMPILE_TEST)
	select CRYPTO_DEV_QAT
	help
	  Support for Intel(R) DH895xcc with Intel(R) QuickAssist Technology
	  for accelerating crypto and compression workloads.

	  To compile this as a module, choose M here: the module
	  will be called qat_dh895xcc.

config CRYPTO_DEV_QAT_C3XXX
	tristate "Support for Intel(R) C3XXX"
	depends on PCI && (!CPU_BIG_ENDIAN || COMPILE_TEST)
	select CRYPTO_DEV_QAT
	help
	  Support for Intel(R) C3xxx with Intel(R) QuickAssist Technology
	  for accelerating crypto and compression workloads.

	  To compile this as a module, choose M here: the module
	  will be called qat_c3xxx.

config CRYPTO_DEV_QAT_C62X
	tristate "Support for Intel(R) C62X"
	depends on PCI && (!CPU_BIG_ENDIAN || COMPILE_TEST)
	select CRYPTO_DEV_QAT
	help
	  Support for Intel(R) C62x with Intel(R) QuickAssist Technology
	  for accelerating crypto and compression workloads.

	  To compile this as a module, choose M here: the module
	  will be called qat_c62x.

config CRYPTO_DEV_QAT_4XXX
	tristate "Support for Intel(R) QAT_4XXX"
	depends on PCI && (!CPU_BIG_ENDIAN || COMPILE_TEST)
	select CRYPTO_DEV_QAT
	help
	  Support for Intel(R) QuickAssist Technology QAT_4xxx
	  for accelerating crypto and compression workloads.

	  To compile this as a module, choose M here: the module
	  will be called qat_4xxx.

config CRYPTO_DEV_QAT_420XX
	tristate "Support for Intel(R) QAT_420XX"
	depends on PCI && (!CPU_BIG_ENDIAN || COMPILE_TEST)
	select CRYPTO_DEV_QAT
	help
	  Support for Intel(R) QuickAssist Technology QAT_420xx
	  for accelerating crypto and compression workloads.

	  To compile this as a module, choose M here: the module
	  will be called qat_420xx.

config CRYPTO_DEV_QAT_6XXX
	tristate "Support for Intel(R) QuickAssist Technology QAT_6XXX"
	depends on (X86 || COMPILE_TEST)
	depends on PCI
	select CRYPTO_DEV_QAT
	help
	  Support for Intel(R) QuickAssist Technology QAT_6xxx
	  for accelerating crypto and compression workloads.

	  To compile this as a module, choose M here: the module
	  will be called qat_6xxx.

config CRYPTO_DEV_QAT_DH895xCCVF
	tristate "Support for Intel(R) DH895xCC Virtual Function"
	depends on PCI && (!CPU_BIG_ENDIAN || COMPILE_TEST)
	select PCI_IOV
	select CRYPTO_DEV_QAT

	help
	  Support for Intel(R) DH895xcc with Intel(R) QuickAssist Technology
	  Virtual Function for accelerating crypto and compression workloads.

	  To compile this as a module, choose M here: the module
	  will be called qat_dh895xccvf.

config CRYPTO_DEV_QAT_C3XXXVF
	tristate "Support for Intel(R) C3XXX Virtual Function"
	depends on PCI && (!CPU_BIG_ENDIAN || COMPILE_TEST)
	select PCI_IOV
	select CRYPTO_DEV_QAT
	help
	  Support for Intel(R) C3xxx with Intel(R) QuickAssist Technology
	  Virtual Function for accelerating crypto and compression workloads.

	  To compile this as a module, choose M here: the module
	  will be called qat_c3xxxvf.

config CRYPTO_DEV_QAT_C62XVF
	tristate "Support for Intel(R) C62X Virtual Function"
	depends on PCI && (!CPU_BIG_ENDIAN || COMPILE_TEST)
	select PCI_IOV
	select CRYPTO_DEV_QAT
	help
	  Support for Intel(R) C62x with Intel(R) QuickAssist Technology
	  Virtual Function for accelerating crypto and compression workloads.

	  To compile this as a module, choose M here: the module
	  will be called qat_c62xvf.

config CRYPTO_DEV_QAT_ERROR_INJECTION
	bool "Support for Intel(R) QAT Devices Heartbeat Error Injection"
	depends on CRYPTO_DEV_QAT
	depends on DEBUG_FS
	help
	  Enables a mechanism that allows to inject a heartbeat error on
	  Intel(R) QuickAssist devices for testing purposes.

	  This is intended for developer use only.
	  If unsure, say N.

	  This functionality is available via debugfs entry of the Intel(R)
	  QuickAssist device
```

## drivers/crypto/keembay/Kconfig
```kconfig
config CRYPTO_DEV_KEEMBAY_OCS_AES_SM4
	tristate "Support for Intel Keem Bay OCS AES/SM4 HW acceleration"
	depends on HAS_IOMEM
	depends on ARCH_KEEMBAY || COMPILE_TEST
	select CRYPTO_SKCIPHER
	select CRYPTO_AEAD
	select CRYPTO_ENGINE
	help
	  Support for Intel Keem Bay Offload and Crypto Subsystem (OCS) AES and
	  SM4 cipher hardware acceleration for use with Crypto API.

	  Provides HW acceleration for the following transformations:
	  cbc(aes), ctr(aes), ccm(aes), gcm(aes), cbc(sm4), ctr(sm4), ccm(sm4)
	  and gcm(sm4).

	  Optionally, support for the following transformations can also be
	  enabled: ecb(aes), cts(cbc(aes)), ecb(sm4) and cts(cbc(sm4)).

config CRYPTO_DEV_KEEMBAY_OCS_AES_SM4_ECB
	bool "Support for Intel Keem Bay OCS AES/SM4 ECB HW acceleration"
	depends on CRYPTO_DEV_KEEMBAY_OCS_AES_SM4
	help
	  Support for Intel Keem Bay Offload and Crypto Subsystem (OCS)
	  AES/SM4 ECB mode hardware acceleration for use with Crypto API.

	  Provides OCS version of ecb(aes) and ecb(sm4)

	  Intel does not recommend use of ECB mode with AES/SM4.

config CRYPTO_DEV_KEEMBAY_OCS_AES_SM4_CTS
	bool "Support for Intel Keem Bay OCS AES/SM4 CTS HW acceleration"
	depends on CRYPTO_DEV_KEEMBAY_OCS_AES_SM4
	help
	  Support for Intel Keem Bay Offload and Crypto Subsystem (OCS)
	  AES/SM4 CBC with CTS mode hardware acceleration for use with
	  Crypto API.

	  Provides OCS version of cts(cbc(aes)) and cts(cbc(sm4)).

	  Intel does not recommend use of CTS mode with AES/SM4.

config CRYPTO_DEV_KEEMBAY_OCS_HCU
	tristate "Support for Intel Keem Bay OCS HCU HW acceleration"
	select CRYPTO_HASH
	select CRYPTO_ENGINE
	depends on HAS_IOMEM
	depends on ARCH_KEEMBAY || COMPILE_TEST
	depends on OF || COMPILE_TEST
	help
	  Support for Intel Keem Bay Offload and Crypto Subsystem (OCS) Hash
	  Control Unit (HCU) hardware acceleration for use with Crypto API.

	  Provides OCS HCU hardware acceleration of sha256, sha384, sha512, and
	  sm3, as well as the HMAC variant of these algorithms.

	  Say Y or M if you're building for the Intel Keem Bay SoC. If compiled
	  as a module, the module will be called keembay-ocs-hcu.

	  If unsure, say N.

config CRYPTO_DEV_KEEMBAY_OCS_HCU_HMAC_SHA224
	bool "Enable sha224 and hmac(sha224) support in Intel Keem Bay OCS HCU"
	depends on CRYPTO_DEV_KEEMBAY_OCS_HCU
	help
	  Enables support for sha224 and hmac(sha224) algorithms in the Intel
	  Keem Bay OCS HCU driver. Intel recommends not to use these
	  algorithms.

	  Provides OCS HCU hardware acceleration of sha224 and hmac(224).

	  If unsure, say N.
```

## drivers/crypto/loongson/Kconfig
```kconfig
config CRYPTO_DEV_LOONGSON_RNG
	tristate "Support for Loongson RNG Driver"
	depends on MFD_LOONGSON_SE
	help
	  Support for Loongson RNG Driver.
```

## drivers/crypto/marvell/Kconfig
```kconfig
#
# Marvell crypto drivers configuration
#

config CRYPTO_DEV_MARVELL
	tristate

config CRYPTO_DEV_MARVELL_CESA
	tristate "Marvell's Cryptographic Engine driver"
	depends on PLAT_ORION || ARCH_MVEBU
	select CRYPTO_LIB_AES
	select CRYPTO_LIB_DES
	select CRYPTO_SKCIPHER
	select CRYPTO_HASH
	select SRAM
	select CRYPTO_DEV_MARVELL
	help
	  This driver allows you to utilize the Cryptographic Engines and
	  Security Accelerator (CESA) which can be found on MVEBU and ORION
	  platforms.
	  This driver supports CPU offload through DMA transfers.

config CRYPTO_DEV_OCTEONTX_CPT
	tristate "Support for Marvell OcteonTX CPT driver"
	depends on ARCH_THUNDER || COMPILE_TEST
	depends on PCI_MSI && 64BIT
	depends on CRYPTO_LIB_AES
	select CRYPTO_SKCIPHER
	select CRYPTO_HASH
	select CRYPTO_AEAD
	select CRYPTO_AUTHENC
	select CRYPTO_DEV_MARVELL
	help
		This driver allows you to utilize the Marvell Cryptographic
		Accelerator Unit(CPT) found in OcteonTX series of processors.

		To compile this driver as module, choose M here:
		the modules will be called octeontx-cpt and octeontx-cptvf

config CRYPTO_DEV_OCTEONTX2_CPT
	tristate "Marvell OcteonTX2 CPT driver"
	depends on ARCH_THUNDER2 || COMPILE_TEST
	depends on PCI_MSI && 64BIT
	depends on CRYPTO_LIB_AES
	depends on NET_VENDOR_MARVELL
	select OCTEONTX2_MBOX
	select CRYPTO_DEV_MARVELL
	select CRYPTO_SKCIPHER
	select CRYPTO_HASH
	select CRYPTO_AEAD
	select CRYPTO_AUTHENC
	select NET_DEVLINK
	help
		This driver allows you to utilize the Marvell Cryptographic
		Accelerator Unit(CPT) found in OcteonTX2 series of processors.
```

## drivers/crypto/nx/Kconfig
```kconfig
config CRYPTO_DEV_NX_ENCRYPT
	tristate "Encryption acceleration support on pSeries platform"
	depends on PPC_PSERIES && IBMVIO && !CPU_LITTLE_ENDIAN
	default y
	select CRYPTO_AES
	select CRYPTO_CCM
	help
	  Support for PowerPC Nest (NX) encryption acceleration. This
	  module supports acceleration for AES and SHA2 algorithms on
	  the pSeries platform.  If you choose 'M' here, this module
	  will be called nx_crypto.

config CRYPTO_DEV_NX_COMPRESS
	tristate "Compression acceleration support"
	default y
	select CRYPTO_ALGAPI
	select 842_DECOMPRESS
	help
	  Support for PowerPC Nest (NX) compression acceleration. This
	  module supports acceleration for compressing memory with the 842
	  algorithm using the cryptographic API.  One of the platform
	  drivers must be selected also.  If you choose 'M' here, this
	  module will be called nx_compress.

if CRYPTO_DEV_NX_COMPRESS

config CRYPTO_DEV_NX_COMPRESS_PSERIES
	tristate "Compression acceleration support on pSeries platform"
	depends on PPC_PSERIES && IBMVIO
	default y
	help
	  Support for PowerPC Nest (NX) compression acceleration. This
	  module supports acceleration for compressing memory with the 842
	  algorithm.  This supports NX hardware on the pSeries platform.
	  If you choose 'M' here, this module will be called nx_compress_pseries.

config CRYPTO_DEV_NX_COMPRESS_POWERNV
	tristate "Compression acceleration support on PowerNV platform"
	depends on PPC_POWERNV
	depends on PPC_VAS
	default y
	help
	  Support for PowerPC Nest (NX) compression acceleration. This
	  module supports acceleration for compressing memory with the 842
	  algorithm.  This supports NX hardware on the PowerNV platform.
	  If you choose 'M' here, this module will be called nx_compress_powernv.

endif
```

## drivers/crypto/qat/Kconfig
```kconfig
config CRYPTO_DEV_QAT
	tristate
	select CRYPTO_AEAD
	select CRYPTO_AUTHENC
	select CRYPTO_BLKCIPHER
	select CRYPTO_AKCIPHER
	select CRYPTO_DH
	select CRYPTO_HMAC
	select CRYPTO_RSA
	select CRYPTO_SHA1
	select CRYPTO_SHA256
	select CRYPTO_SHA512
	select FW_LOADER

config CRYPTO_DEV_QAT_DH895xCC
	tristate "Support for Intel(R) DH895xCC"
	depends on X86 && PCI
	select CRYPTO_DEV_QAT
	help
	  Support for Intel(R) DH895xcc with Intel(R) QuickAssist Technology
	  for accelerating crypto and compression workloads.

	  To compile this as a module, choose M here: the module
	  will be called qat_dh895xcc.

config CRYPTO_DEV_QAT_C3XXX
	tristate "Support for Intel(R) C3XXX"
	depends on X86 && PCI
	select CRYPTO_DEV_QAT
	help
	  Support for Intel(R) C3xxx with Intel(R) QuickAssist Technology
	  for accelerating crypto and compression workloads.

	  To compile this as a module, choose M here: the module
	  will be called qat_c3xxx.

config CRYPTO_DEV_QAT_C62X
	tristate "Support for Intel(R) C62X"
	depends on X86 && PCI
	select CRYPTO_DEV_QAT
	help
	  Support for Intel(R) C62x with Intel(R) QuickAssist Technology
	  for accelerating crypto and compression workloads.

	  To compile this as a module, choose M here: the module
	  will be called qat_c62x.

config CRYPTO_DEV_QAT_DH895xCCVF
	tristate "Support for Intel(R) DH895xCC Virtual Function"
	depends on X86 && PCI
	select PCI_IOV
	select CRYPTO_DEV_QAT

	help
	  Support for Intel(R) DH895xcc with Intel(R) QuickAssist Technology
	  Virtual Function for accelerating crypto and compression workloads.

	  To compile this as a module, choose M here: the module
	  will be called qat_dh895xccvf.

config CRYPTO_DEV_QAT_C3XXXVF
	tristate "Support for Intel(R) C3XXX Virtual Function"
	depends on X86 && PCI
	select PCI_IOV
	select CRYPTO_DEV_QAT
	help
	  Support for Intel(R) C3xxx with Intel(R) QuickAssist Technology
	  Virtual Function for accelerating crypto and compression workloads.

	  To compile this as a module, choose M here: the module
	  will be called qat_c3xxxvf.

config CRYPTO_DEV_QAT_C62XVF
	tristate "Support for Intel(R) C62X Virtual Function"
	depends on X86 && PCI
	select PCI_IOV
	select CRYPTO_DEV_QAT
	help
	  Support for Intel(R) C62x with Intel(R) QuickAssist Technology
	  Virtual Function for accelerating crypto and compression workloads.

	  To compile this as a module, choose M here: the module
	  will be called qat_c62xvf.
```

## drivers/crypto/rockchip/Kconfig
```kconfig
# SPDX-License-Identifier: GPL-2.0-only
if CRYPTO_DEV_ROCKCHIP

config CRYPTO_DEV_ROCKCHIP_V1
	bool "crypto v1 for RV1108 RK3288 RK3368 RK3399"
	default y if CPU_RV1108 || CPU_RK3288 || CPU_RK3368 || CPU_RK3399

config CRYPTO_DEV_ROCKCHIP_V2
	bool "crypto v2 for RV1109/RV1126 RK1808 RK3308 PX30/RK3326 RK356X RK3588"
	default y if CPU_RV1126 || CPU_RK1808 || CPU_RK3308 || CPU_PX30 || CPU_RK3568 || CPU_RK3588

config CRYPTO_DEV_ROCKCHIP_V3
	bool "crypto v3/v4 for RV1106/RK3528"
	default y if CPU_RV1106 || CPU_RK3528

endif

config CRYPTO_DEV_ROCKCHIP_DEV
	tristate "Export rockchip crypto device for user space"
	depends on CRYPTO_DEV_ROCKCHIP
	default n
	help
	  This is a /dev/crypto device driver.The main idea is to
	  access existing ciphers in kernel space from userspace,
	  thus enabling the re-use of a hardware implementation of a cipher.
```
