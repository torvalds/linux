## drivers/net/wireless/brcm80211/Kconfig
```kconfig
config BRCMUTIL
	tristate

config BRCMSMAC
	tristate "Broadcom IEEE802.11n PCIe SoftMAC WLAN driver"
	depends on MAC80211
	depends on BCMA
	select BRCMUTIL
	select FW_LOADER
	select CRC_CCITT
	select CRC8
	select CORDIC
	---help---
	  This module adds support for PCIe wireless adapters based on Broadcom
	  IEEE802.11n SoftMAC chipsets.  If you choose to build a module, it'll
	  be called brcmsmac.ko.

config BRCMFMAC
	tristate "Broadcom IEEE802.11n embedded FullMAC WLAN driver"
	depends on CFG80211
	select BRCMUTIL
	---help---
	  This module adds support for embedded wireless adapters based on
	  Broadcom IEEE802.11n FullMAC chipsets. It has to work with at least
	  one of the bus interface support. If you choose to build a module,
	  it'll be called brcmfmac.ko.

config BRCMFMAC_SDIO
	bool "SDIO bus interface support for FullMAC driver"
	depends on MMC
	depends on BRCMFMAC
	select FW_LOADER
	default y
	---help---
	  This option enables the SDIO bus interface support for Broadcom
	  IEEE802.11n embedded FullMAC WLAN driver. Say Y if you want to
	  use the driver for a SDIO wireless card.

config BRCMFMAC_USB
	bool "USB bus interface support for FullMAC driver"
	depends on USB
	depends on BRCMFMAC
	select FW_LOADER
	---help---
	  This option enables the USB bus interface support for Broadcom
	  IEEE802.11n embedded FullMAC WLAN driver. Say Y if you want to
	  use the driver for an USB wireless card.

config BRCMDBG
	bool "Broadcom driver debug functions"
	depends on BRCMSMAC || BRCMFMAC
	---help---
	  Selecting this enables additional code for debug purposes.
```

## drivers/net/wireless/broadcom/brcm80211/Kconfig
```kconfig
# SPDX-License-Identifier: GPL-2.0-only
config BRCMUTIL
	tristate

config BRCMSMAC
	tristate "Broadcom IEEE802.11n PCIe SoftMAC WLAN driver"
	depends on MAC80211
	depends on BCMA_POSSIBLE
	select BCMA
	select BRCMUTIL
	select FW_LOADER
	select CORDIC
	help
	  This module adds support for PCIe wireless adapters based on Broadcom
	  IEEE802.11n SoftMAC chipsets. If you choose to build a module, the
	  driver will be called brcmsmac.ko.

config BRCMSMAC_LEDS
	def_bool BRCMSMAC && BCMA_DRIVER_GPIO && MAC80211_LEDS
	help
	  The brcmsmac LED support depends on the presence of the
	  BCMA_DRIVER_GPIO driver, and it only works if LED support
	  is enabled and reachable from the driver module.

source "drivers/net/wireless/broadcom/brcm80211/brcmfmac/Kconfig"

config BRCM_TRACING
	bool "Broadcom device tracing"
	depends on BRCMSMAC || BRCMFMAC
	help
	  If you say Y here, the Broadcom wireless drivers will register
	  with ftrace to dump event information into the trace ringbuffer.
	  Tracing can be enabled at runtime to aid in debugging wireless
	  issues. This option adds a small amount of overhead when tracing
	  is disabled. If unsure, say Y to allow developers to better help
	  you when wireless problems occur.

config BRCMDBG
	bool "Broadcom driver debug functions"
	depends on BRCMSMAC || BRCMFMAC
	select WANT_DEV_COREDUMP if BRCMFMAC
	help
	  Selecting this enables additional code for debug purposes.
```

## drivers/net/wireless/broadcom/brcm80211/brcmfmac/Kconfig
```kconfig
config BRCMFMAC
	tristate "Broadcom FullMAC WLAN driver"
	depends on CFG80211
	select BRCMUTIL
	help
	  This module adds support for wireless adapters based on Broadcom
	  FullMAC chipsets. It has to work with at least one of the bus
	  interface support. If you choose to build a module, it'll be called
	  brcmfmac.ko.

config BRCMFMAC_PROTO_BCDC
	bool

config BRCMFMAC_PROTO_MSGBUF
	bool

config BRCMFMAC_SDIO
	bool "SDIO bus interface support for FullMAC driver"
	depends on (MMC = y || MMC = BRCMFMAC)
	depends on BRCMFMAC
	select BRCMFMAC_PROTO_BCDC
	select FW_LOADER
	default y
	help
	  This option enables the SDIO bus interface support for Broadcom
	  IEEE802.11n embedded FullMAC WLAN driver. Say Y if you want to
	  use the driver for a SDIO wireless card.

config BRCMFMAC_USB
	bool "USB bus interface support for FullMAC driver"
	depends on (USB = y || USB = BRCMFMAC)
	depends on BRCMFMAC
	select BRCMFMAC_PROTO_BCDC
	select FW_LOADER
	help
	  This option enables the USB bus interface support for Broadcom
	  IEEE802.11n embedded FullMAC WLAN driver. Say Y if you want to
	  use the driver for an USB wireless card.

config BRCMFMAC_PCIE
	bool "PCIE bus interface support for FullMAC driver"
	depends on BRCMFMAC
	depends on PCI
	select BRCMFMAC_PROTO_MSGBUF
	select FW_LOADER
	help
	  This option enables the PCIE bus interface support for Broadcom
	  IEEE802.11ac embedded FullMAC WLAN driver. Say Y if you want to
	  use the driver for an PCIE wireless card.
```

## drivers/net/wireless/cisco/Kconfig
```kconfig
config WLAN_VENDOR_CISCO
	bool "Cisco devices"
	default y
	---help---
	  If you have a wireless card belonging to this class, say Y.

	  Note that the answer to this question doesn't directly affect the
	  kernel: saying N will just cause the configurator to skip all
	  the questions about  cards. If you say Y, you will be asked for
	  your specific card in the following questions.

if WLAN_VENDOR_CISCO

config AIRO
	tristate "Cisco/Aironet 34X/35X/4500/4800 ISA and PCI cards"
	depends on CFG80211 && ISA_DMA_API && (PCI || BROKEN)
	select WIRELESS_EXT
	select CRYPTO
	select WEXT_SPY
	select WEXT_PRIV
	---help---
	  This is the standard Linux driver to support Cisco/Aironet ISA and
	  PCI 802.11 wireless cards.
	  It supports the new 802.11b cards from Cisco (Cisco 34X, Cisco 35X
	  - with or without encryption) as well as card before the Cisco
	  acquisition (Aironet 4500, Aironet 4800, Aironet 4800B).

	  This driver support both the standard Linux Wireless Extensions
	  and Cisco proprietary API, so both the Linux Wireless Tools and the
	  Cisco Linux utilities can be used to configure the card.

	  The driver can be compiled as a module and will be named "airo".

config AIRO_CS
	tristate "Cisco/Aironet 34X/35X/4500/4800 PCMCIA cards"
	depends on CFG80211 && PCMCIA && (BROKEN || !M32R)
	select WIRELESS_EXT
	select WEXT_SPY
	select WEXT_PRIV
	select CRYPTO
	select CRYPTO_AES
	---help---
	  This is the standard Linux driver to support Cisco/Aironet PCMCIA
	  802.11 wireless cards.  This driver is the same as the Aironet
	  driver part of the Linux Pcmcia package.
	  It supports the new 802.11b cards from Cisco (Cisco 34X, Cisco 35X
	  - with or without encryption) as well as card before the Cisco
	  acquisition (Aironet 4500, Aironet 4800, Aironet 4800B). It also
	  supports OEM of Cisco such as the DELL TrueMobile 4800 and Xircom
	  802.11b cards.

	  This driver support both the standard Linux Wireless Extensions
	  and Cisco proprietary API, so both the Linux Wireless Tools and the
	  Cisco Linux utilities can be used to configure the card.

endif # WLAN_VENDOR_CISCO
```

## drivers/net/wireless/cnss/Kconfig
```kconfig
# SPDX-License-Identifier: GPL-2.0-only
#
# cnss device configuration
#

config CNSS
	tristate "CNSS driver for wifi module"
	select CNSS_UTILS
	select CRYPTO
	select CRYPTO_HASH
	select CRYPTO_BLKCIPHER
	help
	 This module adds support for the CNSS connectivity subsystem used
	 for wifi devices based on the QCA AR6320 chipset.
	 This driver also adds support to integrate WLAN module to subsystem
	 restart framework.

config CNSS_SDIO
	bool "Enable/disable cnss sdio platform driver for wifi module"
	depends on CNSS
	depends on MMC
	help
	 This module adds support for the CNSS wlan module interfaced
	 with SDIO bus.
	 This driver also adds support to integrate WLAN module to subsystem
	 restart framework, power on WLAN chip and registered the WLAN module
	 as a SDIO client device.

config CNSS_MAC_BUG
	bool "Enable/disable 0-4K memory initialization for QCA6174"
	depends on CNSS
	help
	  If enabled, 0-4K memory is reserved for QCA6174 to address
	  a MAC HW bug. MAC would do an invalid pointer fetch based on
	  the data, that was read from 0 to 4K. So fill it with zero's;
	  to an address for which PCIe root complex would honor the read
	  without any errors.

config CLD_DEBUG
	bool "Enable/disable CLD debug features"
	help
	 WLAN CLD driver uses this config to enable certain debug features.
	 Some of the debug features may affect performance or may compromise
	 on security.

	  Say N, if you are building a release kernel for production use.
	  Only say Y, if you are building a kernel with debug support.

config CLD_USB_CORE
	tristate "Qualcomm Technologies Inc. Core wlan driver for QCA USB interface"
	select WIRELESS_EXT
	select WEXT_PRIV
	select WEXT_CORE
	select WEXT_SPY
	select NL80211_TESTMODE
	help
	  This section contains the necessary modules needed to enable the
	  core WLAN driver for Qualcomm Technologies Inc USB wlan chipset.
	  Select Y to compile the driver in order to have WLAN functionality
	  support.

config CLD_HL_SDIO_CORE
	tristate "Qualcomm Technologies Inc. Core wlan driver for QCA SDIO interface"
	select WIRELESS_EXT
	select WEXT_PRIV
	select WEXT_CORE
	select WEXT_SPY
	select NL80211_TESTMODE
	depends on ARCH_QCOM
	depends on MMC

config CLD_LL_CORE
	tristate "Qualcomm Technologies Inc. Core wlan driver"
	select NL80211_TESTMODE
	select WEXT_CORE
	select WEXT_PRIV
	select WEXT_SPY
	select WIRELESS_EXT
	help
	  This section contains the necessary modules needed to enable the
	  core WLAN driver for Qualcomm Technologies Inc QCA6174 chipset.
	  Select Y to compile the driver in order to have WLAN functionality
	  support.

config CNSS_SECURE_FW
	bool "Enable/Disable Memory Allocation for Secure Firmware Feature"
	depends on CNSS
	help
	  CLD Driver can use this for holding local copy of firmware
	  binaries which is used for sha crypto computation.
	  The Memory Allocation is done only if this Config Parameter is
	  enabled

config WLAN_FEATURE_RX_WAKELOCK
        bool "Enable RX wake lock feature"
        help
        Enable WLAN_FEATURE_HOLD_RX_WAKELOCK which is required to take rx
        wakelock when driver receives packets from fw.
```

## drivers/net/wireless/cw1200/Kconfig
```kconfig
config CW1200
	tristate "CW1200 WLAN support"
	depends on MAC80211 && CFG80211
	help
	  This is a driver for the ST-E CW1100 & CW1200 WLAN chipsets.
	  This option just enables the driver core, see below for
	  specific bus support.

if CW1200

config CW1200_WLAN_SDIO
	tristate "Support SDIO platforms"
	depends on CW1200 && MMC
	help
	  Enable support for the CW1200 connected via an SDIO bus.
	  By default this driver only supports the Sagrad SG901-1091/1098 EVK
	  and similar designs that utilize a hardware reset circuit. To
	  support different CW1200 SDIO designs you will need to override
	  the default platform data by calling cw1200_sdio_set_platform_data()
	  in your board setup file.

config CW1200_WLAN_SPI
	tristate "Support SPI platforms"
	depends on CW1200 && SPI
	help
	  Enables support for the CW1200 connected via a SPI bus.  You will
	  need to add appropriate platform data glue in your board setup
	  file.

endif
```
