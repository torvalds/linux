## drivers/net/wireless/ath/ath9k/Kconfig
```kconfig
# SPDX-License-Identifier: ISC
config ATH9K_HW
	tristate
config ATH9K_COMMON
	tristate
	select ATH_COMMON
config ATH9K_COMMON_DEBUG
	bool
config ATH9K_DFS_DEBUGFS
	def_bool y
	depends on ATH9K_DEBUGFS && ATH9K_DFS_CERTIFIED

config ATH9K_BTCOEX_SUPPORT
	bool "Atheros bluetooth coexistence support"
	depends on (ATH9K || ATH9K_HTC)
	default y
	help
	  Say Y, if you want to use the ath9k/ath9k_htc radios together with
	  Bluetooth modules in the same system.

config ATH9K
	tristate "Atheros 802.11n wireless cards support"
	depends on MAC80211 && HAS_DMA
	select ATH9K_HW
	select ATH9K_COMMON
	imply NEW_LEDS
	imply LEDS_CLASS
	imply MAC80211_LEDS
	help
	  This module adds support for wireless adapters based on
	  Atheros IEEE 802.11n AR5008, AR9001 and AR9002 family
	  of chipsets. For a specific list of supported external
	  cards, laptops that already ship with these cards and
	  APs that come with these cards refer to ath9k wiki
	  products page:

	  https://wireless.wiki.kernel.org/en/users/Drivers/ath9k/products

	  If you choose to build a module, it'll be called ath9k.

config ATH9K_PCI
	bool "Atheros ath9k PCI/PCIe bus support"
	default y
	depends on ATH9K && PCI
	help
	  This option enables the PCI bus support in ath9k.

	  Say Y, if you have a compatible PCI/PCIe wireless card.

config ATH9K_AHB
	bool "Atheros ath9k AHB bus support"
	depends on ATH9K
	default n
	help
	  This option enables the AHB bus support in ath9k.

	  Say Y, if you have a SoC with a compatible built-in
	  wireless MAC. Say N if unsure.

config ATH9K_DEBUGFS
	bool "Atheros ath9k debugging"
	depends on ATH9K && DEBUG_FS
	select MAC80211_DEBUGFS
	select ATH9K_COMMON_DEBUG
	help
	  Say Y, if you need access to ath9k's statistics for
	  interrupts, rate control, etc.

	  Also required for changing debug message flags at run time and for
	  TX99.

config ATH9K_STATION_STATISTICS
	bool "Detailed station statistics"
	depends on ATH9K && ATH9K_DEBUGFS && DEBUG_FS
	select MAC80211_DEBUGFS
	default n
	help
	  This option enables detailed statistics for association stations.

config ATH9K_TX99
	bool "Atheros ath9k TX99 testing support"
	depends on ATH9K_DEBUGFS && CFG80211_CERTIFICATION_ONUS
	default n
	help
	  Say N. This should only be enabled on systems undergoing
	  certification testing and evaluation in a controlled environment.
	  Enabling this will only enable TX99 support, all other modes of
	  operation will be disabled.

	  TX99 support enables Specific Absorption Rate (SAR) testing.
	  SAR is the unit of measurement for the amount of radio frequency(RF)
	  absorbed by the body when using a wireless device. The RF exposure
	  limits used are expressed in the terms of SAR, which is a measure
	  of the electric and magnetic field strength and power density for
	  transmitters operating at frequencies from 300 kHz to 100 GHz.
	  Regulatory bodies around the world require that wireless device
	  be evaluated to meet the RF exposure limits set forth in the
	  governmental SAR regulations.

config ATH9K_DFS_CERTIFIED
	bool "Atheros DFS support for certified platforms"
	depends on ATH9K && CFG80211_CERTIFICATION_ONUS
	default n
	help
	  This option enables DFS support for initiating radiation on
	  ath9k. There is no way to dynamically detect if a card was DFS
	  certified and as such this is left as a build time option. This
	  option should only be enabled by system integrators that can
	  guarantee that all the platforms that their kernel will run on
	  have obtained appropriate regulatory body certification for a
	  respective Atheros card by using ath9k on the target shipping
	  platforms.

	  This is currently only a placeholder for future DFS support,
	  as DFS support requires more components that still need to be
	  developed. At this point enabling this option won't do anything
	  except increase code size.

config ATH9K_DYNACK
	bool "Atheros ath9k ACK timeout estimation algorithm"
	depends on ATH9K
	default n
	help
	  This option enables ath9k dynamic ACK timeout estimation algorithm
	  based on ACK frame RX timestamp, TX frame timestamp and frame
	  duration

config ATH9K_WOW
	bool "Wake on Wireless LAN support (EXPERIMENTAL)"
	depends on ATH9K && PM
	default n
	help
	  This option enables Wake on Wireless LAN support for certain cards.
	  Currently, AR9462 is supported.

config ATH9K_RFKILL
	bool "Atheros ath9k rfkill support" if EXPERT
	depends on ATH9K
	depends on RFKILL=y || RFKILL=ATH9K
	default y
	help
	  Say Y to have ath9k poll the RF-Kill GPIO every couple of
	  seconds. Turn off to save power, but enable it if you have
	  a platform that can toggle the RF-Kill GPIO.

config ATH9K_CHANNEL_CONTEXT
	bool "Channel Context support"
	depends on ATH9K
	default n
	help
	  This option enables channel context support in ath9k, which is needed
	  for multi-channel concurrency. Enable this if P2P PowerSave support
	  is required.

config ATH9K_PCOEM
	bool "Atheros ath9k support for PC OEM cards" if EXPERT
	depends on ATH9K
	default y

config ATH9K_PCI_NO_EEPROM
	tristate "Atheros ath9k pci loader for EEPROM-less chips"
	depends on ATH9K_PCI
	default n
	help
	  This separate driver provides a loader in order to support the
	  AR500X to AR92XX-generation of ath9k PCI(e) WiFi chips, which have
	  their initialization data (which contains the real PCI Device ID
	  that ath9k will need) stored together with the calibration data out
	  of reach for the ath9k chip.

	  These devices are usually various network appliances, routers or
	  access Points and such.

	  If unsure say N.

config ATH9K_HTC
	tristate "Atheros HTC based wireless cards support"
	depends on USB && MAC80211
	select ATH9K_HW
	select ATH9K_COMMON
	imply NEW_LEDS
	imply LEDS_CLASS
	imply MAC80211_LEDS
	help
	  Support for Atheros HTC based cards.
	  Chipsets supported: AR9271

	  For more information:
	  https://wireless.wiki.kernel.org/en/users/Drivers/ath9k_htc

	  The built module will be ath9k_htc.

config ATH9K_HTC_DEBUGFS
	bool "Atheros ath9k_htc debugging"
	depends on ATH9K_HTC && DEBUG_FS
	select ATH9K_COMMON_DEBUG
	help
	  Say Y, if you need access to ath9k_htc's statistics.
	  As well as access to the FFT/spectral data.

config ATH9K_HWRNG
	bool "Random number generator support"
	depends on ATH9K && (HW_RANDOM = y || HW_RANDOM = ATH9K)
	default n
	help
	  This option incorporates the ADC register output as a source of
	  randomness into Linux entropy pool (/dev/urandom and /dev/random)

	  Say Y, feeds the entropy directly from the WiFi driver to the input
	  pool.

config ATH9K_COMMON_SPECTRAL
	bool "Atheros ath9k/ath9k_htc spectral scan support"
	depends on ATH9K_DEBUGFS || ATH9K_HTC_DEBUGFS
	select RELAY
	default n
	help
	  Say Y to enable access to the FFT/spectral data via debugfs.
```

## drivers/net/wireless/ath/carl9170/Kconfig
```kconfig
config CARL9170
	tristate "Linux Community AR9170 802.11n USB support"
	depends on USB && MAC80211 && EXPERIMENTAL
	select ATH_COMMON
	select FW_LOADER
	select CRC32
	help
	  This is another driver for the Atheros "otus" 802.11n USB devices.

	  This driver provides more features than the original,
	  but it needs a special firmware (carl9170-1.fw) to do that.

	  The firmware can be downloaded from our wiki here:
	  <http://wireless.kernel.org/en/users/Drivers/carl9170>

	  If you choose to build a module, it'll be called carl9170.

config CARL9170_LEDS
	bool "SoftLED Support"
	depends on CARL9170
	select MAC80211_LEDS
	select LEDS_CLASS
	select NEW_LEDS
	default y
	help
	  This option is necessary, if you want your device' LEDs to blink

	  Say Y, unless you need the LEDs for firmware debugging.

config CARL9170_DEBUGFS
	bool "DebugFS Support"
	depends on CARL9170 && DEBUG_FS && MAC80211_DEBUGFS
	default n
	help
	  Export several driver and device internals to user space.

	  Say N.

config CARL9170_WPC
	bool
	depends on CARL9170 && (INPUT = y || INPUT = CARL9170)
	default y

config CARL9170_HWRNG
        bool "Random number generator"
        depends on CARL9170 && (HW_RANDOM = y || HW_RANDOM = CARL9170)
        default n
	help
	  Provides a hardware random number generator to the kernel.

	  SECURITY WARNING: It's relatively easy to eavesdrop all
	  generated random numbers from the transport stream with
	  usbmon [software] or special usb sniffer hardware.

	  Say N, unless your setup[i.e.: embedded system] has no
	  other rng source and you can afford to take the risk.
```

## drivers/net/wireless/ath/wcn36xx/Kconfig
```kconfig
config WCN36XX
	tristate "Qualcomm Atheros WCN3660/3680 support"
	depends on MAC80211 && HAS_DMA
	depends on QCOM_WCNSS_CTRL || QCOM_WCNSS_CTRL=n
	depends on RPMSG || RPMSG=n
	---help---
	  This module adds support for wireless adapters based on
	  Qualcomm Atheros WCN3660 and WCN3680 mobile chipsets.

	  If you choose to build a module, it'll be called wcn36xx.

config WCN36XX_DEBUGFS
	bool "WCN36XX debugfs support"
	depends on WCN36XX
	---help---
	  Enabled debugfs support

	  If unsure, say Y to make it easier to debug problems.
```

## drivers/net/wireless/ath/wil6210/Kconfig
```kconfig
config WIL6210
	tristate "Wilocity 60g WiFi card wil6210 support"
	select WANT_DEV_COREDUMP
	depends on CFG80211
	depends on PCI
	default n
	---help---
	  This module adds support for wireless adapter based on
	  wil6210 chip by Wilocity. It supports operation on the
	  60 GHz band, covered by the IEEE802.11ad standard.

	  http://wireless.kernel.org/en/users/Drivers/wil6210

	  If you choose to build it as a module, it will be called
	  wil6210

config WIL6210_ISR_COR
	bool "Use Clear-On-Read mode for ISR registers for wil6210"
	depends on WIL6210
	default y
	---help---
	  ISR registers on wil6210 chip may operate in either
	  COR (Clear-On-Read) or W1C (Write-1-to-Clear) mode.
	  For production code, use COR (say y); is default since
	  it saves extra target transaction;
	  For ISR de, use W1C (say n); is allows to monitor ISR
	  registers with defs. If COR were used, ISR would
	  self-clear when accessed for de purposes, it makes
	  such monitoring impossible.
	  Say y unless you de interrupts

config WIL6210_TRACING
	bool "wil6210 tracing support"
	depends on WIL6210
	depends on EVENT_TRACING
	default n
	---help---
	  Say Y here to enable tracepoints for the wil6210 driver
	  using the kernel tracing infrastructure.  Select this
	  option if you are interested in deging the driver.

	  If unsure, say Y to make it easier to de problems.

config WIL6210_DEFS
	bool "wil6210 defs support"
	depends on WIL6210
	depends on DE_FS
	default y
	---help---
	  Say Y here to enable wil6210 defs support, using the
	  kernel defs infrastructure. Select this
	  option if you are interested in deging the driver.

	  If unsure, say Y to make it easier to de problems.
```

## drivers/net/wireless/ath9k/Kconfig
```kconfig
config ATH9K
	tristate "Atheros 802.11n wireless cards support"
	depends on PCI && MAC80211 && WLAN_80211
	select MAC80211_LEDS
	select LEDS_CLASS
	select NEW_LEDS
	---help---
	  This module adds support for wireless adapters based on
	  Atheros IEEE 802.11n AR5008 and AR9001 family of chipsets.

	  If you choose to build a module, it'll be called ath9k.
```

## drivers/net/wireless/atmel/Kconfig
```kconfig
# SPDX-License-Identifier: GPL-2.0-only
config WLAN_VENDOR_ATMEL
	bool "Atmel devices"
	default y
	help
	  If you have a wireless card belonging to this class, say Y.

	  Note that the answer to this question doesn't directly affect the
	  kernel: saying N will just cause the configurator to skip all the
	  questions about these cards. If you say Y, you will be asked for
	  your specific card in the following questions.

if WLAN_VENDOR_ATMEL

config AT76C50X_USB
	tristate "Atmel at76c503/at76c505/at76c505a USB cards"
	depends on MAC80211 && USB
	select FW_LOADER
	help
	  Enable support for USB Wireless devices using Atmel at76c503,
	  at76c505 or at76c505a chips.

endif # WLAN_VENDOR_ATMEL
```
