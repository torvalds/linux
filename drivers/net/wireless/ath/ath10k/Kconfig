## drivers/net/wireless/b43/Kconfig
```kconfig
config B43
	tristate "Broadcom 43xx wireless support (mac80211 stack)"
	depends on (BCMA_POSSIBLE || SSB_POSSIBLE) && MAC80211 && HAS_DMA
	select BCMA if B43_BCMA
	select SSB if B43_SSB
	select FW_LOADER
	---help---
	  b43 is a driver for the Broadcom 43xx series wireless devices.

	  Check "lspci" for something like
	  "Broadcom Corporation BCM43XX 802.11 Wireless LAN Controller"
	  to determine whether you own such a device.

	  This driver supports the new BCM43xx IEEE 802.11G devices, but not
	  the old IEEE 802.11B devices. Old devices are supported by
	  the b43legacy driver.
	  Note that this has nothing to do with the standard that your AccessPoint
	  supports (A, B, G or a combination).
	  IEEE 802.11G devices can talk to IEEE 802.11B AccessPoints.

	  It is safe to include both b43 and b43legacy as the underlying glue
	  layer will automatically load the correct version for your device.

	  This driver uses V4 firmware, which must be installed separately using
	  b43-fwcutter.

	  This driver can be built as a module (recommended) that will be called "b43".
	  If unsure, say M.

config B43_BCMA
	bool

config B43_SSB
	bool

choice
	prompt "Supported bus types"
	depends on B43
	default B43_BUSES_BCMA_AND_SSB

config B43_BUSES_BCMA_AND_SSB
	bool "BCMA and SSB"
	depends on BCMA_POSSIBLE && SSB_POSSIBLE
	select B43_BCMA
	select B43_SSB

config B43_BUSES_BCMA
	bool "BCMA only"
	depends on BCMA_POSSIBLE
	select B43_BCMA

config B43_BUSES_SSB
	bool "SSB only"
	depends on SSB_POSSIBLE
	select B43_SSB

endchoice

# Auto-select SSB PCI-HOST support, if possible
config B43_PCI_AUTOSELECT
	bool
	depends on B43 && SSB_PCIHOST_POSSIBLE
	select SSB_PCIHOST
	select SSB_B43_PCI_BRIDGE
	default y

# Auto-select SSB PCICORE driver, if possible
config B43_PCICORE_AUTOSELECT
	bool
	depends on B43 && SSB_DRIVER_PCICORE_POSSIBLE
	select SSB_DRIVER_PCICORE
	default y

config B43_PCMCIA
	bool "Broadcom 43xx PCMCIA device support"
	depends on B43 && B43_SSB && SSB_PCMCIAHOST_POSSIBLE
	select SSB_PCMCIAHOST
	---help---
	  Broadcom 43xx PCMCIA device support.

	  Support for 16bit PCMCIA devices.
	  Please note that most PC-CARD devices are _NOT_ 16bit PCMCIA
	  devices, but 32bit CardBUS devices. CardBUS devices are supported
	  out of the box by b43.

	  With this config option you can drive b43 cards in
	  CompactFlash formfactor in a PCMCIA adaptor.
	  CF b43 cards can sometimes be found in handheld PCs.

	  It's safe to select Y here, even if you don't have a B43 PCMCIA device.

	  If unsure, say N.

config B43_SDIO
	bool "Broadcom 43xx SDIO device support"
	depends on B43 && B43_SSB && SSB_SDIOHOST_POSSIBLE
	select SSB_SDIOHOST
	---help---
	  Broadcom 43xx device support for Soft-MAC SDIO devices.

	  With this config option you can drive Soft-MAC b43 cards with a
	  Secure Digital I/O interface.
	  This includes the WLAN daughter card found on the Nintendo Wii
	  video game console.
	  Note that this does not support Broadcom 43xx Full-MAC devices.

	  It's safe to select Y here, even if you don't have a B43 SDIO device.

	  If unsure, say N.

#Data transfers to the device via PIO. We want it as a fallback even
# if we can do DMA.
config B43_BCMA_PIO
	bool
	depends on B43 && B43_BCMA
	select BCMA_BLOCKIO
	default y

config B43_PIO
	bool
	depends on B43 && B43_SSB
	select SSB_BLOCKIO
	default y

config B43_PHY_G
	bool "Support for G-PHY (802.11g) devices"
	depends on B43 && B43_SSB
	default y
	---help---
	  This PHY type can be found in the following chipsets:
	  PCI: BCM4306, BCM4311, BCM4318
	  SoC: BCM4712, BCM5352E

config B43_PHY_N
	bool "Support for N-PHY (the main 802.11n series) devices"
	depends on B43
	default y
	---help---
	  This PHY type can be found in the following chipsets:
	  PCI: BCM4321, BCM4322,
	       BCM43222, BCM43224, BCM43225,
	       BCM43131, BCM43217, BCM43227, BCM43228
	  SoC: BCM4716, BCM4717, BCM4718, BCM5356, BCM5357, BCM5358

config B43_PHY_LP
	bool "Support for LP-PHY (low-power 802.11g) devices"
	depends on B43 && B43_SSB
	default y
	---help---
	  The LP-PHY is a low-power PHY built into some notebooks
	  and embedded devices. It supports 802.11a/b/g
	  (802.11a support is optional, and currently disabled).

config B43_PHY_HT
	bool "Support for HT-PHY (high throughput 802.11n) devices"
	depends on B43 && B43_BCMA
	default y
	---help---
	  This PHY type with 3x3:3 MIMO can be found in the BCM4331 PCI chipset.

config B43_PHY_LCN
	bool "Support for LCN-PHY devices (BROKEN)"
	depends on B43 && BROKEN
	---help---
	  Support for the LCN-PHY.

	  Say N, this is BROKEN and crashes driver.

# This config option automatically enables b43 LEDS support,
# if it's possible.
config B43_LEDS
	bool
	depends on B43 && MAC80211_LEDS && (LEDS_CLASS = y || LEDS_CLASS = B43)
	default y

# This config option automatically enables b43 HW-RNG support,
# if the HW-RNG core is enabled.
config B43_HWRNG
	bool
	depends on B43 && (HW_RANDOM = y || HW_RANDOM = B43)
	default y

config B43_DEBUG
	bool "Broadcom 43xx debugging"
	depends on B43
	---help---
	  Broadcom 43xx debugging.

	  This adds additional runtime sanity checks and statistics to the driver.
	  These checks and statistics might be expensive and hurt the runtime
	  performance of your system.
	  This also adds the b43 debugfs interface.

	  Do not enable this, unless you are debugging the driver.

	  Say N, if you are a distributor or user building a release kernel
	  for production use.
	  Only say Y, if you are debugging a problem in the b43 driver sourcecode.
```

## drivers/net/wireless/b43legacy/Kconfig
```kconfig
config B43LEGACY
	tristate "Broadcom 43xx-legacy wireless support (mac80211 stack)"
	depends on SSB_POSSIBLE && MAC80211 && WLAN_80211
	select SSB
	select FW_LOADER
	select HW_RANDOM
	---help---
	  b43legacy is a driver for 802.11b devices from Broadcom (BCM4301 and
	  BCM4303) and early model 802.11g chips (BCM4306 Ver. 2) used in the
	  Linksys WPC54G V1 PCMCIA devices.

	  Newer 802.11g and 802.11a devices need b43.

	  It is safe to include both b43 and b43legacy as the underlying glue
	  layer will automatically load the correct version for your device.

	  This driver uses V3 firmware, which must be installed separately using
	  b43-fwcutter.

	  This driver can be built as a module (recommended) that will be
	  called "b43legacy". If unsure, say M.

# Auto-select SSB PCI-HOST support, if possible
config B43LEGACY_PCI_AUTOSELECT
	bool
	depends on B43LEGACY && SSB_PCIHOST_POSSIBLE
	select SSB_PCIHOST
	select SSB_B43_PCI_BRIDGE
	default y

# Auto-select SSB PCICORE driver, if possible
config B43LEGACY_PCICORE_AUTOSELECT
	bool
	depends on B43LEGACY && SSB_DRIVER_PCICORE_POSSIBLE
	select SSB_DRIVER_PCICORE
	default y

# LED support
# This config option automatically enables b43legacy LEDS support,
# if it's possible.
config B43LEGACY_LEDS
	bool
	depends on B43LEGACY && MAC80211_LEDS && (LEDS_CLASS = y || LEDS_CLASS = B43LEGACY)
	default y

# RFKILL support
# This config option automatically enables b43legacy RFKILL support,
# if it's possible.
config B43LEGACY_RFKILL
	bool
	depends on B43LEGACY && (RFKILL = y || RFKILL = B43LEGACY) && RFKILL_INPUT && (INPUT_POLLDEV = y || INPUT_POLLDEV = B43LEGACY)
	default y

config B43LEGACY_DEBUG
	bool "Broadcom 43xx-legacy debugging"
	depends on B43LEGACY
	default y
	---help---
	  Say Y, because this information will help you get the driver running.
	  This option generates a minimum of log output.

config B43LEGACY_DMA
	bool
	depends on B43LEGACY

config B43LEGACY_PIO
	bool
	depends on B43LEGACY

choice
	prompt "Broadcom 43xx-legacy data transfer mode"
	depends on B43LEGACY
	default B43LEGACY_DMA_AND_PIO_MODE

config B43LEGACY_DMA_AND_PIO_MODE
	bool "DMA + PIO"
	select B43LEGACY_DMA
	select B43LEGACY_PIO
	---help---
	  Include both, Direct Memory Access (DMA) and Programmed I/O (PIO)
	  data transfer modes. The mode actually used is selectable through
	  the module parameter "pio". With pio=0 as a module parameter, the
	  default DMA is used, otherwise PIO is used.

	  If unsure, choose this option.

config B43LEGACY_DMA_MODE
	bool "DMA (Direct Memory Access) only"
	select B43LEGACY_DMA
	---help---
	  Only include Direct Memory Access (DMA).
	  This reduces the size of the driver module, by omitting the PIO code.

config B43LEGACY_PIO_MODE
	bool "PIO (Programmed I/O) only"
	select B43LEGACY_PIO
	---help---
	  Only include Programmed I/O (PIO).
	  This reduces the size of the driver module, by omitting the DMA code.
	  Please note that PIO transfers are slow (compared to DMA).

	  Also note that not all devices of the b43legacy series support PIO.

	  You should use PIO only if DMA does not work for you.

endchoice
```

## drivers/net/wireless/bcm4319/Kconfig.bcm4319
```kconfig
config BCM4319
	bool "Broadcom 4319 wireless cards support"
	depends on WLAN_80211 && MMC
	select WIRELESS_EXT
	select IEEE80211
	select FW_LOADER
	---help---
	  This module adds support for wireless adapters based on
	  Broadcom 4319 chipset.

	  This driver uses the kernel's wireless extensions subsystem.

	  If you choose to build a module, it'll be called dhd. Say M if
	  unsure.
```

## drivers/net/wireless/bcm4329/Kconfig
```kconfig
config BCM4329
	tristate "Broadcom 4329 wireless cards support"
	depends on MMC
	select WIRELESS_EXT
	select WEXT_PRIV
	---help---
	  This module adds support for wireless adapters based on
	  Broadcom 4329 chipset.

	  This driver uses the kernel's wireless extensions subsystem.

	  If you choose to build a module, it'll be called dhd. Say M if
	  unsure.

config BCM4329_FW_PATH
	depends on BCM4329
	string "Firmware path"
	default "/system/etc/firmware/fw_bcm4329.bin"
	---help---
	  Path to the firmware file.

config BCM4329_NVRAM_PATH
	depends on BCM4329
	string "NVRAM path"
	default "/system/etc/firmware/nvram_B23.txt"
	---help---
	  Path to the calibration file.
```

## drivers/net/wireless/bcm4330/Kconfig
```kconfig
config BCM4330
	tristate "Broadcom 4329/4330(Hardkernel) wireless cards support"
	default n
	depends on MMC
	select WIRELESS_EXT
	select WEXT_PRIV
	---help---
	  This module adds support for wireless adapters based on
	  Broadcom 4329/4330 chipset.

	  This driver uses the kernel's wireless extensions subsystem.

	  If you choose to build a module, it'll be called dhd. Say M if
	  unsure.
	  
config BCM4330_FW_PATH
	depends on BCM4330
	string "Firmware path"
	default "/system/etc/firmware/fw_bcmdhd.bin"
	---help---
	  Path to the firmware file.

config BCM4330_NVRAM_PATH
	depends on BCM4330
	string "NVRAM path"
	default "/system/etc/firmware/bcmdhd.cal"
	---help---
	  Path to the calibration file.
```

## drivers/net/wireless/bcm4336/Kconfig
```kconfig
config BCMDHD
	tristate "Broadcom FullMAC wireless cards support"
	---help---
	  This module adds support for wireless adapters based on
	  Broadcom FullMAC chipset.

config BCMDHD_FW_PATH
	depends on BCMDHD
	string "Firmware path"
	default "/system/etc/firmware/fw_bcmdhd.bin"
	---help---
	  Path to the firmware file.

config BCMDHD_NVRAM_PATH
	depends on BCMDHD
	string "NVRAM path"
	default "/system/etc/firmware/nvram.txt"
	---help---
	  Path to the calibration file.

config BCMDHD_CONFIG_PATH
	depends on BCMDHD
	string "Config path"
	default "/system/etc/firmware/config.txt"
	---help---
	  Path to the driver configuration file.

config BCMDHD_WEXT
	bool "Enable WEXT support"
	depends on BCMDHD && CFG80211 = n
	select WIRELESS_EXT
	select WEXT_PRIV
	help
	  Enables WEXT support

choice
	depends on BCMDHD
	prompt "Interrupt type"
	default BCMDHD_OOB
	---help---
	  Interrupt type
config BCMDHD_OOB
	depends on BCMDHD
	bool "Out-of-Band Interrupt"
	---help---
	  Interrupt from WL_HOST_WAKE.
config BCMDHD_SDIO_IRQ
	depends on BCMDHD
	bool "In-Band Interrupt"
	---help---
	  Interrupt from SDIO DAT[1]
endchoice
```

## drivers/net/wireless/bcm43xx/Kconfig
```kconfig
config BCM43XX
	tristate "Broadcom BCM43xx wireless support"
	depends on PCI && IEEE80211 && IEEE80211_SOFTMAC && NET_RADIO && EXPERIMENTAL
	select FW_LOADER
	---help---
	  This is an experimental driver for the Broadcom 43xx wireless chip,
	  found in the Apple Airport Extreme and various other devices.

config BCM43XX_DEBUG
	bool "Broadcom BCM43xx debugging (RECOMMENDED)"
	depends on BCM43XX
	default y
	---help---
	  Broadcom 43xx debugging messages.
	  Say Y, because the driver is still very experimental and
	  this will help you get it running.

config BCM43XX_DMA
	bool
	depends on BCM43XX

config BCM43XX_PIO
	bool
	depends on BCM43XX

choice
	prompt "BCM43xx data transfer mode"
	depends on BCM43XX
	default BCM43XX_DMA_AND_PIO_MODE

config BCM43XX_DMA_AND_PIO_MODE
	bool "DMA + PIO"
	select BCM43XX_DMA
	select BCM43XX_PIO
	---help---
	  Include both, Direct Memory Access (DMA) and Programmed I/O (PIO)
	  data transfer modes.
	  The actually used mode is selectable through the module
	  parameter "pio". If the module parameter is pio=0, DMA is used.
	  Otherwise PIO is used. DMA is default.

	  If unsure, choose this option.

config BCM43XX_DMA_MODE
	bool "DMA (Direct Memory Access) only"
	select BCM43XX_DMA
	---help---
	  Only include Direct Memory Access (DMA).
	  This reduces the size of the driver module, by omitting the PIO code.

config BCM43XX_PIO_MODE
	bool "PIO (Programmed I/O) only"
	select BCM43XX_PIO
	---help---
	  Only include Programmed I/O (PIO).
	  This reduces the size of the driver module, by omitting the DMA code.
	  Please note that PIO transfers are slow (compared to DMA).

	  Also note that not all devices of the 43xx series support PIO.
	  The 4306 (Apple Airport Extreme and others) supports PIO, while
	  the 4318 is known to _not_ support PIO.

	  Only use PIO, if DMA does not work for you.

endchoice
```

## drivers/net/wireless/bcmdhd/Kconfig
```kconfig
config BCMDHD
	tristate "Broadcom 4329/30 wireless cards support"
	depends on MMC
	---help---
	  This module adds support for wireless adapters based on
	  Broadcom 4329/30 chipset.

	  This driver uses the kernel's wireless extensions subsystem.

	  If you choose to build a module, it'll be called dhd. Say M if
	  unsure.

config BCMDHD_FW_PATH
	depends on BCMDHD
	string "Firmware path"
	default "/system/etc/firmware/fw_bcmdhd.bin"
	---help---
	  Path to the firmware file.

config BCMDHD_NVRAM_PATH
	depends on BCMDHD
	string "NVRAM path"
	default "/system/etc/wifi/bcmdhd.cal"
	---help---
	  Path to the calibration file.

config BCMDHD_WEXT
	bool "Enable WEXT support"
	depends on BCMDHD && CFG80211 = n
	select WIRELESS_EXT
	select WEXT_PRIV
	help
	  Enables WEXT support

config DHD_USE_STATIC_BUF
	bool "Enable memory preallocation"
	depends on BCMDHD
	default n
	---help---
	  Use memory preallocated in platform

config DHD_USE_SCHED_SCAN
	bool "Use CFG80211 sched scan"
	depends on BCMDHD && CFG80211
	default n
	---help---
	  Use CFG80211 sched scan

config DHD_ENABLE_P2P
	bool "Enable Wifi Direct"
	depends on BCMDHD && CFG80211
	default n
	---help---
	  Use Enable Wifi Direct
```
