## drivers/net/wireless/ath/ath10k/Kconfig
```kconfig
# SPDX-License-Identifier: ISC
config ATH10K
	tristate "Atheros 802.11ac wireless cards support"
	depends on MAC80211 && HAS_DMA
	select ATH_COMMON
	select CRC32
	select WANT_DEV_COREDUMP
	select ATH10K_CE
	help
	  This module adds support for wireless adapters based on
	  Atheros IEEE 802.11ac family of chipsets.

	  If you choose to build a module, it'll be called ath10k.

config ATH10K_CE
	bool

config ATH10K_PCI
	tristate "Atheros ath10k PCI support"
	depends on ATH10K && PCI
	help
	  This module adds support for PCIE bus

config ATH10K_AHB
	bool "Atheros ath10k AHB support"
	depends on ATH10K_PCI && OF && RESET_CONTROLLER
	help
	  This module adds support for AHB bus

config ATH10K_SDIO
	tristate "Atheros ath10k SDIO support"
	depends on ATH10K && MMC
	help
	  This module adds support for SDIO/MMC bus.

config ATH10K_USB
	tristate "Atheros ath10k USB support (EXPERIMENTAL)"
	depends on ATH10K && USB
	help
	  This module adds experimental support for USB bus. Currently
	  work in progress and will not fully work.

config ATH10K_SNOC
	tristate "Qualcomm ath10k SNOC support"
	depends on ATH10K
	depends on ARCH_QCOM || COMPILE_TEST
	depends on QCOM_SMEM
	select QCOM_SCM
	select QCOM_QMI_HELPERS
	help
	  This module adds support for integrated WCN3990 chip connected
	  to system NOC(SNOC).

config ATH10K_DEBUG
	bool "Atheros ath10k debugging"
	depends on ATH10K
	help
	  Enables debug support

	  If unsure, say Y to make it easier to debug problems.

config ATH10K_DEBUGFS
	bool "Atheros ath10k debugfs support"
	depends on ATH10K && DEBUG_FS
	help
	  Enabled debugfs support

	  If unsure, say Y to make it easier to debug problems.

config ATH10K_SPECTRAL
	bool "Atheros ath10k spectral scan support"
	depends on ATH10K_DEBUGFS
	select RELAY
	default n
	help
	  Say Y to enable access to the FFT/spectral data via debugfs.

config ATH10K_TRACING
	bool "Atheros ath10k tracing support"
	depends on ATH10K
	depends on EVENT_TRACING
	help
	  Select this to ath10k use tracing infrastructure.

config ATH10K_DFS_CERTIFIED
	bool "Atheros DFS support for certified platforms"
	depends on ATH10K && CFG80211_CERTIFICATION_ONUS
	default n
	help
	This option enables DFS support for initiating radiation on
	ath10k.
```

## drivers/net/wireless/ath/ath11k/Kconfig
```kconfig
# SPDX-License-Identifier: BSD-3-Clause-Clear
config ATH11K
	tristate "Qualcomm Technologies 802.11ax chipset support"
	depends on MAC80211 && HAS_DMA
	depends on CRYPTO_MICHAEL_MIC
	select ATH_COMMON
	select QCOM_QMI_HELPERS
	help
	  This module adds support for Qualcomm Technologies 802.11ax family of
	  chipsets.

	  If you choose to build a module, it'll be called ath11k.

config ATH11K_AHB
	tristate "Atheros ath11k AHB support"
	depends on ATH11K
	depends on REMOTEPROC
	help
	  This module adds support for AHB bus

config ATH11K_PCI
	tristate "Atheros ath11k PCI support"
	depends on ATH11K && PCI
	select MHI_BUS
	select QRTR
	select QRTR_MHI
	help
	  This module adds support for PCIE bus

config ATH11K_DEBUG
	bool "QCA ath11k debugging"
	depends on ATH11K
	help
	  Enables debug support

	  If unsure, say Y to make it easier to debug problems.

config ATH11K_DEBUGFS
	bool "QCA ath11k debugfs support"
	depends on ATH11K && DEBUG_FS && MAC80211_DEBUGFS
	help
	  Enable ath11k debugfs support

	  If unsure, say Y to make it easier to debug problems.

config ATH11K_TRACING
	bool "ath11k tracing support"
	depends on ATH11K && EVENT_TRACING
	help
	  Select this to use ath11k tracing infrastructure.

config ATH11K_SPECTRAL
	bool "QCA ath11k spectral scan support"
	depends on ATH11K_DEBUGFS
	depends on RELAY
	help
	  Enable ath11k spectral scan support

	  Say Y to enable access to the FFT/spectral data via debugfs.
```

## drivers/net/wireless/ath/ath12k/Kconfig
```kconfig
# SPDX-License-Identifier: BSD-3-Clause-Clear
config ATH12K
	tristate "Qualcomm Technologies Wi-Fi 7 support (ath12k)"
	depends on MAC80211 && HAS_DMA && PCI
	select CRYPTO_MICHAEL_MIC
	select QCOM_QMI_HELPERS
	select MHI_BUS
	select QRTR
	select QRTR_MHI
	select PCI_PWRCTL_PWRSEQ if HAVE_PWRCTL
	help
	  Enable support for Qualcomm Technologies Wi-Fi 7 (IEEE
	  802.11be) family of chipsets, for example WCN7850 and
	  QCN9274.

	  If you choose to build a module, it'll be called ath12k.

config ATH12K_AHB
	bool "QTI ath12k AHB support"
	depends on ATH12K && REMOTEPROC
	select QCOM_MDT_LOADER
	select QCOM_SCM
	help
	  Enable support for Ath12k AHB bus chipsets, example IPQ5332.

config ATH12K_DEBUG
	bool "ath12k debugging"
	depends on ATH12K
	help
	  Enable debug support, for example debug messages which must
	  be enabled separately using the debug_mask module parameter.

	  If unsure, say Y to make it easier to debug problems. But if
	  you want optimal performance choose N.

config ATH12K_DEBUGFS
	bool "QTI ath12k debugfs support"
	depends on ATH12K && MAC80211_DEBUGFS
	help
	  Enable ath12k debugfs support

	  If unsure, say Y to make it easier to debug problems. But if
	  you want optimal performance choose N.

config ATH12K_TRACING
	bool "ath12k tracing support"
	depends on ATH12K && EVENT_TRACING
	help
	  Enable ath12k tracing infrastructure.

	  If unsure, say Y to make it easier to debug problems. But if
	  you want optimal performance choose N.

config ATH12K_COREDUMP
	bool "ath12k coredump"
	depends on ATH12K
	select WANT_DEV_COREDUMP
	help
	  Enable ath12k coredump collection

	  If unsure, say Y to make it easier to debug problems. But if
	  dump collection not required choose N.
```

## drivers/net/wireless/ath/ath5k/Kconfig
```kconfig
config ATH5K
	tristate "Atheros 5xxx wireless cards support"
	depends on (PCI || ATH25) && MAC80211
	select ATH_COMMON
	select MAC80211_LEDS
	select LEDS_CLASS
	select NEW_LEDS
	select ATH5K_AHB if ATH25
	select ATH5K_PCI if !ATH25
	---help---
	  This module adds support for wireless adapters based on
	  Atheros 5xxx chipset.

	  Currently the following chip versions are supported:

	  MAC: AR5211 AR5212
	  PHY: RF5111/2111 RF5112/2112 RF5413/2413

	  This driver uses the kernel's mac80211 subsystem.

	  If you choose to build a module, it'll be called ath5k. Say M if
	  unsure.

config ATH5K_DE
	bool "Atheros 5xxx deging"
	depends on ATH5K
	---help---
	  Atheros 5xxx deging messages.

	  Say Y, if and you will get de options for ath5k.
	  To use this, you need to mount defs:

	  mount -t defs de /sys/kernel/de

	  You will get access to files under:
	  /sys/kernel/de/ath5k/phy0/

	  To enable de, pass the de level to the de module
	  parameter. For example:

	  modprobe ath5k de=0x00000400

config ATH5K_TRACER
	bool "Atheros 5xxx tracer"
	depends on ATH5K
	depends on EVENT_TRACING
	---help---
	  Say Y here to enable tracepoints for the ath5k driver
	  using the kernel tracing infrastructure.  Select this
	  option if you are interested in deging the driver.

	  If unsure, say N.

config ATH5K_AHB
	bool "Atheros 5xxx AHB bus support"
	depends on ATH25
	---help---
	  This adds support for WiSoC type chipsets of the 5xxx Atheros
	  family.

config ATH5K_PCI
	bool "Atheros 5xxx PCI bus support"
	depends on (!ATH25 && PCI)
	---help---
	  This adds support for PCI type chipsets of the 5xxx Atheros
	  family.

config ATH5K_TEST_CHANNELS
	bool "Enables testing channels on ath5k"
	depends on ATH5K && CFG80211_CERTIFICATION_ONUS
	---help---
	  This enables non-standard IEEE 802.11 channels on ath5k, which
	  can be used for research purposes. This option should be disabled
	  unless doing research.
```

## drivers/net/wireless/ath/ath6kl/Kconfig
```kconfig
# SPDX-License-Identifier: ISC
config ATH6KL
	tristate "Atheros mobile chipsets support"
	depends on CFG80211
        ---help---
	  This module adds core support for wireless adapters based on
	  Atheros AR6003 and AR6004 chipsets. You still need separate
	  bus drivers for USB and SDIO to be able to use real devices.

	  If you choose to build it as a module, it will be called
	  ath6kl_core. Please note that AR6002 and AR6001 are not
	  supported by this driver.

config ATH6KL_SDIO
	tristate "Atheros ath6kl SDIO support"
	depends on ATH6KL
	depends on MMC
	---help---
	  This module adds support for wireless adapters based on
	  Atheros AR6003 and AR6004 chipsets running over SDIO. If you
	  choose to build it as a module, it will be called ath6kl_sdio.
	  Please note that AR6002 and AR6001 are not supported by this
	  driver.

config ATH6KL_USB
	tristate "Atheros ath6kl USB support"
	depends on ATH6KL
	depends on USB
	---help---
	  This module adds support for wireless adapters based on
	  Atheros AR6004 chipset and chipsets based on it running over
	  USB. If you choose to build it as a module, it will be
	  called ath6kl_usb.

config ATH6KL_DEBUG
	bool "Atheros ath6kl debugging"
	depends on ATH6KL
	---help---
	  Enables ath6kl debug support, including debug messages
	  enabled with debug_mask module parameter and debugfs
	  interface.

	  If unsure, say Y to make it easier to debug problems.

config ATH6KL_TRACING
	bool "Atheros ath6kl tracing support"
	depends on ATH6KL
	depends on EVENT_TRACING
	---help---
	  Select this to ath6kl use tracing infrastructure which, for
	  example, can be enabled with help of trace-cmd. All debug
	  messages and commands are delivered to using individually
	  enablable trace points.

	  If unsure, say Y to make it easier to debug problems.

config ATH6KL_REGDOMAIN
	bool "Atheros ath6kl regdomain support"
	depends on ATH6KL
	depends on CFG80211_CERTIFICATION_ONUS
	---help---
	  Enabling this makes it possible to change the regdomain in
	  the firmware. This can be only enabled if regulatory requirements
	  are taken into account.

	  If unsure, say N.
```
