## drivers/net/wireless/mediatek/mt76/mt7915/Kconfig
```kconfig
# SPDX-License-Identifier: ISC
config MT7915E
	tristate "MediaTek MT7915E (PCIe) support"
	select MT76_CONNAC_LIB
	depends on MAC80211
	depends on PCI
	select RELAY
	help
	  This adds support for MT7915-based wireless PCIe devices,
	  which support concurrent dual-band operation at both 5GHz
	  and 2.4GHz IEEE 802.11ax 4x4:4SS 1024-QAM, 160MHz channels,
	  OFDMA, spatial reuse and dual carrier modulation.

	  To compile this driver as a module, choose M here.
```

## drivers/net/wireless/mediatek/mt76/mt7921/Kconfig
```kconfig
# SPDX-License-Identifier: ISC
config MT7921_COMMON
	tristate
	select MT76_CONNAC_LIB
	select WANT_DEV_COREDUMP

config MT7921E
	tristate "MediaTek MT7921E (PCIe) support"
	select MT7921_COMMON
	depends on MAC80211
	depends on PCI
	help
	  This adds support for MT7921E 802.11ax 2x2:2SS wireless devices.

	  To compile this driver as a module, choose M here.

config MT7921S
	tristate "MediaTek MT7921S (SDIO) support"
	select MT76_SDIO
	select MT7921_COMMON
	depends on MAC80211
	depends on MMC
	help
	  This adds support for MT7921S 802.11ax 2x2:2SS wireless devices.

	  To compile this driver as a module, choose M here.
```
