## drivers/net/wireless/iwlwifi/Kconfig
```kconfig
config IWLWIFI
	tristate "Intel Wireless WiFi Next Gen AGN - Wireless-N/Advanced-N/Ultimate-N (iwlwifi) "
	depends on PCI && MAC80211 && HAS_IOMEM
	select FW_LOADER
	---help---
	  Select to build the driver supporting the:

	  Intel Wireless WiFi Link Next-Gen AGN

	  This option enables support for use with the following hardware:
		Intel Wireless WiFi Link 6250AGN Adapter
		Intel 6000 Series Wi-Fi Adapters (6200AGN and 6300AGN)
		Intel WiFi Link 1000BGN
		Intel Wireless WiFi 5150AGN
		Intel Wireless WiFi 5100AGN, 5300AGN, and 5350AGN
		Intel 6005 Series Wi-Fi Adapters
		Intel 6030 Series Wi-Fi Adapters
		Intel Wireless WiFi Link 6150BGN 2 Adapter
		Intel 100 Series Wi-Fi Adapters (100BGN and 130BGN)
		Intel 2000 Series Wi-Fi Adapters
		Intel 7260 Wi-Fi Adapter
		Intel 3160 Wi-Fi Adapter
		Intel 7265 Wi-Fi Adapter


	  This driver uses the kernel's mac80211 subsystem.

	  In order to use this driver, you will need a firmware
	  image for it. You can obtain the microcode from:

	          <http://wireless.kernel.org/en/users/Drivers/iwlwifi>.

	  The firmware is typically installed in /lib/firmware. You can
	  look in the hotplug script /etc/hotplug/firmware.agent to
	  determine which directory FIRMWARE_DIR is set to when the script
	  runs.

	  If you want to compile the driver as a module ( = code which can be
	  inserted in and removed from the running kernel whenever you want),
	  say M here and read <file:Documentation/kbuild/modules.txt>.  The
	  module will be called iwlwifi.

if IWLWIFI

config IWLWIFI_LEDS
	bool
	depends on LEDS_CLASS=y || LEDS_CLASS=IWLWIFI
	select LEDS_TRIGGERS
	select MAC80211_LEDS
	default y

config IWLDVM
	tristate "Intel Wireless WiFi DVM Firmware support"
	depends on m
	default IWLWIFI
	help
	  This is the driver that supports the DVM firmware which is
	  used by most existing devices (with the exception of 7260
	  and 3160).

config IWLMVM
	tristate "Intel Wireless WiFi MVM Firmware support"
	depends on m
	help
	  This is the driver that supports the MVM firmware which is
	  currently only available for 7260 and 3160 devices.

# don't call it _MODULE -- will confuse Kconfig/fixdep/...
config IWLWIFI_OPMODE_MODULAR
	bool
	default y if IWLDVM=m
	default y if IWLMVM=m

comment "WARNING: iwlwifi is useless without IWLDVM or IWLMVM"
	depends on IWLDVM=n && IWLMVM=n

config IWLWIFI_BCAST_FILTERING
	bool "Enable broadcast filtering"
	depends on IWLMVM
	help
	  Say Y here to enable default bcast filtering configuration.

	  Enabling broadcast filtering will drop any incoming wireless
	  broadcast frames, except some very specific predefined
	  patterns (e.g. incoming arp requests).

	  If unsure, don't enable this option, as some programs might
	  expect incoming broadcasts for their normal operations.

menu "Debugging Options"

config IWLWIFI_DEBUG
	bool "Enable full debugging output in the iwlwifi driver"
	---help---
	  This option will enable debug tracing output for the iwlwifi drivers

	  This will result in the kernel module being ~100k larger.  You can
	  control which debug output is sent to the kernel log by setting the
	  value in

		/sys/module/iwlwifi/parameters/debug

	  This entry will only exist if this option is enabled.

	  To set a value, simply echo an 8-byte hex value to the same file:

		  % echo 0x43fff > /sys/module/iwlwifi/parameters/debug

	  You can find the list of debug mask values in:
		  drivers/net/wireless/iwlwifi/iwl-debug.h

	  If this is your first time using this driver, you should say Y here
	  as the debug information can assist others in helping you resolve
	  any problems you may encounter.

config IWLWIFI_DEBUGFS
        bool "iwlwifi debugfs support"
        depends on MAC80211_DEBUGFS
        ---help---
	  Enable creation of debugfs files for the iwlwifi drivers. This
	  is a low-impact option that allows getting insight into the
	  driver's state at runtime.

config IWLWIFI_DEBUG_EXPERIMENTAL_UCODE
        bool "Experimental uCode support"
        depends on IWLWIFI_DEBUG
        ---help---
	  Enable use of experimental ucode for testing and debugging.

config IWLWIFI_DEVICE_TRACING
	bool "iwlwifi device access tracing"
	depends on EVENT_TRACING
	help
	  Say Y here to trace all commands, including TX frames and IO
	  accesses, sent to the device. If you say yes, iwlwifi will
	  register with the ftrace framework for event tracing and dump
	  all this information to the ringbuffer, you may need to
	  increase the ringbuffer size. See the ftrace documentation
	  for more information.

	  When tracing is not enabled, this option still has some
	  (though rather small) overhead.

	  If unsure, say Y so we can help you better when problems
	  occur.
endmenu

endif
```

## drivers/net/wireless/iwmc3200wifi/Kconfig
```kconfig
config IWM
	tristate "Intel Wireless Multicomm 3200 WiFi driver"
	depends on MMC && EXPERIMENTAL
	depends on CFG80211
	select FW_LOADER
	select IWMC3200TOP
	help
	  The Intel Wireless Multicomm 3200 hardware is a combo
	  card with GPS, Bluetooth, WiMax and 802.11 radios. It
	  runs over SDIO and is typically found on Moorestown
	  based platform. This driver takes care of the 802.11
	  part, which is a fullmac one.

	  If you choose to build it as a module, it'll be called
	  iwmc3200wifi.ko.

config IWM_DEBUG
	bool "Enable full debugging output in iwmc3200wifi"
	depends on IWM && DEBUG_FS
	---help---
	  This option will enable debug tracing and setting for iwm

	  You can set the debug level and module through debugfs. By
	  default all modules are set to the IWL_DL_ERR level.
	  To see the list of debug modules and levels, see iwm/debug.h

	  For example, if you want the full MLME debug output:
	  echo 0xff > /sys/kernel/debug/iwm/phyN/debug/mlme

	  Or, if you want the full debug, for all modules:
	  echo 0xff > /sys/kernel/debug/iwm/phyN/debug/level
	  echo 0xff > /sys/kernel/debug/iwm/phyN/debug/modules
```

## drivers/net/wireless/legacy/Kconfig
```kconfig
config USB_NET_RNDIS_WLAN
	tristate "Wireless RNDIS USB support"
	depends on USB
	depends on CFG80211
	select USB_NET_DRIVERS
	select USB_USBNET
	select USB_NET_CDCETHER
	select USB_NET_RNDIS_HOST
	help
	  This is a driver for wireless RNDIS devices.
	  These are USB based adapters found in devices such as:

	  Buffalo WLI-U2-KG125S
	  U.S. Robotics USR5421
	  Belkin F5D7051
	  Linksys WUSB54GSv2
	  Linksys WUSB54GSC
	  Asus WL169gE
	  Eminent EM4045
	  BT Voyager 1055
	  Linksys WUSB54GSv1
	  U.S. Robotics USR5420
	  BUFFALO WLI-USB-G54

	  All of these devices are based on Broadcom 4320 chip which is the
	  only wireless RNDIS chip known to date.

	  If you choose to build a module, it'll be called rndis_wlan.
```

## drivers/net/wireless/marvell/Kconfig
```kconfig
# SPDX-License-Identifier: GPL-2.0-only
config WLAN_VENDOR_MARVELL
	bool "Marvell devices"
	default y
	---help---
	  If you have a wireless card belonging to this class, say Y.

	  Note that the answer to this question doesn't directly affect the
	  kernel: saying N will just cause the configurator to skip all the
	  questions about these cards. If you say Y, you will be asked for
	  your specific card in the following questions.

if WLAN_VENDOR_MARVELL

source "drivers/net/wireless/marvell/libertas/Kconfig"
source "drivers/net/wireless/marvell/libertas_tf/Kconfig"
source "drivers/net/wireless/marvell/mwifiex/Kconfig"

config MWL8K
	tristate "Marvell 88W8xxx PCI/PCIe Wireless support"
	depends on MAC80211 && PCI
	---help---
	  This driver supports Marvell TOPDOG 802.11 wireless cards.

	  To compile this driver as a module, choose M here: the module
	  will be called mwl8k.  If unsure, say N.

endif # WLAN_VENDOR_MARVELL
```

## drivers/net/wireless/marvell/libertas/Kconfig
```kconfig
config LIBERTAS
	tristate "Marvell 8xxx Libertas WLAN driver support"
	depends on CFG80211
	select WIRELESS_EXT
	select WEXT_SPY
	select LIB80211
	select FW_LOADER
	---help---
	  A library for Marvell Libertas 8xxx devices.

config LIBERTAS_USB
	tristate "Marvell Libertas 8388 USB 802.11b/g cards"
	depends on LIBERTAS && USB
	---help---
	  A driver for Marvell Libertas 8388 USB devices.

config LIBERTAS_CS
	tristate "Marvell Libertas 8385 CompactFlash 802.11b/g cards"
	depends on LIBERTAS && PCMCIA && HAS_IOPORT_MAP
	---help---
	  A driver for Marvell Libertas 8385 CompactFlash devices.

config LIBERTAS_SDIO
	tristate "Marvell Libertas 8385/8686/8688 SDIO 802.11b/g cards"
	depends on LIBERTAS && MMC
	---help---
	  A driver for Marvell Libertas 8385/8686/8688 SDIO devices.

config LIBERTAS_SPI
	tristate "Marvell Libertas 8686 SPI 802.11b/g cards"
	depends on LIBERTAS && SPI
	---help---
	  A driver for Marvell Libertas 8686 SPI devices.

config LIBERTAS_DEBUG
	bool "Enable full debugging output in the Libertas module."
	depends on LIBERTAS
	---help---
	  Debugging support.

config LIBERTAS_MESH
	bool "Enable mesh support"
	depends on LIBERTAS
	help
	  This enables Libertas' MESH support, used by e.g. the OLPC people.
```

## drivers/net/wireless/marvell/libertas_tf/Kconfig
```kconfig
# SPDX-License-Identifier: GPL-2.0-only
config LIBERTAS_THINFIRM
	tristate "Marvell 8xxx Libertas WLAN driver support with thin firmware"
	depends on MAC80211
	select FW_LOADER
	help
	  A library for Marvell Libertas 8xxx devices using thinfirm.

config LIBERTAS_THINFIRM_DEBUG
	bool "Enable full debugging output in the Libertas thin firmware module."
	depends on LIBERTAS_THINFIRM
	help
	  Debugging support.

config LIBERTAS_THINFIRM_USB
	tristate "Marvell Libertas 8388 USB 802.11b/g cards with thin firmware"
	depends on LIBERTAS_THINFIRM && USB
	help
	  A driver for Marvell Libertas 8388 USB devices using thinfirm.
```

## drivers/net/wireless/marvell/mwifiex/Kconfig
```kconfig
# SPDX-License-Identifier: GPL-2.0-only
config MWIFIEX
	tristate "Marvell WiFi-Ex Driver"
	depends on CFG80211
	help
	  This adds support for wireless adapters based on Marvell
	  802.11n/ac chipsets.

	  If you choose to build it as a module, it will be called
	  mwifiex.

config MWIFIEX_SDIO
	tristate "Marvell WiFi-Ex Driver for SD8786/SD8787/SD8797/SD8887/SD8897/SD8977/SD8978/SD8987/SD8997"
	depends on MWIFIEX && MMC
	select FW_LOADER
	select WANT_DEV_COREDUMP
	help
	  This adds support for wireless adapters based on Marvell
	  8786/8787/8797/8887/8897/8977/8978/8987/8997 chipsets with
	  SDIO interface. SD8978 is also known as NXP IW416.

	  If you choose to build it as a module, it will be called
	  mwifiex_sdio.

config MWIFIEX_PCIE
	tristate "Marvell WiFi-Ex Driver for PCIE 8766/8897/8997"
	depends on MWIFIEX && PCI
	select FW_LOADER
	select WANT_DEV_COREDUMP
	help
	  This adds support for wireless adapters based on Marvell
	  8766/8897/8997 chipsets with PCIe interface.

	  If you choose to build it as a module, it will be called
	  mwifiex_pcie.

config MWIFIEX_USB
	tristate "Marvell WiFi-Ex Driver for USB8766/8797/8997"
	depends on MWIFIEX && USB
	select FW_LOADER
	help
	  This adds support for wireless adapters based on Marvell
	  8797/8997 chipset with USB interface.

	  If you choose to build it as a module, it will be called
	  mwifiex_usb.
```

## drivers/net/wireless/mediatek/Kconfig
```kconfig
config WLAN_VENDOR_MEDIATEK
	bool "MediaTek devices"
	default y
	---help---
	  If you have a wireless card belonging to this class, say Y.

	  Note that the answer to this question doesn't directly affect the
	  kernel: saying N will just cause the configurator to skip all
	  the questions about  cards. If you say Y, you will be asked for
	  your specific card in the following questions.

if WLAN_VENDOR_MEDIATEK
source "drivers/net/wireless/mediatek/mt7601u/Kconfig"
endif # WLAN_VENDOR_MEDIATEK
```

## drivers/net/wireless/mediatek/mt76/Kconfig
```kconfig
# SPDX-License-Identifier: GPL-2.0-only
config MT76_CORE
	tristate

config MT76_LEDS
	bool
	depends on MT76_CORE
	depends on LEDS_CLASS=y || MT76_CORE=LEDS_CLASS
	default y

config MT76_USB
	tristate
	depends on MT76_CORE

config MT76_SDIO
	tristate
	depends on MT76_CORE

config MT76x02_LIB
	tristate
	select MT76_CORE

config MT76x02_USB
	tristate
	select MT76_USB

config MT76_CONNAC_LIB
	tristate
	select MT76_CORE

source "drivers/net/wireless/mediatek/mt76/mt76x0/Kconfig"
source "drivers/net/wireless/mediatek/mt76/mt76x2/Kconfig"
source "drivers/net/wireless/mediatek/mt76/mt7603/Kconfig"
source "drivers/net/wireless/mediatek/mt76/mt7615/Kconfig"
source "drivers/net/wireless/mediatek/mt76/mt7915/Kconfig"
source "drivers/net/wireless/mediatek/mt76/mt7921/Kconfig"
```

## drivers/net/wireless/mediatek/mt76/mt7603/Kconfig
```kconfig
# SPDX-License-Identifier: BSD-3-Clause-Clear
config MT7603E
	tristate "MediaTek MT7603E (PCIe) and MT76x8 WLAN support"
	select MT76_CORE
	depends on MAC80211
	depends on PCI
	help
	  This adds support for MT7603E PCIe wireless devices and the WLAN core
	  on MT7628/MT7688 SoC devices. This family supports IEEE 802.11n 2x2
	  to 300Mbps PHY rate

	  To compile this driver as a module, choose M here.
```

## drivers/net/wireless/mediatek/mt76/mt7615/Kconfig
```kconfig
# SPDX-License-Identifier: GPL-2.0-only

config MT7615_COMMON
	tristate
	select MT76_CORE

config MT7615E
	tristate "MediaTek MT7615E and MT7663E (PCIe) support"
	select MT7615_COMMON
	depends on MAC80211
	depends on PCI
	help
	  This adds support for MT7615-based wireless PCIe devices,
	  which support concurrent dual-band operation at both 5GHz
	  and 2.4GHz, IEEE 802.11ac 4x4:4SS 1733Mbps PHY rate, wave2
	  MU-MIMO up to 4 users/group and 160MHz channels.

	  To compile this driver as a module, choose M here.

config MT7622_WMAC
	bool "MT7622 (SoC) WMAC support"
	depends on MT7615E
	depends on ARCH_MEDIATEK || COMPILE_TEST
	select REGMAP
	default y
	help
	  This adds support for the built-in WMAC on MT7622 SoC devices
	  which has the same feature set as a MT7615, but limited to
	  2.4 GHz only.

config MT7663U
	tristate "MediaTek MT7663U (USB) support"
	select MT76_USB
	select MT7615_COMMON
	depends on MAC80211
	depends on USB
	help
	  This adds support for MT7663U 802.11ax 2x2:2 wireless devices.

	  To compile this driver as a module, choose M here.
```

## drivers/net/wireless/mediatek/mt76/mt76x0/Kconfig
```kconfig
# SPDX-License-Identifier: GPL-2.0-only
config MT76x0_COMMON
	tristate
	select MT76x02_LIB

config MT76x0U
	tristate "MediaTek MT76x0U (USB) support"
	select MT76x0_COMMON
	select MT76x02_USB
	depends on MAC80211
	depends on USB
	help
	  This adds support for MT7610U-based wireless USB 2.0 dongles,
	  which comply with IEEE 802.11ac standards and support 1x1
	  433Mbps PHY rate.

	  To compile this driver as a module, choose M here.

config MT76x0E
	tristate "MediaTek MT76x0E (PCIe) support"
	select MT76x0_COMMON
	depends on MAC80211
	depends on PCI
	help
	  This adds support for MT7610/MT7630-based wireless PCIe devices,
	  which comply with IEEE 802.11ac standards and support 1x1
	  433Mbps PHY rate.

	  To compile this driver as a module, choose M here.
```

## drivers/net/wireless/mediatek/mt76/mt76x2/Kconfig
```kconfig
# SPDX-License-Identifier: BSD-3-Clause-Clear
config MT76x2_COMMON
	tristate
	select MT76x02_LIB

config MT76x2E
	tristate "MediaTek MT76x2E (PCIe) support"
	select MT76x2_COMMON
	depends on MAC80211
	depends on PCI
	help
	  This adds support for MT7612/MT7602/MT7662-based PCIe wireless
	  devices, which comply with IEEE 802.11ac standards and support
	  2SS to 866Mbit/s PHY rate.

	  To compile this driver as a module, choose M here.

config MT76x2U
	tristate "MediaTek MT76x2U (USB) support"
	select MT76x2_COMMON
	select MT76x02_USB
	depends on MAC80211
	depends on USB
	help
	  This adds support for MT7612U-based USB 3.0 wireless dongles,
	  which comply with IEEE 802.11ac standards and support 2SS to
	  866Mbit/s PHY rate.

	  To compile this driver as a module, choose M here.
```
