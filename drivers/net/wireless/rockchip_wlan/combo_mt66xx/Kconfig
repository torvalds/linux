## drivers/net/wireless/rockchip_wlan/combo_mt66xx/Kconfig
```kconfig
menuconfig MTK_COMBO_MT66XX
	bool "MediaTek combo_mt66xx WiFi Config"
	help
	  Config MTK combo chip mt6628&mt6620

if MTK_COMBO_MT66XX

config MTK_COMBO_WIFI
	tristate "MediaTek Combo Chip Wi-Fi support"
	default y
	#depends on MTK_COMBO_WMT
	depends on MMC
	depends on IPV6
	select WIRELESS_EXT
	select WEXT_PRIV
	help
	  This module adds support for wireless adapters based on
	  MTK MT66XX chipset.

	  This driver uses the kernel's wireless extensions subsystem.

	  If you choose to build a module, it'll be called dhd. Say M if
	  unsure.

endif
```

## drivers/net/wireless/rockchip_wlan/cywdhd/Kconfig
```kconfig
# SPDX-License-Identifier: GPL-2.0
config CYW_BCMDHD
	tristate "Cypress wireless sdio cards support"
	depends on (!AP6XXX)
	select WIRELESS_EXT
	select WEXT_PRIV
	#select CFG80211
	#select MAC80211
	select CFG80211_WEXT
	help
	  This module adds support for wireless adapters based on
	  Broadcom awzxxx chipset.

	  This driver uses the kernel's wireless extensions subsystem.

	  If you choose to build a module, it'll be called dhd. Say M if
	  unsure.

if CYW_BCMDHD
config SDIO_CIS_CYW43438
	bool "Cypress 43438 for keepalive"
config SDIO_CIS_CYW43012
	bool "Cypress 43012 for keepalive"
endif
```

## drivers/net/wireless/rockchip_wlan/cywdhd/bcmdhd/Kconfig
```kconfig
# SPDX-License-Identifier: GPL-2.0
config BCMDHD
	tristate "Broadcom FullMAC wireless cards support"
	---help---
	  This module adds support for wireless adapters based on
	  Broadcom FullMAC chipset.

	  If you choose to build a module, it'll be called dhd. Say M if
	  unsure.

config BCMDHD_SDIO
	bool "SDIO bus interface support"
	depends on BCMDHD && MMC

config BCMDHD_PCIE
	bool "PCIe bus interface support"
	depends on BCMDHD && PCI && !BCMDHD_SDIO

config BCM4354
	tristate "BCM4354 support"
	depends on BCMDHD

config BCM4356
	tristate "BCM4356 support"
	depends on BCMDHD
	default n

config BCMDHD_FW_PATH
	depends on BCMDHD
	string "Firmware path"
	default "/system/vendor/firmware/fw_bcmdhd.bin"
	---help---
	  Path to the firmware file.

config BCMDHD_NVRAM_PATH
	depends on BCMDHD
	string "NVRAM path"
	default "/system/etc/wifi/bcmdhd.cal"
	---help---
	  Path to the calibration file.

config BCMDHD_WEXT
	bool "Enable WEXT support"
	depends on BCMDHD && CFG80211 = n
	select WIRELESS_EXT
	select WEXT_PRIV
	help
	  Enables WEXT support

config DHD_USE_STATIC_BUF
	bool "Enable memory preallocation"
	depends on BCMDHD
	default n
	---help---
	  Use memory preallocated in platform

config DHD_USE_SCHED_SCAN
	bool "Use CFG80211 sched scan"
	depends on BCMDHD && CFG80211
	default n
	---help---
	  Use CFG80211 sched scan

config DHD_SET_RANDOM_MAC_VAL
hex "Vendor OUI"
depends on BCMDHD
default 0x001A11
 ---help---
Set vendor OUI for SoftAP
```

## drivers/net/wireless/rockchip_wlan/esp8089/Kconfig
```kconfig
config ESP8089
#      depends on WLAN_80211 && MMC
      select WIRELESS_EXT
      select WEXT_PRIV
      select CFG80211
      select MAC80211
	  select NL80211_TESTMODE
      bool "Espressif 8089 sdio Wi-Fi"
      ---help---
        Espressif 8089 sdio Wi-Fi support
	
  config BK3515A_COMBO
	  depends on ESP8089
	  select WIRELESS_EXT
	  select WEXT_PRIV
	  select CFG80211
	  select MAC80211
	  select NL80211_TESTMODE
	  bool "Espressif 8089 sdio Wi-Fi combo with BK3515A bluetooth"
	  ---help---
	    RK Wi-Fi+BT+[GPS optional] Combo module support
```

## drivers/net/wireless/rockchip_wlan/infineon/Kconfig
```kconfig
# SPDX-License-Identifier: GPL-2.0
config INFINEON_DHD
	tristate "Infineon wireless sdio cards support"
	depends on (!AP6XXX)
	select WIRELESS_EXT
	select WEXT_PRIV
	#select CFG80211
	#select MAC80211
	select CFG80211_WEXT
	help
	  This module adds support for wireless adapters based on
	  Infineon chipset.
```

## drivers/net/wireless/rockchip_wlan/infineon/bcmdhd/Kconfig
```kconfig
#
# $ Copyright Open Broadcom $
#
#
# <<Broadcom-WL-IPTag/Open:>>
#

config BCMDHD
	tristate "Broadcom FullMAC wireless cards support"
	---help---
	  This module adds support for wireless adapters based on
	  Broadcom FullMAC chipset.

	  If you choose to build a module, it'll be called dhd. Say M if
	  unsure.

config BCMDHD_SDIO
	bool "SDIO bus interface support"
	depends on BCMDHD && MMC

config BCMDHD_PCIE
	bool "PCIe bus interface support"
	depends on BCMDHD && PCI && !BCMDHD_SDIO

config BCM4354
	tristate "BCM4354 support"
	depends on BCMDHD

config BCM4356
	tristate "BCM4356 support"
	depends on BCMDHD
	default n

config BCM4358
	tristate "BCM4358 support"
	depends on BCMDHD
	default n

config BCM4359
	tristate "BCM4359 support"
	depends on BCMDHD
	default y

config BCM4361
	tristate "BCM4361 support"
	depends on BCMDHD
	default n

config CYW89570
	tristate "CYW89570 support"
	depends on BCMDHD
	default y

config DHD_OF_SUPPORT
	bool "Use in-drive platform device"
	depends on BCMDHD
	default n

config BCMDHD_FW_PATH
	depends on BCMDHD
	string "Firmware path"
	default "/system/vendor/firmware/fw_bcmdhd.bin"
	---help---
	  Path to the firmware file.

config BCMDHD_NVRAM_PATH
	depends on BCMDHD
	string "NVRAM path"
	default "/system/etc/wifi/bcmdhd.cal"
	---help---
	  Path to the calibration file.

config BROADCOM_WIFI_RESERVED_MEM
	bool "BROADCOM Reserved memory for wifi device"
	depends on BCMDHD
	---help---
	  This is a configuration for Broadcom WLAN driver.

config BCMDHD_WEXT
	bool "Enable WEXT support"
	depends on BCMDHD && CFG80211 = n
	select WIRELESS_EXT
	select WEXT_PRIV
	help
	  Enables WEXT support

config DHD_USE_STATIC_BUF
	bool "Enable memory preallocation"
	depends on BCMDHD
	default n
	---help---
	  Use memory preallocated in platform

config DHD_USE_SCHED_SCAN
	bool "Use CFG80211 sched scan"
	depends on BCMDHD && CFG80211
	default n
	---help---
	  Use CFG80211 sched scan

config DHD_SET_RANDOM_MAC_VAL
	hex "Vendor OUI"
	depends on BCMDHD
	default 0x001A11
	---help---
	  Set vendor OUI for SoftAP

config WLAN_REGION_CODE
	int "---Region codes for Broadcom WiFi Driver"
	depends on BCMDHD
	default 100
	---help---
		This is a region code for Broadcom Wi-Fi featured functions.
		- 100 : EUR OPEN
		- 101 : EUR ORG
		- 200 : KOR OPEN
		- 201 : KOR SKT
		- 202 : KOR KTT
		- 203 : KOR LGT
		- 300 : CHN OPEN

config WLAIBSS
	bool "Advanced IBSS mode"
	depends on (BCM4335 || BCM4339 || BCM4354 || BCM4358 || BCM4359 || BCM4361)
	default y
	---help---
	  This is a configuration for Oxygen Network.

config WL_RELMCAST
	bool "Reliable Multicast Support"
	depends on (BCM4335 || BCM4339 || BCM4354 || BCM4358 || BCM4359 || BCM4361)
	default y
	---help---
	  This is a configuration for RMC.

config WL_NAN
	bool "NAN Feature"
	depends on BCMDHD
	default n
	---help---
	  This is a configuration for NAN Feature.

config WL_AP_IF
	bool "Create additional AP interface during intialization"
	default n
	---help---
	  Create additional AP interface during initialization.

config BCMDHD_PREALLOC_PKTIDMAP
	bool "BROADCOM PCIE specific memory reserved for PKTIDMAP"
	depends on BROADCOM_WIFI_RESERVED_MEM && BCMDHD_PCIE
	---help---
	  Preallocated memory support for PCIE interface in Broadcom
	  WLAN driver.

config BCMDHD_PREALLOC_MEMDUMP
	bool "BROADCOM PCIE specific memory reserved for MEMDUMP"
	depends on BROADCOM_WIFI_RESERVED_MEM
	---help---
	  Preallocated memory support for dongle memory dump

config BCMDHD_OOB_HOST_WAKE
        bool "Use the external WLAN_HOST_WAKE pin"
        depends on BCMDHD
        ---help---
          Use the external GPIO pin to wake up host

config BCMDHD_GET_OOB_STATE
        bool "Support WLAN_HOST_WAKE pin level information"
        depends on BCMDHD_OOB_HOST_WAKE
        default y
        ---help---
          Support WLAN_HOST_WAKE pin level information

config BCMDHD_WPA3
	bool "Support WPA3 feature"
	depends on BCMDHD
	default n
	---help---
	  This will enable WPA3 support
```

## drivers/net/wireless/rockchip_wlan/mvl88w8977/Kconfig
```kconfig
# SPDX-License-Identifier: GPL-2.0
config MVL88W8977
	tristate "Marvell 88W8977 SDIO WiFi"
	help
	  Help message of MVL88W8977
```

## drivers/net/wireless/rockchip_wlan/rkwifi/Kconfig
```kconfig
# SPDX-License-Identifier: GPL-2.0
config AP6XXX
	tristate "ap6xxx wireless cards support"
	depends on RFKILL_RK
	select CFG80211
	select MAC80211
	help
	  This module adds support for wireless adapters based on
	  Broadcom ap6xxx chipset.

	  This driver uses the kernel's wireless extensions subsystem.

	  If you choose to build a module, it'll be called dhd. Say M if
	  unsure.

choice
	prompt "Enable Chip Interface"
	depends on BCMDHD
	default BCMDHD_SDIO
	help
	  Enable Chip Interface.

config BCMDHD_SDIO
	bool "SDIO bus interface support"
	depends on BCMDHD && MMC

config BCMDHD_PCIE
	bool "PCIe bus interface support"
	depends on BCMDHD && PCI

endchoice

config PCIEASPM_ROCKCHIP_WIFI_EXTENSION
	bool "Extend ASPM function"
	depends on BCMDHD_PCIE && PCIEASPM_EXT
	help
	  This enables the extensions APIs for ASPM control.

config BCMDHD_FW_PATH
	depends on BCMDHD
	string "Firmware path"
	default "/vendor/etc/firmware/fw_bcmdhd.bin"
	help
	  Path to the firmware file.

config BCMDHD_NVRAM_PATH
	depends on BCMDHD
	string "NVRAM path"
	default "/vendor/etc/firmware/nvram.txt"
	help
	  Path to the calibration file.a

config BCMDHD_STATIC_IF
	bool "Enable wlan1 support"
	help
	  default to add wlan1 interface
```

## drivers/net/wireless/rockchip_wlan/rkwifi/bcmdhd_indep_power/Kconfig
```kconfig
# SPDX-License-Identifier: GPL-2.0
config BCMDHD_INDEP_POWER
	depends on BCMDHD
	bool "wifi keepalive"
	default y

config BCMDHD_FW_PATH
	depends on BCMDHD
	string "Firmware path"
	default "/vendor/etc/firmware/fw_bcmdhd.bin"
	help
	  Path to the firmware file.

config BCMDHD_NVRAM_PATH
	depends on BCMDHD
	string "NVRAM path"
	default "/vendor/etc/firmware/nvram.txt"
	help
	  Path to the calibration file.

config BCMDHD_WEXT
	bool "Enable WEXT support"
	depends on BCMDHD && CFG80211 = n
	select WIRELESS_EXT
	select WEXT_PRIV
	help
	  Enables WEXT support

choice
	prompt "Enable Chip Interface"
	depends on BCMDHD
	help
		Enable Chip Interface.
config BCMDHD_SDIO
		bool "SDIO bus interface support"
		depends on BCMDHD && MMC
config BCMDHD_PCIE
		bool "PCIe bus interface support"
		depends on BCMDHD && PCI
config BCMDHD_USB
		bool "USB bus interface support"
		depends on BCMDHD && USB
endchoice

choice
	depends on BCMDHD && BCMDHD_SDIO
	prompt "Interrupt type"
	help
		Interrupt type
config BCMDHD_OOB
	depends on BCMDHD && BCMDHD_SDIO
	bool "Out-of-Band Interrupt"
	default y
	help
		Interrupt from WL_HOST_WAKE.
config BCMDHD_SDIO_IRQ
	depends on BCMDHD && BCMDHD_SDIO
	bool "In-Band Interrupt"
	help
	  Interrupt from SDIO DAT[1]
endchoice
```

## drivers/net/wireless/rockchip_wlan/rtl8188eu/Kconfig
```kconfig
# SPDX-License-Identifier: GPL-2.0
config RTL8188EU
	tristate "Realtek 8188E USB WiFi"
	depends on USB
	---help---
	  Help message of RTL8188EU
```

## drivers/net/wireless/rockchip_wlan/rtl8188fu/Kconfig
```kconfig
# SPDX-License-Identifier: GPL-2.0
config RTL8188FU
	tristate "Realtek 8188F USB WiFi"
	depends on USB
	---help---
	  Help message of RTL8818FU
```

## drivers/net/wireless/rockchip_wlan/rtl8189es/Kconfig
```kconfig
# SPDX-License-Identifier: GPL-2.0
config RTL8189ES
	tristate "Realtek 8189E SDIO WiFi"
	depends on USB
	help
	  Help message of RTL8189ES
```

## drivers/net/wireless/rockchip_wlan/rtl8189fs/Kconfig
```kconfig
# SPDX-License-Identifier: GPL-2.0
config RTL8189FS
	tristate "Realtek 8189F SDIO WiFi"
	help
	  Help message of RTL8189FS
```

## drivers/net/wireless/rockchip_wlan/rtl8192cu/Kconfig
```kconfig
# SPDX-License-Identifier: GPL-2.0
config RTL8192CU
	tristate "Realtek 8192CU USB WiFi Support"
	depends on USB
	select WIRELESS_EXT
	select WEXT_PRIV
	select IEEE80211
	---help---
	  Help message of RTL8192CU
```

## drivers/net/wireless/rockchip_wlan/rtl8192du/Kconfig
```kconfig
# SPDX-License-Identifier: GPL-2.0
config RTL8192DU
	tristate "Realtek 8192DU USB WiFi Support"
	depends on USB
	select WIRELESS_EXT
	select WEXT_PRIV
	select IEEE80211
	---help---
	  Help message of RTL8192DU
```

## drivers/net/wireless/rockchip_wlan/rtl8723au/Kconfig
```kconfig
# SPDX-License-Identifier: GPL-2.0
config RTL8723AU
	tristate "Realtek 8723AU USB WiFi Support"
	depends on USB
        select WIRELESS_EXT
        select WEXT_PRIV
        select IEEE80211
        select BT_RTKBTUSB
        select UHID
	---help---
	  Help message of RTL8723AU
```

## drivers/net/wireless/rockchip_wlan/rtl8723bs-vq0/Kconfig
```kconfig
config RTL8723BS_VQ0
	tristate "Realtek 8723BS-VQ0 COB WiFi"
	---help---
	  Help message of RTL8723BS-VQ0 COB
```

## drivers/net/wireless/rockchip_wlan/rtl8723bs/Kconfig
```kconfig
# SPDX-License-Identifier: GPL-2.0
config RTL8723BS
	tristate "Realtek 8723B SDIO or SPI WiFi"
	---help---
	  Help message of RTL8723BS
```

## drivers/net/wireless/rockchip_wlan/rtl8723bu/Kconfig
```kconfig
# SPDX-License-Identifier: GPL-2.0
config RTL8723BU
	tristate "Realtek 8723B USB WiFi"
	depends on USB
	---help---
	  Help message of RTL8723BU
```

## drivers/net/wireless/rockchip_wlan/rtl8723cs/Kconfig
```kconfig
# SPDX-License-Identifier: GPL-2.0
config RTL8723CS
	tristate "Realtek 8723C SDIO or SPI WiFi"
	help
	  Help message of RTL8723CS
```

## drivers/net/wireless/rockchip_wlan/rtl8723ds/Kconfig
```kconfig
# SPDX-License-Identifier: GPL-2.0
config RTL8723DS
	tristate "Realtek 8723D SDIO or SPI WiFi"
	help
	  Help message of RTL8723DS
```

## drivers/net/wireless/rockchip_wlan/rtl8812au/Kconfig
```kconfig
config RTL8812AU
	tristate "Realtek 8812AU USB WiFi Support"
	depends on USB
        select WIRELESS_EXT
        select WEXT_PRIV
        select IEEE80211
        select BT_RTKBTUSB
        select UHID
	---help---
	  Help message of RTL8812AU
```

## drivers/net/wireless/rockchip_wlan/rtl8821cs/Kconfig
```kconfig
config RTL8821CS
	tristate "Realtek 8821C SDIO WiFi"
	---help---
	  Help message of RTL8821CS
```

## drivers/net/wireless/rockchip_wlan/rtl8822be/Kconfig
```kconfig
# SPDX-License-Identifier: GPL-2.0
config RTL8822BE
	tristate "Realtek 8822B PCIE WiFi"
	depends on PCI
	---help---
	  Help message of RTL8822BE
```
