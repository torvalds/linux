## drivers/net/wireless/ti/Kconfig
```kconfig
config WLAN_VENDOR_TI
	bool "Texas Instrument devices"
	default y
	---help---
	  If you have a wireless card belonging to this class, say Y.

	  Note that the answer to this question doesn't directly affect the
	  kernel: saying N will just cause the configurator to skip all the
	  questions about these cards. If you say Y, you will be asked for
	  your specific card in the following questions.

if WLAN_VENDOR_TI
source "drivers/net/wireless/ti/wl1251/Kconfig"
source "drivers/net/wireless/ti/wl12xx/Kconfig"
source "drivers/net/wireless/ti/wl18xx/Kconfig"

# keep last for automatic dependencies
source "drivers/net/wireless/ti/wlcore/Kconfig"

config WILINK_PLATFORM_DATA
	bool "TI WiLink platform data"
	depends on WLCORE_SDIO || WL1251_SDIO
	default y
	---help---
	Small platform data bit needed to pass data to the sdio modules.


endif # WLAN_VENDOR_TI
```

## drivers/net/wireless/ti/wl1251/Kconfig
```kconfig
# SPDX-License-Identifier: GPL-2.0-only
config WL1251
	tristate "TI wl1251 driver support"
	depends on MAC80211
	select FW_LOADER
	select CRC7
	help
	  This will enable TI wl1251 driver support. The drivers make
	  use of the mac80211 stack.

	  If you choose to build a module, it'll be called wl1251. Say
	  N if unsure.

config WL1251_SPI
	tristate "TI wl1251 SPI support"
	depends on WL1251 && SPI_MASTER
	help
	  This module adds support for the SPI interface of adapters using
	  TI wl1251 chipset.  Select this if your platform is using
	  the SPI bus.

	  If you choose to build a module, it'll be called wl1251_spi.
	  Say N if unsure.

config WL1251_SDIO
	tristate "TI wl1251 SDIO support"
	depends on WL1251 && MMC
	help
	  This module adds support for the SDIO interface of adapters using
	  TI wl1251 chipset.  Select this if your platform is using
	  the SDIO bus.

	  If you choose to build a module, it'll be called
	  wl1251_sdio. Say N if unsure.
```

## drivers/net/wireless/ti/wl12xx/Kconfig
```kconfig
# SPDX-License-Identifier: GPL-2.0-only
config WL12XX
       tristate "TI wl12xx support"
	depends on MAC80211
       select WLCORE
       ---help---
	  This module adds support for wireless adapters based on TI wl1271,
	  wl1273, wl1281 and wl1283 chipsets. This module does *not* include
	  support for wl1251.  For wl1251 support, use the separate homonymous
	   driver instead.
```

## drivers/net/wireless/ti/wl18xx/Kconfig
```kconfig
config WL18XX
       tristate "TI wl18xx support"
       select WLCORE
       ---help---
	  This module adds support for wireless adapters based on TI
	  WiLink 8 chipsets.
```

## drivers/net/wireless/ti/wlcore/Kconfig
```kconfig
config WLCORE
	tristate "TI wlcore support"
	depends on WL_TI && GENERIC_HARDIRQS && MAC80211
	select FW_LOADER
	---help---
	  This module contains the main code for TI WLAN chips.  It abstracts
	  hardware-specific differences among different chipset families.
	  Each chipset family needs to implement its own lower-level module
	  that will depend on this module for the common code.

	  If you choose to build a module, it will be called wlcore. Say N if
	  unsure.

config WLCORE_SPI
	tristate "TI wlcore SPI support"
	depends on WLCORE && SPI_MASTER
	select CRC7
	---help---
	  This module adds support for the SPI interface of adapters using
	  TI WLAN chipsets.  Select this if your platform is using
	  the SPI bus.

	  If you choose to build a module, it'll be called wlcore_spi.
	  Say N if unsure.

config WLCORE_SDIO
	tristate "TI wlcore SDIO support"
	depends on WLCORE && MMC
	---help---
	  This module adds support for the SDIO interface of adapters using
	  TI WLAN chipsets.  Select this if your platform is using
	  the SDIO bus.

	  If you choose to build a module, it'll be called wlcore_sdio.
	  Say N if unsure.

config WL12XX_PLATFORM_DATA
	bool
	depends on WLCORE_SDIO != n || WL1251_SDIO != n
	default y
```

## drivers/net/wireless/virtual/Kconfig
```kconfig
config MAC80211_HWSIM
	tristate "Simulated radio testing tool for mac80211"
	depends on MAC80211
	help
	  This driver is a developer testing tool that can be used to test
	  IEEE 802.11 networking stack (mac80211) functionality. This is not
	  needed for normal wireless LAN usage and is only for testing. See
	  Documentation/networking/mac80211_hwsim for more information on how
	  to use this tool.

	  To compile this driver as a module, choose M here: the module will be
	  called mac80211_hwsim.  If unsure, say N.

config VIRT_WIFI
	tristate "Wifi wrapper for ethernet drivers"
	depends on CFG80211
	help
	  This option adds support for ethernet connections to appear as if they
	  are wifi connections through a special rtnetlink device.
```

## drivers/net/wireless/wl12xx/Kconfig
```kconfig
menuconfig WL12XX_MENU
	tristate "TI wl12xx driver support"
	depends on MAC80211 && EXPERIMENTAL
	---help---
	  This will enable TI wl12xx driver support for the following chips:
	  wl1271 and wl1273.
	  The drivers make use of the mac80211 stack.

config WL12XX
	tristate "TI wl12xx support"
	depends on WL12XX_MENU && GENERIC_HARDIRQS
	depends on INET
	select FW_LOADER
	select CRC7
	---help---
	  This module adds support for wireless adapters based on TI wl1271 and
	  TI wl1273 chipsets. This module does *not* include support for wl1251.
	  For wl1251 support, use the separate homonymous driver instead.

	  If you choose to build a module, it will be called wl12xx. Say N if
	  unsure.

config WL12XX_HT
        bool "TI wl12xx 802.11 HT support (EXPERIMENTAL)"
        depends on WL12XX && EXPERIMENTAL
        default n
        ---help---
          This will enable 802.11 HT support in the wl12xx module.

	  That configuration is temporary due to the code incomplete and
	  still in testing process.

config WL12XX_SPI
	tristate "TI wl12xx SPI support"
	depends on WL12XX && SPI_MASTER
	---help---
	  This module adds support for the SPI interface of adapters using
	  TI wl12xx chipsets.  Select this if your platform is using
	  the SPI bus.

	  If you choose to build a module, it'll be called wl12xx_spi.
	  Say N if unsure.

config WL12XX_SDIO
	tristate "TI wl12xx SDIO support"
	depends on WL12XX && MMC
	---help---
	  This module adds support for the SDIO interface of adapters using
	  TI wl12xx chipsets.  Select this if your platform is using
	  the SDIO bus.

	  If you choose to build a module, it'll be called wl12xx_sdio.
	  Say N if unsure.

config WL12XX_SDIO_TEST
	tristate "TI wl12xx SDIO testing support"
	depends on WL12XX && MMC
	default n
	---help---
	  This module adds support for the SDIO bus testing with the
	  TI wl12xx chipsets.  You probably don't want this unless you are
	  testing a new hardware platform.  Select this if you want to test the
	  SDIO bus which is connected to the wl12xx chip.

config WL12XX_PLATFORM_DATA
	bool
	depends on WL12XX_SDIO != n || WL1251_SDIO != n
	default y
```

## drivers/net/wireless/zydas/Kconfig
```kconfig
# SPDX-License-Identifier: GPL-2.0-only
config WLAN_VENDOR_ZYDAS
	bool "ZyDAS devices"
	default y
	help
	  If you have a wireless card belonging to this class, say Y.

	  Note that the answer to this question doesn't directly affect the
	  kernel: saying N will just cause the configurator to skip all the
	  questions about these cards. If you say Y, you will be asked for
	  your specific card in the following questions.

if WLAN_VENDOR_ZYDAS

config USB_ZD1201
	tristate "USB ZD1201 based Wireless device support"
	depends on CFG80211 && USB
	select WIRELESS_EXT
	select WEXT_PRIV
	select FW_LOADER
	help
	  Say Y if you want to use wireless LAN adapters based on the ZyDAS
	  ZD1201 chip.

	  This driver makes the adapter appear as a normal Ethernet interface,
	  typically on wlan0.

	  The zd1201 device requires external firmware to be loaded.
	  This can be found at http://linux-lc100020.sourceforge.net/

	  To compile this driver as a module, choose M here: the
	  module will be called zd1201.

source "drivers/net/wireless/zydas/zd1211rw/Kconfig"

endif # WLAN_VENDOR_ZYDAS
```

## drivers/net/wireless/zydas/zd1211rw/Kconfig
```kconfig
config ZD1211RW
	tristate "ZyDAS ZD1211/ZD1211B USB-wireless support"
	depends on USB && MAC80211
	select FW_LOADER
	---help---
	  This is a driver for the ZyDAS ZD1211/ZD1211B wireless
	  chip, present in many USB-wireless adapters.

	  Device firmware is required alongside this driver. You can download
	  the firmware distribution from http://sf.net/projects/zd1211/files/

config ZD1211RW_DE
	bool "ZyDAS ZD1211 deging"
	depends on ZD1211RW
	---help---
	  ZD1211 deging messages. Choosing Y will result in additional de
	  messages being saved to your kernel logs, which may help de any
	  problems.
```
