## drivers/net/wireless/rockchip_wlan/rtl8822bs/Kconfig
```kconfig
config RTL8822BS
	tristate "Realtek 8822B SDIO WiFi"
	help
	  Help message of RTL8822BS
```

## drivers/net/wireless/rockchip_wlan/ssv6xxx/Kconfig
```kconfig
menu "SouthSV 6XXX WLAN support"
config SSV6051
	tristate "ssv6XXX Wireless driver"
	depends on MAC80211 && MMC
	---help---
		Enable SouthSV 6XXX WLAN kernel driver.

endmenu
```

## drivers/net/wireless/rockchip_wlan/ssv6xxx/bridge/Kconfig
```kconfig
config SSV_SDIO_BRIDGE_HW
	tristate
	default m
	depends on MMC
	help
	  This option enables the SDIO bus support in ssvcabrio.

	  Say Y, if you have a ssv SDIO device.

config SSV_SDIO_BRIDGE_DEBUGFS
	bool "SSV ssvsdiobridge debugging"
	depends on DEBUG_FS
	help
	  Say Y, if you need access to ssvsdiobridge's statistics.

	  Also required for changing debug message flags at run time.
```

## drivers/net/wireless/rsi/Kconfig
```kconfig
config WLAN_VENDOR_RSI
	bool "Redpine Signals Inc devices"
	default y
	---help---
	  If you have a wireless card belonging to this class, say Y.

	  Note that the answer to this question doesn't directly affect the
	  kernel: saying N will just cause the configurator to skip all
	  the questions about  cards. If you say Y, you will be asked for
	  your specific card in the following questions.

if WLAN_VENDOR_RSI

config RSI_91X
	tristate "Redpine Signals Inc 91x WLAN driver support"
	depends on MAC80211
	---help---
	  This option enabes support for RSI 1x1 devices.
	  Select M (recommended), if you have a RSI 1x1 wireless module.

config RSI_DEBUGFS
	bool "Redpine Signals Inc debug support"
	depends on RSI_91X
	default y
	---help---
	 Say Y, if you would like to enable debug support. This option
	 creates debugfs entries

config RSI_SDIO
	tristate "Redpine Signals SDIO bus support"
	depends on MMC && RSI_91X
	default m
	---help---
	  This option enables the SDIO bus support in rsi drivers.
	  Select M (recommended), if you have a RSI 1x1 wireless module.

config RSI_USB
	tristate "Redpine Signals USB bus support"
	depends on USB && RSI_91X
	default m
	---help---
	  This option enables the USB bus support in rsi drivers.
	  Select M (recommended), if you have a RSI 1x1 wireless module.

endif # WLAN_VENDOR_RSI
```

## drivers/net/wireless/rt2x00/Kconfig
```kconfig
menuconfig RT2X00
	tristate "Ralink driver support"
	depends on MAC80211
	---help---
	  This will enable the support for the Ralink drivers,
	  developed in the rt2x00 project <http://rt2x00.serialmonkey.com>.

	  These drivers make use of the mac80211 stack.

	  When building one of the individual drivers, the rt2x00 library
	  will also be created. That library (when the driver is built as
	  a module) will be called rt2x00lib.

	  Additionally PCI and USB libraries will also be build depending
	  on the types of drivers being selected, these libraries will be
	  called rt2x00pci and rt2x00usb.

if RT2X00

config RT2400PCI
	tristate "Ralink rt2400 (PCI/PCMCIA) support"
	depends on PCI
	select RT2X00_LIB_PCI
	select EEPROM_93CX6
	---help---
	  This adds support for rt2400 wireless chipset family.
	  Supported chips: RT2460.

	  When compiled as a module, this driver will be called rt2400pci.

config RT2500PCI
	tristate "Ralink rt2500 (PCI/PCMCIA) support"
	depends on PCI
	select RT2X00_LIB_PCI
	select EEPROM_93CX6
	---help---
	  This adds support for rt2500 wireless chipset family.
	  Supported chips: RT2560.

	  When compiled as a module, this driver will be called rt2500pci.

config RT61PCI
	tristate "Ralink rt2501/rt61 (PCI/PCMCIA) support"
	depends on PCI
	select RT2X00_LIB_PCI
	select RT2X00_LIB_FIRMWARE
	select RT2X00_LIB_CRYPTO
	select CRC_ITU_T
	select EEPROM_93CX6
	---help---
	  This adds support for rt2501 wireless chipset family.
	  Supported chips: RT2561, RT2561S & RT2661.

	  When compiled as a module, this driver will be called rt61pci.

config RT2800PCI
	tristate "Ralink rt27xx/rt28xx/rt30xx (PCI/PCIe/PCMCIA) support"
	depends on PCI || RALINK_RT288X || RALINK_RT305X
	select RT2800_LIB
	select RT2X00_LIB_PCI if PCI
	select RT2X00_LIB_SOC if RALINK_RT288X || RALINK_RT305X
	select RT2X00_LIB_FIRMWARE
	select RT2X00_LIB_CRYPTO
	select CRC_CCITT
	select EEPROM_93CX6
	---help---
	  This adds support for rt27xx/rt28xx/rt30xx wireless chipset family.
	  Supported chips: RT2760, RT2790, RT2860, RT2880, RT2890, RT3052,
			   RT3090, RT3091 & RT3092

	  When compiled as a module, this driver will be called "rt2800pci.ko".

if RT2800PCI

config RT2800PCI_RT33XX
	bool "rt2800pci - Include support for rt33xx devices"
	default y
	---help---
	  This adds support for rt33xx wireless chipset family to the
	  rt2800pci driver.
	  Supported chips: RT3390

config RT2800PCI_RT35XX
	bool "rt2800pci - Include support for rt35xx devices (EXPERIMENTAL)"
	depends on EXPERIMENTAL
	default n
	---help---
	  This adds support for rt35xx wireless chipset family to the
	  rt2800pci driver.
	  Supported chips: RT3060, RT3062, RT3562, RT3592

	  Support for these devices is non-functional at the moment and is
	  intended for testers and developers.

config RT2800PCI_RT53XX
       bool "rt2800pci - Include support for rt53xx devices (EXPERIMENTAL)"
       depends on EXPERIMENTAL
       default y
       ---help---
         This adds support for rt53xx wireless chipset family to the
         rt2800pci driver.
         Supported chips: RT5390

endif

config RT2500USB
	tristate "Ralink rt2500 (USB) support"
	depends on USB
	select RT2X00_LIB_USB
	select RT2X00_LIB_CRYPTO
	---help---
	  This adds support for rt2500 wireless chipset family.
	  Supported chips: RT2571 & RT2572.

	  When compiled as a module, this driver will be called rt2500usb.

config RT73USB
	tristate "Ralink rt2501/rt73 (USB) support"
	depends on USB
	select RT2X00_LIB_USB
	select RT2X00_LIB_FIRMWARE
	select RT2X00_LIB_CRYPTO
	select CRC_ITU_T
	---help---
	  This adds support for rt2501 wireless chipset family.
	  Supported chips: RT2571W, RT2573 & RT2671.

	  When compiled as a module, this driver will be called rt73usb.

config RT2800USB
	tristate "Ralink rt27xx/rt28xx/rt30xx (USB) support"
	depends on USB
	select RT2800_LIB
	select RT2X00_LIB_USB
	select RT2X00_LIB_FIRMWARE
	select RT2X00_LIB_CRYPTO
	select CRC_CCITT
	---help---
	  This adds support for rt27xx/rt28xx/rt30xx wireless chipset family.
	  Supported chips: RT2770, RT2870 & RT3070, RT3071 & RT3072

	  When compiled as a module, this driver will be called "rt2800usb.ko".

if RT2800USB

config RT2800USB_RT33XX
	bool "rt2800usb - Include support for rt33xx devices"
	default y
	---help---
	  This adds support for rt33xx wireless chipset family to the
	  rt2800usb driver.
	  Supported chips: RT3370

config RT2800USB_RT35XX
	bool "rt2800usb - Include support for rt35xx devices (EXPERIMENTAL)"
	depends on EXPERIMENTAL
	default n
	---help---
	  This adds support for rt35xx wireless chipset family to the
	  rt2800usb driver.
	  Supported chips: RT3572

	  Support for these devices is non-functional at the moment and is
	  intended for testers and developers.

config RT2800USB_RT53XX
       bool "rt2800usb - Include support for rt53xx devices (EXPERIMENTAL)"
       depends on EXPERIMENTAL
       default y
       ---help---
         This adds support for rt53xx wireless chipset family to the
         rt2800pci driver.
         Supported chips: RT5370

config RT2800USB_UNKNOWN
	bool "rt2800usb - Include support for unknown (USB) devices"
	default n
	---help---
	  This adds support for rt2800usb devices that are known to
	  have a rt28xx family compatible chipset, but for which the exact
	  chipset is unknown.

	  Support status for these devices is unknown, and enabling these
	  devices may or may not work.

endif

config RT2800_LIB
	tristate

config RT2X00_LIB_PCI
	tristate
	select RT2X00_LIB

config RT2X00_LIB_SOC
	tristate
	select RT2X00_LIB

config RT2X00_LIB_USB
	tristate
	select RT2X00_LIB

config RT2X00_LIB
	tristate

config RT2X00_LIB_FIRMWARE
	boolean
	select FW_LOADER

config RT2X00_LIB_CRYPTO
	boolean

config RT2X00_LIB_LEDS
	boolean
	default y if (RT2X00_LIB=y && LEDS_CLASS=y) || (RT2X00_LIB=m && LEDS_CLASS!=n)

config RT2X00_LIB_DEBUGFS
	bool "Ralink debugfs support"
	depends on RT2X00_LIB && MAC80211_DEBUGFS
	---help---
	  Enable creation of debugfs files for the rt2x00 drivers.
	  These debugfs files support both reading and writing of the
	  most important register types of the rt2x00 hardware.

config RT2X00_DEBUG
	bool "Ralink debug output"
	depends on RT2X00_LIB
	---help---
	  Enable debugging output for all rt2x00 modules

endif
```

## drivers/net/wireless/rtl8188eu/Kconfig
```kconfig
config RTL8188EU
	tristate "Realtek 8188EU USB WiFi Support"
    select WIRELESS_EXT
    select WEXT_PRIV
    select IEEE80211
	---help---
	  Help message of RTL8188EU & RTL8189ES
```

## drivers/net/wireless/rtl8189es/Kconfig
```kconfig
config RTL8189ES
	tristate "Realtek 8189E SDIO WiFi"
	depends on USB
    select WEXT_PRIV
	---help---
	  Help message of RTL8189ES
```

## drivers/net/wireless/rtl8191su/Kconfig
```kconfig
config RTL8191SU
	tristate "Realtek 8191SU USB WiFi"
	depends on USB
	default n
	select WIRELESS_EXT
	select WEXT_PRIV
	---help---
	  Help message of RTL8191SU
	  Support Chip Set : rtl8712/8188/8191/8192su

choice
	prompt "RTL8191 WirelessAPI Select"
	depends on RTL8191SU
	default RTL8191SU_CFG80211

config RTL8191SU_CFG80211
	bool "Wireless API CFG80211"

config RTL8191SU_WEXT
	bool "Wireless API WEXT"

endchoice

config RTL8191SU_DEBUG
	bool "Realtek 8191SU Driver Debug"
	depends on RTL8191SU
	default n
	---help---
	  Debug Message Enable Flag.
```

## drivers/net/wireless/rtl8192c/Kconfig
```kconfig
config RTL8192CU
	tristate "Realtek 8192C USB WiFi"
	depends on USB
#	depends on !RFKILL
	select WIRELESS_EXT
	select WEXT_PRIV
	select IEEE80211
	---help---
	  Help message of RTL8192CU
```

## drivers/net/wireless/rtl8192cu/Kconfig
```kconfig
config RTL8192CU_SDK
	tristate "Realtek 8192C USB WiFi(WEXT) - SDK Version"
	depends on USB
	select WIRELESS_EXT
	select WEXT_PRIV
	---help---
	  Help message of RTL8192CU
```

## drivers/net/wireless/rtl8723as/Kconfig
```kconfig
# SPDX-License-Identifier: GPL-2.0
    config RTL8723AS
          tristate "Realtek 8723AS SDIO WiFi Support"
          depends on WLAN_80211 && MMC
          select WIRELESS_EXT
          select WEXT_PRIV
          select IEEE80211
	help
          Help message of RTL8723AS
```

## drivers/net/wireless/rtl8723bs/Kconfig
```kconfig
config RTL8723BS
	tristate "Realtek 8723BS SDIO or SPI WiFi Support"
    select WIRELESS_EXT
    select WEXT_PRIV
    select IEEE80211
	---help---
	  Help message of RTL8723BS
```

## drivers/net/wireless/rtlwifi/Kconfig
```kconfig
menuconfig RTL_CARDS
	tristate "Realtek rtlwifi family of devices"
	depends on MAC80211 && (PCI || USB)
	default y
	---help---
	  This option will enable support for the Realtek mac80211-based
	  wireless drivers. Drivers rtl8192ce, rtl8192cu, rtl8192se, rtl8192de,
	  rtl8723ae, rtl8723be, and rtl8188ae share some common code.

if RTL_CARDS

config RTL8192CE
	tristate "Realtek RTL8192CE/RTL8188CE Wireless Network Adapter"
	depends on PCI
	select RTL8192C_COMMON
	select RTLWIFI
	select RTLWIFI_PCI
	---help---
	This is the driver for Realtek RTL8192CE/RTL8188CE 802.11n PCIe
	wireless network adapters.

	If you choose to build it as a module, it will be called rtl8192ce

config RTL8192SE
	tristate "Realtek RTL8192SE/RTL8191SE PCIe Wireless Network Adapter"
	depends on PCI
	select RTLWIFI
	select RTLWIFI_PCI
	---help---
	This is the driver for Realtek RTL8192SE/RTL8191SE 802.11n PCIe
	wireless network adapters.

	If you choose to build it as a module, it will be called rtl8192se

config RTL8192DE
	tristate "Realtek RTL8192DE/RTL8188DE PCIe Wireless Network Adapter"
	depends on PCI
	select RTLWIFI
	select RTLWIFI_PCI
	---help---
	This is the driver for Realtek RTL8192DE/RTL8188DE 802.11n PCIe
	wireless network adapters.

	If you choose to build it as a module, it will be called rtl8192de

config RTL8723AE
	tristate "Realtek RTL8723AE PCIe Wireless Network Adapter"
	depends on PCI
	select RTLWIFI
	select RTLWIFI_PCI
	select RTL8723_COMMON
	select RTLBTCOEXIST
	---help---
	This is the driver for Realtek RTL8723AE 802.11n PCIe
	wireless network adapters.

	If you choose to build it as a module, it will be called rtl8723ae

config RTL8723BE
	tristate "Realtek RTL8723BE PCIe Wireless Network Adapter"
	depends on PCI
	select RTLWIFI
	select RTLWIFI_PCI
	select RTL8723_COMMON
	select RTLBTCOEXIST
	---help---
	This is the driver for Realtek RTL8723BE 802.11n PCIe
	wireless network adapters.

	If you choose to build it as a module, it will be called rtl8723be

config RTL8188EE
	tristate "Realtek RTL8188EE Wireless Network Adapter"
	depends on PCI
	select RTLWIFI
	select RTLWIFI_PCI
	---help---
	This is the driver for Realtek RTL8188EE 802.11n PCIe
	wireless network adapters.

	If you choose to build it as a module, it will be called rtl8188ee

config RTL8192CU
	tristate "Realtek RTL8192CU/RTL8188CU USB Wireless Network Adapter"
	depends on USB
	select RTLWIFI
	select RTLWIFI_USB
	select RTL8192C_COMMON
	---help---
	This is the driver for Realtek RTL8192CU/RTL8188CU 802.11n USB
	wireless network adapters.

	If you choose to build it as a module, it will be called rtl8192cu

config RTLWIFI
	tristate
	select FW_LOADER

config RTLWIFI_PCI
	tristate

config RTLWIFI_USB
	tristate

config RTLWIFI_DEBUG
	bool "Debugging output for rtlwifi driver family"
	depends on RTLWIFI
	default y
	---help---
	To use the module option that sets the dynamic-debugging level for,
	the front-end driver, this parameter must be "Y". For memory-limited
	systems, choose "N". If in doubt, choose "Y".

config RTL8192C_COMMON
	tristate
	depends on RTL8192CE || RTL8192CU
	default y

config RTL8723_COMMON
	tristate
	depends on RTL8723AE || RTL8723BE
	default y

config RTLBTCOEXIST
	tristate
	depends on RTL8723AE || RTL8723BE
	default y

endif
```

## drivers/net/wireless/rtxx7x/Kconfig
```kconfig
config RTXX7X_SW
	tristate "Ralink 3070/3370/5370/5372 USB WiFi for SW"
	depends on USB
	select WIRELESS_EXT
	select WEXT_PRIV
	---help---
	Adds support for Ralink 3070/3370/5370/5372 USB WiFi wireless chipset family
```

## drivers/net/wireless/silabs/Kconfig
```kconfig
# SPDX-License-Identifier: GPL-2.0

config WLAN_VENDOR_SILABS
	bool "Silicon Laboratories devices"
	default y
	help
	  If you have a wireless card belonging to this class, say Y.

	  Note that the answer to this question doesn't directly affect the
	  kernel: saying N will just cause the configurator to skip all the
	  questions about these cards. If you say Y, you will be asked for
	  your specific card in the following questions.

if WLAN_VENDOR_SILABS

source "drivers/net/wireless/silabs/wfx/Kconfig"

endif # WLAN_VENDOR_SILABS
```

## drivers/net/wireless/silabs/wfx/Kconfig
```kconfig
# SPDX-License-Identifier: GPL-2.0-only
config WFX
	tristate "Silicon Labs wireless chips WF200 and further"
	depends on MAC80211
	depends on MMC || !MMC # do not allow WFX=y if MMC=m
	depends on (SPI || MMC)
	help
	  This is a driver for Silicons Labs WFxxx series (WF200 and further)
	  chipsets. This chip can be found on SPI or SDIO buses.

	  Silabs does not use a reliable SDIO vendor ID. So, to avoid conflicts,
	  the driver won't probe the device if it is not also declared in the
	  Device Tree.
```
