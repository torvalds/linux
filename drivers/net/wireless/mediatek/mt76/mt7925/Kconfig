## drivers/net/wireless/mediatek/mt76/mt7925/Kconfig
```kconfig
# SPDX-License-Identifier: BSD-3-Clause-Clear
config MT7925_COMMON
	tristate
	select MT792x_LIB
	select WANT_DEV_COREDUMP

config MT7925E
	tristate "MediaTek MT7925E (PCIe) support"
	select MT7925_COMMON
	depends on MAC80211
	depends on PCI
	help
	  This adds support for MT7925-based wireless PCIe devices,
	  which support operation at 6GHz, 5GHz, and 2.4GHz IEEE 802.11be
	  2x2:2SS 4096-QAM, 160MHz channels.

	  To compile this driver as a module, choose M here.

config MT7925U
	tristate "MediaTek MT7925U (USB) support"
	select MT792x_USB
	select MT7925_COMMON
	depends on MAC80211
	depends on USB
	help
	  This adds support for MT7925-based wireless USB devices,
	  which support operation at 6GHz, 5GHz, and 2.4GHz IEEE 802.11be
	  2x2:2SS 4096-QAM, 160MHz channels.

	  To compile this driver as a module, choose M here.
```

## drivers/net/wireless/mediatek/mt76/mt7996/Kconfig
```kconfig
# SPDX-License-Identifier: BSD-3-Clause-Clear
config MT7996E
	tristate "MediaTek MT7996 (PCIe) support"
	select MT76_CONNAC_LIB
	select WANT_DEV_COREDUMP
	select RELAY
	depends on MAC80211
	depends on PCI
	help
	  This adds support for MT7996-based PCIe wireless devices,
	  which support concurrent tri-band operation at 6GHz, 5GHz,
	  and 2.4GHz IEEE 802.11be 4x4:4SS 4096-QAM, 320MHz channels.

	  To compile this driver as a module, choose M here.

config MT7996_NPU
	bool "MT7996 (PCIe) NPU support"
	depends on MT7996E
	depends on NET_AIROHA_NPU=y || MT7996E=NET_AIROHA_NPU
	select MT76_NPU
	default n
```

## drivers/net/wireless/mediatek/mt7601u/Kconfig
```kconfig
config MT7601U
	tristate "MediaTek MT7601U (USB) support"
	depends on MAC80211
	depends on USB
	---help---
	  This adds support for MT7601U-based wireless USB dongles.
```

## drivers/net/wireless/mt5931/Kconfig
```kconfig
	config MT5931
	  depends on WLAN_80211 && MMC
	  select WIRELESS_EXT
	  select WEXT_PRIV
	  select CFG80211
          select NL80211_TESTMODE
	  bool "MediaTek MT5931 WiFi"
	  ---help---
	    MediaTek MT5931 WiFi

	config MT5931_MT6622
	  depends on WLAN_80211 && MMC
	  select WIRELESS_EXT
	  select WEXT_PRIV
	  select CFG80211
          select NL80211_TESTMODE
	  bool "MediaTek MT5931 & MT6622 WiFi Bluetooth Combo"
	  ---help---
	    MediaTek MT5931 & MT6622 WiFi Bluetooth Combo
```

## drivers/net/wireless/mt5931_kk/Kconfig
```kconfig
menuconfig MTK_MT5931
	bool "MediaTek MT5931 Config"
	help
	  Config MTK WLAN chip mt5931


config MTK_MT5931_WIFI
	tristate "MT5931 Wi-Fi"
	depends on MTK_MT5931
	depends on MMC
	depends on IPV6
	select WIRELESS_EXT
	select WEXT_PRIV
	select NL80211_TESTMODE
	default y
	help
	  This module adds support for wireless adapters based on
	  MTK MT5931 chipset.

	  This driver uses the kernel's wireless extensions subsystem.

	  If you choose to build a module, it'll be called dhd. Say M if
	  unsure.

config MTK_MT5931_POWER
	tristate "MT5931 power"
	depends on MTK_MT5931
	default y
	help
	  MT5931 power control
```

## drivers/net/wireless/mt7601/Kconfig
```kconfig
config MT7601
	tristate "Mediatek MT7601 USB WiFi Support"
   	select WIRELESS_EXT
	select WEXT_PRIV
	select IEEE80211
	select CFG80211
	select NL80211_TESTMODE
	---help---
	  Help message of MT7601
```

## drivers/net/wireless/mwifiex/Kconfig
```kconfig
config MWIFIEX
	tristate "Marvell WiFi-Ex Driver"
	depends on CFG80211
	---help---
	  This adds support for wireless adapters based on Marvell
	  802.11n/ac chipsets.

	  If you choose to build it as a module, it will be called
	  mwifiex.

config MWIFIEX_SDIO
	tristate "Marvell WiFi-Ex Driver for SD8786/SD8787/SD8797/SD8887/SD8897/SD8997"
	depends on MWIFIEX && MMC
	select FW_LOADER
	select WANT_DEV_COREDUMP
	---help---
	  This adds support for wireless adapters based on Marvell
	  8786/8787/8797/8887/8897/8997 chipsets with SDIO interface.

	  If you choose to build it as a module, it will be called
	  mwifiex_sdio.

config MWIFIEX_PCIE
	tristate "Marvell WiFi-Ex Driver for PCIE 8766/8897/8997"
	depends on MWIFIEX && PCI
	select FW_LOADER
	select WANT_DEV_COREDUMP
	---help---
	  This adds support for wireless adapters based on Marvell
	  8766/8897/8997 chipsets with PCIe interface.

	  If you choose to build it as a module, it will be called
	  mwifiex_pcie.

config MWIFIEX_USB
	tristate "Marvell WiFi-Ex Driver for USB8766/8797/8997"
	depends on MWIFIEX && USB
	select FW_LOADER
	---help---
	  This adds support for wireless adapters based on Marvell
	  8797/8997 chipset with USB interface.

	  If you choose to build it as a module, it will be called
	  mwifiex_usb.
```

## drivers/net/wireless/nxp/nxpwifi/Kconfig
```kconfig
# SPDX-License-Identifier: GPL-2.0-only
config NXPWIFI
	tristate "NXP WiFi Driver"
	depends on CFG80211
	help
	  This adds support for wireless adapters based on NXP
	  802.11n/ac chipsets.

	  If you choose to build it as a module, it will be called
	  nxpwifi.

config NXPWIFI_SDIO
	tristate "NXP WiFi Driver for IW61x"
	depends on NXPWIFI && MMC
	select FW_LOADER
	select WANT_DEV_COREDUMP
	help
	  This adds support for wireless adapters based on NXP
	  IW61x interface.

	  If you choose to build it as a module, it will be called
	  nxpwifi_sdio.
```

## drivers/net/wireless/orinoco/Kconfig
```kconfig
config HERMES
	tristate "Hermes chipset 802.11b support (Orinoco/Prism2/Symbol)"
	depends on (PPC_PMAC || PCI || PCMCIA)
	depends on CFG80211 && CFG80211_WEXT
	select WIRELESS_EXT
	select WEXT_SPY
	select WEXT_PRIV
	select FW_LOADER
	select CRYPTO
	select CRYPTO_MICHAEL_MIC
	---help---
	  A driver for 802.11b wireless cards based on the "Hermes" or
	  Intersil HFA384x (Prism 2) MAC controller.  This includes the vast
	  majority of the PCMCIA 802.11b cards (which are nearly all rebadges)
	  - except for the Cisco/Aironet cards.  Cards supported include the
	  Apple Airport (not a PCMCIA card), WavelanIEEE/Orinoco,
	  Cabletron/EnteraSys Roamabout, ELSA AirLancer, MELCO Buffalo, Avaya,
	  IBM High Rate Wireless, Farralon Syyline, Samsung MagicLAN, Netgear
	  MA401, LinkSys WPC-11, D-Link DWL-650, 3Com AirConnect, Intel
	  IPW2011, and Symbol Spectrum24 High Rate amongst others.

	  This option includes the guts of the driver, but in order to
	  actually use a card you will also need to enable support for PCMCIA
	  Hermes cards, PLX9052 based PCI adaptors or the Apple Airport below.

	  You will also very likely also need the Wireless Tools in order to
	  configure your card and that /etc/pcmcia/wireless.opts works :
	  <http://www.hpl.hp.com/personal/Jean_Tourrilhes/Linux/Tools.html>

config HERMES_PRISM
	bool "Support Prism 2/2.5 chipset"
	depends on HERMES
	---help---

	  Say Y to enable support for Prism 2 and 2.5 chipsets.  These
	  chipsets are better handled by the hostap driver.  This driver
	  would not support WPA or firmware download for Prism chipset.

	  If you are not sure, say N.

config HERMES_CACHE_FW_ON_INIT
	bool "Cache Hermes firmware on driver initialisation"
	depends on HERMES
	default y
	---help---
	  Say Y to cache any firmware required by the Hermes drivers
	  on startup.  The firmware will remain cached until the
	  driver is unloaded.  The cache uses 64K of RAM.

	  Otherwise load the firmware from userspace as required.  In
	  this case the driver should be unloaded and restarted
	  whenever the firmware is changed.

	  If you are not sure, say Y.

config APPLE_AIRPORT
	tristate "Apple Airport support (built-in)"
	depends on PPC_PMAC && HERMES
	help
	  Say Y here to support the Airport 802.11b wireless Ethernet hardware
	  built into the Macintosh iBook and other recent PowerPC-based
	  Macintosh machines. This is essentially a Lucent Orinoco card with
	  a non-standard interface.

	  This driver does not support the Airport Extreme (802.11b/g). Use
	  the BCM43xx driver for Airport Extreme cards.

config PLX_HERMES
	tristate "Hermes in PLX9052 based PCI adaptor support (Netgear MA301 etc.)"
	depends on PCI && HERMES
	help
	  Enable support for PCMCIA cards supported by the "Hermes" (aka
	  orinoco) driver when used in PLX9052 based PCI adaptors.  These
	  adaptors are not a full PCMCIA controller but act as a more limited
	  PCI <-> PCMCIA bridge.  Several vendors sell such adaptors so that
	  802.11b PCMCIA cards can be used in desktop machines.  The Netgear
	  MA301 is such an adaptor.

config TMD_HERMES
	tristate "Hermes in TMD7160 based PCI adaptor support"
	depends on PCI && HERMES
	help
	  Enable support for PCMCIA cards supported by the "Hermes" (aka
	  orinoco) driver when used in TMD7160 based PCI adaptors.  These
	  adaptors are not a full PCMCIA controller but act as a more limited
	  PCI <-> PCMCIA bridge.  Several vendors sell such adaptors so that
	  802.11b PCMCIA cards can be used in desktop machines.

config NORTEL_HERMES
	tristate "Nortel emobility PCI adaptor support"
	depends on PCI && HERMES
	help
	  Enable support for PCMCIA cards supported by the "Hermes" (aka
	  orinoco) driver when used in Nortel emobility PCI adaptors.  These
	  adaptors are not full PCMCIA controllers, but act as a more limited
	  PCI <-> PCMCIA bridge.

config PCI_HERMES
	tristate "Prism 2.5 PCI 802.11b adaptor support"
	depends on PCI && HERMES && HERMES_PRISM
	help
	  Enable support for PCI and mini-PCI 802.11b wireless NICs based on
	  the Prism 2.5 chipset.  These are true PCI cards, not the 802.11b
	  PCMCIA cards bundled with PCI<->PCMCIA adaptors which are also
	  common.  Some of the built-in wireless adaptors in laptops are of
	  this variety.

config PCMCIA_HERMES
	tristate "Hermes PCMCIA card support"
	depends on PCMCIA && HERMES
	---help---
	  A driver for "Hermes" chipset based PCMCIA wireless adaptors, such
	  as the Lucent WavelanIEEE/Orinoco cards and their OEM (Cabletron/
	  EnteraSys RoamAbout 802.11, ELSA Airlancer, Melco Buffalo and
	  others).  It should also be usable on various Prism II based cards
	  such as the Linksys, D-Link and Farallon Skyline.  It should also
	  work on Symbol cards such as the 3Com AirConnect and Ericsson WLAN.

	  You will very likely need the Wireless Tools in order to
	  configure your card and that /etc/pcmcia/wireless.opts works:
	  <http://www.hpl.hp.com/personal/Jean_Tourrilhes/Linux/Tools.html>.

config PCMCIA_SPECTRUM
	tristate "Symbol Spectrum24 Trilogy PCMCIA card support"
	depends on PCMCIA && HERMES
	---help---

	  This is a driver for 802.11b cards using RAM-loadable Symbol
	  firmware, such as Symbol Wireless Networker LA4100, CompactFlash
	  cards by Socket Communications and Intel PRO/Wireless 2011B.

	  This driver requires firmware download on startup.  Utilities
	  for downloading Symbol firmware are available at
	  <http://sourceforge.net/projects/orinoco/>

config ORINOCO_USB
	tristate "Agere Orinoco USB support"
	depends on USB && HERMES
	select FW_LOADER
	---help---
	  This driver is for USB versions of the Agere Orinoco card.
```

## drivers/net/wireless/p54/Kconfig
```kconfig
config P54_COMMON
	tristate "Softmac Prism54 support"
	depends on MAC80211 && EXPERIMENTAL
	select FW_LOADER
	select CRC_CCITT
	---help---
	  This is common code for isl38xx/stlc45xx based modules.
	  This module does nothing by itself - the USB/PCI/SPI front-ends
	  also need to be enabled in order to support any devices.

	  These devices require softmac firmware which can be found at
	  <http://wireless.kernel.org/en/users/Drivers/p54>

	  If you choose to build a module, it'll be called p54common.

config P54_USB
	tristate "Prism54 USB support"
	depends on P54_COMMON && USB
	select CRC32
	---help---
	  This driver is for USB isl38xx based wireless cards.

	  These devices require softmac firmware which can be found at
	  <http://wireless.kernel.org/en/users/Drivers/p54>

	  If you choose to build a module, it'll be called p54usb.

config P54_PCI
	tristate "Prism54 PCI support"
	depends on P54_COMMON && PCI
	---help---
	  This driver is for PCI isl38xx based wireless cards.
	  This driver supports most devices that are supported by the
	  fullmac prism54 driver plus many devices which are not
	  supported by the fullmac driver/firmware.

	  This driver requires softmac firmware which can be found at
	  <http://wireless.kernel.org/en/users/Drivers/p54>

	  If you choose to build a module, it'll be called p54pci.

config P54_SPI
	tristate "Prism54 SPI (stlc45xx) support"
	depends on P54_COMMON && SPI_MASTER && GENERIC_HARDIRQS
	---help---
	  This driver is for stlc4550 or stlc4560 based wireless chips
	  such as Nokia's N800/N810 Portable Internet Tablet.

	  If you choose to build a module, it'll be called p54spi.

config P54_SPI_DEFAULT_EEPROM
	bool "Include fallback EEPROM blob"
	depends on P54_SPI
	default n
	---help---
	 Unlike the PCI or USB devices, the SPI variants don't have
	 a dedicated EEPROM chip to store all device specific values
	 for calibration, country and interface settings.

	 The driver will try to load the image "3826.eeprom", if the
	 file is put at the right place. (usually /lib/firmware.)

	 Only if this request fails, this option will provide a
	 backup set of generic values to get the device working.

	 Enabling this option adds about 4k to p54spi.

config P54_LEDS
	bool
	depends on P54_COMMON && MAC80211_LEDS && (LEDS_CLASS = y || LEDS_CLASS = P54_COMMON)
	default y
```

## drivers/net/wireless/purelifi/plfxlc/Kconfig
```kconfig
# SPDX-License-Identifier: GPL-2.0-only
config PLFXLC
	tristate "pureLiFi X, XL, XC device support"
	depends on CFG80211 && MAC80211 && USB
	help
	   This option adds support for pureLiFi LiFi USB wireless
	   adapters. The pureLiFi X, XL, XC USB devices are based on
	   802.11 OFDM PHY but uses light as the transmission medium.
	   The driver supports common 802.11 encryption/authentication
	   methods including Open, WPA, WPA2-Personal and
	   WPA2-Enterprise (802.1X).

	   To compile this driver as a module, choose m here. The module will
	   be called plfxlc.
```

## drivers/net/wireless/quantenna/Kconfig
```kconfig
config WLAN_VENDOR_QUANTENNA
	bool "Quantenna wireless cards support"
	default y
	help
	  If you have a wireless card belonging to this class, say Y.

	  Note that the answer to this question doesn't directly affect the
	  kernel: saying N will just cause the configurator to skip all the
	  questions about these cards. If you say Y, you will be asked for
	  your specific card in the following questions.

if WLAN_VENDOR_QUANTENNA

source "drivers/net/wireless/quantenna/qtnfmac/Kconfig"

endif # WLAN_VENDOR_QUANTENNA
```

## drivers/net/wireless/quantenna/qtnfmac/Kconfig
```kconfig
config QTNFMAC
	tristate
	depends on QTNFMAC_PEARL_PCIE
	default m if QTNFMAC_PEARL_PCIE=m
	default y if QTNFMAC_PEARL_PCIE=y

config QTNFMAC_PEARL_PCIE
	tristate "Quantenna QSR10g PCIe support"
	default n
	depends on PCI && CFG80211
	select QTNFMAC
	select FW_LOADER
	select CRC32
	help
	  This option adds support for wireless adapters based on Quantenna
	  802.11ac QSR10g (aka Pearl) FullMAC chipset running over PCIe.

	  If you choose to build it as a module, two modules will be built:
	  qtnfmac.ko and qtnfmac_pearl_pcie.ko.
```

## drivers/net/wireless/ralink/Kconfig
```kconfig
config WLAN_VENDOR_RALINK
	bool "Ralink devices"
	default y
	---help---
	  If you have a wireless card belonging to this class, say Y.

	  Note that the answer to this question doesn't directly affect the
	  kernel: saying N will just cause the configurator to skip all the
	  questions about these cards. If you say Y, you will be asked for
	  your specific card in the following questions.

if WLAN_VENDOR_RALINK

source "drivers/net/wireless/ralink/rt2x00/Kconfig"

endif # WLAN_VENDOR_RALINK
```

## drivers/net/wireless/realtek/8189es/Kconfig
```kconfig
config RTL8189ES
	tristate "Realtek 8189E SDIO WiFi"
	depends on MMC
	---help---
	  Help message of RTL8189ES
```
