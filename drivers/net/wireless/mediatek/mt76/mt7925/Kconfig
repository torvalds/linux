## drivers/net/wireless/realtek/8192cu/Kconfig
```kconfig
config RTL8192CU
	tristate "Realtek 8192C USB WiFi"
	depends on USB
	select WIRELESS_EXT
	select WEXT_PRIV
	---help---
	  Enable wireless network adapters based on Realtek RTL8192C chipset family, such as EDUP nano series
```

## drivers/net/wireless/realtek/8723bs/Kconfig
```kconfig
config RTL8723AS
	tristate "Realtek 8723A SDIO or SPI WiFi"
	---help---
	  Help message of RTL8723AS

config RTL8723BS
	tristate "Realtek 8723B SDIO or SPI WiFi"
	---help---
	  Help message of RTL8723BS

config WLAN_SDIO
	bool "Enable SDIO interface for Realtek"
	depends on RTL8723AS || RTL8723BS
	default n
	---help---
	  Use memory preallocated in platform
```

## drivers/net/wireless/realtek/Kconfig
```kconfig
config WLAN_VENDOR_REALTEK
	bool "Realtek devices"
	default y
	---help---
	  If you have a wireless card belonging to this class, say Y.

	  Note that the answer to this question doesn't directly affect the
	  kernel: saying N will just cause the configurator to skip all the
	  questions about these cards. If you say Y, you will be asked for
	  your specific card in the following questions.

if WLAN_VENDOR_REALTEK

source "drivers/net/wireless/realtek/rtl818x/Kconfig"
source "drivers/net/wireless/realtek/rtlwifi/Kconfig"
source "drivers/net/wireless/realtek/rtl8xxxu/Kconfig"

endif # WLAN_VENDOR_REALTEK
```

## drivers/net/wireless/realtek/rtl818x/Kconfig
```kconfig
# SPDX-License-Identifier: GPL-2.0-only
#
# RTL818X Wireless LAN device configuration
#
config RTL8180
	tristate "Realtek 8180/8185/8187SE PCI support"
	depends on MAC80211 && PCI
	select EEPROM_93CX6
	---help---
	  This is a driver for RTL8180, RTL8185 and RTL8187SE based cards.
	  These are PCI based chips found in cards such as:

	  (RTL8185 802.11g)
	  A-Link WL54PC

	  (RTL8180 802.11b)
	  Belkin F5D6020 v3
	  Belkin F5D6020 v3
	  Dlink DWL-610
	  Dlink DWL-510
	  Netgear MA521
	  Level-One WPC-0101
	  Acer Aspire 1357 LMi
	  VCTnet PC-11B1
	  Ovislink AirLive WL-1120PCM
	  Mentor WL-PCI
	  Linksys WPC11 v4
	  TrendNET TEW-288PI
	  D-Link DWL-520 Rev D
	  Repotec RP-WP7126
	  TP-Link TL-WN250/251
	  Zonet ZEW1000
	  Longshine LCS-8031-R
	  HomeLine HLW-PCC200
	  GigaFast WF721-AEX
	  Planet WL-3553
	  Encore ENLWI-PCI1-NT
	  TrendNET TEW-266PC
	  Gigabyte GN-WLMR101
	  Siemens-fujitsu Amilo D1840W
	  Edimax EW-7126
	  PheeNet WL-11PCIR
	  Tonze PC-2100T
	  Planet WL-8303
	  Dlink DWL-650 v M1
	  Edimax EW-7106
	  Q-Tec 770WC
	  Topcom Skyr@cer 4011b
	  Roper FreeLan 802.11b (edition 2004)
	  Wistron Neweb Corp CB-200B
	  Pentagram HorNET
	  QTec 775WC
	  TwinMOS Booming B Series
	  Micronet SP906BB
	  Sweex LC700010
	  Surecom EP-9428
	  Safecom SWLCR-1100

	  Thanks to Realtek for their support!

config RTL8187
	tristate "Realtek 8187 and 8187B USB support"
	depends on MAC80211 && USB
	select EEPROM_93CX6
	---help---
	  This is a driver for RTL8187 and RTL8187B based cards.
	  These are USB based chips found in devices such as:

	  Netgear WG111v2
	  Level 1 WNC-0301USB
	  Micronet SP907GK V5
	  Encore ENUWI-G2
	  Trendnet TEW-424UB
	  ASUS P5B Deluxe/P5K Premium motherboards
	  Toshiba Satellite Pro series of laptops
	  Asus Wireless Link
	  Linksys WUSB54GC-EU v2
	    (v1 = rt73usb; v3 is rt2070-based,
	     use staging/rt3070 or try rt2800usb)

	  Thanks to Realtek for their support!

# If possible, automatically enable LEDs for RTL8187.

config RTL8187_LEDS
	bool
	depends on RTL8187 && MAC80211_LEDS && (LEDS_CLASS = y || LEDS_CLASS = RTL8187)
	default y
```

## drivers/net/wireless/realtek/rtl8xxxu/Kconfig
```kconfig
# SPDX-License-Identifier: GPL-2.0-only
#
# RTL8XXXU Wireless LAN device configuration
#
config RTL8XXXU
	tristate "Realtek 802.11n USB wireless chips support"
	depends on MAC80211 && USB
	depends on LEDS_CLASS
	help
	  This is an alternative driver for various Realtek RTL8XXX
	  parts written to utilize the Linux mac80211 stack.
	  The driver is known to work with a number of RTL8723AU,
	  RL8188CU, RTL8188RU, RTL8191CU, RTL8192CU, RTL8723BU, RTL8192EU,
	  RTL8188FU, RTL8188EU, and RTL8710BU (aka RTL8188GU) devices.

	  This driver is under development and has a limited feature
	  set. In particular it does not yet support 40MHz channels
	  and power management. However it should have a smaller
	  memory footprint than the vendor drivers and benefits
	  from the in kernel mac80211 stack.

	  It can coexist with drivers from drivers/staging/rtl8723au,
	  drivers/staging/rtl8192u, and drivers/net/wireless/rtlwifi,
	  but you will need to control which module you wish to load.

	  To compile this driver as a module, choose M here: the module will
	  be called rtl8xxxu.  If unsure, say N.

config RTL8XXXU_UNTESTED
	bool "Include support for untested Realtek 8xxx USB devices (EXPERIMENTAL)"
	depends on RTL8XXXU
	help
	  This option enables detection of Realtek 8723/8188/8191/8192 WiFi
	  USB devices which have not been tested directly by the driver
	  author or reported to be working by third parties.

	  Please report your results!
```

## drivers/net/wireless/realtek/rtw88/Kconfig
```kconfig
# SPDX-License-Identifier: GPL-2.0-only
menuconfig RTW88
	tristate "Realtek 802.11ac wireless chips support"
	depends on MAC80211
	help
	  This module adds support for mac80211-based wireless drivers that
	  enables Realtek IEEE 802.11ac wireless chipsets.

	  If you choose to build a module, it'll be called rtw88.

if RTW88

config RTW88_CORE
	tristate
	select WANT_DEV_COREDUMP

config RTW88_PCI
	tristate

config RTW88_SDIO
	tristate

config RTW88_USB
	tristate

config RTW88_8822B
	tristate

config RTW88_8822C
	tristate

config RTW88_8723X
	tristate

config RTW88_8703B
	tristate
	select RTW88_8723X

config RTW88_8723D
	tristate
	select RTW88_8723X

config RTW88_8821C
	tristate

config RTW88_88XXA
	tristate

config RTW88_8821A
	tristate
	select RTW88_88XXA

config RTW88_8812A
	tristate
	select RTW88_88XXA

config RTW88_8822BE
	tristate "Realtek 8822BE PCI wireless network adapter"
	depends on PCI
	select RTW88_CORE
	select RTW88_PCI
	select RTW88_8822B
	help
	  Select this option will enable support for 8822BE chipset

	  802.11ac PCIe wireless network adapter

config RTW88_8822BS
	tristate "Realtek 8822BS SDIO wireless network adapter"
	depends on MMC
	select RTW88_CORE
	select RTW88_SDIO
	select RTW88_8822B
	help
	  Select this option will enable support for 8822BS chipset

	  802.11ac SDIO wireless network adapter

config RTW88_8822BU
	tristate "Realtek 8822BU USB wireless network adapter"
	depends on USB
	select RTW88_CORE
	select RTW88_USB
	select RTW88_8822B
	help
	  Select this option will enable support for 8822BU chipset

	  802.11ac USB wireless network adapter

config RTW88_8822CE
	tristate "Realtek 8822CE PCI wireless network adapter"
	depends on PCI
	select RTW88_CORE
	select RTW88_PCI
	select RTW88_8822C
	help
	  Select this option will enable support for 8822CE chipset

	  802.11ac PCIe wireless network adapter

config RTW88_8822CS
	tristate "Realtek 8822CS SDIO wireless network adapter"
	depends on MMC
	select RTW88_CORE
	select RTW88_SDIO
	select RTW88_8822C
	help
	  Select this option will enable support for 8822CS chipset

	  802.11ac SDIO wireless network adapter

config RTW88_8822CU
	tristate "Realtek 8822CU USB wireless network adapter"
	depends on USB
	select RTW88_CORE
	select RTW88_USB
	select RTW88_8822C
	help
	  Select this option will enable support for 8822CU chipset

	  802.11ac USB wireless network adapter

config RTW88_8723DE
	tristate "Realtek 8723DE PCI wireless network adapter"
	depends on PCI
	select RTW88_CORE
	select RTW88_PCI
	select RTW88_8723D
	help
	  Select this option will enable support for 8723DE chipset

	  802.11n PCIe wireless network adapter

config RTW88_8723DS
	tristate "Realtek 8723DS SDIO wireless network adapter"
	depends on MMC
	select RTW88_CORE
	select RTW88_SDIO
	select RTW88_8723D
	help
	  Select this option will enable support for 8723DS chipset

	  802.11n SDIO wireless network adapter

config RTW88_8723CS
	tristate "Realtek 8723CS SDIO wireless network adapter"
	depends on MMC
	select RTW88_CORE
	select RTW88_SDIO
	select RTW88_8703B
	help
	  Select this option to enable support for 8723CS chipset (EXPERIMENTAL)

	  This module adds support for the 8723CS 802.11n SDIO
	  wireless network adapter.

	  If you choose to build a module, it'll be called rtw88_8723cs.

config RTW88_8723DU
	tristate "Realtek 8723DU USB wireless network adapter"
	depends on USB
	select RTW88_CORE
	select RTW88_USB
	select RTW88_8723D
	help
	  Select this option will enable support for 8723DU chipset

	  802.11n USB wireless network adapter

config RTW88_8821CE
	tristate "Realtek 8821CE PCI wireless network adapter"
	depends on PCI
	select RTW88_CORE
	select RTW88_PCI
	select RTW88_8821C
	help
	  Select this option will enable support for 8821CE chipset

	  802.11ac PCIe wireless network adapter

config RTW88_8821CS
	tristate "Realtek 8821CS SDIO wireless network adapter"
	depends on MMC
	select RTW88_CORE
	select RTW88_SDIO
	select RTW88_8821C
	help
	  Select this option will enable support for 8821CS chipset

	  802.11ac SDIO wireless network adapter

config RTW88_8821CU
	tristate "Realtek 8821CU USB wireless network adapter"
	depends on USB
	select RTW88_CORE
	select RTW88_USB
	select RTW88_8821C
	help
	  Select this option will enable support for 8821CU chipset

	  802.11ac USB wireless network adapter

config RTW88_8821AU
	tristate "Realtek 8821AU/8811AU USB wireless network adapter"
	depends on USB
	select RTW88_CORE
	select RTW88_USB
	select RTW88_8821A
	help
	  Select this option will enable support for 8821AU and 8811AU chipset

	  802.11ac USB wireless network adapter

config RTW88_8812AU
	tristate "Realtek 8812AU USB wireless network adapter"
	depends on USB
	select RTW88_CORE
	select RTW88_USB
	select RTW88_8812A
	help
	  Select this option will enable support for 8812AU chipset

	  802.11ac USB wireless network adapter

config RTW88_DEBUG
	bool "Realtek rtw88 debug support"
	depends on RTW88_CORE
	help
	  Enable debug support

	  If unsure, say Y to simplify debug problems

config RTW88_DEBUGFS
	bool "Realtek rtw88 debugfs support"
	depends on RTW88_CORE
	help
	  Enable debug support

	  If unsure, say Y to simplify debug problems

config RTW88_LEDS
	bool
	depends on LEDS_CLASS=y || LEDS_CLASS=MAC80211
	default y

endif
```

## drivers/net/wireless/realtek/rtw89/Kconfig
```kconfig
# SPDX-License-Identifier: GPL-2.0 OR BSD-3-Clause
menuconfig RTW89
	tristate "Realtek 802.11ax wireless chips support"
	depends on MAC80211
	help
	  This module adds support for mac80211-based wireless drivers that
	  enables Realtek IEEE 802.11ax wireless chipsets.

	  If you choose to build a module, it'll be called rtw89.

if RTW89

config RTW89_CORE
	tristate

config RTW89_PCI
	tristate

config RTW89_8851B
	tristate

config RTW89_8852A
	tristate

config RTW89_8852B_COMMON
	tristate

config RTW89_8852B
	tristate

config RTW89_8852C
	tristate

config RTW89_8922A
	tristate

config RTW89_8851BE
	tristate "Realtek 8851BE PCI wireless network (Wi-Fi 6) adapter"
	depends on PCI
	select RTW89_CORE
	select RTW89_PCI
	select RTW89_8851B
	help
	  Select this option will enable support for 8851BE chipset

	  802.11ax PCIe wireless network (Wi-Fi 6) adapter

config RTW89_8852AE
	tristate "Realtek 8852AE PCI wireless network (Wi-Fi 6) adapter"
	depends on PCI
	select RTW89_CORE
	select RTW89_PCI
	select RTW89_8852A
	help
	  Select this option will enable support for 8852AE chipset

	  802.11ax PCIe wireless network (Wi-Fi 6) adapter

config RTW89_8852BE
	tristate "Realtek 8852BE PCI wireless network (Wi-Fi 6) adapter"
	depends on PCI
	select RTW89_CORE
	select RTW89_PCI
	select RTW89_8852B
	select RTW89_8852B_COMMON
	help
	  Select this option will enable support for 8852BE chipset

	  802.11ax PCIe wireless network (Wi-Fi 6) adapter

config RTW89_8852CE
	tristate "Realtek 8852CE PCI wireless network (Wi-Fi 6E) adapter"
	depends on PCI
	select RTW89_CORE
	select RTW89_PCI
	select RTW89_8852C
	help
	  Select this option will enable support for 8852CE chipset

	  802.11ax PCIe wireless network (Wi-Fi 6E) adapter

config RTW89_8922AE
	tristate "Realtek 8922AE PCI wireless network (Wi-Fi 7) adapter"
	depends on PCI
	select RTW89_CORE
	select RTW89_PCI
	select RTW89_8922A
	help
	  Select this option will enable support for 8922AE chipset

	  802.11be PCIe wireless network (Wi-Fi 7) adapter
	  supporting 2x2 2GHz/5GHz/6GHz 4096-QAM 160MHz channels.

config RTW89_DEBUG
	bool

config RTW89_DEBUGMSG
	bool "Realtek rtw89 debug message support"
	depends on RTW89_CORE
	select RTW89_DEBUG
	help
	  Enable debug message support

	  If unsure, say Y to simplify debug problems

config RTW89_DEBUGFS
	bool "Realtek rtw89 debugfs support"
	depends on RTW89_CORE
	select RTW89_DEBUG
	help
	  Enable debugfs support

	  If unsure, say Y to simplify debug problems

endif
```

## drivers/net/wireless/rkusbwifi/rt5370/Kconfig
```kconfig
config RT5370
	tristate "Mediatek RT5370 USB WiFi Support"
   	select WIRELESS_EXT
	select WEXT_PRIV
	select IEEE80211
	---help---
	  Help message of RT5370
```

## drivers/net/wireless/rkwifi/Kconfig
```kconfig
config RKWIFI
	tristate "RK901/RK903/BCM4330/AP6XXX wireless cards support"
	#depends on MMC && WLAN_80211
    select CFG80211
    select MAC80211
	select WIRELESS_EXT
	select WEXT_PRIV
	---help---
	  This module adds support for wireless adapters based on
	  Broadcom 4329/30 chipset.

	  This driver uses the kernel's wireless extensions subsystem.

	  If you choose to build a module, it'll be called dhd. Say M if
	  unsure.
```

## drivers/net/wireless/rockchip_wlan/Kconfig
```kconfig
# SPDX-License-Identifier: GPL-2.0
menuconfig WL_ROCKCHIP
	tristate "Rockchip Wireless LAN support"
	select WIRELESS_EXT
	select WEXT_PRIV
	select CFG80211
	select MAC80211
	help
	  Enable compatible Wifi drivers for Rockchip platform.

if WL_ROCKCHIP

config WIFI_BUILD_MODULE
	bool "build wifi ko modules"
	default n
	help
	  Wifi drivers will compile as ko module

config WIFI_LOAD_DRIVER_WHEN_KERNEL_BOOTUP
	bool "Wifi load driver when kernel bootup"
	default n
	help
	  Wifi driver will be load (use late_initcall) when kernel bootup

config WIFI_GENERATE_RANDOM_MAC_ADDR
	bool "Wifi generate random mac address and save to vendor storage for cob chip"
	default n
	help
	  Wifi generate random mac address and save to vendor storage for cob chip

menuconfig BCMDHD
	bool "Broadcom Wireless Device Driver Support"
	default y

if BCMDHD
source "drivers/net/wireless/rockchip_wlan/rkwifi/Kconfig"
endif

source "drivers/net/wireless/rockchip_wlan/cywdhd/Kconfig"
source "drivers/net/wireless/rockchip_wlan/infineon/Kconfig"

endif # WL_ROCKCHIP
```
