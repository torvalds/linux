## drivers/net/phy/realtek/Kconfig
```kconfig
# SPDX-License-Identifier: GPL-2.0-only
config REALTEK_PHY
	tristate "Realtek PHYs"
	help
	  Currently supports RTL821x/RTL822x and fast ethernet PHYs

if REALTEK_PHY

config REALTEK_PHY_HWMON
	bool "HWMON support for Realtek PHYs"
	depends on HWMON && !(REALTEK_PHY=y && HWMON=m)
	help
	  Optional hwmon support for the temperature sensor

endif # REALTEK_PHY
```

## drivers/net/plip/Kconfig
```kconfig
# SPDX-License-Identifier: GPL-2.0-only
#
# Parallel Line Internet Protocol (PLIP) network device configuration
#

config PLIP
	tristate "PLIP (parallel port) support"
	depends on PARPORT
	help
	  PLIP (Parallel Line Internet Protocol) is used to create a
	  reasonably fast mini network consisting of two (or, rarely, more)
	  local machines.  A PLIP link from a Linux box is a popular means to
	  install a Linux distribution on a machine which doesn't have a
	  CD-ROM drive (a minimal system has to be transferred with floppies
	  first). The kernels on both machines need to have this PLIP option
	  enabled for this to work.

	  The PLIP driver has two modes, mode 0 and mode 1.  The parallel
	  ports (the connectors at the computers with 25 holes) are connected
	  with "null printer" or "Turbo Laplink" cables which can transmit 4
	  bits at a time (mode 0) or with special PLIP cables, to be used on
	  bidirectional parallel ports only, which can transmit 8 bits at a
	  time (mode 1); you can find the wiring of these cables in
	  <file:Documentation/networking/plip.rst>.  The cables can be up to
	  15m long.  Mode 0 works also if one of the machines runs DOS/Windows
	  and has some PLIP software installed, e.g. the Crynwr PLIP packet
	  driver (<http://oak.oakland.edu/simtel.net/msdos/pktdrvr-pre.html>)
	  and winsock or NCSA's telnet.

	  If you want to use PLIP, say Y and read the PLIP mini-HOWTO as well
	  as the NET-3-HOWTO, both available from
	  <http://www.tldp.org/docs.html#howto>.  Note that the PLIP
	  protocol has been changed and this PLIP driver won't work together
	  with the PLIP support in Linux versions 1.0.x.  This option enlarges
	  your kernel by about 8 KB.

	  To compile this driver as a module, choose M here. The module
	  will be called plip. If unsure, say Y or M, in case you buy
	  a laptop later.
```

## drivers/net/ppp/Kconfig
```kconfig
# SPDX-License-Identifier: GPL-2.0-only
#
# PPP network device configuration
#

config PPP
	tristate "PPP (point-to-point protocol) support"
	select SLHC
	help
	  PPP (Point to Point Protocol) is a newer and better SLIP.  It serves
	  the same purpose: sending Internet traffic over telephone (and other
	  serial) lines.  Ask your access provider if they support it, because
	  otherwise you can't use it; most Internet access providers these
	  days support PPP rather than SLIP.

	  To use PPP, you need an additional program called pppd as described
	  in the PPP-HOWTO, available at
	  <http://www.tldp.org/docs.html#howto>.  Make sure that you have
	  the version of pppd recommended in <file:Documentation/Changes>.
	  The PPP option enlarges your kernel by about 16 KB.

	  There are actually two versions of PPP: the traditional PPP for
	  asynchronous lines, such as regular analog phone lines, and
	  synchronous PPP which can be used over digital ISDN lines for
	  example.  If you want to use PPP over phone lines or other
	  asynchronous serial lines, you need to say Y (or M) here and also to
	  the next option, "PPP support for async serial ports".  For PPP over
	  synchronous lines, you should say Y (or M) here and to "Support
	  synchronous PPP", below.

	  If you said Y to "Version information on all symbols" above, then
	  you cannot compile the PPP driver into the kernel; you can then only
	  compile it as a module. To compile this driver as a module, choose M
	  here. The module will be called ppp_generic.

if PPP

config PPP_BSDCOMP
	tristate "PPP BSD-Compress compression"
	depends on PPP
	help
	  Support for the BSD-Compress compression method for PPP, which uses
	  the LZW compression method to compress each PPP packet before it is
	  sent over the wire. The machine at the other end of the PPP link
	  (usually your ISP) has to support the BSD-Compress compression
	  method as well for this to be useful. Even if they don't support it,
	  it is safe to say Y here.

	  The PPP Deflate compression method ("PPP Deflate compression",
	  above) is preferable to BSD-Compress, because it compresses better
	  and is patent-free.

	  Note that the BSD compression code will always be compiled as a
	  module; it is called bsd_comp and will show up in the directory
	  modules once you have said "make modules". If unsure, say N.

config PPP_DEFLATE
	tristate "PPP Deflate compression"
	depends on PPP
	select ZLIB_INFLATE
	select ZLIB_DEFLATE
	help
	  Support for the Deflate compression method for PPP, which uses the
	  Deflate algorithm (the same algorithm that gzip uses) to compress
	  each PPP packet before it is sent over the wire.  The machine at the
	  other end of the PPP link (usually your ISP) has to support the
	  Deflate compression method as well for this to be useful.  Even if
	  they don't support it, it is safe to say Y here.

	  To compile this driver as a module, choose M here.

config PPP_FILTER
	bool "PPP filtering"
	depends on PPP
	help
	  Say Y here if you want to be able to filter the packets passing over
	  PPP interfaces.  This allows you to control which packets count as
	  activity (i.e. which packets will reset the idle timer or bring up
	  a demand-dialed link) and which packets are to be dropped entirely.
	  You need to say Y here if you wish to use the pass-filter and
	  active-filter options to pppd.

	  If unsure, say N.

config PPP_MPPE
	tristate "PPP MPPE compression (encryption)"
	depends on PPP
	select CRYPTO
	select CRYPTO_SHA1
	select CRYPTO_LIB_ARC4
	help
	  Support for the MPPE Encryption protocol, as employed by the
	  Microsoft Point-to-Point Tunneling Protocol.

	  See http://pptpclient.sourceforge.net/ for information on
	  configuring PPTP clients and servers to utilize this method.

config PPP_MULTILINK
	bool "PPP multilink support"
	depends on PPP
	help
	  PPP multilink is a protocol (defined in RFC 1990) which allows you
	  to combine several (logical or physical) lines into one logical PPP
	  connection, so that you can utilize your full bandwidth.

	  This has to be supported at the other end as well and you need a
	  version of the pppd daemon which understands the multilink protocol.

	  If unsure, say N.

config PPPOATM
	tristate "PPP over ATM"
	depends on ATM && PPP
	help
	  Support PPP (Point to Point Protocol) encapsulated in ATM frames.
	  This implementation does not yet comply with section 8 of RFC2364,
	  which can lead to bad results if the ATM peer loses state and
	  changes its encapsulation unilaterally.

config PPPOE
	tristate "PPP over Ethernet"
	depends on PPP
	help
	  Support for PPP over Ethernet.

	  This driver requires the latest version of pppd from the CVS
	  repository at cvs.samba.org.  Alternatively, see the
	  RoaringPenguin package (<http://www.roaringpenguin.com/pppoe>)
	  which contains instruction on how to use this driver (under
	  the heading "Kernel mode PPPoE").

choice
	prompt "Number of PPPoE hash bits"
	default PPPOE_HASH_BITS_4
	depends on PPPOE
	help
		Select the number of bits used for hashing PPPoE interfaces.

		Larger sizes reduces the risk of hash collisions at the cost
		of slightly increased memory usage.

		This hash table is on a per outer ethernet interface.

config PPPOE_HASH_BITS_1
	bool "1 bit (2 buckets)"

config PPPOE_HASH_BITS_2
	bool "2 bits (4 buckets)"

config PPPOE_HASH_BITS_4
	bool "4 bits (16 buckets)"

config PPPOE_HASH_BITS_8
	bool "8 bits (256 buckets)"

endchoice

config PPPOE_HASH_BITS
	int
	default 1 if PPPOE_HASH_BITS_1
	default 2 if PPPOE_HASH_BITS_2
	default 4 if PPPOE_HASH_BITS_4
	default 8 if PPPOE_HASH_BITS_8
	default 4

config PPTP
	tristate "PPP over IPv4 (PPTP)"
	depends on PPP && NET_IPGRE_DEMUX
	help
	  Support for PPP over IPv4.(Point-to-Point Tunneling Protocol)

	  This driver requires pppd plugin to work in client mode or
	  modified pptpd (poptop) to work in server mode.
	  See http://accel-pptp.sourceforge.net/ for information how to
	  utilize this module.

config PPPOL2TP
	tristate "PPP over L2TP"
	depends on L2TP && PPP
	help
	  Support for PPP-over-L2TP socket family. L2TP is a protocol
	  used by ISPs and enterprises to tunnel PPP traffic over UDP
	  tunnels. L2TP is replacing PPTP for VPN uses.
if TTY

config PPP_ASYNC
	tristate "PPP support for async serial ports"
	depends on PPP
	select CRC_CCITT
	help
	  Say Y (or M) here if you want to be able to use PPP over standard
	  asynchronous serial ports, such as COM1 or COM2 on a PC.  If you use
	  a modem (not a synchronous or ISDN modem) to contact your ISP, you
	  need this option.

	  To compile this driver as a module, choose M here.

	  If unsure, say Y.

config PPP_SYNC_TTY
	tristate "PPP support for sync tty ports"
	depends on PPP
	help
	  Say Y (or M) here if you want to be able to use PPP over synchronous
	  (HDLC) tty devices, such as the SyncLink adapter. These devices
	  are often used for high-speed leased lines like T1/E1.

	  To compile this driver as a module, choose M here.

endif # TTY

endif # PPP
```

## drivers/net/sfc/Kconfig
```kconfig
config SFC
	tristate "Solarflare Solarstorm SFC4000/SFC9000-family support"
	depends on PCI && INET
	select MDIO
	select CRC32
	select I2C
	select I2C_ALGOBIT
	help
	  This driver supports 10-gigabit Ethernet cards based on
	  the Solarflare Communications Solarstorm SFC4000 and
	  SFC9000-family controllers.

	  To compile this driver as a module, choose M here.  The module
	  will be called sfc.
config SFC_MTD
	bool "Solarflare Solarstorm SFC4000/SFC9000-family MTD support"
	depends on SFC && MTD && !(SFC=y && MTD=m)
	default y
	help
	  This exposes the on-board flash memory as MTD devices (e.g.
	  /dev/mtd1).  This makes it possible to upload new firmware
	  to the NIC.
```

## drivers/net/slip/Kconfig
```kconfig
#
# SLIP network device configuration
#

config SLIP
	tristate "SLIP (serial line) support"
	depends on TTY
	---help---
	  Say Y if you intend to use SLIP or CSLIP (compressed SLIP) to
	  connect to your Internet service provider or to connect to some
	  other local Unix box or if you want to configure your Linux box as a
	  Slip/CSlip server for other people to dial in. SLIP (Serial Line
	  Internet Protocol) is a protocol used to send Internet traffic over
	  serial connections such as telephone lines or null modem cables;
	  nowadays, the protocol PPP is more commonly used for this same
	  purpose.

	  Normally, your access provider has to support SLIP in order for you
	  to be able to use it, but there is now a SLIP emulator called SLiRP
	  around (available from
	  <ftp://ibiblio.org/pub/Linux/system/network/serial/>) which
	  allows you to use SLIP over a regular dial up shell connection. If
	  you plan to use SLiRP, make sure to say Y to CSLIP, below. The
	  NET-3-HOWTO, available from
	  <http://www.tldp.org/docs.html#howto>, explains how to
	  configure SLIP. Note that you don't need this option if you just
	  want to run term (term is a program which gives you almost full
	  Internet connectivity if you have a regular dial up shell account on
	  some Internet connected Unix computer. Read
	  <http://www.bart.nl/~patrickr/term-howto/Term-HOWTO.html>). SLIP
	  support will enlarge your kernel by about 4 KB. If unsure, say N.

	  To compile this driver as a module, choose M here. The module
	  will be called slip.

config SLHC
	tristate
	---help---
	  This option enables Van Jacobsen serial line header compression
	  routines.

if SLIP

config SLIP_COMPRESSED
	bool "CSLIP compressed headers"
	depends on SLIP
	select SLHC
	---help---
	  This protocol is faster than SLIP because it uses compression on the
	  TCP/IP headers (not on the data itself), but it has to be supported
	  on both ends. Ask your access provider if you are not sure and
	  answer Y, just in case. You will still be able to use plain SLIP. If
	  you plan to use SLiRP, the SLIP emulator (available from
	  <ftp://ibiblio.org/pub/Linux/system/network/serial/>) which
	  allows you to use SLIP over a regular dial up shell connection, you
	  definitely want to say Y here. The NET-3-HOWTO, available from
	  <http://www.tldp.org/docs.html#howto>, explains how to configure
	  CSLIP. This won't enlarge your kernel.

config SLIP_SMART
	bool "Keepalive and linefill"
	depends on SLIP
	---help---
	  Adds additional capabilities to the SLIP driver to support the
	  RELCOM line fill and keepalive monitoring. Ideal on poor quality
	  analogue lines.

config SLIP_MODE_SLIP6
	bool "Six bit SLIP encapsulation"
	depends on SLIP
	---help---
	  Just occasionally you may need to run IP over hostile serial
	  networks that don't pass all control characters or are only seven
	  bit. Saying Y here adds an extra mode you can use with SLIP:
	  "slip6". In this mode, SLIP will only send normal ASCII symbols over
	  the serial device. Naturally, this has to be supported at the other
	  end of the link as well. It's good enough, for example, to run IP
	  over the async ports of a Camtec JNT Pad. If unsure, say N.

endif # SLIP
```

## drivers/net/stmmac/Kconfig
```kconfig
config STMMAC_ETH
	tristate "STMicroelectronics 10/100/1000 Ethernet driver"
	select MII
	select PHYLIB
	select CRC32
	depends on NETDEVICES && HAS_IOMEM
	help
	  This is the driver for the Ethernet IPs are built around a
	  Synopsys IP Core and only tested on the STMicroelectronics
	  platforms.

if STMMAC_ETH

config STMMAC_DA
	bool "STMMAC DMA arbitration scheme"
	default n
	help
	  Selecting this option, rx has priority over Tx (only for Giga
	  Ethernet device).
	  By default, the DMA arbitration scheme is based on Round-robin
	  (rx:tx priority is 1:1).

config STMMAC_DUAL_MAC
	bool "STMMAC: dual mac support (EXPERIMENTAL)"
	default n
        depends on EXPERIMENTAL && STMMAC_ETH && !STMMAC_TIMER
	help
	  Some ST SoCs (for example the stx7141 and stx7200c2) have two
	  Ethernet Controllers. This option turns on the second Ethernet
	  device on this kind of platforms.

config STMMAC_TIMER
	bool "STMMAC Timer optimisation"
	default n
	depends on RTC_HCTOSYS_DEVICE
	help
	  Use an external timer for mitigating the number of network
	  interrupts. Currently, for SH architectures, it is possible
	  to use the TMU channel 2 and the SH-RTC device.

choice
        prompt "Select Timer device"
        depends on STMMAC_TIMER

config STMMAC_TMU_TIMER
        bool "TMU channel 2"
        depends on CPU_SH4
	help

config STMMAC_RTC_TIMER
        bool "Real time clock"
        depends on RTC_CLASS
	help

endchoice

endif
```
