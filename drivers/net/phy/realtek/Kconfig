## drivers/net/wireless/aic8800/aic8800_fdrv/Kconfig
```kconfig
config AIC8800_WLAN_SUPPORT
	tristate "AIC8800 wlan Support"
	help
	  This is support for aic wifi driver.

#choice
#        depends on AIC8800_WLAN_SUPPORT
#        prompt "Select 8800 support platform"
#
#        config PLATFORM_ROCHCHIP
#                bool "PLATFORM_ROCHCHIP"
#                depends on AIC8800_WLAN_SUPPORT
#
#	config PLATFORM_ALLWINNER
#                bool "PLATFORM_ALLWINNER"
#                depends on AIC8800_WLAN_SUPPORT
#
#        config PLATFORM_AMLOGIC
#                bool "PLATFORM_AMLOGIC"
#                depends on AIC8800_WLAN_SUPPORT
#
#        config PLATFORM_UBUNTU
#                bool "PLATFORM_UBUNTU"
#                depends on AIC8800_WLAN_SUPPORT
#
#endchoice
#
#config USE_5G
#	bool "AIC8800 force enable 5G"
#        ---help---
#          This is parameter that force enable 5G.
#
#config HE_FOR_OLD_KERNEL
#	bool "AIC8800 support AX for old kernel"
#        ---help---
#          This is parameter that enable AX for old kernel.
```

## drivers/net/wireless/aic8800/aic_load_fw/Kconfig
```kconfig
config AIC_LOADFW_SUPPORT
	tristate "AIC8800 Load Firmware Support"
	help
	  This is support for aic load firmware driver.
```

## drivers/net/wireless/ar6003/Kconfig
```kconfig
	config AR6003
	  depends on WLAN_80211 && MMC
	  select WIRELESS_EXT
	  select IEEE80211
	  select FW_LOADER
	  bool "Atheros AR6003/AR6302 SDIO"
	  ---help---
	    Atheros ROC AR6003/AR6302.
```

## drivers/net/wireless/ar9170/Kconfig
```kconfig
config AR9170_COMMON
	tristate "Atheros AR9170 support"
	depends on WLAN_80211 && MAC80211 && EXPERIMENTAL
	help
	  This is common code for AR9170 based devices.
	  This module does nothing by itself - the USB/(SPI) frontends
	  also need to be enabled in order to support any devices.

	  Say Y if you have the hardware, or M to build a module called
	  ar9170common.

config AR9170_USB
	tristate "Atheros AR9170 USB support"
	depends on AR9170_COMMON && USB
	select FW_LOADER
	help
	  This is a driver for the Atheros "otus" 802.11n USB devices.

	  These devices require additional firmware (2 files).
	  For now, these files can be downloaded from here:
	  http://wireless.kernel.org/en/users/Drivers/ar9170

	  If you choose to build a module, it'll be called ar9170usb.

config AR9170_LEDS
	bool
	depends on AR9170_COMMON && MAC80211_LEDS && (LEDS_CLASS = y || LEDS_CLASS = AR9170_COMMON)
	default y
```

## drivers/net/wireless/ath/Kconfig
```kconfig
# SPDX-License-Identifier: ISC
config ATH_COMMON
	tristate

config WLAN_VENDOR_ATH
	bool "Atheros/Qualcomm devices"
	default y
	help
	  If you have a wireless card belonging to this class, say Y.

	  Note that the answer to this question doesn't directly affect the
	  kernel: saying N will just cause the configurator to skip all the
	  questions about these cards. If you say Y, you will be asked for
	  your specific card in the following questions.

	  For more information and documentation on this module you can visit:

	  https://wireless.wiki.kernel.org/en/users/Drivers/ath

	  For information on all Atheros wireless drivers visit:

	  https://wireless.wiki.kernel.org/en/users/Drivers/Atheros

if WLAN_VENDOR_ATH

config ATH_DEBUG
	bool "Atheros wireless debugging"
	help
	  Say Y, if you want to debug atheros wireless drivers.
	  Right now only ath9k makes use of this.

config ATH_TRACEPOINTS
	bool "Atheros wireless tracing"
	depends on ATH_DEBUG
	depends on EVENT_TRACING
	help
	  This option enables tracepoints for atheros wireless drivers.
	  Currently, ath9k makes use of this facility.

config ATH_REG_DYNAMIC_USER_REG_HINTS
	bool "Atheros dynamic user regulatory hints"
	depends on CFG80211_CERTIFICATION_ONUS
	default n
	help
	  Say N. This should only be enabled in countries where
	  this feature is explicitly allowed and only on cards that
	  specifically have been tested for this.

config ATH_REG_DYNAMIC_USER_CERT_TESTING
	bool "Atheros dynamic user regulatory testing"
	depends on ATH_REG_DYNAMIC_USER_REG_HINTS && CFG80211_CERTIFICATION_ONUS
	default n
	help
	  Say N. This should only be enabled on systems
	  undergoing certification testing.

source "drivers/net/wireless/ath/ath5k/Kconfig"
source "drivers/net/wireless/ath/ath9k/Kconfig"
source "drivers/net/wireless/ath/carl9170/Kconfig"
source "drivers/net/wireless/ath/ath6kl/Kconfig"
source "drivers/net/wireless/ath/ar5523/Kconfig"
source "drivers/net/wireless/ath/wil6210/Kconfig"
source "drivers/net/wireless/ath/ath10k/Kconfig"
source "drivers/net/wireless/ath/wcn36xx/Kconfig"
source "drivers/net/wireless/ath/ath11k/Kconfig"

endif
```

## drivers/net/wireless/ath/ar5523/Kconfig
```kconfig
# SPDX-License-Identifier: ISC
config AR5523
       tristate "Atheros AR5523 wireless driver support"
       depends on MAC80211 && USB
       select ATH_COMMON
       select FW_LOADER
       ---help---
	 This module add support for AR5523 based USB dongles such as D-Link
	 DWL-G132, Netgear WPN111 and many more.
```

## drivers/net/wireless/ath/ar9170/Kconfig
```kconfig
config AR9170_USB
	tristate "Atheros AR9170 802.11n USB support (OBSOLETE)"
	depends on USB && MAC80211
	select FW_LOADER
	help
	  This driver is going to get replaced by carl9170.

	  This is a driver for the Atheros "otus" 802.11n USB devices.

	  These devices require additional firmware (2 files).
	  For now, these files can be downloaded from here:

	  http://wireless.kernel.org/en/users/Drivers/ar9170

	  If you choose to build a module, it'll be called ar9170usb.

config AR9170_LEDS
	bool
	depends on AR9170_USB && MAC80211_LEDS && (LEDS_CLASS = y || LEDS_CLASS = AR9170_USB)
	default y
```
