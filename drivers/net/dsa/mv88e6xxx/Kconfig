## drivers/net/ethernet/alteon/Kconfig
```kconfig
#
# Alteon network device configuration
#

config NET_VENDOR_ALTEON
	bool "Alteon devices"
	default y
	depends on PCI
	---help---
	  If you have a network (Ethernet) card belonging to this class, say Y
	  and read the Ethernet-HOWTO, available from
	  <http://www.tldp.org/docs.html#howto>.

	  Note that the answer to this question doesn't directly affect the
	  kernel: saying N will just cause the configurator to skip all
	  the questions about Alteon cards. If you say Y, you will be asked for
	  your specific card in the following questions.

if NET_VENDOR_ALTEON

config ACENIC
	tristate "Alteon AceNIC/3Com 3C985/NetGear GA620 Gigabit support"
	depends on PCI
	---help---
	  Say Y here if you have an Alteon AceNIC, 3Com 3C985(B), NetGear
	  GA620, SGI Gigabit or Farallon PN9000-SX PCI Gigabit Ethernet
	  adapter. The driver allows for using the Jumbo Frame option (9000
	  bytes/frame) however it requires that your switches can handle this
	  as well. To enable Jumbo Frames, add `mtu 9000' to your ifconfig
	  line.

	  To compile this driver as a module, choose M here: the
	  module will be called acenic.

config ACENIC_OMIT_TIGON_I
	bool "Omit support for old Tigon I based AceNICs"
	depends on ACENIC
	---help---
	  Say Y here if you only have Tigon II based AceNICs and want to leave
	  out support for the older Tigon I based cards which are no longer
	  being sold (ie. the original Alteon AceNIC and 3Com 3C985 (non B
	  version)).  This will reduce the size of the driver object by
	  app. 100KB.  If you are not sure whether your card is a Tigon I or a
	  Tigon II, say N here.

	  The safe and default value for this is N.

endif # NET_VENDOR_ALTEON
```

## drivers/net/ethernet/altera/Kconfig
```kconfig
# SPDX-License-Identifier: GPL-2.0-only
config ALTERA_TSE
	tristate "Altera Triple-Speed Ethernet MAC support"
	depends on HAS_DMA
	depends on HAS_IOMEM
	select PHYLIB
	select PHYLINK
	select PCS_LYNX
	select MDIO_REGMAP
	select REGMAP_MMIO
	help
	  This driver supports the Altera Triple-Speed (TSE) Ethernet MAC.

	  To compile this driver as a module, choose M here. The module
	  will be called alteratse.
```

## drivers/net/ethernet/amazon/Kconfig
```kconfig
#
# Amazon network device configuration
#

config NET_VENDOR_AMAZON
	bool "Amazon Devices"
	default y
	---help---
	  If you have a network (Ethernet) device belonging to this class, say Y.

	  Note that the answer to this question doesn't directly affect the
	  kernel: saying N will just cause the configurator to skip all
	  the questions about Amazon devices. If you say Y, you will be asked
	  for your specific device in the following questions.

if NET_VENDOR_AMAZON

config ENA_ETHERNET
	tristate "Elastic Network Adapter (ENA) support"
	depends on (PCI_MSI && X86)
	---help---
	  This driver supports Elastic Network Adapter (ENA)"

	  To compile this driver as a module, choose M here.
	  The module will be called ena.

endif #NET_VENDOR_AMAZON
```
