## drivers/net/dsa/mv88e6xxx/Kconfig
```kconfig
# SPDX-License-Identifier: GPL-2.0-only
config NET_DSA_MV88E6XXX
	tristate "Marvell 88E6xxx Ethernet switch fabric support"
	depends on NET_DSA
	select IRQ_DOMAIN
	select NET_DSA_TAG_EDSA
	select NET_DSA_TAG_DSA
	help
	  This driver adds support for most of the Marvell 88E6xxx models of
	  Ethernet switch chips, except 88E6060.

config NET_DSA_MV88E6XXX_PTP
	bool "PTP support for Marvell 88E6xxx"
	default n
	depends on PTP_1588_CLOCK
	help
	  Say Y to enable PTP hardware timestamping on Marvell 88E6xxx switch
	  chips that support it.
```

## drivers/net/dsa/mxl862xx/Kconfig
```kconfig
# SPDX-License-Identifier: GPL-2.0-only
config NET_DSA_MXL862
	tristate "MaxLinear MxL862xx"
	depends on NET_DSA
	select MAXLINEAR_GPHY
	select NET_DSA_TAG_MXL_862XX
	help
	  This enables support for the MaxLinear MxL862xx switch family.
	  These switches have two 10GE SerDes interfaces, one typically
	  used as CPU port.
	   - MxL86282 has eight 2.5 Gigabit PHYs
	   - MxL86252 has five 2.5 Gigabit PHYs
```

## drivers/net/dsa/netc/Kconfig
```kconfig
# SPDX-License-Identifier: GPL-2.0-only
config NET_DSA_NETC_SWITCH
	tristate "NXP NETC Ethernet switch support"
	depends on ARM64 || COMPILE_TEST
	depends on NET_DSA && PCI
	depends on NET_VENDOR_FREESCALE
	select NET_DSA_TAG_NETC
	select FSL_ENETC_MDIO
	select NXP_NTMP
	select NXP_NETC_LIB
	help
	  This driver supports the NXP NETC Ethernet switch, which is embedded
	  as a PCIe function of the NXP NETC IP. But note that this driver is
	  only available for NETC v4.3 and later versions.

	  If compiled as module (M), the module name is nxp-netc-switch.
```

## drivers/net/dsa/ocelot/Kconfig
```kconfig
# SPDX-License-Identifier: GPL-2.0-only
config NET_DSA_MSCC_FELIX
	tristate "Ocelot / Felix Ethernet switch support"
	depends on NET_DSA && PCI
	depends on NET_VENDOR_MICROSEMI
	depends on NET_VENDOR_FREESCALE
	depends on HAS_IOMEM
	depends on PTP_1588_CLOCK_OPTIONAL
	depends on NET_SCH_TAPRIO || NET_SCH_TAPRIO=n
	select MSCC_OCELOT_SWITCH_LIB
	select NET_DSA_TAG_OCELOT_8021Q
	select NET_DSA_TAG_OCELOT
	select FSL_ENETC_MDIO
	select PCS_LYNX
	help
	  This driver supports the VSC9959 (Felix) switch, which is embedded as
	  a PCIe function of the NXP LS1028A ENETC RCiEP.

config NET_DSA_MSCC_SEVILLE
	tristate "Ocelot / Seville Ethernet switch support"
	depends on NET_DSA
	depends on NET_VENDOR_MICROSEMI
	depends on HAS_IOMEM
	depends on PTP_1588_CLOCK_OPTIONAL
	select MDIO_MSCC_MIIM
	select MSCC_OCELOT_SWITCH_LIB
	select NET_DSA_TAG_OCELOT_8021Q
	select NET_DSA_TAG_OCELOT
	select PCS_LYNX
	help
	  This driver supports the VSC9953 (Seville) switch, which is embedded
	  as a platform device on the NXP T1040 SoC.
```

## drivers/net/dsa/qca/Kconfig
```kconfig
# SPDX-License-Identifier: GPL-2.0-only
config NET_DSA_AR9331
	tristate "Qualcomm Atheros AR9331 Ethernet switch support"
	depends on NET_DSA
	select NET_DSA_TAG_AR9331
	select REGMAP
	help
	  This enables support for the Qualcomm Atheros AR9331 built-in Ethernet
	  switch.

config NET_DSA_QCA8K
	tristate "Qualcomm Atheros QCA8K Ethernet switch family support"
	select NET_DSA_TAG_QCA
	select REGMAP
	help
	  This enables support for the Qualcomm Atheros QCA8K Ethernet
	  switch chips.

config NET_DSA_QCA8K_LEDS_SUPPORT
	bool "Qualcomm Atheros QCA8K Ethernet switch family LEDs support"
	depends on NET_DSA_QCA8K
	depends on LEDS_CLASS=y || LEDS_CLASS=NET_DSA_QCA8K
	help
	  This enabled support for LEDs present on the Qualcomm Atheros
	  QCA8K Ethernet switch chips.
```

## drivers/net/dsa/realtek/Kconfig
```kconfig
# SPDX-License-Identifier: GPL-2.0-only
menuconfig NET_DSA_REALTEK
	tristate "Realtek Ethernet switch family support"
	depends on NET_DSA
	select FIXED_PHY
	select IRQ_DOMAIN
	select REALTEK_PHY
	select REGMAP
	help
	  Select to enable support for Realtek Ethernet switch chips.

	  Note that at least one interface driver must be enabled for the
	  subdrivers to be loaded. Moreover, an interface driver cannot achieve
	  anything without at least one subdriver enabled.

if NET_DSA_REALTEK

config NET_DSA_REALTEK_MDIO
	tristate "Realtek MDIO interface driver"
	depends on OF
	depends on NET_DSA_REALTEK_RTL8365MB || NET_DSA_REALTEK_RTL8366RB
	depends on NET_DSA_REALTEK_RTL8365MB || !NET_DSA_REALTEK_RTL8365MB
	depends on NET_DSA_REALTEK_RTL8366RB || !NET_DSA_REALTEK_RTL8366RB
	help
	  Select to enable support for registering switches configured
	  through MDIO.

config NET_DSA_REALTEK_SMI
	tristate "Realtek SMI interface driver"
	depends on OF
	depends on NET_DSA_REALTEK_RTL8365MB || NET_DSA_REALTEK_RTL8366RB
	depends on NET_DSA_REALTEK_RTL8365MB || !NET_DSA_REALTEK_RTL8365MB
	depends on NET_DSA_REALTEK_RTL8366RB || !NET_DSA_REALTEK_RTL8366RB
	help
	  Select to enable support for registering switches connected
	  through SMI.

config NET_DSA_REALTEK_RTL8365MB
	tristate "Realtek RTL8365MB switch subdriver"
	imply NET_DSA_REALTEK_SMI
	imply NET_DSA_REALTEK_MDIO
	select NET_DSA_TAG_RTL8_4
	help
	  Select to enable support for Realtek RTL8365MB-VC and RTL8367S.

config NET_DSA_REALTEK_RTL8366RB
	tristate "Realtek RTL8366RB switch subdriver"
	imply NET_DSA_REALTEK_SMI
	imply NET_DSA_REALTEK_MDIO
	select NET_DSA_TAG_RTL4_A
	help
	  Select to enable support for Realtek RTL8366RB.

endif
```

## drivers/net/dsa/sja1105/Kconfig
```kconfig
# SPDX-License-Identifier: GPL-2.0-only
config NET_DSA_SJA1105
tristate "NXP SJA1105 Ethernet switch family support"
	depends on NET_DSA && SPI
	select NET_DSA_TAG_SJA1105
	select PACKING
	select CRC32
	help
	  This is the driver for the NXP SJA1105 automotive Ethernet switch
	  family. These are 5-port devices and are managed over an SPI
	  interface. Probing is handled based on OF bindings and so is the
	  linkage to PHYLINK. The driver supports the following revisions:
	    - SJA1105E (Gen. 1, No TT-Ethernet)
	    - SJA1105T (Gen. 1, TT-Ethernet)
	    - SJA1105P (Gen. 2, No SGMII, No TT-Ethernet)
	    - SJA1105Q (Gen. 2, No SGMII, TT-Ethernet)
	    - SJA1105R (Gen. 2, SGMII, No TT-Ethernet)
	    - SJA1105S (Gen. 2, SGMII, TT-Ethernet)

config NET_DSA_SJA1105_PTP
	bool "Support for the PTP clock on the NXP SJA1105 Ethernet switch"
	depends on NET_DSA_SJA1105
	depends on PTP_1588_CLOCK
	help
	  This enables support for timestamping and PTP clock manipulations in
	  the SJA1105 DSA driver.

config NET_DSA_SJA1105_TAS
	bool "Support for the Time-Aware Scheduler on NXP SJA1105"
	depends on NET_DSA_SJA1105 && NET_SCH_TAPRIO
	depends on NET_SCH_TAPRIO=y || NET_DSA_SJA1105=m
	depends on NET_DSA_SJA1105_PTP
	help
	  This enables support for the TTEthernet-based egress scheduling
	  engine in the SJA1105 DSA driver, which is controlled using a
	  hardware offload of the tc-tqprio qdisc.
```

## drivers/net/dsa/xrs700x/Kconfig
```kconfig
# SPDX-License-Identifier: GPL-2.0-only
config NET_DSA_XRS700X
	tristate
	depends on NET_DSA
	select NET_DSA_TAG_XRS700X
	select REGMAP
	help
	  This enables support for Arrow SpeedChips XRS7003/7004 gigabit
	  Ethernet switches.

config NET_DSA_XRS700X_I2C
	tristate "Arrow XRS7000X series switch in I2C mode"
	depends on NET_DSA && I2C
	select NET_DSA_XRS700X
	select REGMAP_I2C
	help
	  Enable I2C support for Arrow SpeedChips XRS7003/7004 gigabit Ethernet
	  switches.

config NET_DSA_XRS700X_MDIO
	tristate "Arrow XRS7000X series switch in MDIO mode"
	depends on NET_DSA
	select NET_DSA_XRS700X
	help
	  Enable MDIO support for Arrow SpeedChips XRS7003/7004 gigabit Ethernet
	  switches.
```

## drivers/net/eth_mac/Kconfig
```kconfig
#
#	set Ethernet mac source
#
choice 
	prompt "Ethernet mac source"
	depends on NETDEV_10000 ||NETDEV_1000 ||NET_ETHERNET
	default ETH_MAC_FROM_RANDOM

	config ETH_MAC_FROM_RANDOM
		bool "Random Ethernet mac "
		---help---
	 	   Say Y here if you want to set Random mac to Ethernet mac.
	 
	  	   This option alone does not add any kernel code.

	  	   If you say N, all options in this submenu will be skipped and disabled.	

	config ETH_MAC_FROM_EEPROM
		bool "Ethernet mac from EEPROM"
		depends on EEPROM_AT24C16
		---help---
	 	   Say Y here if you want to set EEPROM mac to Ethernet mac,
	 	   when the EEPROM exsits and mac has been written in.
	 
	  	   This option alone does not add any kernel code.

	  	   If you say N, all options in this submenu will be skipped and disabled.	

	config ETH_MAC_FROM_IDB
		bool "Ethernet mac from IDB"
		---help---
	 	  Say Y here if you want to set IDB mac to Ethernet mac,
	  	  when the IDB mac has been written in.
	 	
	  	  This option alone does not add any kernel code.

	  	  If you say N, all options in this submenu will be skipped and disabled.

	config ETH_MAC_FROM_WIFI_MAC
		bool "Ethernet mac from Wifi mac"
		---help---
	  	  Say Y here if you want to set Wifi mac to Ethernet mac,
	  	  when the Wifi device exsits.
	  	  This option alone does not add any kernel code.

	  	  If you say N, all options in this submenu will be skipped and disabled.

	config ETH_MAC_FROM_SECURE_CHIP
		bool "Ethernet mac from Secure chip"
		---help---
	  	  Say Y here if you want to set Secure chip mac to Ethernet mac,
	  	  when the Secure chip exsits and mac has been written in.
	  	  This option alone does not add any kernel code.

	  	  If you say N, all options in this submenu will be skipped and disabled.

endchoice
```

## drivers/net/ethernet/3com/Kconfig
```kconfig
#
# 3Com Ethernet device configuration
#

config NET_VENDOR_3COM
	bool "3Com devices"
	default y
	depends on ISA || EISA || PCI || PCMCIA
	---help---
	  If you have a network (Ethernet) card belonging to this class, say Y
	  and read the Ethernet-HOWTO, available from
	  <http://www.tldp.org/docs.html#howto>.

	  Note that the answer to this question doesn't directly affect the
	  kernel: saying N will just cause the configurator to skip all
	  the questions about 3Com cards. If you say Y, you will be asked for
	  your specific card in the following questions.

if NET_VENDOR_3COM

config EL3
	tristate "3c509/3c579 \"EtherLink III\" support"
	depends on (ISA || EISA)
	---help---
	  If you have a network (Ethernet) card belonging to the 3Com
	  EtherLinkIII series, say Y and read the Ethernet-HOWTO, available
	  from <http://www.tldp.org/docs.html#howto>.

	  If your card is not working you may need to use the DOS
	  setup disk to disable Plug & Play mode, and to select the default
	  media type.

	  To compile this driver as a module, choose M here. The module
	  will be called 3c509.

config 3C515
	tristate "3c515 ISA \"Fast EtherLink\""
	depends on ISA && ISA_DMA_API
	---help---
	  If you have a 3Com ISA EtherLink XL "Corkscrew" 3c515 Fast Ethernet
	  network card, say Y and read the Ethernet-HOWTO, available from
	  <http://www.tldp.org/docs.html#howto>.

	  To compile this driver as a module, choose M here. The module
	  will be called 3c515.

config PCMCIA_3C574
	tristate "3Com 3c574 PCMCIA support"
	depends on PCMCIA
	---help---
	  Say Y here if you intend to attach a 3Com 3c574 or compatible PCMCIA
	  (PC-card) Fast Ethernet card to your computer.

	  To compile this driver as a module, choose M here: the module will be
	  called 3c574_cs.  If unsure, say N.

config PCMCIA_3C589
	tristate "3Com 3c589 PCMCIA support"
	depends on PCMCIA
	---help---
	  Say Y here if you intend to attach a 3Com 3c589 or compatible PCMCIA
	  (PC-card) Ethernet card to your computer.

	  To compile this driver as a module, choose M here: the module will be
	  called 3c589_cs.  If unsure, say N.

config VORTEX
	tristate "3c590/3c900 series (592/595/597) \"Vortex/Boomerang\" support"
	depends on (PCI || EISA) && HAS_IOPORT
	select MII
	---help---
	  This option enables driver support for a large number of 10Mbps and
	  10/100Mbps EISA, PCI and Cardbus 3Com network cards:

	  "Vortex"    (Fast EtherLink 3c590/3c592/3c595/3c597) EISA and PCI
	  "Boomerang" (EtherLink XL 3c900 or 3c905)            PCI
	  "Cyclone"   (3c540/3c900/3c905/3c980/3c575/3c656)    PCI and Cardbus
	  "Tornado"   (3c905)                                  PCI
	  "Hurricane" (3c555/3cSOHO)                           PCI

	  If you have such a card, say Y and read the Ethernet-HOWTO,
	  available from <http://www.tldp.org/docs.html#howto>. More
	  specific information is in
	  <file:Documentation/networking/vortex.txt> and in the comments at
	  the beginning of <file:drivers/net/ethernet/3com/3c59x.c>.

	  To compile this support as a module, choose M here.

config TYPHOON
	tristate "3cr990 series \"Typhoon\" support"
	depends on PCI
	select CRC32
	---help---
	  This option enables driver support for the 3cr990 series of cards:

	  3C990-TX, 3CR990-TX-95, 3CR990-TX-97, 3CR990-FX-95, 3CR990-FX-97,
	  3CR990SVR, 3CR990SVR95, 3CR990SVR97, 3CR990-FX-95 Server,
	  3CR990-FX-97 Server, 3C990B-TX-M, 3C990BSVR

	  If you have a network (Ethernet) card of this type, say Y and read
	  the Ethernet-HOWTO, available from
	  <http://www.tldp.org/docs.html#howto>.

	  To compile this driver as a module, choose M here. The module
	  will be called typhoon.

endif # NET_VENDOR_3COM
```
