## drivers/net/ethernet/Kconfig
```kconfig
#
# Ethernet LAN device configuration
#

menuconfig ETHERNET
	bool "Ethernet driver support"
	depends on NET
	default y
	---help---
	  This section contains all the Ethernet device drivers.

if ETHERNET

config MDIO
	tristate

config SUNGEM_PHY
	tristate

source "drivers/net/ethernet/3com/Kconfig"
source "drivers/net/ethernet/adaptec/Kconfig"
source "drivers/net/ethernet/aeroflex/Kconfig"
source "drivers/net/ethernet/agere/Kconfig"
source "drivers/net/ethernet/alacritech/Kconfig"
source "drivers/net/ethernet/allwinner/Kconfig"
source "drivers/net/ethernet/alteon/Kconfig"
source "drivers/net/ethernet/altera/Kconfig"
source "drivers/net/ethernet/amazon/Kconfig"
source "drivers/net/ethernet/amd/Kconfig"
source "drivers/net/ethernet/apm/Kconfig"
source "drivers/net/ethernet/apple/Kconfig"
source "drivers/net/ethernet/aquantia/Kconfig"
source "drivers/net/ethernet/arc/Kconfig"
source "drivers/net/ethernet/atheros/Kconfig"
source "drivers/net/ethernet/aurora/Kconfig"
source "drivers/net/ethernet/broadcom/Kconfig"
source "drivers/net/ethernet/brocade/Kconfig"
source "drivers/net/ethernet/cadence/Kconfig"
source "drivers/net/ethernet/calxeda/Kconfig"
source "drivers/net/ethernet/cavium/Kconfig"
source "drivers/net/ethernet/chelsio/Kconfig"
source "drivers/net/ethernet/cirrus/Kconfig"
source "drivers/net/ethernet/cisco/Kconfig"
source "drivers/net/ethernet/cortina/Kconfig"

config CX_ECAT
	tristate "Beckhoff CX5020 EtherCAT master support"
	depends on PCI
	depends on X86 || COMPILE_TEST
	---help---
	  Driver for EtherCAT master module located on CCAT FPGA
	  that can be found on Beckhoff CX5020, and possibly other of CX
	  Beckhoff CX series industrial PCs.

	  To compile this driver as a module, choose M here. The module
	  will be called ec_bhf.

source "drivers/net/ethernet/davicom/Kconfig"

config DNET
	tristate "Dave ethernet support (DNET)"
	depends on HAS_IOMEM
	select PHYLIB
	---help---
	  The Dave ethernet interface (DNET) is found on Qong Board FPGA.
	  Say Y to include support for the DNET chip.

	  To compile this driver as a module, choose M here: the module
	  will be called dnet.

source "drivers/net/ethernet/dec/Kconfig"
source "drivers/net/ethernet/dlink/Kconfig"
source "drivers/net/ethernet/emulex/Kconfig"
source "drivers/net/ethernet/ezchip/Kconfig"
source "drivers/net/ethernet/faraday/Kconfig"
source "drivers/net/ethernet/freescale/Kconfig"
source "drivers/net/ethernet/fujitsu/Kconfig"
source "drivers/net/ethernet/hisilicon/Kconfig"
source "drivers/net/ethernet/hp/Kconfig"
source "drivers/net/ethernet/huawei/Kconfig"
source "drivers/net/ethernet/i825xx/Kconfig"
source "drivers/net/ethernet/ibm/Kconfig"
source "drivers/net/ethernet/intel/Kconfig"
source "drivers/net/ethernet/xscale/Kconfig"

config JME
	tristate "JMicron(R) PCI-Express Gigabit Ethernet support"
	depends on PCI
	select CRC32
	select MII
	---help---
	  This driver supports the PCI-Express gigabit ethernet adapters
	  based on JMicron JMC250 chipset.

	  To compile this driver as a module, choose M here. The module
	  will be called jme.

config KORINA
	tristate "Korina (IDT RC32434) Ethernet support"
	depends on MIKROTIK_RB532
	---help---
	  If you have a Mikrotik RouterBoard 500 or IDT RC32434
	  based system say Y. Otherwise say N.

config LANTIQ_ETOP
	tristate "Lantiq SoC ETOP driver"
	depends on SOC_TYPE_XWAY
	---help---
	  Support for the MII0 inside the Lantiq SoC

config LANTIQ_XRX200
	tristate "Lantiq / Intel xRX200 PMAC network driver"
	depends on SOC_TYPE_XWAY
	---help---
	  Support for the PMAC of the Gigabit switch (GSWIP) inside the
	  Lantiq / Intel VRX200 VDSL SoC

source "drivers/net/ethernet/marvell/Kconfig"
source "drivers/net/ethernet/mediatek/Kconfig"
source "drivers/net/ethernet/mellanox/Kconfig"
source "drivers/net/ethernet/micrel/Kconfig"
source "drivers/net/ethernet/microchip/Kconfig"
source "drivers/net/ethernet/moxa/Kconfig"
source "drivers/net/ethernet/mscc/Kconfig"
source "drivers/net/ethernet/myricom/Kconfig"

config FEALNX
	tristate "Myson MTD-8xx PCI Ethernet support"
	depends on PCI
	select CRC32
	select MII
	---help---
	  Say Y here to support the Myson MTD-800 family of PCI-based Ethernet
	  cards. <http://www.myson.com.tw/>

source "drivers/net/ethernet/natsemi/Kconfig"
source "drivers/net/ethernet/neterion/Kconfig"
source "drivers/net/ethernet/netronome/Kconfig"
source "drivers/net/ethernet/ni/Kconfig"
source "drivers/net/ethernet/8390/Kconfig"

config NET_NETX
	tristate "NetX Ethernet support"
	select MII
	depends on ARCH_NETX
	---help---
	  This is support for the Hilscher netX builtin Ethernet ports

	  To compile this driver as a module, choose M here. The module
	  will be called netx-eth.

source "drivers/net/ethernet/nuvoton/Kconfig"
source "drivers/net/ethernet/nvidia/Kconfig"
source "drivers/net/ethernet/nxp/Kconfig"
source "drivers/net/ethernet/oki-semi/Kconfig"

config ETHOC
	tristate "OpenCores 10/100 Mbps Ethernet MAC support"
	depends on HAS_IOMEM && HAS_DMA
	select MII
	select PHYLIB
	select CRC32
	select BITREVERSE
	---help---
	  Say Y here if you want to use the OpenCores 10/100 Mbps Ethernet MAC.

source "drivers/net/ethernet/packetengines/Kconfig"
source "drivers/net/ethernet/pasemi/Kconfig"
source "drivers/net/ethernet/qlogic/Kconfig"
source "drivers/net/ethernet/qualcomm/Kconfig"
source "drivers/net/ethernet/rdc/Kconfig"
source "drivers/net/ethernet/realtek/Kconfig"
source "drivers/net/ethernet/renesas/Kconfig"
source "drivers/net/ethernet/rocker/Kconfig"
source "drivers/net/ethernet/samsung/Kconfig"
source "drivers/net/ethernet/seeq/Kconfig"
source "drivers/net/ethernet/sfc/Kconfig"
source "drivers/net/ethernet/sgi/Kconfig"
source "drivers/net/ethernet/silan/Kconfig"
source "drivers/net/ethernet/sis/Kconfig"
source "drivers/net/ethernet/smsc/Kconfig"
source "drivers/net/ethernet/socionext/Kconfig"
source "drivers/net/ethernet/stmicro/Kconfig"
source "drivers/net/ethernet/sun/Kconfig"
source "drivers/net/ethernet/synopsys/Kconfig"
source "drivers/net/ethernet/tehuti/Kconfig"
source "drivers/net/ethernet/ti/Kconfig"
source "drivers/net/ethernet/toshiba/Kconfig"
source "drivers/net/ethernet/tundra/Kconfig"
source "drivers/net/ethernet/via/Kconfig"
source "drivers/net/ethernet/wiznet/Kconfig"
source "drivers/net/ethernet/xilinx/Kconfig"
source "drivers/net/ethernet/xircom/Kconfig"

endif # ETHERNET
```

## drivers/net/ethernet/actions/Kconfig
```kconfig
# SPDX-License-Identifier: GPL-2.0-only

config NET_VENDOR_ACTIONS
	bool "Actions Semi devices"
	depends on ARCH_ACTIONS || COMPILE_TEST
	default ARCH_ACTIONS
	help
	  If you have a network (Ethernet) card belonging to this class, say Y.

	  Note that the answer to this question doesn't directly affect the
	  kernel: saying N will just cause the configurator to skip all the
	  questions about Actions Semi devices.  If you say Y, you will be
	  asked for your specific card in the following questions.

if NET_VENDOR_ACTIONS

config OWL_EMAC
	tristate "Actions Semi Owl Ethernet MAC support"
	select PHYLIB
	help
	  This driver supports the Actions Semi Ethernet Media Access
	  Controller (EMAC) found on the S500 and S900 SoCs.  The controller
	  is compliant with the IEEE 802.3 CSMA/CD standard and supports
	  both half-duplex and full-duplex operation modes at 10/100 Mb/s.

endif # NET_VENDOR_ACTIONS
```

## drivers/net/ethernet/adaptec/Kconfig
```kconfig
#
# Adaptec network device configuration
#

config NET_VENDOR_ADAPTEC
	bool "Adaptec devices"
	default y
	depends on PCI
	---help---
	  If you have a network (Ethernet) card belonging to this class, say Y
	  and read the Ethernet-HOWTO, available from
	  <http://www.tldp.org/docs.html#howto>.

	  Note that the answer to this question doesn't directly affect the
	  kernel: saying N will just cause the configurator to skip all
	  the questions about Adaptec cards. If you say Y, you will be asked for
	  your specific card in the following questions.

if NET_VENDOR_ADAPTEC

config ADAPTEC_STARFIRE
	tristate "Adaptec Starfire/DuraLAN support"
	depends on PCI
	select CRC32
	select NET_CORE
	select MII
	---help---
	  Say Y here if you have an Adaptec Starfire (or DuraLAN) PCI network
	  adapter. The DuraLAN chip is used on the 64 bit PCI boards from
	  Adaptec e.g. the ANA-6922A. The older 32 bit boards use the tulip
	  driver.

	  To compile this driver as a module, choose M here: the module
	  will be called starfire.  This is recommended.

endif # NET_VENDOR_ADAPTEC
```

## drivers/net/ethernet/adi/Kconfig
```kconfig
# SPDX-License-Identifier: GPL-2.0 OR BSD-2-Clause
#
# Analog Devices device configuration
#

config NET_VENDOR_ADI
	bool "Analog Devices devices"
	default y
	depends on SPI
	help
	  If you have a network (Ethernet) card belonging to this class, say Y.

	  Note that the answer to this question doesn't directly affect the
	  kernel: saying N will just cause the configurator to skip all
	  the questions about ADI devices. If you say Y, you will be asked
	  for your specific card in the following questions.

if NET_VENDOR_ADI

config ADIN1110
	tristate "Analog Devices ADIN1110 MAC-PHY"
	depends on SPI && NET_SWITCHDEV
	select CRC8
	select PHYLIB
	help
	  Say yes here to build support for Analog Devices ADIN1110
	  Low Power 10BASE-T1L Ethernet MAC-PHY.

config ADIN1140
	tristate "Analog Devices ADIN1140 MAC-PHY"
	depends on SPI
	select ADIN1140_PHY
	select OA_TC6
	help
	  Say yes here to build support for Analog Devices, Inc. ADIN1140
	  10BASE-T1S Ethernet MAC-PHY.

	  To compile this driver as a module, choose M here. The module will be
	  called adin1140.

endif # NET_VENDOR_ADI
```

## drivers/net/ethernet/aeroflex/Kconfig
```kconfig
#
# Aeroflex Gaisler network device configuration
#

config GRETH
	tristate "Aeroflex Gaisler GRETH Ethernet MAC support"
	depends on SPARC
	select PHYLIB
	select CRC32
	---help---
	  Say Y here if you want to use the Aeroflex Gaisler GRETH Ethernet MAC.
```

## drivers/net/ethernet/agere/Kconfig
```kconfig
# SPDX-License-Identifier: GPL-2.0-only
#
# Agere device configuration
#

config NET_VENDOR_AGERE
	bool "Agere devices"
	default y
	depends on PCI
	---help---
	  If you have a network (Ethernet) card belonging to this class, say Y.

	  Note that the answer to this question doesn't directly affect the
	  kernel: saying N will just cause the configurator to skip all
	  the questions about Agere devices. If you say Y, you will be asked
	  for your specific card in the following questions.

if NET_VENDOR_AGERE

config ET131X
	tristate "Agere ET-1310 Gigabit Ethernet support"
	depends on PCI
	select PHYLIB
	---help---
	  This driver supports Agere ET-1310 ethernet adapters.

	  To compile this driver as a module, choose M here. The module
	  will be called et131x.

endif # NET_VENDOR_AGERE
```

## drivers/net/ethernet/airoha/Kconfig
```kconfig
# SPDX-License-Identifier: GPL-2.0-only
config NET_VENDOR_AIROHA
	bool "Airoha devices"
	depends on ARCH_AIROHA || COMPILE_TEST
	help
	  If you have a Airoha SoC with ethernet, say Y.

if NET_VENDOR_AIROHA

config NET_AIROHA_NPU
	tristate "Airoha NPU support"
	select WANT_DEV_COREDUMP
	select REGMAP_MMIO
	help
	  This driver supports Airoha Network Processor (NPU) available
	  on the Airoha Soc family.

config NET_AIROHA
	tristate "Airoha SoC Gigabit Ethernet support"
	depends on NET_DSA || !NET_DSA
	select NET_AIROHA_NPU
	select PAGE_POOL
	help
	  This driver supports the gigabit ethernet MACs in the
	  Airoha SoC family.

endif #NET_VENDOR_AIROHA
```

## drivers/net/ethernet/alacritech/Kconfig
```kconfig
# SPDX-License-Identifier: GPL-2.0-only
config NET_VENDOR_ALACRITECH
	bool "Alacritech devices"
	default y
	help
	  If you have a network (Ethernet) card belonging to this class, say Y.

	  Note that the answer to this question doesn't directly affect the
	  kernel: saying N will just cause the configurator to skip all the
	  questions about Alacritech devices. If you say Y, you will be asked
	  for your specific device in the following questions.

if NET_VENDOR_ALACRITECH

config SLICOSS
	tristate "Alacritech Slicoss support"
	depends on PCI
	select CRC32
	help
	  This driver supports Gigabit Ethernet adapters based on the
	  Session Layer Interface (SLIC) technology by Alacritech.

	  Supported are Mojave (1 port) and Oasis (1, 2 and 4 port) cards,
	  both copper and fiber.

	  To compile this driver as a module, choose M here: the module
	  will be called slicoss. This is recommended.

endif # NET_VENDOR_ALACRITECH
```

## drivers/net/ethernet/alibaba/Kconfig
```kconfig
#
# Alibaba network device configuration
#

config NET_VENDOR_ALIBABA
	bool "Alibaba Devices"
	default y
	help
	  If you have a network (Ethernet) device belonging to this class, say Y.

	  Note that the answer to this question doesn't directly affect the
	  kernel: saying N will just cause the configurator to skip all
	  the questions about Alibaba devices. If you say Y, you will be asked
	  for your specific device in the following questions.

if NET_VENDOR_ALIBABA

config ALIBABA_EEA
	tristate "Alibaba Elastic Ethernet Adapter support"
	depends on PCI_MSI
	depends on 64BIT
	select PAGE_POOL
	help
	  This driver supports Alibaba Elastic Ethernet Adapter.

	  To compile this driver as a module, choose M here.

endif #NET_VENDOR_ALIBABA
```

## drivers/net/ethernet/allwinner/Kconfig
```kconfig
#
# Allwinner device configuration
#

config NET_VENDOR_ALLWINNER
	bool "Allwinner devices"
	default y

	depends on ARCH_SUNXI
	---help---
	  If you have a network (Ethernet) card belonging to this
	  class, say Y and read the Ethernet-HOWTO, available from
	  <http://www.tldp.org/docs.html#howto>.

	  Note that the answer to this question doesn't directly
	  affect the kernel: saying N will just cause the configurator
	  to skip all the questions about Allwinner cards. If you say Y,
	  you will be asked for your specific card in the following
	  questions.

if NET_VENDOR_ALLWINNER

config SUN4I_EMAC
        tristate "Allwinner A10 EMAC support"
	depends on ARCH_SUNXI
	depends on OF
	select CRC32
	select MII
	select PHYLIB
	select MDIO_SUN4I
        ---help---
          Support for Allwinner A10 EMAC ethernet driver.

          To compile this driver as a module, choose M here.  The module
          will be called sun4i-emac.

endif # NET_VENDOR_ALLWINNER
```

## drivers/net/ethernet/allwinner/gmac/Kconfig
```kconfig
config SUNXI_GMAC
	tristate "Sunxi platform 10/100/1000Mbps Ethernet driver"
	depends on HAS_IOMEM
	depends on ARCH_SUN7I
	select NET_CORE
	select MII
	select PHYLIB
	select CRC32
	default m
	---help---
	  This is the driver for the Sunxi Ethernet.

if SUNXI_GMAC

config GMAC_SCRIPT_SYS
	bool "Use sunxi platform script"
	depends on SUNXI_GMAC
	default y
	---help---
	 The GMAC gpio request and control by the script of sunxi platform.
	 Select it, by script. If not, ioremap by drivers itself.

config GMAC_CLK_SYS
	bool "Clock use system interface"
	depends on SUNXI_GMAC
	default y
	---help---
	 It select the clock controler is system or the driver itself.
	 If you want to use the system interface, select it. If not, the
	 driver will control the clock by ioremap.

choice
	prompt "Select the DMA TX/RX descriptor operating modes"
	depends on SUNXI_GMAC
	---help---
	  This driver supports DMA descriptor to operate both in dual buffer
	  (RING) and linked-list(CHAINED) mode. In RING mode each descriptor
	  points to two data buffer pointers whereas in CHAINED mode they
	  points to only one data buffer pointer.

config GMAC_RING
	bool "Enable Descriptor Ring Mode"

config GMAC_CHAINED
	bool "Enable Descriptor Chained Mode"

endchoice

endif
```
