## drivers/nfc/st21nfcb/Kconfig
```kconfig
config NFC_ST21NFCB
	tristate "STMicroelectronics ST21NFCB NFC driver"
	depends on NFC_NCI
	default n
	---help---
	  STMicroelectronics ST21NFCB core driver. It implements the chipset
	  NCI logic and hooks into the NFC kernel APIs. Physical layers will
	  register against it.

	  To compile this driver as a module, choose m here. The module will
	  be called st21nfcb.
	  Say N if unsure.

config NFC_ST21NFCB_I2C
	tristate "NFC ST21NFCB i2c support"
	depends on NFC_ST21NFCB && I2C
	---help---
	  This module adds support for the STMicroelectronics st21nfcb i2c interface.
	  Select this if your platform is using the i2c bus.

	  If you choose to build a module, it'll be called st21nfcb_i2c.
	  Say N if unsure.
```

## drivers/nfc/st95hf/Kconfig
```kconfig
config NFC_ST95HF
	tristate "ST95HF NFC Transceiver driver"
	depends on SPI && NFC_DIGITAL
	help
	This enables the ST NFC driver for ST95HF NFC transceiver.
	This makes use of SPI framework to communicate with transceiver
	and registered with NFC digital core to support Linux NFC framework.

	Say Y here to compile support for ST NFC transceiver ST95HF
	linux driver into the kernel or say M to compile it as module.
```

## drivers/ntb/Kconfig
```kconfig
# SPDX-License-Identifier: GPL-2.0-only
menuconfig NTB
	tristate "Non-Transparent Bridge support"
	depends on PCI
	help
	 The PCI-E Non-transparent bridge hardware is a point-to-point PCI-E bus
	 connecting 2 systems.  When configured, writes to the device's PCI
	 mapped memory will be mirrored to a buffer on the remote system.  The
	 ntb Linux driver uses this point-to-point communication as a method to
	 transfer data from one system to the other.

	 If unsure, say N.

if NTB

config NTB_MSI
	bool "MSI Interrupt Support"
	depends on PCI_MSI
	help
	 Support using MSI interrupt forwarding instead of (or in addition to)
	 hardware doorbells. MSI interrupts typically offer lower latency
	 than doorbells and more MSI interrupts can be made available to
	 clients. However this requires an extra memory window and support
	 in the hardware driver for creating the MSI interrupts.

	 If unsure, say N.
source "drivers/ntb/hw/Kconfig"

source "drivers/ntb/test/Kconfig"

config NTB_TRANSPORT
	tristate "NTB Transport Client"
	help
	 This is a transport driver that enables connected systems to exchange
	 messages over the ntb hardware.  The transport exposes a queue pair api
	 to client drivers.

	 If unsure, say N.

endif # NTB
```

## drivers/ntb/hw/Kconfig
```kconfig
# SPDX-License-Identifier: GPL-2.0-only
source "drivers/ntb/hw/amd/Kconfig"
source "drivers/ntb/hw/idt/Kconfig"
source "drivers/ntb/hw/intel/Kconfig"
source "drivers/ntb/hw/mscc/Kconfig"
```

## drivers/ntb/hw/amd/Kconfig
```kconfig
config NTB_AMD
	tristate "AMD Non-Transparent Bridge support"
	depends on X86_64
	help
	 This driver supports AMD NTB on capable Zeppelin hardware.

	 If unsure, say N.
```

## drivers/ntb/hw/epf/Kconfig
```kconfig
config NTB_EPF
	tristate "Generic EPF Non-Transparent Bridge support"
	help
	  This driver supports EPF NTB on configurable endpoint.
	  If unsure, say N.
```

## drivers/ntb/hw/idt/Kconfig
```kconfig
# SPDX-License-Identifier: GPL-2.0-only
config NTB_IDT
	tristate "IDT PCIe-switch Non-Transparent Bridge support"
	depends on PCI
	select HWMON
	help
	 This driver supports NTB of capable IDT PCIe-switches.

	 Some of the pre-initializations must be made before IDT PCIe-switch
	 exposes its NT-functions correctly. It should be done by either proper
	 initialization of EEPROM connected to master SMbus of the switch or
	 by BIOS using slave-SMBus interface changing corresponding registers
	 value. Evidently it must be done before PCI bus enumeration is
	 finished in Linux kernel.

	 First of all partitions must be activated and properly assigned to all
	 the ports with NT-functions intended to be activated (see SWPARTxCTL
	 and SWPORTxCTL registers). Then all NT-function BARs must be enabled
	 with chosen valid aperture. For memory windows related BARs the
	 aperture settings shall determine the maximum size of memory windows
	 accepted by a BAR. Note that BAR0 must map PCI configuration space
	 registers.

	 It's worth to note, that since a part of this driver relies on the
	 BAR settings of peer NT-functions, the BAR setups can't be done over
	 kernel PCI fixups. That's why the alternative pre-initialization
	 techniques like BIOS using SMBus interface or EEPROM should be
	 utilized.

	 If unsure, say N.
```

## drivers/ntb/hw/intel/Kconfig
```kconfig
# SPDX-License-Identifier: GPL-2.0-only
config NTB_INTEL
	tristate "Intel Non-Transparent Bridge support"
	depends on X86_64
	help
	 This driver supports Intel NTB on capable Xeon and Atom hardware.

	 If unsure, say N.
```

## drivers/ntb/hw/mscc/Kconfig
```kconfig
config NTB_SWITCHTEC
	tristate "MicroSemi Switchtec Non-Transparent Bridge Support"
	select PCI_SW_SWITCHTEC
	help
	 Enables NTB support for Switchtec PCI switches. This also
	 selects the Switchtec management driver as they share the same
	 hardware interface.

	 If unsure, say N.
```

## drivers/ntb/test/Kconfig
```kconfig
# SPDX-License-Identifier: GPL-2.0-only
config NTB_PINGPONG
	tristate "NTB Ping Pong Test Client"
	help
	 This is a simple ping pong driver that exercises the scratchpads and
	 doorbells of the ntb hardware.  This driver may be used to test that
	 your ntb hardware and drivers are functioning at a basic level.

	 If unsure, say N.

config NTB_TOOL
	tristate "NTB Debugging Tool Test Client"
	help
	 This is a simple debugging driver that enables the doorbell and
	 scratchpad registers to be read and written from the debugfs.  This
	 enables more complicated debugging to be scripted from user space.
	 This driver may be used to test that your ntb hardware and drivers are
	 functioning at a basic level.

	 If unsure, say N.

config NTB_PERF
	tristate "NTB RAW Perf Measuring Tool"
	help
	 This is a tool to measure raw NTB performance by transferring data
	 to and from the window without additional software interaction.

	 If unsure, say N.

config NTB_MSI_TEST
	tristate "NTB MSI Test Client"
	depends on NTB_MSI
	help
	  This tool demonstrates the use of the NTB MSI library to
	  send MSI interrupts between peers.

	  If unsure, say N.
```

## drivers/nvdimm/Kconfig
```kconfig
# SPDX-License-Identifier: GPL-2.0-only
menuconfig LIBNVDIMM
	tristate "NVDIMM (Non-Volatile Memory Device) Support"
	depends on PHYS_ADDR_T_64BIT
	depends on HAS_IOMEM
	depends on BLK_DEV
	select MEMREGION
	help
	  Generic support for non-volatile memory devices including
	  ACPI-6-NFIT defined resources.  On platforms that define an
	  NFIT, or otherwise can discover NVDIMM resources, a libnvdimm
	  bus is registered to advertise PMEM (persistent memory)
	  namespaces (/dev/pmemX). A PMEM namespace refers to a
	  memory resource that may span multiple DIMMs and support DAX
	  (see CONFIG_DAX).

if LIBNVDIMM

config BLK_DEV_PMEM
	tristate "PMEM: Persistent memory block device support"
	default LIBNVDIMM
	select DAX
	select ND_BTT if BTT
	select ND_PFN if NVDIMM_PFN
	help
	  Memory ranges for PMEM are described by either an NFIT
	  (NVDIMM Firmware Interface Table, see CONFIG_NFIT_ACPI), a
	  non-standard OEM-specific E820 memory type (type-12, see
	  CONFIG_X86_PMEM_LEGACY), or it is manually specified by the
	  'memmap=nn[KMG]!ss[KMG]' kernel command line (see
	  Documentation/admin-guide/kernel-parameters.rst).  This driver converts
	  these persistent memory ranges into block devices that are
	  capable of DAX (direct-access) file system mappings.  See
	  Documentation/driver-api/nvdimm/nvdimm.rst for more details.

	  Say Y if you want to use an NVDIMM

config ND_CLAIM
	bool

config ND_BTT
	tristate

config BTT
	bool "BTT: Block Translation Table (atomic sector updates)"
	default y if LIBNVDIMM
	select ND_CLAIM
	help
	  The Block Translation Table (BTT) provides atomic sector
	  update semantics for persistent memory devices, so that
	  applications that rely on sector writes not being torn (a
	  guarantee that typical disks provide) can continue to do so.
	  The BTT manifests itself as an alternate personality for an
	  NVDIMM namespace, i.e. a namespace can be in raw mode pmemX,
	  or 'sectored' mode.

	  Select Y if unsure

config ND_PFN
	tristate

config NVDIMM_PFN
	bool "PFN: Map persistent (device) memory"
	default LIBNVDIMM
	depends on ZONE_DEVICE
	select ND_CLAIM
	help
	  Map persistent memory, i.e. advertise it to the memory
	  management sub-system.  By default persistent memory does
	  not support direct I/O, RDMA, or any other usage that
	  requires a 'struct page' to mediate an I/O request.  This
	  driver allocates and initializes the infrastructure needed
	  to support those use cases.

	  Select Y if unsure

config NVDIMM_DAX
	bool "NVDIMM DAX: Raw access to persistent memory"
	default LIBNVDIMM
	depends on NVDIMM_PFN
	help
	  Support raw device dax access to a persistent memory
	  namespace.  For environments that want to hard partition
	  persistent memory, this capability provides a mechanism to
	  sub-divide a namespace into character devices that can only be
	  accessed via DAX (mmap(2)).

	  Select Y if unsure

config OF_PMEM
	tristate "Device-tree support for persistent memory regions"
	depends on OF
	default LIBNVDIMM
	help
	  Allows regions of persistent memory to be described in the
	  device-tree.

	  Select Y if unsure.

config NVDIMM_KEYS
	def_bool y
	depends on ENCRYPTED_KEYS
	depends on (LIBNVDIMM=ENCRYPTED_KEYS) || LIBNVDIMM=m

config NVDIMM_KMSAN
	bool
	depends on KMSAN
	help
	  KMSAN, and other memory debug facilities, increase the size of
	  'struct page' to contain extra metadata. This collides with
	  the NVDIMM capability to store a potentially
	  larger-than-"System RAM" size 'struct page' array in a
	  reservation of persistent memory rather than limited /
	  precious DRAM. However, that reservation needs to persist for
	  the life of the given NVDIMM namespace. If you are using KMSAN
	  to debug an issue unrelated to NVDIMMs or DAX then say N to this
	  option. Otherwise, say Y but understand that any namespaces
	  (with the page array stored pmem) created with this build of
	  the kernel will permanently reserve and strand excess
	  capacity compared to the CONFIG_KMSAN=n case.

	  Select N if unsure.

config NVDIMM_TEST_BUILD
	tristate "Build the unit test core"
	depends on m
	depends on COMPILE_TEST && X86_64
	default m if COMPILE_TEST
	help
	  Build the core of the unit test infrastructure. The result of
	  this build is non-functional for unit test execution, but it
	  otherwise helps catch build errors induced by changes to the
	  core devm_memremap_pages() implementation and other
	  infrastructure.

endif
```

## drivers/nvme/Kconfig
```kconfig
# SPDX-License-Identifier: GPL-2.0-only
menu "NVME Support"

source "drivers/nvme/common/Kconfig"
source "drivers/nvme/host/Kconfig"
source "drivers/nvme/target/Kconfig"

endmenu
```

## drivers/nvme/common/Kconfig
```kconfig
# SPDX-License-Identifier: GPL-2.0-only

config NVME_KEYRING
       tristate
       select KEYS

config NVME_AUTH
	tristate
	select CRYPTO
	select CRYPTO_DH
	select CRYPTO_DH_RFC7919_GROUPS
	select CRYPTO_LIB_SHA256
	select CRYPTO_LIB_SHA512

config NVME_AUTH_KUNIT_TEST
	tristate "KUnit tests for NVMe authentication" if !KUNIT_ALL_TESTS
	depends on KUNIT && NVME_AUTH
	default KUNIT_ALL_TESTS
	help
	  Enable KUnit tests for some of the common code for NVMe over Fabrics
	  In-Band Authentication.
```

## drivers/nvme/host/Kconfig
```kconfig
# SPDX-License-Identifier: GPL-2.0-only
config NVME_CORE
	tristate

config BLK_DEV_NVME
	tristate "NVM Express block device"
	depends on PCI && BLOCK
	select NVME_CORE
	help
	  The NVM Express driver is for solid state drives directly
	  connected to the PCI or PCI Express bus.  If you know you
	  don't have one of these, it is safe to answer N.

	  To compile this driver as a module, choose M here: the
	  module will be called nvme.

config NVME_MULTIPATH
	bool "NVMe multipath support"
	depends on NVME_CORE
	help
	  This option controls support for multipath access to NVMe
	  subsystems. If this option is enabled support for NVMe multipath
	  access is included in the kernel. If this option is disabled support
	  for NVMe multipath access is excluded from the kernel. When this
	  option is disabled each controller/namespace receives its
	  own /dev/nvmeXnY device entry and NVMe multipath access is
	  not supported.

	  If unsure, say Y.

config NVME_VERBOSE_ERRORS
	bool "NVMe verbose error reporting"
	depends on NVME_CORE
	help
	   This option enables verbose reporting for NVMe errors. The
	   error translation table will grow the kernel image size by
	   about 4 KB.

config NVME_HWMON
	bool "NVMe hardware monitoring"
	depends on (NVME_CORE=y && HWMON=y) || (NVME_CORE=m && HWMON)
	help
	  This provides support for NVMe hardware monitoring. If enabled,
	  a hardware monitoring device will be created for each NVMe drive
	  in the system.

config NVME_FABRICS
	select NVME_CORE
	select NVME_KEYRING if NVME_TCP_TLS
	tristate

config NVME_RDMA
	tristate "NVM Express over Fabrics RDMA host driver"
	depends on INFINIBAND && INFINIBAND_ADDR_TRANS && BLOCK
	select NVME_FABRICS
	select SG_POOL
	help
	  This provides support for the NVMe over Fabrics protocol using
	  the RDMA (Infiniband, RoCE, iWarp) transport.  This allows you
	  to use remote block devices exported using the NVMe protocol set.

	  To configure a NVMe over Fabrics controller use the nvme-cli tool
	  from https://github.com/linux-nvme/nvme-cli.

	  If unsure, say N.

config NVME_FC
	tristate "NVM Express over Fabrics FC host driver"
	depends on BLOCK
	depends on HAS_DMA
	select NVME_FABRICS
	select SG_POOL
	help
	  This provides support for the NVMe over Fabrics protocol using
	  the FC transport.  This allows you to use remote block devices
	  exported using the NVMe protocol set.

	  To configure a NVMe over Fabrics controller use the nvme-cli tool
	  from https://github.com/linux-nvme/nvme-cli.

	  If unsure, say N.

config NVME_TCP
	tristate "NVM Express over Fabrics TCP host driver"
	depends on INET
	depends on BLOCK
	select NVME_FABRICS
	select CRYPTO
	select CRYPTO_CRC32C
	help
	  This provides support for the NVMe over Fabrics protocol using
	  the TCP transport.  This allows you to use remote block devices
	  exported using the NVMe protocol set.

	  To configure a NVMe over Fabrics controller use the nvme-cli tool
	  from https://github.com/linux-nvme/nvme-cli.

	  If unsure, say N.

config NVME_TCP_TLS
	bool "NVMe over Fabrics TCP TLS encryption support"
	depends on NVME_TCP
	select NET_HANDSHAKE
	select KEYS
	select TLS
	help
	  Enables TLS encryption for NVMe TCP using the netlink handshake API.

	  The TLS handshake daemon is availble at
	  https://github.com/oracle/ktls-utils.

	  If unsure, say N.

config NVME_HOST_AUTH
	bool "NVMe over Fabrics In-Band Authentication in host side"
	depends on NVME_CORE
	select NVME_AUTH
	select NVME_KEYRING
	help
	  This provides support for NVMe over Fabrics In-Band Authentication in
	  host side.

	  If unsure, say N.

config NVME_APPLE
	tristate "Apple ANS2 NVM Express host driver"
	depends on OF && BLOCK
	depends on APPLE_RTKIT && APPLE_SART
	depends on ARCH_APPLE || COMPILE_TEST
	select NVME_CORE
	help
	  This provides support for the NVMe controller embedded in Apple SoCs
	  such as the M1.

	  To compile this driver as a module, choose M here: the
	  module will be called nvme-apple.
```
