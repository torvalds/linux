## drivers/net/wwan/Kconfig
```kconfig
# SPDX-License-Identifier: GPL-2.0-only
#
# Wireless WAN device configuration
#

menu "Wireless WAN"

config WWAN
	tristate "WWAN Driver Core"
	help
	  Say Y here if you want to use the WWAN driver core. This driver
	  provides a common framework for WWAN drivers.

	  To compile this driver as a module, choose M here: the module will be
	  called wwan.

if WWAN

config WWAN_DEBUGFS
	bool "WWAN devices debugfs interface" if EXPERT
	depends on DEBUG_FS
	default y
	help
	  Enables debugfs infrastructure for the WWAN core and device drivers.

	  If this option is selected, then you can find the debug interface
	  elements for each WWAN device in a directory that is corresponding to
	  the device name: debugfs/wwan/wwanX.

config WWAN_HWSIM
	tristate "Simulated WWAN device"
	help
	  This driver is a developer testing tool that can be used to test WWAN
	  framework.

	  To compile this driver as a module, choose M here: the module will be
	  called wwan_hwsim.  If unsure, say N.

config MHI_WWAN_CTRL
	tristate "MHI WWAN control driver for QCOM-based PCIe modems"
	depends on MHI_BUS
	help
	  MHI WWAN CTRL allows QCOM-based PCIe modems to expose different modem
	  control protocols/ports to userspace, including AT, MBIM, QMI, DIAG
	  and FIREHOSE. These protocols can be accessed directly from userspace
	  (e.g. AT commands) or via libraries/tools (e.g. libmbim, libqmi,
	  libqcdm...).

	  To compile this driver as a module, choose M here: the module will be
	  called mhi_wwan_ctrl.

config MHI_WWAN_MBIM
        tristate "MHI WWAN MBIM network driver for QCOM-based PCIe modems"
        depends on MHI_BUS
        help
          MHI WWAN MBIM is a WWAN network driver for QCOM-based PCIe modems.
          It implements MBIM over MHI, for IP data aggregation and muxing.
          A default wwan0 network interface is created for MBIM data session
          ID 0. Additional links can be created via wwan rtnetlink type.

          To compile this driver as a module, choose M here: the module will be
          called mhi_wwan_mbim.

config QCOM_BAM_DMUX
	tristate "Qualcomm BAM-DMUX WWAN network driver"
	depends on (DMA_ENGINE && PM && QCOM_SMEM_STATE) || COMPILE_TEST
	help
	  The BAM Data Multiplexer provides access to the network data channels
	  of modems integrated into many older Qualcomm SoCs, e.g. Qualcomm
	  MSM8916 or MSM8974. The connection can be established via QMI/AT from
	  userspace with control ports available through the WWAN subsystem
	  (CONFIG_RPMSG_WWAN_CTRL) or QRTR network sockets (CONFIG_QRTR).

	  To compile this driver as a module, choose M here: the module will be
	  called qcom_bam_dmux.

config RPMSG_WWAN_CTRL
	tristate "RPMSG WWAN control driver"
	depends on RPMSG
	help
	  RPMSG WWAN CTRL allows modems available via RPMSG channels to expose
	  different modem protocols/ports to userspace, including AT and QMI.
	  These protocols can be accessed directly from userspace
	  (e.g. AT commands) or via libraries/tools (e.g. libqmi, libqcdm...).

	  This is mainly used for modems integrated into many Qualcomm SoCs,
	  e.g. for AT and QMI on Qualcomm MSM8916 or MSM8974. Note that many
	  newer Qualcomm SoCs (e.g. SDM845) still provide an AT port through
	  this driver but the QMI messages can only be sent through
	  QRTR network sockets (CONFIG_QRTR).

	  To compile this driver as a module, choose M here: the module will be
	  called rpmsg_wwan_ctrl.

config IOSM
	tristate "IOSM Driver for Intel M.2 WWAN Device"
	depends on PCI
	select NET_DEVLINK
	select RELAY if WWAN_DEBUGFS
	help
	  This driver enables Intel M.2 WWAN Device communication.

	  If you have one of those Intel M.2 WWAN Modules and wish to use it in
	  Linux say Y/M here.

	  If unsure, say N.

config MTK_T7XX
	tristate "MediaTek PCIe 5G WWAN modem T7xx device"
	depends on PCI
	select RELAY if WWAN_DEBUGFS
	help
	  Enables MediaTek PCIe based 5G WWAN modem (T7xx series) device.
	  Adapts WWAN framework and provides network interface like wwan0
	  and tty interfaces like wwan0at0 (AT protocol), wwan0mbim0
	  (MBIM protocol), etc.

	  To compile this driver as a module, choose M here: the module will be
	  called mtk_t7xx.

	  If unsure, say N.

endif # WWAN

endmenu
```

## drivers/nfc/Kconfig
```kconfig
# SPDX-License-Identifier: GPL-2.0-only
#
# Near Field Communication (NFC) devices
#

menu "Near Field Communication (NFC) devices"
	depends on NFC

config NFC_TRF7970A
	tristate "Texas Instruments TRF7970a NFC driver"
	depends on SPI && NFC_DIGITAL && GPIOLIB
	help
	  This option enables the NFC driver for Texas Instruments' TRF7970a
	  device. Such device supports 5 different protocols: ISO14443A,
	  ISO14443B, FeLiCa, ISO15693 and ISO18000-3.

	  Say Y here to compile support for TRF7970a into the kernel or
	  say M  to compile it as a module. The module will be called
	  trf7970a.ko.

config NFC_MEI_PHY
	tristate "MEI bus NFC device support"
	depends on INTEL_MEI && NFC_HCI
	help
	  This adds support to use an mei bus nfc device. Select this if you
	  will use an HCI NFC driver for an NFC chip connected behind an
	  Intel's Management Engine chip.

	  If unsure, say N.

config NFC_SIM
	tristate "NFC hardware simulator driver"
	depends on NFC_DIGITAL
	help
	  This driver declares two virtual NFC devices supporting NFC-DEP
	  protocol. An LLCP connection can be established between them and
	  all packets sent from one device is sent back to the other, acting as
	  loopback devices.

	  If unsure, say N.

config NFC_PORT100
	tristate "Sony NFC Port-100 Series USB device support"
	depends on USB
	depends on NFC_DIGITAL
	help
	  This adds support for Sony Port-100 chip based USB devices such as the
	  RC-S380 dongle.

	  If unsure, say N.

config NFC_VIRTUAL_NCI
	tristate "NCI device simulator driver"
	depends on NFC_NCI
	help
	  NCI virtual device simulates a NCI device to the user.
	  It can be used to validate the NCI module and applications.
	  This driver supports communication between the virtual NCI device and
	  module.

	  If unsure, say N.

source "drivers/nfc/fdp/Kconfig"
source "drivers/nfc/pn544/Kconfig"
source "drivers/nfc/pn533/Kconfig"
source "drivers/nfc/microread/Kconfig"
source "drivers/nfc/nfcmrvl/Kconfig"
source "drivers/nfc/st21nfca/Kconfig"
source "drivers/nfc/st-nci/Kconfig"
source "drivers/nfc/nxp-nci/Kconfig"
source "drivers/nfc/s3fwrn5/Kconfig"
source "drivers/nfc/st95hf/Kconfig"
endmenu
```

## drivers/nfc/fdp/Kconfig
```kconfig
config NFC_FDP
	tristate "Intel FDP NFC driver"
	depends on NFC_NCI
	select CRC_CCITT
	default n
	---help---
	  Intel Fields Peak NFC controller core driver.
	  This is a driver based on the NCI NFC kernel layers.

	  To compile this driver as a module, choose m here. The module will
	  be called fdp.
	  Say N if unsure.

config NFC_FDP_I2C
	tristate "NFC FDP i2c support"
	depends on NFC_FDP && I2C
	---help---
	  This module adds support for the Intel Fields Peak NFC controller
	  i2c interface.
	  Select this if your platform is using the i2c bus.

	  If you choose to build a module, it'll be called fdp_i2c.
	  Say N if unsure.
```

## drivers/nfc/microread/Kconfig
```kconfig
config NFC_MICROREAD
	tristate
	select CRC_CCITT
	---help---
	  This module contains the main code for Inside Secure microread
	  NFC chipsets. It implements the chipset HCI logic and hooks into
	  the NFC kernel APIs. Physical layers will register against it.

config NFC_MICROREAD_I2C
	tristate "Inside Secure Microread device support (I2C)"
	depends on NFC_HCI && I2C && NFC_SHDLC
	select NFC_MICROREAD
	---help---
	  This module adds support for the i2c interface of adapters using
	  Inside microread chipsets.  Select this if your platform is using
	  the i2c bus.

	  If you choose to build a module, it'll be called microread_i2c.
	  Say N if unsure.

config NFC_MICROREAD_MEI
	tristate "Inside Secure Microread device support (MEI)"
	depends on NFC_HCI && NFC_MEI_PHY
	select NFC_MICROREAD
	---help---
	  This module adds support for the mei interface of adapters using
	  Inside microread chipsets.  Select this if your microread chipset
	  is handled by Intel's Management Engine Interface on your platform.

	  If you choose to build a module, it'll be called microread_mei.
	  Say N if unsure.
```

## drivers/nfc/nfcmrvl/Kconfig
```kconfig
# SPDX-License-Identifier: GPL-2.0-only
config NFC_MRVL
	tristate
	help
	  The core driver to support Marvell NFC devices.

	  This driver is required if you want to support
	  Marvell NFC device 8897.

config NFC_MRVL_USB
	tristate "Marvell NFC-over-USB driver"
	depends on NFC_NCI && USB
	select NFC_MRVL
	help
	  Marvell NFC-over-USB driver.

	  This driver provides support for Marvell NFC-over-USB devices:
          8897.

	  Say Y here to compile support for Marvell NFC-over-USB driver
	  into the kernel or say M to compile it as module.

config NFC_MRVL_UART
	tristate "Marvell NFC-over-UART driver"
	depends on NFC_NCI && NFC_NCI_UART
	select NFC_MRVL
	help
	  Marvell NFC-over-UART driver.

	  This driver provides support for Marvell NFC-over-UART devices

	  Say Y here to compile support for Marvell NFC-over-UART driver
	  into the kernel or say M to compile it as module.

config NFC_MRVL_I2C
	tristate "Marvell NFC-over-I2C driver"
	depends on NFC_MRVL && I2C
	help
	  Marvell NFC-over-I2C driver.

	  This driver provides support for Marvell NFC-over-I2C devices.

	  Say Y here to compile support for Marvell NFC-over-I2C driver
	  into the kernel or say M to compile it as module.

config NFC_MRVL_SPI
	tristate "Marvell NFC-over-SPI driver"
	depends on NFC_MRVL && NFC_NCI_SPI
	help
	  Marvell NFC-over-SPI driver.

	  This driver provides support for Marvell NFC-over-SPI devices.

	  Say Y here to compile support for Marvell NFC-over-SPI driver
	  into the kernel or say M to compile it as module.
```

## drivers/nfc/nxp-nci/Kconfig
```kconfig
config NFC_NXP_NCI
	tristate "NXP-NCI NFC driver"
	depends on NFC_NCI
	default n
	---help---
	  Generic core driver for NXP NCI chips such as the NPC100
	  or PN7150 families.
	  This is a driver based on the NCI NFC kernel layers and
	  will thus not work with NXP libnfc library.

	  To compile this driver as a module, choose m here. The module will
	  be called nxp_nci.
	  Say N if unsure.

config NFC_NXP_NCI_I2C
	tristate "NXP-NCI I2C support"
	depends on NFC_NXP_NCI && I2C
	---help---
	  This module adds support for an I2C interface to the NXP NCI
	  chips.
	  Select this if your platform is using the I2C bus.

	  To compile this driver as a module, choose m here. The module will
	  be called nxp_nci_i2c.
	  Say Y if unsure.
```

## drivers/nfc/pn533/Kconfig
```kconfig
# SPDX-License-Identifier: GPL-2.0-only
config NFC_PN533
	tristate
	help
	  NXP PN533 core driver.
	  This driver provides core functionality for NXP PN533 NFC devices.

config NFC_PN533_USB
	tristate "NFC PN533 device support (USB)"
	depends on USB
	select NFC_PN533
	help
	  This module adds support for the NXP pn533 USB interface.
	  Select this if your platform is using the USB bus.

	  If you choose to build a module, it'll be called pn533_usb.
	  Say N if unsure.

config NFC_PN533_I2C
	tristate "NFC PN533 device support (I2C)"
	depends on I2C
	select NFC_PN533
	help
	  This module adds support for the NXP pn533 I2C interface.
	  Select this if your platform is using the I2C bus.

	  If you choose to build a module, it'll be called pn533_i2c.
	  Say N if unsure.

config NFC_PN532_UART
	tristate "NFC PN532 device support (UART)"
	depends on SERIAL_DEV_BUS
	select NFC_PN533
	help
	  This module adds support for the NXP pn532 UART interface.
	  Select this if your platform is using the UART bus.

	  If you choose to build a module, it'll be called pn532_uart.
	  Say N if unsure.
```

## drivers/nfc/pn544/Kconfig
```kconfig
config NFC_PN544
	tristate
	select CRC_CCITT
	---help---
	  NXP PN544 core driver.
	  This is a driver based on the HCI NFC kernel layers and
	  will thus not work with NXP libnfc library.

config NFC_PN544_I2C
	tristate "NXP PN544 device support (I2C)"
	depends on NFC_HCI && I2C && NFC_SHDLC
	select NFC_PN544
	---help---
	  This module adds support for the NXP pn544 i2c interface.
	  Select this if your platform is using the i2c bus.

	  If you choose to build a module, it'll be called pn544_i2c.
	  Say N if unsure.

config NFC_PN544_MEI
	tristate "NXP PN544 device support (MEI)"
	depends on NFC_HCI && NFC_MEI_PHY
	select NFC_PN544
	---help---
	  This module adds support for the mei interface of adapters using
	  NXP pn544 chipsets.  Select this if your pn544 chipset
	  is handled by Intel's Management Engine Interface on your platform.

	  If you choose to build a module, it'll be called pn544_mei.
	  Say N if unsure.
```

## drivers/nfc/s3fwrn5/Kconfig
```kconfig
# SPDX-License-Identifier: GPL-2.0-only
config NFC_S3FWRN5
	tristate
	select CRYPTO_LIB_SHA1
	help
	  Core driver for Samsung S3FWRN5 NFC chip. Contains core utilities
	  of chip. It's intended to be used by PHYs to avoid duplicating lots
	  of common code.

config NFC_S3FWRN5_I2C
	tristate "Samsung S3FWRN5 I2C support"
	depends on NFC_NCI && I2C
	select NFC_S3FWRN5
	default n
	help
	  This module adds support for an I2C interface to the S3FWRN5 chip.
	  Select this if your platform is using the I2C bus.

	  To compile this driver as a module, choose m here. The module will
	  be called s3fwrn5_i2c.ko.
	  Say N if unsure.

config NFC_S3FWRN82_UART
        tristate "Samsung S3FWRN82 UART support"
        depends on NFC_NCI && SERIAL_DEV_BUS
        select NFC_S3FWRN5
        help
          This module adds support for a UART interface to the S3FWRN82 chip.
          Select this if your platform is using the UART bus.

          To compile this driver as a module, choose m here. The module will
          be called s3fwrn82_uart.ko.
          Say N if unsure.
```

## drivers/nfc/st-nci/Kconfig
```kconfig
config NFC_ST_NCI
	tristate
	---help---
	  STMicroelectronics NFC NCI chips core driver. It implements the chipset
	  NCI logic and hooks into the NFC kernel APIs. Physical layers will
	  register against it.

config NFC_ST_NCI_I2C
	tristate "STMicroelectronics ST NCI NFC driver (I2C)"
	depends on NFC_NCI && I2C
	select NFC_ST_NCI
	---help---
	  This module adds support for an I2C interface to the
	  STMicroelectronics NFC NCI chips family.
	  Select this if your platform is using the i2c bus.

	  If you choose to build a module, it'll be called st-nci_i2c.
	  Say N if unsure.

config NFC_ST_NCI_SPI
	tristate "STMicroelectronics ST NCI NFC driver (SPI)"
	depends on NFC_NCI && SPI
	select NFC_ST_NCI
	---help---
	  This module adds support for an SPI interface to the
	  STMicroelectronics NFC NCI chips family.
	  Select this if your platform is using the spi bus.

	  If you choose to build a module, it'll be called st-nci_spi.
	  Say N if unsure.
```

## drivers/nfc/st21nfca/Kconfig
```kconfig
# SPDX-License-Identifier: GPL-2.0-only
config NFC_ST21NFCA
	tristate
	select CRC_CCITT
	---help---
	  STMicroelectronics ST21NFCA core driver. It implements the chipset
	  HCI logic and hooks into the NFC kernel APIs. Physical layers will
	  register against it.

config NFC_ST21NFCA_I2C
	tristate "STMicroelectronics ST21NFCA NFC driver (I2C)"
	depends on NFC_HCI && I2C && NFC_SHDLC
	select NFC_ST21NFCA
	---help---
	  This module adds support for the STMicroelectronics st21nfca i2c interface.
	  Select this if your platform is using the i2c bus.

	  If you choose to build a module, it'll be called st21nfca_i2c.
	  Say N if unsure.
```
