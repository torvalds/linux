## drivers/net/can/ctucanfd/Kconfig
```kconfig
config CAN_CTUCANFD
	tristate "CTU CAN-FD IP core" if COMPILE_TEST
	help
	  This driver adds support for the CTU CAN FD open-source IP core.
	  More documentation and core sources at project page
	  (https://gitlab.fel.cvut.cz/canbus/ctucanfd_ip_core).
	  The core integration to Xilinx Zynq system as platform driver
	  is available (https://gitlab.fel.cvut.cz/canbus/zynq/zynq-can-sja1000-top).
	  Implementation on Intel FPGA-based PCI Express board is available
	  from project (https://gitlab.fel.cvut.cz/canbus/pcie-ctucanfd) and
	  on Intel SoC from project (https://gitlab.fel.cvut.cz/canbus/intel-soc-ctucanfd).
	  Guidepost CTU FEE CAN bus projects page https://canbus.pages.fel.cvut.cz/ .

config CAN_CTUCANFD_PCI
	tristate "CTU CAN-FD IP core PCI/PCIe driver"
	depends on PCI
	select CAN_CTUCANFD
	help
	  This driver adds PCI/PCIe support for CTU CAN-FD IP core.
	  The project providing FPGA design for Intel EP4CGX15 based DB4CGX15
	  PCIe board with PiKRON.com designed transceiver riser shield is available
	  at https://gitlab.fel.cvut.cz/canbus/pcie-ctucanfd .

config CAN_CTUCANFD_PLATFORM
	tristate "CTU CAN-FD IP core platform (FPGA, SoC) driver"
	depends on HAS_IOMEM && (OF || COMPILE_TEST)
	select CAN_CTUCANFD
	help
	  The core has been tested together with OpenCores SJA1000
	  modified to be CAN FD frames tolerant on MicroZed Zynq based
	  MZ_APO education kits designed by Petr Porazil from PiKRON.com
	  company. FPGA design https://gitlab.fel.cvut.cz/canbus/zynq/zynq-can-sja1000-top.
	  The kit description at the Computer Architectures course pages
	  https://cw.fel.cvut.cz/wiki/courses/b35apo/documentation/mz_apo/start .
```

## drivers/net/can/esd/Kconfig
```kconfig
# SPDX-License-Identifier: GPL-2.0-only
config CAN_ESD_402_PCI
	tristate "esd electronics gmbh CAN-PCI(e)/402 family"
	depends on PCI && HAS_DMA
	help
	  Support for C402 card family from esd electronics gmbh.
	  This card family is based on the ESDACC CAN controller and
	  available in several form factors:  PCI, PCIe, PCIe Mini,
	  M.2 PCIe, CPCIserial, PMC, XMC  (see https://esd.eu/en)

	  This driver can also be built as a module. In this case the
	  module will be called esd_402_pci.
```

## drivers/net/can/ifi_canfd/Kconfig
```kconfig
# SPDX-License-Identifier: GPL-2.0-only
config CAN_IFI_CANFD
	depends on HAS_IOMEM
	tristate "IFI CAN_FD IP"
	help
	  This driver adds support for the I/F/I CAN_FD soft IP block
	  connected to the "platform bus" (Linux abstraction for directly
	  to the processor attached devices). The CAN_FD is most often
	  synthesised into an FPGA or CPLD.
```

## drivers/net/can/m_can/Kconfig
```kconfig
# SPDX-License-Identifier: GPL-2.0-only
config CAN_M_CAN
	tristate "Bosch M_CAN support"
	help
	  Say Y here if you want support for Bosch M_CAN controller framework.
	  This is common support for devices that embed the Bosch M_CAN IP.

config CAN_M_CAN_PLATFORM
	tristate "Bosch M_CAN support for io-mapped devices"
	depends on HAS_IOMEM
	depends on CAN_M_CAN
	help
	  Say Y here if you want support for IO Mapped Bosch M_CAN controller.
	  This support is for devices that have the Bosch M_CAN controller
	  IP embedded into the device and the IP is IO Mapped to the processor.

config CAN_M_CAN_TCAN4X5X
	depends on CAN_M_CAN
	depends on SPI
	select REGMAP_SPI
	tristate "TCAN4X5X M_CAN device"
	help
	  Say Y here if you want support for Texas Instruments TCAN4x5x
	  M_CAN controller.  This device is a peripheral device that uses the
	  SPI bus for communication.
```

## drivers/net/can/mscan/Kconfig
```kconfig
# SPDX-License-Identifier: GPL-2.0-only
config CAN_MSCAN
	depends on PPC
	tristate "Support for Freescale MSCAN based chips"
	help
	  The Motorola Scalable Controller Area Network (MSCAN) definition
	  is based on the MSCAN12 definition which is the specific
	  implementation of the Motorola Scalable CAN concept targeted for
	  the Motorola MC68HC12 Microcontroller Family.

if CAN_MSCAN

config CAN_MPC5XXX
	tristate "Freescale MPC5xxx onboard CAN controller"
	depends on (PPC_MPC52xx || PPC_MPC512x)
	help
	  If you say yes here you get support for Freescale's MPC5xxx
	  onboard CAN controller. Currently, the MPC5200, MPC5200B and
	  MPC5121 (Rev. 2 and later) are supported.

	  This driver can also be built as a module. If so, the module
	  will be called mscan-mpc5xxx.ko.

endif
```

## drivers/net/can/peak_canfd/Kconfig
```kconfig
# SPDX-License-Identifier: GPL-2.0-only
config CAN_PEAK_PCIEFD
	depends on PCI
	tristate "PEAK-System PCAN-PCIe FD cards"
	help
	  This driver adds support for the PEAK-System PCI Express FD
	  CAN-FD cards family.
	  These 1x or 2x CAN-FD channels cards offer CAN 2.0 a/b as well as
	  CAN-FD access to the CAN bus. Besides the nominal bitrate of up to
	  1 Mbit/s, the data bytes of CAN-FD frames can be transmitted with
	  up to 12 Mbit/s. A galvanic isolation of the CAN ports protects the
	  electronics of the card and the respective computer against
	  disturbances of up to 500 Volts. The PCAN-PCI Express FD can be
	  operated with ambient temperatures in a range of -40 to +85 °C.
```

## drivers/net/can/rcar/Kconfig
```kconfig
# SPDX-License-Identifier: GPL-2.0
config CAN_RCAR
	tristate "Renesas R-Car and RZ/G CAN controller"
	depends on ARCH_RENESAS || COMPILE_TEST
	help
	  Say Y here if you want to use CAN controller found on Renesas R-Car
	  or RZ/G SoCs.

	  To compile this driver as a module, choose M here: the module will
	  be called rcar_can.

config CAN_RCAR_CANFD
	tristate "Renesas R-Car CAN FD controller"
	depends on ARCH_RENESAS || COMPILE_TEST
	help
	  Say Y here if you want to use CAN FD controller found on
	  Renesas R-Car SoCs. The driver puts the controller in CAN FD only
	  mode, which can interoperate with CAN2.0 nodes but does not support
	  dedicated CAN 2.0 mode.

	  To compile this driver as a module, choose M here: the module will
	  be called rcar_canfd.
```

## drivers/net/can/rockchip/Kconfig
```kconfig
# SPDX-License-Identifier: GPL-2.0

config CAN_ROCKCHIP_CANFD
	tristate "Rockchip CAN-FD controller"
	depends on OF
	depends on ARCH_ROCKCHIP || COMPILE_TEST
	select CAN_RX_OFFLOAD
	help
	  Say Y here if you want to use CAN-FD controller found on
	  Rockchip SoCs.
```

## drivers/net/can/sja1000/Kconfig
```kconfig
# SPDX-License-Identifier: GPL-2.0-only

menuconfig CAN_SJA1000
	tristate "Philips/NXP SJA1000 devices"
	depends on HAS_IOMEM

if CAN_SJA1000

config CAN_EMS_PCI
	tristate "EMS CPC-PCI, CPC-PCIe and CPC-104P Card"
	depends on PCI
	help
	  This driver is for the one, two or four channel CPC-PCI,
	  CPC-PCIe and CPC-104P cards from EMS Dr. Thomas Wuensche
	  (http://www.ems-wuensche.de).

config CAN_EMS_PCMCIA
	tristate "EMS CPC-CARD Card"
	depends on PCMCIA
	help
	  This driver is for the one or two channel CPC-CARD cards from
	  EMS Dr. Thomas Wuensche (http://www.ems-wuensche.de).

config CAN_F81601
	tristate "Fintek F81601 PCIE to 2 CAN Controller"
	depends on PCI
	help
	  This driver adds support for Fintek F81601 PCIE to 2 CAN
	  Controller. It had internal 24MHz clock source, but it can
	  be changed by manufacturer. Use modinfo to get usage for
	  parameters. Visit http://www.fintek.com.tw to get more
	  information.

config CAN_KVASER_PCI
	tristate "Kvaser PCIcanx and Kvaser PCIcan PCI Cards"
	depends on PCI
	help
	  This driver is for the PCIcanx and PCIcan cards (1, 2 or
	  4 channel) from Kvaser (http://www.kvaser.com).

config CAN_PEAK_PCI
	tristate "PEAK PCAN-PCI/PCIe/miniPCI Cards"
	depends on PCI
	help
	  This driver is for the PCAN-PCI/PCIe/miniPCI cards
	  (1, 2, 3 or 4 channels) from PEAK-System Technik
	  (http://www.peak-system.com).

config CAN_PEAK_PCIEC
	bool "PEAK PCAN-ExpressCard Cards"
	depends on CAN_PEAK_PCI
	select I2C
	select I2C_ALGOBIT
	default y
	help
	  Say Y here if you want to use a PCAN-ExpressCard from PEAK-System
	  Technik. This will also automatically select I2C and I2C_ALGO
	  configuration options.

config CAN_PEAK_PCMCIA
	tristate "PEAK PCAN-PC Card"
	depends on PCMCIA
	depends on HAS_IOPORT_MAP
	help
	  This driver is for the PCAN-PC Card PCMCIA adapter (1 or 2 channels)
	  from PEAK-System (http://www.peak-system.com). To compile this
	  driver as a module, choose M here: the module will be called
	  peak_pcmcia.

config CAN_PLX_PCI
	tristate "PLX90xx PCI-bridge based Cards"
	depends on PCI
	help
	  This driver is for CAN interface cards based on
	  the PLX90xx PCI bridge.
	  Driver supports now:
	   - Adlink PCI-7841/cPCI-7841 card (http://www.adlinktech.com/)
	   - Adlink PCI-7841/cPCI-7841 SE card
	   - esd CAN-PCI/CPCI/PCI104/200 (http://www.esd.eu/)
	   - esd CAN-PCI/PMC/266
	   - esd CAN-PCIe/2000
	   - Marathon CAN-bus-PCI card (http://www.marathon.ru/)
	   - TEWS TECHNOLOGIES TPMC810 card (http://www.tews.com/)
	   - IXXAT Automation PC-I 04/PCI card (http://www.ixxat.com/)
	   - Connect Tech Inc. CANpro/104-Plus Opto (CRG001) card (http://www.connecttech.com)
	   - ASEM CAN raw - 2 isolated CAN channels (www.asem.it)

config CAN_SJA1000_ISA
	tristate "ISA Bus based legacy SJA1000 driver"
	help
	  This driver adds legacy support for SJA1000 chips connected to
	  the ISA bus using I/O port, memory mapped or indirect access.

config CAN_SJA1000_PLATFORM
	tristate "Generic Platform Bus based SJA1000 driver"
	help
	  This driver adds support for the SJA1000 chips connected to
	  the "platform bus" (Linux abstraction for directly to the
	  processor attached devices).  Which can be found on various
	  boards from Phytec (http://www.phytec.de) like the PCM027,
	  PCM038. It also provides the OpenFirmware "platform bus" found
	  on embedded systems with OpenFirmware bindings, e.g. if you
	  have a PowerPC based system you may want to enable this option.

config CAN_TSCAN1
	tristate "TS-CAN1 PC104 boards"
	depends on ISA
	help
	  This driver is for Technologic Systems' TSCAN-1 PC104 boards.
	  http://www.embeddedarm.com/products/board-detail.php?product=TS-CAN1
	  The driver supports multiple boards and automatically configures them:
	  PLD IO base addresses are read from jumpers JP1 and JP2,
	  IRQ numbers are read from jumpers JP4 and JP5,
	  SJA1000 IO base addresses are chosen heuristically (first that works).

endif
```

## drivers/net/can/softing/Kconfig
```kconfig
config CAN_SOFTING
	tristate "Softing Gmbh CAN generic support"
	depends on CAN_DEV && HAS_IOMEM
	---help---
	  Support for CAN cards from Softing Gmbh & some cards
	  from Vector Gmbh.
	  Softing Gmbh CAN cards come with 1 or 2 physical busses.
	  Those cards typically use Dual Port RAM to communicate
	  with the host CPU. The interface is then identical for PCI
	  and PCMCIA cards. This driver operates on a platform device,
	  which has been created by softing_cs or softing_pci driver.
	  Warning:
	  The API of the card does not allow fine control per bus, but
	  controls the 2 busses on the card together.
	  As such, some actions (start/stop/busoff recovery) on 1 bus
	  must bring down the other bus too temporarily.

config CAN_SOFTING_CS
	tristate "Softing Gmbh CAN pcmcia cards"
	depends on PCMCIA
	select CAN_SOFTING
	---help---
	  Support for PCMCIA cards from Softing Gmbh & some cards
	  from Vector Gmbh.
	  You need firmware for these, which you can get at
	  http://developer.berlios.de/projects/socketcan/
	  This version of the driver is written against
	  firmware version 4.6 (softing-fw-4.6-binaries.tar.gz)
	  In order to use the card as CAN device, you need the Softing generic
	  support too.
```

## drivers/net/can/spi/Kconfig
```kconfig
# SPDX-License-Identifier: GPL-2.0-only
menu "CAN SPI interfaces"
	depends on SPI

config CAN_HI311X
	tristate "Holt HI311x SPI CAN controllers"
	help
	  Driver for the Holt HI311x SPI CAN controllers.

config CAN_MCP251X
	tristate "Microchip MCP251x and MCP25625 SPI CAN controllers"
	help
	  Driver for the Microchip MCP251x and MCP25625 SPI CAN
	  controllers.

source "drivers/net/can/spi/mcp251xfd/Kconfig"

endmenu
```

## drivers/net/can/spi/mcp251xfd/Kconfig
```kconfig
# SPDX-License-Identifier: GPL-2.0-only

config CAN_MCP251XFD
	tristate "Microchip MCP251xFD SPI CAN controllers"
	select CAN_RX_OFFLOAD
	select REGMAP
	select WANT_DEV_COREDUMP
	help
	  Driver for the Microchip MCP251XFD SPI FD-CAN controller
	  family.

config CAN_MCP251XFD_SANITY
	depends on CAN_MCP251XFD
	bool "Additional Sanity Checks"
	help
	  This option enables additional sanity checks in the driver,
	  that compares various internal counters with the in chip
	  variants. This comes with a runtime overhead.
	  Disable if unsure.
```
