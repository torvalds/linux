## drivers/net/can/usb/Kconfig
```kconfig
# SPDX-License-Identifier: GPL-2.0-only
menu "CAN USB interfaces"
	depends on USB

config CAN_8DEV_USB
	tristate "8 devices USB2CAN interface"
	help
	  This driver supports the USB2CAN interface
	  from 8 devices (http://www.8devices.com).

config CAN_EMS_USB
	tristate "EMS CPC-USB/ARM7 CAN/USB interface"
	help
	  This driver is for the one channel CPC-USB/ARM7 CAN/USB interface
	  from EMS Dr. Thomas Wuensche (http://www.ems-wuensche.de).

config CAN_ESD_USB
	tristate "esd electronics gmbh CAN/USB interfaces"
	help
	  This driver adds support for several CAN/USB interfaces
	  from esd electronics gmbh (https://www.esd.eu).

	  The drivers supports the following devices:
	    - esd CAN-USB/2
	    - esd CAN-USB/3-FD
	    - esd CAN-USB/Micro

	  To compile this driver as a module, choose M here: the module
	  will be called esd_usb.

config CAN_ETAS_ES58X
	tristate "ETAS ES58X CAN/USB interfaces"
	select CRC16
	select NET_DEVLINK
	help
	  This driver supports the ES581.4, ES582.1 and ES584.1 interfaces
	  from ETAS GmbH (https://www.etas.com/en/products/es58x.php).

	  To compile this driver as a module, choose M here: the module
	  will be called etas_es58x.

config CAN_F81604
        tristate "Fintek F81604 USB to 2CAN interface"
        help
          This driver supports the Fintek F81604 USB to 2CAN interface.
          The device can support CAN2.0A/B protocol and also support
          2 output pins to control external terminator (optional).

          To compile this driver as a module, choose M here: the module will
          be called f81604.

          (see also https://www.fintek.com.tw).

config CAN_GS_USB
	tristate "Geschwister Schneider UG and candleLight compatible interfaces"
	select CAN_RX_OFFLOAD
	help
	  This driver supports the Geschwister Schneider and
	  bytewerk.org candleLight compatible
	  (https://github.com/candle-usb/candleLight_fw) USB/CAN
	  interfaces.

	  If unsure choose N,
	  choose Y for built in support,
	  M to compile as module (module will be named: gs_usb).

config CAN_KVASER_USB
	tristate "Kvaser CAN/USB interface"
	help
	  This driver adds support for Kvaser CAN/USB devices like Kvaser
	  Leaf Light, Kvaser USBcan II and Kvaser Memorator Pro 5xHS.

	  The driver provides support for the following devices:
	    - Kvaser Leaf Light
	    - Kvaser Leaf Professional HS
	    - Kvaser Leaf SemiPro HS
	    - Kvaser Leaf Professional LS
	    - Kvaser Leaf Professional SWC
	    - Kvaser Leaf Professional LIN
	    - Kvaser Leaf SemiPro LS
	    - Kvaser Leaf SemiPro SWC
	    - Kvaser Memorator II HS/HS
	    - Kvaser USBcan Professional HS/HS
	    - Kvaser Leaf Light GI
	    - Kvaser Leaf Professional HS (OBD-II connector)
	    - Kvaser Memorator Professional HS/LS
	    - Kvaser Leaf Light "China"
	    - Kvaser BlackBird SemiPro
	    - Kvaser USBcan R
	    - Kvaser USBcan R v2
	    - Kvaser Leaf Light v2
	    - Kvaser Leaf Light R v2
	    - Kvaser Mini PCI Express HS
	    - Kvaser Mini PCI Express 2xHS
	    - Kvaser Mini PCIe 1xCAN
	    - Kvaser USBcan Light 2xHS
	    - Kvaser USBcan II HS/HS
	    - Kvaser USBcan II HS/LS
	    - Kvaser USBcan Rugged ("USBcan Rev B")
	    - Kvaser Memorator HS/HS
	    - Kvaser Memorator HS/LS
	    - Scania VCI2 (if you have the Kvaser logo on top)
	    - Kvaser BlackBird v2
	    - Kvaser Leaf Pro HS v2
	    - Kvaser Leaf v3
	    - Kvaser Hybrid CAN/LIN
	    - Kvaser Hybrid 2xCAN/LIN
	    - Kvaser Hybrid Pro CAN/LIN
	    - Kvaser Hybrid Pro 2xCAN/LIN
	    - Kvaser Memorator 2xHS v2
	    - Kvaser Memorator Pro 2xHS v2
	    - Kvaser Memorator Pro 5xHS
	    - Kvaser USBcan Light 4xHS
	    - Kvaser USBcan Pro 2xHS v2
	    - Kvaser USBcan Pro 4xHS
	    - Kvaser USBcan Pro 5xCAN
	    - Kvaser USBcan Pro 5xHS
	    - Kvaser U100
	    - Kvaser U100P
	    - Kvaser U100S
	    - ATI Memorator Pro 2xHS v2
	    - ATI USBcan Pro 2xHS v2
	    - Vining 800

	  If unsure, say N.

	  To compile this driver as a module, choose M here: the
	  module will be called kvaser_usb.

config CAN_MCBA_USB
	tristate "Microchip CAN BUS Analyzer interface"
	help
	  This driver supports the CAN BUS Analyzer interface
	  from Microchip (http://www.microchip.com/development-tools/).

config CAN_PEAK_USB
	tristate "PEAK PCAN-USB/USB Pro interfaces for CAN 2.0b/CAN-FD"
	help
	  This driver supports the PEAK-System Technik USB adapters that enable
	  access to the CAN bus, with respect to the CAN 2.0b and/or CAN-FD
	  standards, that is:

	  PCAN-USB             single CAN 2.0b channel USB adapter
	  PCAN-USB Pro         dual CAN 2.0b channels USB adapter
	  PCAN-USB FD          single CAN-FD channel USB adapter
	  PCAN-USB Pro FD      dual CAN-FD channels USB adapter
	  PCAN-Chip USB        CAN-FD to USB stamp module
	  PCAN-USB X6          6 CAN-FD channels USB adapter

	  (see also http://www.peak-system.com).

config CAN_UCAN
	tristate "Theobroma Systems UCAN interface"
	help
	  This driver supports the Theobroma Systems
	  UCAN USB-CAN interface.

	  The UCAN driver supports the microcontroller-based USB/CAN
	  adapters from Theobroma Systems. There are two form-factors
	  that run essentially the same firmware:

	  * Seal: standalone USB stick
	          https://www.theobroma-systems.com/seal)
	  * Mule: integrated on the PCB of various System-on-Modules
	          from Theobroma Systems like the A31-µQ7 and the RK3399-Q7
	          (https://www.theobroma-systems.com/rk3399-q7)

endmenu
```

## drivers/net/dsa/Kconfig
```kconfig
# SPDX-License-Identifier: GPL-2.0-only
menu "Distributed Switch Architecture drivers"
	depends on NET_DSA

source "drivers/net/dsa/b53/Kconfig"

config NET_DSA_BCM_SF2
	tristate "Broadcom Starfighter 2 Ethernet switch support"
	depends on HAS_IOMEM
	select NET_DSA_TAG_BRCM
	select FIXED_PHY
	select BCM7XXX_PHY
	select MDIO_BCM_UNIMAC
	select B53
	help
	  This enables support for the Broadcom Starfighter 2 Ethernet
	  switch chips.

config NET_DSA_LOOP
	tristate "DSA mock-up Ethernet switch chip support"
	select NET_DSA_TAG_NONE
	select FIXED_PHY
	help
	  This enables support for a fake mock-up switch chip which
	  exercises the DSA APIs.

source "drivers/net/dsa/hirschmann/Kconfig"

source "drivers/net/dsa/lantiq/Kconfig"

config NET_DSA_MT7530
	tristate "MediaTek MT7530 and MT7531 Ethernet switch support"
	select NET_DSA_TAG_MTK
	select REGMAP_IRQ
	imply NET_DSA_MT7530_MDIO
	imply NET_DSA_MT7530_MMIO
	help
	  This enables support for the MediaTek MT7530 and MT7531 Ethernet
	  switch chips. Multi-chip module MT7530 in MT7621AT, MT7621DAT,
	  MT7621ST and MT7623AI SoCs, and built-in switch in MT7988 SoC are
	  supported as well.

config NET_DSA_MT7530_MDIO
	tristate "MediaTek MT7530 MDIO interface driver"
	depends on NET_DSA_MT7530
	select MEDIATEK_GE_PHY
	select PCS_MTK_LYNXI
	help
	  This enables support for the MediaTek MT7530 and MT7531 switch
	  chips which are connected via MDIO, as well as multi-chip
	  module MT7530 which can be found in the MT7621AT, MT7621DAT,
	  MT7621ST and MT7623AI SoCs.

config NET_DSA_MT7530_MMIO
	tristate "MediaTek MT7530 MMIO interface driver"
	depends on NET_DSA_MT7530
	depends on HAS_IOMEM
	imply MEDIATEK_GE_SOC_PHY
	help
	  This enables support for the built-in Ethernet switch found
	  in the MediaTek MT7988 SoC.
	  The switch is a similar design as MT7531, but the switch registers
	  are directly mapped into the SoCs register space rather than being
	  accessible via MDIO.

config NET_DSA_MV88E6060
	tristate "Marvell 88E6060 ethernet switch chip support"
	select NET_DSA_TAG_TRAILER
	help
	  This enables support for the Marvell 88E6060 ethernet switch
	  chip.

source "drivers/net/dsa/microchip/Kconfig"

source "drivers/net/dsa/mv88e6xxx/Kconfig"

source "drivers/net/dsa/ocelot/Kconfig"

source "drivers/net/dsa/qca/Kconfig"

source "drivers/net/dsa/sja1105/Kconfig"

source "drivers/net/dsa/xrs700x/Kconfig"

source "drivers/net/dsa/realtek/Kconfig"

config NET_DSA_RZN1_A5PSW
	tristate "Renesas RZ/N1 A5PSW Ethernet switch support"
	depends on OF && (ARCH_RZN1 || COMPILE_TEST)
	select NET_DSA_TAG_RZN1_A5PSW
	select PCS_RZN1_MIIC
	help
	  This driver supports the A5PSW switch, which is embedded in Renesas
	  RZ/N1 SoC.

config NET_DSA_KS8995
	tristate "Micrel KS8995 family 5-ports 10/100 Ethernet switches"
	depends on SPI
	select NET_DSA_TAG_NONE
	help
	  This driver supports the Micrel KS8995 family of 10/100 Mbit ethernet
	  switches, managed over SPI.

config NET_DSA_SMSC_LAN9303
	tristate
	select NET_DSA_TAG_LAN9303
	select REGMAP
	imply SMSC_PHY
	help
	  This enables support for the Microchip LAN9303/LAN9354 3 port ethernet
	  switch chips.

config NET_DSA_SMSC_LAN9303_I2C
	tristate "SMSC/Microchip LAN9303 3-ports 10/100 ethernet switch in I2C managed mode"
	depends on I2C
	depends on VLAN_8021Q || VLAN_8021Q=n
	select NET_DSA_SMSC_LAN9303
	select REGMAP_I2C
	help
	  Enable access functions if the SMSC/Microchip LAN9303 is configured
	  for I2C managed mode.

config NET_DSA_SMSC_LAN9303_MDIO
	tristate "Microchip LAN9303/LAN9354 3-ports 10/100 ethernet switch in MDIO managed mode"
	select NET_DSA_SMSC_LAN9303
	depends on VLAN_8021Q || VLAN_8021Q=n
	help
	  Enable access functions if the Microchip LAN9303/LAN9354 is configured
	  for MDIO managed mode.

config NET_DSA_VITESSE_VSC73XX
	tristate
	select NET_DSA_TAG_VSC73XX_8021Q
	select FIXED_PHY
	select VITESSE_PHY
	select GPIOLIB
	help
	  This enables support for the Vitesse VSC7385, VSC7388,
	  VSC7395 and VSC7398 SparX integrated ethernet switches.

config NET_DSA_VITESSE_VSC73XX_SPI
	tristate "Vitesse VSC7385/7388/7395/7398 SPI mode support"
	depends on SPI
	select NET_DSA_VITESSE_VSC73XX
	help
	  This enables support for the Vitesse VSC7385, VSC7388, VSC7395
	  and VSC7398 SparX integrated ethernet switches in SPI managed mode.

config NET_DSA_VITESSE_VSC73XX_PLATFORM
	tristate "Vitesse VSC7385/7388/7395/7398 Platform mode support"
	depends on HAS_IOMEM
	select NET_DSA_VITESSE_VSC73XX
	help
	  This enables support for the Vitesse VSC7385, VSC7388, VSC7395
	  and VSC7398 SparX integrated ethernet switches, connected over
	  a CPU-attached address bus and work in memory-mapped I/O mode.
endmenu
```

## drivers/net/dsa/b53/Kconfig
```kconfig
# SPDX-License-Identifier: GPL-2.0-only
menuconfig B53
	tristate "Broadcom BCM53xx managed switch support"
	depends on NET_DSA
	select NET_DSA_TAG_NONE
	select NET_DSA_TAG_BRCM
	select NET_DSA_TAG_BRCM_LEGACY
	select NET_DSA_TAG_BRCM_PREPEND
	help
	  This driver adds support for Broadcom managed switch chips. It supports
	  BCM5325E, BCM5365, BCM539x, BCM53115 and BCM53125 as well as BCM63XX
	  integrated switches.

config B53_SPI_DRIVER
	tristate "B53 SPI connected switch driver"
	depends on B53 && SPI
	help
	  Select to enable support for registering switches configured through SPI.

config B53_MDIO_DRIVER
	tristate "B53 MDIO connected switch driver"
	depends on B53
	help
	  Select to enable support for registering switches configured through MDIO.

config B53_MMAP_DRIVER
	tristate "B53 MMAP connected switch driver"
	depends on B53 && HAS_IOMEM
	default BCM63XX || BMIPS_GENERIC
	help
	  Select to enable support for memory-mapped switches like the BCM63XX
	  integrated switches.

config B53_SRAB_DRIVER
	tristate "B53 SRAB connected switch driver"
	depends on B53 && HAS_IOMEM
	depends on B53_SERDES || !B53_SERDES
	default ARCH_BCM_IPROC
	help
	  Select to enable support for memory-mapped Switch Register Access
	  Bridge Registers (SRAB) like it is found on the BCM53010

config B53_SERDES
	tristate "B53 SerDes support"
	depends on B53
	default ARCH_BCM_NSP
	help
	  Select to enable support for SerDes on e.g: Northstar Plus SoCs.
```

## drivers/net/dsa/hirschmann/Kconfig
```kconfig
# SPDX-License-Identifier: GPL-2.0
config NET_DSA_HIRSCHMANN_HELLCREEK
	tristate "Hirschmann Hellcreek TSN Switch support"
	depends on HAS_IOMEM
	depends on NET_DSA
	depends on PTP_1588_CLOCK
	depends on LEDS_CLASS
	depends on NET_SCH_TAPRIO
	select NET_DSA_TAG_HELLCREEK
	help
	  This driver adds support for Hirschmann Hellcreek TSN switches.
```

## drivers/net/dsa/lantiq/Kconfig
```kconfig
config NET_DSA_LANTIQ_COMMON
	tristate
	select REGMAP

config NET_DSA_LANTIQ_GSWIP
	tristate "Lantiq / Intel GSWIP"
	depends on HAS_IOMEM
	select NET_DSA_TAG_GSWIP
	select NET_DSA_LANTIQ_COMMON
	help
	  This enables support for the Lantiq / Intel GSWIP 2.1 found in
	  the xrx200 / VR9 SoC.

config NET_DSA_MXL_GSW1XX
	tristate "MaxLinear GSW1xx Ethernet switch support"
	select NET_DSA_TAG_MXL_GSW1XX
	select NET_DSA_LANTIQ_COMMON
	help
	  This enables support for the MaxLinear GSW1xx family of 1GE switches
	    GSW120 4 port, 2 PHYs, RGMII & SGMII/2500Base-X
	    GSW125 4 port, 2 PHYs, RGMII & SGMII/2500Base-X, industrial temperature
	    GSW140 6 port, 4 PHYs, RGMII & SGMII/2500Base-X
	    GSW141 6 port, 4 PHYs, RGMII & SGMII
	    GSW145 6 port, 4 PHYs, RGMII & SGMII/2500Base-X, industrial temperature
```

## drivers/net/dsa/microchip/Kconfig
```kconfig
# SPDX-License-Identifier: GPL-2.0-only
menuconfig NET_DSA_MICROCHIP_KSZ_COMMON
	tristate "Microchip KSZ8XXX/KSZ9XXX/LAN937X series switch support"
	depends on NET_DSA
	select NET_DSA_TAG_KSZ
	select NET_DSA_TAG_NONE
	select NET_IEEE8021Q_HELPERS
	select DCB
	select PCS_XPCS
	help
	  This driver adds support for Microchip KSZ8, KSZ9 and
	  LAN937X series switch chips, being KSZ8863/8873,
	  KSZ8895/8864, KSZ8794/8795/8765,
	  KSZ9477/9897/9896/9567/8567, KSZ9893/9563/8563 and
	  LAN9370/9371/9372/9373/9374.

config NET_DSA_MICROCHIP_KSZ9477_I2C
	tristate "KSZ series I2C connected switch driver"
	depends on NET_DSA_MICROCHIP_KSZ_COMMON && I2C
	select REGMAP_I2C
	help
	  Select to enable support for registering switches configured through I2C.

config NET_DSA_MICROCHIP_KSZ_SPI
	tristate "KSZ series SPI connected switch driver"
	depends on NET_DSA_MICROCHIP_KSZ_COMMON && SPI
	select REGMAP_SPI
	help
	  Select to enable support for registering switches configured through SPI.

config NET_DSA_MICROCHIP_KSZ_PTP
	bool "Support for the PTP clock on the KSZ9563/LAN937x Ethernet Switch"
	depends on NET_DSA_MICROCHIP_KSZ_COMMON && PTP_1588_CLOCK
	depends on NET_DSA_MICROCHIP_KSZ_COMMON=m || PTP_1588_CLOCK=y
	help
	  Select to enable support for timestamping & PTP clock manipulation in
	  KSZ8563/KSZ9563/LAN937x series of switches. KSZ9563/KSZ8563 supports
	  only one step timestamping. LAN937x switch supports both one step and
	  two step timestamping.

config NET_DSA_MICROCHIP_KSZ8863_SMI
	tristate "KSZ series SMI connected switch driver"
	depends on NET_DSA_MICROCHIP_KSZ_COMMON
	select MDIO_BITBANG
	help
	  Select to enable support for registering switches configured through
	  Microchip SMI. It supports the KSZ8863 and KSZ8873 switch.
```
