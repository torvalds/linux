## drivers/net/ethernet/intel/libie/Kconfig
```kconfig
# SPDX-License-Identifier: GPL-2.0-only
# Copyright (C) 2024 Intel Corporation

config LIBIE
	tristate
	select LIBETH
	help
	  libie (Intel Ethernet library) is a common library built on top of
	  libeth and containing vendor-specific routines shared between several
	  Intel Ethernet drivers.

config LIBIE_ADMINQ
	tristate
	help
	  Helper functions used by Intel Ethernet drivers for administration
	  queue command interface (aka adminq).

config LIBIE_FWLOG
	tristate
	select LIBIE_ADMINQ
	help
	  Library to support firmware logging on device that have support
	  for it. Firmware logging is using admin queue interface to communicate
	  with the device. Debugfs is a user interface used to config logging
	  and dump all collected logs.
```

## drivers/net/ethernet/litex/Kconfig
```kconfig
#
# LiteX device configuration
#

config NET_VENDOR_LITEX
	bool "LiteX devices"
	default y
	help
	  If you have a network (Ethernet) card belonging to this class, say Y.

	  Note that the answer to this question doesn't directly affect the
	  kernel: saying N will just cause the configurator to skip all
	  the questions about LiteX devices. If you say Y, you will be asked
	  for your specific card in the following questions.

if NET_VENDOR_LITEX

config LITEX_LITEETH
	tristate "LiteX Ethernet support"
	help
	  If you wish to compile a kernel for hardware with a LiteX LiteEth
	  device then you should answer Y to this.

	  LiteX is a soft system-on-chip that targets FPGAs. LiteETH is a basic
	  network device that is commonly used in LiteX designs.

endif # NET_VENDOR_LITEX
```

## drivers/net/ethernet/marvell/Kconfig
```kconfig
# SPDX-License-Identifier: GPL-2.0-only
#
# Marvell device configuration
#

config NET_VENDOR_MARVELL
	bool "Marvell devices"
	default y
	depends on PCI || CPU_PXA168 || PPC32 || PLAT_ORION || INET || COMPILE_TEST
	help
	  If you have a network (Ethernet) card belonging to this class, say Y.

	  Note that the answer to this question doesn't directly affect the
	  kernel: saying N will just cause the configurator to skip all
	  the questions about Marvell devices. If you say Y, you will be
	  asked for your specific card in the following questions.

if NET_VENDOR_MARVELL

config MV643XX_ETH
	tristate "Marvell Discovery (643XX) and Orion ethernet support"
	depends on PPC32 || PLAT_ORION || COMPILE_TEST
	depends on INET
	select PHYLIB
	select MVMDIO
	help
	  This driver supports the gigabit ethernet MACs in the
	  Marvell Discovery PPC/MIPS chipset family (MV643XX) and
	  in the Marvell Orion ARM SoC family.

	  Some boards that use the Discovery chipset are the Momenco
	  Ocelot C and Jaguar ATX and Pegasos II.

config MVMDIO
	tristate "Marvell MDIO interface support"
	depends on HAS_IOMEM
	select MDIO_DEVRES
	select PHYLIB
	help
	  This driver supports the MDIO interface found in the network
	  interface units of the Marvell EBU SoCs (Kirkwood, Orion5x,
	  Dove, Armada 370 and Armada XP).

	  This driver is used by the MV643XX_ETH and MVNETA drivers.

config MVNETA_BM_ENABLE
	tristate "Marvell Armada 38x/XP network interface BM support"
	depends on MVNETA
	depends on !64BIT
	help
	  This driver supports auxiliary block of the network
	  interface units in the Marvell ARMADA XP and ARMADA 38x SoC
	  family, which is called buffer manager.

	  This driver, when enabled, strictly cooperates with mvneta
	  driver and is common for all network ports of the devices,
	  even for Armada 370 SoC, which doesn't support hardware
	  buffer management.

config MVNETA
	tristate "Marvell Armada 370/38x/XP/37xx network interface support"
	depends on ARCH_MVEBU || COMPILE_TEST
	select MVMDIO
	select PHYLINK
	select PAGE_POOL
	select PAGE_POOL_STATS
	help
	  This driver supports the network interface units in the
	  Marvell ARMADA XP, ARMADA 370, ARMADA 38x and
	  ARMADA 37xx SoC family.

	  Note that this driver is distinct from the mv643xx_eth
	  driver, which should be used for the older Marvell SoCs
	  (Dove, Orion, Discovery, Kirkwood).

config MVNETA_BM
	tristate
	depends on !64BIT
	default y if MVNETA=y && MVNETA_BM_ENABLE!=n
	default MVNETA_BM_ENABLE
	select HWBM
	select GENERIC_ALLOCATOR
	help
	  MVNETA_BM must not be 'm' if MVNETA=y, so this symbol ensures
	  that all dependencies are met.

config MVPP2
	tristate "Marvell Armada 375/7K/8K network interface support"
	depends on ARCH_MVEBU || COMPILE_TEST
	select MVMDIO
	select PHYLINK
	select PAGE_POOL
	help
	  This driver supports the network interface units in the
	  Marvell ARMADA 375, 7K and 8K SoCs.

config MVPP2_PTP
	bool "Marvell Armada 8K Enable PTP support"
	depends on (PTP_1588_CLOCK = y && MVPP2 = y) || \
		   (PTP_1588_CLOCK && MVPP2 = m)

config PXA168_ETH
	tristate "Marvell pxa168 ethernet support"
	depends on HAS_IOMEM
	depends on CPU_PXA168 || ARCH_BERLIN || COMPILE_TEST
	select PHYLIB
	help
	  This driver supports the pxa168 Ethernet ports.

	  To compile this driver as a module, choose M here. The module
	  will be called pxa168_eth.

config SKGE
	tristate "Marvell Yukon Gigabit Ethernet support"
	depends on PCI
	select CRC32
	help
	  This driver support the Marvell Yukon or SysKonnect SK-98xx/SK-95xx
	  and related Gigabit Ethernet adapters. It is a new smaller driver
	  with better performance and more complete ethtool support.

	  It does not support the link failover and network management
	  features that "portable" vendor supplied sk98lin driver does.

	  This driver supports adapters based on the original Yukon chipset:
	  Marvell 88E8001, Belkin F5D5005, CNet GigaCard, DLink DGE-530T,
	  Linksys EG1032/EG1064, 3Com 3C940/3C940B, SysKonnect SK-9871/9872.

	  It does not support the newer Yukon2 chipset: a separate driver,
	  sky2, is provided for these adapters.

	  To compile this driver as a module, choose M here: the module
	  will be called skge.  This is recommended.

config SKGE_DEBUG
	bool "Debugging interface"
	depends on SKGE && DEBUG_FS
	help
	  This option adds the ability to dump driver state for debugging.
	  The file /sys/kernel/debug/skge/ethX displays the state of the internal
	  transmit and receive rings.

	  If unsure, say N.

config SKGE_GENESIS
	bool "Support for older SysKonnect Genesis boards"
	depends on SKGE
	help
	 This enables support for the older and uncommon SysKonnect Genesis
	 chips, which support MII via an external transceiver, instead of
	 an internal one. Disabling this option will save some memory
	 by making code smaller. If unsure say Y.

config SKY2
	tristate "Marvell Yukon 2 support"
	depends on PCI
	select CRC32
	help
	  This driver supports Gigabit Ethernet adapters based on the
	  Marvell Yukon 2 chipset:
	  Marvell 88E8021/88E8022/88E8035/88E8036/88E8038/88E8050/88E8052/
	  88E8053/88E8055/88E8061/88E8062, SysKonnect SK-9E21D/SK-9S21

	  There is companion driver for the older Marvell Yukon and
	  SysKonnect Genesis based adapters: skge.

	  To compile this driver as a module, choose M here: the module
	  will be called sky2.  This is recommended.

config SKY2_DEBUG
	bool "Debugging interface"
	depends on SKY2 && DEBUG_FS
	help
	  This option adds the ability to dump driver state for debugging.
	  The file /sys/kernel/debug/sky2/ethX displays the state of the internal
	  transmit and receive rings.

	  If unsure, say N.


source "drivers/net/ethernet/marvell/octeontx2/Kconfig"
source "drivers/net/ethernet/marvell/octeon_ep/Kconfig"
source "drivers/net/ethernet/marvell/prestera/Kconfig"

endif # NET_VENDOR_MARVELL
```

## drivers/net/ethernet/marvell/octeon_ep/Kconfig
```kconfig
# SPDX-License-Identifier: GPL-2.0-only
#
# Marvell's Octeon PCI Endpoint NIC Driver Configuration
#

config OCTEON_EP
	tristate "Marvell Octeon PCI Endpoint NIC Driver"
	depends on 64BIT
	depends on PCI
	depends on PTP_1588_CLOCK_OPTIONAL
	help
	  This driver supports networking functionality of Marvell's
	  Octeon PCI Endpoint NIC.

	  To know the list of devices supported by this driver, refer
	  documentation in
	  <file:Documentation/networking/device_drivers/ethernet/marvell/octeon_ep.rst>.

	  To compile this drivers as a module, choose M here. Name of the
	  module is octeon_ep.
```

## drivers/net/ethernet/marvell/octeon_ep_vf/Kconfig
```kconfig
# SPDX-License-Identifier: GPL-2.0-only
#
# Marvell's Octeon PCI Endpoint NIC VF Driver Configuration
#

config OCTEON_EP_VF
	tristate "Marvell Octeon PCI Endpoint NIC VF Driver"
	depends on 64BIT
	depends on PCI
	help
	  This driver supports the networking functionality of Marvell's
	  Octeon PCI Endpoint NIC VF.

	  To know the list of devices supported by this driver, refer to the
	  documentation in
	  <file:Documentation/networking/device_drivers/ethernet/marvell/octeon_ep_vf.rst>.

	  To compile this driver as a module, choose M here.
	  The name of the module will be octeon_ep_vf.
```

## drivers/net/ethernet/marvell/octeontx2/Kconfig
```kconfig
# SPDX-License-Identifier: GPL-2.0-only
#
# Marvell OcteonTX2 drivers configuration
#

config OCTEONTX2_MBOX
	tristate

config OCTEONTX2_AF
	tristate "Marvell OcteonTX2 RVU Admin Function driver"
	select OCTEONTX2_MBOX
	select NET_DEVLINK
	depends on (64BIT && COMPILE_TEST) || ARM64
	depends on PCI
	help
	  This driver supports Marvell's OcteonTX2 Resource Virtualization
	  Unit's admin function manager which manages all RVU HW resources
	  and provides a medium to other PF/VFs to configure HW. Should be
	  enabled for other RVU device drivers to work.

config NDC_DIS_DYNAMIC_CACHING
	bool "Disable caching of dynamic entries in NDC"
	depends on OCTEONTX2_AF
	default n
	help
	  This config option disables caching of dynamic entries such as NIX SQEs
	  , NPA stack pages etc in NDC. Also locks down NIX SQ/CQ/RQ/RSS and
	  NPA Aura/Pool contexts.

config OCTEONTX2_PF
	tristate "Marvell OcteonTX2 NIC Physical Function driver"
	select OCTEONTX2_MBOX
	depends on (64BIT && COMPILE_TEST) || ARM64
	depends on PCI
	help
	  This driver supports Marvell's OcteonTX2 NIC physical function.

config OCTEONTX2_VF
	tristate "Marvell OcteonTX2 NIC Virtual Function driver"
	depends on OCTEONTX2_PF
	help
	  This driver supports Marvell's OcteonTX2 NIC virtual function.
```

## drivers/net/ethernet/marvell/prestera/Kconfig
```kconfig
# SPDX-License-Identifier: GPL-2.0-only
#
# Marvell Prestera drivers configuration
#

config PRESTERA
	tristate "Marvell Prestera Switch ASICs support"
	depends on NET_SWITCHDEV && VLAN_8021Q
	depends on BRIDGE || BRIDGE=n
	select NET_DEVLINK
	help
	  This driver supports Marvell Prestera Switch ASICs family.

	  To compile this driver as a module, choose M here: the
	  module will be called prestera.

config PRESTERA_PCI
	tristate "PCI interface driver for Marvell Prestera Switch ASICs family"
	depends on PCI && HAS_IOMEM && PRESTERA
	default PRESTERA
	help
	  This is implementation of PCI interface support for Marvell Prestera
	  Switch ASICs family.

	  To compile this driver as a module, choose M here: the
	  module will be called prestera_pci.
```

## drivers/net/ethernet/mediatek/Kconfig
```kconfig
# SPDX-License-Identifier: GPL-2.0-only
config NET_VENDOR_MEDIATEK
	bool "MediaTek devices"
	depends on ARCH_MEDIATEK || ARCH_AIROHA || SOC_MT7621 || SOC_MT7620 || COMPILE_TEST
	help
	  If you have a Mediatek SoC with ethernet, say Y.

if NET_VENDOR_MEDIATEK

config NET_MEDIATEK_SOC_WED
	depends on ARCH_MEDIATEK || COMPILE_TEST
	def_bool NET_MEDIATEK_SOC != n

config NET_MEDIATEK_SOC
	tristate "MediaTek SoC Gigabit Ethernet support"
	depends on NET_DSA || !NET_DSA
	select PINCTRL
	select PHYLINK
	select DIMLIB
	select GENERIC_ALLOCATOR
	select PAGE_POOL
	select PAGE_POOL_STATS
	select PCS_MTK_LYNXI
	select REGMAP_MMIO
	help
	  This driver supports the gigabit ethernet MACs in the
	  MediaTek SoC family.

config NET_MEDIATEK_STAR_EMAC
	tristate "MediaTek STAR Ethernet MAC support"
	select PHYLIB
	select REGMAP_MMIO
	help
	  This driver supports the ethernet MAC IP first used on
	  MediaTek MT85** SoCs.

endif #NET_VENDOR_MEDIATEK
```

## drivers/net/ethernet/mellanox/Kconfig
```kconfig
# SPDX-License-Identifier: GPL-2.0-only
#
# Mellaanalx driver configuration
#

config NET_VENDOR_MELLAANALX
	bool "Mellaanalx devices"
	default y
	depends on PCI || I2C
	help
	  If you have a network (Ethernet or RDMA) device belonging to this
	  class, say Y.

	  Analte that the answer to this question doesn't directly affect the
	  kernel: saying N will just cause the configurator to skip all
	  the questions about Mellaanalx cards. If you say Y, you will be asked
	  for your specific card in the following questions.

if NET_VENDOR_MELLAANALX

source "drivers/net/ethernet/mellaanalx/mlx4/Kconfig"
source "drivers/net/ethernet/mellaanalx/mlx5/core/Kconfig"
source "drivers/net/ethernet/mellaanalx/mlxsw/Kconfig"
source "drivers/net/ethernet/mellaanalx/mlxfw/Kconfig"
source "drivers/net/ethernet/mellaanalx/mlxbf_gige/Kconfig"

endif # NET_VENDOR_MELLAANALX
```

## drivers/net/ethernet/mellanox/mlx4/Kconfig
```kconfig
# SPDX-License-Identifier: GPL-2.0-only
#
# Mellanox driver configuration
#

config MLX4_EN
	tristate "Mellanox Technologies 1/10/40Gbit Ethernet support"
	depends on PCI && NETDEVICES && ETHERNET && INET
	depends on PTP_1588_CLOCK_OPTIONAL
	select MLX4_CORE
	help
	  This driver supports Mellanox Technologies ConnectX Ethernet
	  devices.

config MLX4_EN_DCB
	bool "Data Center Bridging (DCB) Support"
	default y
	depends on MLX4_EN && DCB
	help
	  Say Y here if you want to use Data Center Bridging (DCB) in the
	  driver.
	  If set to N, will not be able to configure QoS and ratelimit attributes.
	  This flag is depended on the kernel's DCB support.

	  If unsure, set to Y

config MLX4_CORE
	tristate
	depends on PCI
	select NET_DEVLINK
	default n

config MLX4_DEBUG
	bool "Verbose debugging output" if (MLX4_CORE && EXPERT)
	depends on MLX4_CORE
	default y
	help
	  This option causes debugging code to be compiled into the
	  mlx4_core driver.  The output can be turned on via the
	  debug_level module parameter (which can also be set after
	  the driver is loaded through sysfs).

config MLX4_CORE_GEN2
	bool "Support for old gen2 Mellanox PCI IDs" if (MLX4_CORE)
	depends on MLX4_CORE
	default y
	help
	  Say Y here if you want to use old gen2 Mellanox devices in the
	  driver.
```
