## drivers/net/ethernet/microchip/sparx5/Kconfig
```kconfig
config SPARX5_SWITCH
	tristate "Sparx5 switch driver"
	depends on NET_SWITCHDEV
	depends on HAS_IOMEM
	depends on OF
	depends on ARCH_SPARX5 || ARCH_LAN969X || COMPILE_TEST
	depends on PTP_1588_CLOCK_OPTIONAL
	depends on BRIDGE || BRIDGE=n
	select PHYLINK
	select PHY_SPARX5_SERDES
	select RESET_CONTROLLER
	select VCAP
	select FDMA
	help
	  This driver supports the Sparx5 network switch device.

config SPARX5_DCB
	bool "Data Center Bridging (DCB) support"
	depends on SPARX5_SWITCH && DCB
	default y
	help
	  Say Y here if you want to use Data Center Bridging (DCB) in the
	  driver. This can be used to assign priority to traffic, based on
	  DSCP and PCP.

	  If unsure, set to Y.

config LAN969X_SWITCH
	bool "Lan969x switch driver"
	depends on SPARX5_SWITCH
	select PAGE_POOL
	help
	  This driver supports the lan969x family of network switch devices.
```

## drivers/net/ethernet/microchip/vcap/Kconfig
```kconfig
# SPDX-License-Identifier: GPL-2.0-only
#
# Microchip VCAP API configuration
#

if NET_VENDOR_MICROCHIP

config VCAP
	bool "VCAP (Versatile Content-Aware Processor) library"
	help
	  Provides the basic VCAP functionality for multiple Microchip switchcores

	  A VCAP is essentially a TCAM with rules consisting of

	    - Programmable key fields
	    - Programmable action fields
	    - A counter (which may be only one bit wide)

	  Besides this each VCAP has:

	    - A number of lookups
	    - A keyset configuration per port per lookup

	  The VCAP implementation provides switchcore independent handling of rules
	  and supports:

	    - Creating and deleting rules
	    - Updating and getting rules

	  The platform specific configuration as well as the platform specific model
	  of the VCAP instances are attached to the VCAP API and a client can then
	  access rules via the API in a platform independent way, with the
	  limitations that each VCAP has in terms of its supported keys and actions.

	  Different switchcores will have different VCAP instances with different
	  characteristics. Look in the datasheet for the VCAP specifications for the
	  specific switchcore.

config VCAP_KUNIT_TEST
	bool "KUnit test for VCAP library" if !KUNIT_ALL_TESTS
	depends on KUNIT
	depends on KUNIT=y && VCAP=y && y
	select DEBUG_FS
	default KUNIT_ALL_TESTS
	help
	  This builds unit tests for the VCAP library.

	  For more information on KUnit and unit tests in general, please refer
	  to the KUnit documentation in Documentation/dev-tools/kunit/.

	  If unsure, say N.

endif # NET_VENDOR_MICROCHIP
```

## drivers/net/ethernet/moxa/Kconfig
```kconfig
# SPDX-License-Identifier: GPL-2.0-only
#
# MOXART device configuration
#

config NET_VENDOR_MOXART
	bool "MOXA ART devices"
	default y
	depends on (ARM && ARCH_MOXART)
	help
	  If you have a network (Ethernet) card belonging to this class, say Y.

	  Note that the answer to this question doesn't directly affect the
	  kernel: saying N will just cause the configurator to skip all
	  the questions about MOXA ART devices. If you say Y, you will be asked
	  for your specific card in the following questions.

if NET_VENDOR_MOXART

config ARM_MOXART_ETHER
	tristate "MOXART Ethernet support"
	depends on ARM && ARCH_MOXART
	select NET_CORE
	help
	  If you wish to compile a kernel for a hardware with MOXA ART SoC and
	  want to use the internal ethernet then you should answer Y to this.


endif # NET_VENDOR_MOXART
```

## drivers/net/ethernet/mscc/Kconfig
```kconfig
# SPDX-License-Identifier: (GPL-2.0 OR MIT)
config NET_VENDOR_MICROSEMI
	bool "Microsemi devices"
	default y
	help
	  If you have a network (Ethernet) card belonging to this class, say Y.

	  Note that the answer to this question doesn't directly affect the
	  kernel: saying N will just cause the configurator to skip all
	  the questions about Microsemi devices.

if NET_VENDOR_MICROSEMI

# Users should depend on NET_SWITCHDEV, HAS_IOMEM
config MSCC_OCELOT_SWITCH_LIB
	select NET_DEVLINK
	select REGMAP_MMIO
	select PACKING
	select PHYLIB
	tristate
	help
	  This is a hardware support library for Ocelot network switches. It is
	  used by switchdev as well as by DSA drivers.

config MSCC_OCELOT_SWITCH
	tristate "Ocelot switch driver"
	depends on NET_SWITCHDEV
	depends on HAS_IOMEM
	depends on OF_NET
	select MSCC_OCELOT_SWITCH_LIB
	select GENERIC_PHY
	help
	  This driver supports the Ocelot network switch device as present on
	  the Ocelot SoCs (VSC7514).

endif # NET_VENDOR_MICROSEMI
```
