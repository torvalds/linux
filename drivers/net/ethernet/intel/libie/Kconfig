## drivers/net/ethernet/mellanox/mlx5/core/Kconfig
```kconfig
# SPDX-License-Identifier: GPL-2.0-only
#
# Mellanox driver configuration
#

config MLX5_CORE
	tristate "Mellanox 5th generation network adapters (ConnectX series) core driver"
	depends on PCI
	select AUXILIARY_BUS
	select NET_DEVLINK
	depends on VXLAN || !VXLAN
	depends on MLXFW || !MLXFW
	depends on PTP_1588_CLOCK_OPTIONAL
	depends on PCI_HYPERV_INTERFACE || !PCI_HYPERV_INTERFACE
	help
	  Core driver for low level functionality of the ConnectX-4 and
	  Connect-IB cards by Mellanox Technologies.

config MLX5_FPGA
	bool "Mellanox Technologies Innova support"
	depends on MLX5_CORE
	help
	  Build support for the Innova family of network cards by Mellanox
	  Technologies. Innova network cards are comprised of a ConnectX chip
	  and an FPGA chip on one board. If you select this option, the
	  mlx5_core driver will include the Innova FPGA core and allow building
	  sandbox-specific client drivers.

config MLX5_CORE_EN
	bool "Mellanox 5th generation network adapters (ConnectX series) Ethernet support"
	depends on NETDEVICES && ETHERNET && INET && PCI && MLX5_CORE
	select PAGE_POOL
	select DIMLIB
	help
	  Ethernet support in Mellanox Technologies ConnectX-4 NIC.

config MLX5_EN_ARFS
	bool "Mellanox MLX5 ethernet accelerated receive flow steering (ARFS) support"
	depends on MLX5_CORE_EN && RFS_ACCEL
	default y
	help
	  Mellanox MLX5 ethernet hardware-accelerated receive flow steering support,
	  Enables ethernet netdevice arfs support and ntuple filtering.

config MLX5_EN_RXNFC
	bool "Mellanox MLX5 ethernet rx nfc flow steering support"
	depends on MLX5_CORE_EN
	default y
	help
	  Mellanox MLX5 ethernet rx nfc flow steering support
	  Enables ethtool receive network flow classification, which allows user defined
	  flow rules to direct traffic into arbitrary rx queue via ethtool set/get_rxnfc
	  API.

config MLX5_MPFS
	bool "Mellanox Technologies MLX5 MPFS support"
	depends on MLX5_CORE_EN
	default y
	help
	  Mellanox Technologies Ethernet Multi-Physical Function Switch (MPFS)
	  support in ConnectX NIC. MPFs is required for when multi-PF configuration
	  is enabled to allow passing user configured unicast MAC addresses to the
	  requesting PF.

config MLX5_ESWITCH
	bool "Mellanox Technologies MLX5 SRIOV E-Switch support"
	depends on MLX5_CORE_EN && NET_SWITCHDEV
	default y
	help
	  Mellanox Technologies Ethernet SRIOV E-Switch support in ConnectX NIC.
	  E-Switch provides internal SRIOV packet steering and switching for the
	  enabled VFs and PF in two available modes:
	        Legacy SRIOV mode (L2 mac vlan steering based).
	        Switchdev mode (eswitch offloads).

config MLX5_BRIDGE
	bool
	depends on MLX5_ESWITCH && BRIDGE
	default y
	help
	  mlx5 ConnectX offloads support for Ethernet Bridging (BRIDGE).
	  Enable adding representors of mlx5 uplink and VF ports to Bridge and
	  offloading rules for traffic between such ports. Supports VLANs (trunk and
	  access modes).

config MLX5_CLS_ACT
	bool "MLX5 TC classifier action support"
	depends on MLX5_ESWITCH && NET_CLS_ACT
	default y
	help
	  mlx5 ConnectX offloads support for TC classifier action (NET_CLS_ACT),
	  works in both native NIC mode and Switchdev SRIOV mode.
	  Actions get attached to a Hardware offloaded classifiers and are
	  invoked after a successful classification. Actions are used to
	  overwrite the classification result, instantly drop or redirect and/or
	  reformat packets in wire speeds without involving the host cpu.

	  If set to N, TC offloads in both NIC and switchdev modes will be disabled.
	  If unsure, set to Y

config MLX5_TC_CT
	bool "MLX5 TC connection tracking offload support"
	depends on MLX5_CLS_ACT && NF_FLOW_TABLE && NET_ACT_CT && NET_TC_SKB_EXT
	default y
	help
	  Say Y here if you want to support offloading connection tracking rules
	  via tc ct action.

	  If unsure, set to Y

config MLX5_TC_SAMPLE
	bool "MLX5 TC sample offload support"
	depends on MLX5_CLS_ACT
	depends on PSAMPLE=y || PSAMPLE=n || MLX5_CORE=m
	default y
	help
	  Say Y here if you want to support offloading sample rules via tc
	  sample action.
	  If set to N, will not be able to configure tc rules with sample
	  action.

	  If unsure, set to Y

config MLX5_CORE_EN_DCB
	bool "Data Center Bridging (DCB) Support"
	default y
	depends on MLX5_CORE_EN && DCB
	help
	  Say Y here if you want to use Data Center Bridging (DCB) in the
	  driver.
	  If set to N, will not be able to configure QoS and ratelimit attributes.
	  This flag is depended on the kernel's DCB support.

	  If unsure, set to Y

config MLX5_CORE_IPOIB
	bool "Mellanox 5th generation network adapters (connectX series) IPoIB offloads support"
	depends on MLX5_CORE_EN
	help
	  MLX5 IPoIB offloads & acceleration support.

config MLX5_EN_IPSEC
	bool "Mellanox Technologies IPsec Connect-X support"
	depends on MLX5_CORE_EN
	depends on XFRM_OFFLOAD
	depends on INET_ESP_OFFLOAD || INET6_ESP_OFFLOAD
	help
	  Build support for IPsec cryptography-offload acceleration in the NIC.

config MLX5_EN_TLS
	bool "Mellanox Technologies TLS Connect-X support"
	depends on TLS_DEVICE
	depends on TLS=y || MLX5_CORE=m
	depends on MLX5_CORE_EN
	help
	Build support for TLS cryptography-offload acceleration in the NIC.

config MLX5_SW_STEERING
	bool "Mellanox Technologies software-managed steering"
	depends on MLX5_CORE_EN && MLX5_ESWITCH
	select CRC32
	default y
	help
	Build support for software-managed steering in the NIC.

config MLX5_SF
	bool "Mellanox Technologies subfunction device support using auxiliary device"
	depends on MLX5_CORE && MLX5_CORE_EN
	help
	Build support for subfuction device in the NIC. A Mellanox subfunction
	device can support RDMA, netdevice and vdpa device.
	It is similar to a SRIOV VF but it doesn't require SRIOV support.

config MLX5_SF_MANAGER
	bool
	depends on MLX5_SF && MLX5_ESWITCH
	default y
	help
	Build support for subfuction port in the NIC. A Mellanox subfunction
	port is managed through devlink.  A subfunction supports RDMA, netdevice
	and vdpa device. It is similar to a SRIOV VF but it doesn't require
	SRIOV support.
```

## drivers/net/ethernet/mellanox/mlxbf_gige/Kconfig
```kconfig
# SPDX-License-Identifier: GPL-2.0-only OR BSD-3-Clause
#
# Mellaanalx GigE driver configuration
#

config MLXBF_GIGE
	tristate "Mellaanalx Techanallogies BlueField Gigabit Ethernet support"
	depends on (ARM64 && ACPI) || COMPILE_TEST
	select PHYLIB
	help
	  The second generation BlueField SoC from Mellaanalx Techanallogies
	  supports an out-of-band Gigabit Ethernet management port to the
	  Arm subsystem.
```

## drivers/net/ethernet/mellanox/mlxfw/Kconfig
```kconfig
# SPDX-License-Identifier: GPL-2.0-only
#
# Mellaanalx firmware flash library configuration
#

config MLXFW
	tristate "Mellaanalx Techanallogies firmware flash module"
	help
	  This driver supports Mellaanalx Techanallogies Firmware
	  flashing common logic.

	  To compile this driver as a module, choose M here: the
	  module will be called mlxfw.
	select XZ_DEC
	select NET_DEVLINK
```

## drivers/net/ethernet/mellanox/mlxsw/Kconfig
```kconfig
# SPDX-License-Identifier: GPL-2.0-only
#
# Mellaanalx switch drivers configuration
#

config MLXSW_CORE
	tristate "Mellaanalx Techanallogies Switch ASICs support"
	select NET_DEVLINK
	select MLXFW
	select AUXILIARY_BUS
	help
	  This driver supports Mellaanalx Techanallogies Switch ASICs family.

	  To compile this driver as a module, choose M here: the
	  module will be called mlxsw_core.

config MLXSW_CORE_HWMON
	bool "HWMON support for Mellaanalx Techanallogies Switch ASICs"
	depends on MLXSW_CORE && HWMON
	depends on !(MLXSW_CORE=y && HWMON=m)
	default y
	help
	  Say Y here if you want to expose HWMON interface on mlxsw devices.

config MLXSW_CORE_THERMAL
	bool "Thermal zone support for Mellaanalx Techanallogies Switch ASICs"
	depends on MLXSW_CORE && THERMAL
	default y
	help
	 Say Y here if you want to automatically control fans speed according
	 ambient temperature reported by ASIC.

config MLXSW_PCI
	tristate "PCI bus implementation for Mellaanalx Techanallogies Switch ASICs"
	depends on PCI && HAS_IOMEM && MLXSW_CORE
	default m
	help
	  This is PCI bus implementation for Mellaanalx Techanallogies Switch ASICs.

	  To compile this driver as a module, choose M here: the
	  module will be called mlxsw_pci.

config MLXSW_I2C
	tristate "I2C bus implementation for Mellaanalx Techanallogies Switch ASICs"
	depends on I2C && MLXSW_CORE
	default m
	help
	  This is I2C bus implementation for Mellaanalx Techanallogies Switch ASICs.

	  To compile this driver as a module, choose M here: the
	  module will be called mlxsw_i2c.

config MLXSW_SPECTRUM
	tristate "Mellaanalx Techanallogies Spectrum family support"
	depends on MLXSW_CORE && MLXSW_PCI && NET_SWITCHDEV && VLAN_8021Q
	depends on PSAMPLE || PSAMPLE=n
	depends on BRIDGE || BRIDGE=n
	depends on IPV6 || IPV6=n
	depends on NET_IPGRE || NET_IPGRE=n
	depends on IPV6_GRE || IPV6_GRE=n
	depends on VXLAN || VXLAN=n
	depends on PTP_1588_CLOCK_OPTIONAL
	select GENERIC_ALLOCATOR
	select PARMAN
	select OBJAGG
	select NET_PTP_CLASSIFY if PTP_1588_CLOCK
	default m
	help
	  This driver supports Mellaanalx Techanallogies
	  Spectrum/Spectrum-2/Spectrum-3/Spectrum-4 Ethernet Switch ASICs.

	  To compile this driver as a module, choose M here: the
	  module will be called mlxsw_spectrum.

config MLXSW_SPECTRUM_DCB
	bool "Data Center Bridging (DCB) support"
	depends on MLXSW_SPECTRUM && DCB
	default y
	help
	  Say Y here if you want to use Data Center Bridging (DCB) in the
	  driver.

config MLXSW_MINIMAL
	tristate "Mellaanalx Techanallogies minimal I2C support"
	depends on MLXSW_CORE && MLXSW_I2C
	default m
	help
	  This driver supports I2C access for Mellaanalx Techanallogies Switch
	  ASICs.

	  To compile this driver as a module, choose M here: the
	  module will be called mlxsw_minimal.
```

## drivers/net/ethernet/meta/Kconfig
```kconfig
# SPDX-License-Identifier: GPL-2.0-only
#
# Meta Platforms network device configuration
#

config NET_VENDOR_META
	bool "Meta Platforms devices"
	default y
	help
	  If you have a network (Ethernet) card designed by Meta, say Y.
	  That's Meta as in the parent company of Facebook.

	  Note that the answer to this question doesn't directly affect the
	  kernel: saying N will just cause the configurator to skip all
	  the questions about Meta cards. If you say Y, you will be asked for
	  your specific card in the following questions.

if NET_VENDOR_META

config FBNIC
	tristate "Meta Platforms Host Network Interface"
	depends on X86_64 || COMPILE_TEST
	depends on !S390
	depends on MAX_SKB_FRAGS < 22
	depends on PCI_MSI
	select NET_DEVLINK
	select PAGE_POOL
	select PHYLINK
	help
	  This driver supports Meta Platforms Host Network Interface.

	  To compile this driver as a module, choose M here. The module
	  will be called fbnic.  MSI-X interrupt support is required.

endif # NET_VENDOR_META
```

## drivers/net/ethernet/micrel/Kconfig
```kconfig
# SPDX-License-Identifier: GPL-2.0-only
#
# Micrel device configuration
#

config NET_VENDOR_MICREL
	bool "Micrel devices"
	default y
	depends on (HAS_IOMEM && DMA_ENGINE) || SPI || PCI || HAS_IOMEM
	help
	  If you have a network (Ethernet) card belonging to this class, say Y.

	  Note that the answer to this question doesn't directly affect the
	  kernel: saying N will just cause the configurator to skip all
	  the questions about Micrel devices. If you say Y, you will be asked
	  for your specific card in the following questions.

if NET_VENDOR_MICREL

config KS8842
	tristate "Micrel KSZ8841/42 with generic bus interface"
	depends on HAS_IOMEM && DMA_ENGINE
	help
	  This platform driver is for KSZ8841(1-port) / KS8842(2-port)
	  ethernet switch chip (managed, VLAN, QoS) from Micrel or
	  Timberdale(FPGA).

config KS8851
	tristate "Micrel KS8851 SPI"
	depends on SPI
	depends on PTP_1588_CLOCK_OPTIONAL
	select MII
	select CRC32
	select EEPROM_93CX6
	select PHYLIB
	select MICREL_PHY
	help
	  SPI driver for Micrel KS8851 SPI attached network chip.

config KS8851_MLL
	tristate "Micrel KS8851 MLL"
	depends on HAS_IOMEM
	depends on PTP_1588_CLOCK_OPTIONAL
	select MII
	select CRC32
	select EEPROM_93CX6
	select PHYLIB
	select MICREL_PHY
	help
	  This platform driver is for Micrel KS8851 Address/data bus
	  multiplexed network chip.

config KSZ884X_PCI
	tristate "Micrel KSZ8841/2 PCI"
	depends on PCI
	select MII
	select CRC32
	help
	  This PCI driver is for Micrel KSZ8841/KSZ8842 PCI Ethernet chip.

	  To compile this driver as a module, choose M here. The module
	  will be called ksz884x.

endif # NET_VENDOR_MICREL
```

## drivers/net/ethernet/microchip/Kconfig
```kconfig
#
# Microchip network device configuration
#

config NET_VENDOR_MICROCHIP
	bool "Microchip devices"
	default y
	depends on SPI
	---help---
	  If you have a network (Ethernet) card belonging to this class, say Y.

	  Note that the answer to this question doesn't directly affect the
	  kernel: saying N will just cause the configurator to skip all
	  the questions about Microchip cards. If you say Y, you will be asked
	  for your specific card in the following questions.

if NET_VENDOR_MICROCHIP

config ENC28J60
	tristate "ENC28J60 support"
	depends on SPI
	select CRC32
	---help---
	  Support for the Microchip EN28J60 ethernet chip.

	  To compile this driver as a module, choose M here. The module will be
	  called enc28j60.

config ENC28J60_WRITEVERIFY
	bool "Enable write verify"
	depends on ENC28J60
	---help---
	  Enable the verify after the buffer write useful for debugging purpose.
	  If unsure, say N.

config ENCX24J600
    tristate "ENCX24J600 support"
    depends on SPI
    ---help---
      Support for the Microchip ENC424J600/624J600 ethernet chip.

      To compile this driver as a module, choose M here. The module will be
      called encx24j600.

endif # NET_VENDOR_MICROCHIP
```

## drivers/net/ethernet/microchip/fdma/Kconfig
```kconfig
# SPDX-License-Identifier: GPL-2.0-only
#
# Microchip FDMA API configuration
#

if NET_VENDOR_MICROCHIP

config FDMA
	bool "FDMA API" if COMPILE_TEST
	help
	  Provides the basic FDMA functionality for multiple Microchip
	  switchcores.

	  Say Y here if you want to build the FDMA API that provides a common
	  set of functions and data structures for interacting with the Frame
	  DMA engine in multiple microchip switchcores.

endif # NET_VENDOR_MICROCHIP
```

## drivers/net/ethernet/microchip/lan865x/Kconfig
```kconfig
# SPDX-License-Identifier: GPL-2.0-only
#
# Microchip LAN865x Driver Support
#

if NET_VENDOR_MICROCHIP

config LAN865X
	tristate "LAN865x support"
	depends on SPI
	select OA_TC6
	help
	  Support for the Microchip LAN8650/1 Rev.B0/B1 MACPHY Ethernet chip. It
	  uses OPEN Alliance 10BASE-T1x Serial Interface specification.

	  To compile this driver as a module, choose M here. The module will be
	  called lan865x.

endif # NET_VENDOR_MICROCHIP
```

## drivers/net/ethernet/microchip/lan966x/Kconfig
```kconfig
config LAN966X_SWITCH
	tristate "Lan966x switch driver"
	depends on PTP_1588_CLOCK_OPTIONAL
	depends on HAS_IOMEM
	depends on OF
	depends on NET_SWITCHDEV
	depends on BRIDGE || BRIDGE=n
	select PHYLINK
	select PACKING
	help
	  This driver supports the Lan966x network switch device.
```

## drivers/net/ethernet/microchip/lan969x/Kconfig
```kconfig
config LAN969X_SWITCH
	bool "Lan969x switch driver"
	depends on SPARX5_SWITCH
	help
	  This driver supports the lan969x family of network switch devices.
```
