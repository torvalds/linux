## drivers/net/ethernet/chelsio/Kconfig
```kconfig
#
# Chelsio device configuration
#

config NET_VENDOR_CHELSIO
	bool "Chelsio devices"
	default y
	depends on PCI
	---help---
	  If you have a network (Ethernet) card belonging to this class, say Y.

	  Note that the answer to this question doesn't directly affect the
	  kernel: saying N will just cause the configurator to skip all
	  the questions about Chelsio devices. If you say Y, you will be asked for
	  your specific card in the following questions.

if NET_VENDOR_CHELSIO

config CHELSIO_T1
	tristate "Chelsio 10Gb Ethernet support"
	depends on PCI
	select CRC32
	select MDIO
	---help---
	  This driver supports Chelsio gigabit and 10-gigabit
	  Ethernet cards. More information about adapter features and
	  performance tuning is in <file:Documentation/networking/cxgb.txt>.

	  For general information about Chelsio and our products, visit
	  our website at <http://www.chelsio.com>.

	  For customer support, please visit our customer support page at
	  <http://www.chelsio.com/support.html>.

	  Please send feedback to <linux-bugs@chelsio.com>.

	  To compile this driver as a module, choose M here: the module
	  will be called cxgb.

config CHELSIO_T1_1G
	bool "Chelsio gigabit Ethernet support"
	depends on CHELSIO_T1
	---help---
	  Enables support for Chelsio's gigabit Ethernet PCI cards.  If you
	  are using only 10G cards say 'N' here.

config CHELSIO_T3
	tristate "Chelsio Communications T3 10Gb Ethernet support"
	depends on PCI && INET
	select FW_LOADER
	select MDIO
	---help---
	  This driver supports Chelsio T3-based gigabit and 10Gb Ethernet
	  adapters.

	  For general information about Chelsio and our products, visit
	  our website at <http://www.chelsio.com>.

	  For customer support, please visit our customer support page at
	  <http://www.chelsio.com/support.html>.

	  Please send feedback to <linux-bugs@chelsio.com>.

	  To compile this driver as a module, choose M here: the module
	  will be called cxgb3.

config CHELSIO_T4
	tristate "Chelsio Communications T4/T5/T6 Ethernet support"
	depends on PCI && (IPV6 || IPV6=n)
	select FW_LOADER
	select MDIO
	select ZLIB_DEFLATE
	---help---
	  This driver supports Chelsio T4, T5 & T6 based gigabit, 10Gb Ethernet
	  adapter and T5/T6 based 40Gb and T6 based 25Gb, 50Gb and 100Gb
	  Ethernet adapters.

	  For general information about Chelsio and our products, visit
	  our website at <http://www.chelsio.com>.

	  For customer support, please visit our customer support page at
	  <http://www.chelsio.com/support.html>.

	  Please send feedback to <linux-bugs@chelsio.com>.

	  To compile this driver as a module choose M here; the module
	  will be called cxgb4.

config CHELSIO_T4_DCB
	bool "Data Center Bridging (DCB) Support for Chelsio T4/T5/T6 cards"
	default n
	depends on CHELSIO_T4 && DCB
	---help---
	  Enable DCB support through rtNetlink interface.
	  Say Y here if you want to enable Data Center Bridging (DCB) support
	  in the driver.

	  If unsure, say N.

config CHELSIO_T4_FCOE
	bool "Fibre Channel over Ethernet (FCoE) Support for Chelsio T5 cards"
	default n
	depends on CHELSIO_T4 && CHELSIO_T4_DCB && FCOE
	---help---
	  Enable FCoE offload features.
	  Say Y here if you want to enable Fibre Channel over Ethernet (FCoE) support
	  in the driver.

	  If unsure, say N.

config CHELSIO_T4VF
	tristate "Chelsio Communications T4/T5/T6 Virtual Function Ethernet support"
	depends on PCI
	---help---
	  This driver supports Chelsio T4, T5 & T6 based gigabit, 10Gb Ethernet
	  adapters and T5/T6 based 40Gb and T6 based 25Gb, 50Gb and 100Gb
	  Ethernet adapters with PCI-E SR-IOV Virtual Functions.

	  For general information about Chelsio and our products, visit
	  our website at <http://www.chelsio.com>.

	  For customer support, please visit our customer support page at
	  <http://www.chelsio.com/support.html>.

	  Please send feedback to <linux-bugs@chelsio.com>.

	  To compile this driver as a module choose M here; the module
	  will be called cxgb4vf.

config CHELSIO_LIB
	tristate
	---help---
	Common library for Chelsio drivers.

endif # NET_VENDOR_CHELSIO
```

## drivers/net/ethernet/chelsio/inline_crypto/Kconfig
```kconfig
# SPDX-License-Identifier: GPL-2.0-only
#
# Chelsio inline crypto configuration
#

config CHELSIO_INLINE_CRYPTO
	bool "Chelsio Inline Crypto support"
	depends on CHELSIO_T4
	default y
	help
	  Enable support for inline crypto.
	  Allows enable/disable from list of inline crypto drivers.

if CHELSIO_INLINE_CRYPTO

config CRYPTO_DEV_CHELSIO_TLS
	tristate "Chelsio Crypto Inline TLS Driver"
	depends on CHELSIO_T4
	depends on TLS
	depends on TLS_TOE
	help
	  Support Chelsio Inline TLS with Chelsio crypto accelerator.
	  Enable inline TLS support for Tx and Rx.

	  To compile this driver as a module, choose M here: the module
	  will be called chtls.

config CHELSIO_IPSEC_INLINE
       tristate "Chelsio IPSec XFRM Tx crypto offload"
       depends on CHELSIO_T4
       depends on XFRM_OFFLOAD
       depends on INET_ESP_OFFLOAD || INET6_ESP_OFFLOAD
       help
        Support Chelsio Inline IPsec with Chelsio crypto accelerator.
        Enable inline IPsec support for Tx.

        To compile this driver as a module, choose M here: the module
        will be called ch_ipsec.

config CHELSIO_TLS_DEVICE
        tristate "Chelsio Inline KTLS Offload"
        depends on CHELSIO_T4
        depends on TLS
        depends on TLS_DEVICE
        help
          This flag enables support for kernel tls offload over Chelsio T6
          crypto accelerator. CONFIG_CHELSIO_TLS_DEVICE flag can be enabled
          only if CONFIG_TLS and CONFIG_TLS_DEVICE flags are enabled.

	  To compile this driver as a module, choose M here: the module
	  will be called ch_ktls.

endif # CHELSIO_INLINE_CRYPTO
```

## drivers/net/ethernet/cirrus/Kconfig
```kconfig
# SPDX-License-Identifier: GPL-2.0-only
#
# Cirrus network device configuration
#

config NET_VENDOR_CIRRUS
	bool "Cirrus devices"
	default y
	depends on ISA || EISA || ARM || MAC || COMPILE_TEST
	help
	  If you have a network (Ethernet) card belonging to this class, say Y.

	  Note that the answer to this question doesn't directly affect the
	  kernel: saying N will just cause the configurator to skip all
	  the questions about Cirrus cards. If you say Y, you will be asked
	  for your specific card in the following questions.

if NET_VENDOR_CIRRUS

config CS89x0
	tristate

config CS89x0_ISA
	tristate "CS89x0 ISA driver support"
	depends on HAS_IOPORT_MAP
	depends on ISA
	depends on !PPC32
	depends on CS89x0_PLATFORM=n
	select NETDEV_LEGACY_INIT
	select CS89x0
	help
	  Support for CS89x0 chipset based Ethernet cards. If you have a
	  network (Ethernet) card of this type, say Y and read the file
	  <file:Documentation/networking/device_drivers/ethernet/cirrus/cs89x0.rst>.

	  To compile this driver as a module, choose M here. The module
	  will be called cs89x0.

config CS89x0_PLATFORM
	tristate "CS89x0 platform driver support"
	depends on ARM || COMPILE_TEST
	select CS89x0
	help
	  Say Y to compile the cs89x0 platform driver. This makes this driver
	  suitable for use on certain evaluation boards such as the iMX21ADS.

	  To compile this driver as a module, choose M here. The module
	  will be called cs89x0.

config EP93XX_ETH
	tristate "EP93xx Ethernet support"
	depends on (ARM && ARCH_EP93XX) || COMPILE_TEST
	select MII
	help
	  This is a driver for the ethernet hardware included in EP93xx CPUs.
	  Say Y if you are building a kernel for EP93xx based devices.

config MAC89x0
	tristate "Macintosh CS89x0 based ethernet cards"
	depends on MAC
	help
	  Support for CS89x0 chipset based Ethernet cards.  If you have a
	  Nubus or LC-PDS network (Ethernet) card of this type, say Y here.

	  To compile this driver as a module, choose M here. This module will
	  be called mac89x0.

endif # NET_VENDOR_CIRRUS
```

## drivers/net/ethernet/cisco/Kconfig
```kconfig
# SPDX-License-Identifier: GPL-2.0-only
#
# Cisco device configuration
#

config NET_VENDOR_CISCO
	bool "Cisco devices"
	default y
	depends on PCI
	---help---
	  If you have a network (Ethernet) card belonging to this class, say Y.

	  Note that the answer to this question doesn't directly affect the
	  kernel: saying N will just cause the configurator to skip all
	  the questions about Cisco cards. If you say Y, you will be asked for
	  your specific card in the following questions.

if NET_VENDOR_CISCO

source "drivers/net/ethernet/cisco/enic/Kconfig"

endif # NET_VENDOR_CISCO
```

## drivers/net/ethernet/cisco/enic/Kconfig
```kconfig
# SPDX-License-Identifier: GPL-2.0-only
#
# Cisco device configuration
#

config ENIC
	tristate "Cisco VIC Ethernet NIC Support"
	depends on PCI
	select PAGE_POOL
	help
	  This enables the support for the Cisco VIC Ethernet card.
```

## drivers/net/ethernet/cortina/Kconfig
```kconfig
# SPDX-License-Identifier: GPL-2.0
# Cortina ethernet devices

config NET_VENDOR_CORTINA
	bool "Cortina Gemini devices"
	default y
	help
	  If you have a network (Ethernet) card belonging to this class, say Y
	  and read the Ethernet-HOWTO, available from
	  <https://www.tldp.org/docs.html#howto>.

if NET_VENDOR_CORTINA

config GEMINI_ETHERNET
	tristate "Gemini Gigabit Ethernet support"
	depends on OF
	depends on HAS_IOMEM
	select PHYLIB
	select CRC32
	help
	  This driver supports StorLink SL351x (Gemini) dual Gigabit Ethernet.

endif # NET_VENDOR_CORTINA
```

## drivers/net/ethernet/davicom/Kconfig
```kconfig
# SPDX-License-Identifier: GPL-2.0-only
#
# Davicom device configuration
#

config NET_VENDOR_DAVICOM
	bool "Davicom devices"
	default y
	help
	  If you have a network (Ethernet) card belonging to this class, say Y.

	  Note that the answer to this question doesn't directly affect the
	  kernel: saying N will just cause the configurator to skip all
	  the questions about Davicom devices. If you say Y, you will be asked
	  for your specific card in the following selections.

if NET_VENDOR_DAVICOM

config DM9000
	tristate "DM9000 support"
	depends on ARM || MIPS || COLDFIRE || NIOS2 || COMPILE_TEST
	select CRC32
	select MII
	help
	  Support for DM9000 chipset.

	  To compile this driver as a module, choose M here.  The module
	  will be called dm9000.

config DM9000_FORCE_SIMPLE_PHY_POLL
	bool "Force simple NSR based PHY polling"
	depends on DM9000
	help
	  This configuration forces the DM9000 to use the NSR's LinkStatus
	  bit to determine if the link is up or down instead of the more
	  costly MII PHY reads. Note, this will not work if the chip is
	  operating with an external PHY.

config DM9051
	tristate "DM9051 SPI support"
	depends on SPI
	select CRC32
	select MDIO
	select PHYLIB
	select REGMAP_SPI
	help
	  Support for DM9051 SPI chipset.

	  To compile this driver as a module, choose M here.  The module
	  will be called dm9051.

	  The SPI mode for the host's SPI master to access DM9051 is mode
	  0 on the SPI bus.

endif # NET_VENDOR_DAVICOM
```

## drivers/net/ethernet/dec/Kconfig
```kconfig
# SPDX-License-Identifier: GPL-2.0-only
#
# Digital Equipment Inc network device configuration
#

config NET_VENDOR_DEC
	bool "Digital Equipment devices"
	default y
	depends on PCI || EISA || CARDBUS
	help
	  If you have a network (Ethernet) card belonging to this class, say Y.

	  Note that the answer to this question doesn't directly affect the
	  kernel: saying N will just cause the configurator to skip all
	  the questions about DEC cards. If you say Y, you will be asked for
	  your specific card in the following questions.

if NET_VENDOR_DEC
source "drivers/net/ethernet/dec/tulip/Kconfig"
endif # NET_VENDOR_DEC
```

## drivers/net/ethernet/dlink/Kconfig
```kconfig
# SPDX-License-Identifier: GPL-2.0-only
#
# D-Link device configuration
#

config NET_VENDOR_DLINK
	bool "D-Link devices"
	default y
	depends on PCI
	help
	  If you have a network (Ethernet) card belonging to this class, say Y.

	  Note that the answer to this question doesn't directly affect the
	  kernel: saying N will just cause the configurator to skip all
	  the questions about D-Link devices. If you say Y, you will be asked for
	  your specific card in the following questions.

if NET_VENDOR_DLINK

config DL2K
	tristate "DL2000/TC902x/IP1000A-based Gigabit Ethernet support"
	depends on PCI
	select CRC32
	help
	  This driver supports DL2000/TC902x/IP1000A-based Gigabit ethernet cards,
	  which includes
	  D-Link DGE-550T Gigabit Ethernet Adapter.
	  D-Link DL2000-based Gigabit Ethernet Adapter.
	  Sundance/Tamarack TC902x Gigabit Ethernet Adapter.
	  ICPlus IP1000A-based cards

	  To compile this driver as a module, choose M here: the
	  module will be called dl2k.

endif # NET_VENDOR_DLINK
```
