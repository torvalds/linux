## drivers/net/ethernet/amd/Kconfig
```kconfig
#
# AMD network device configuration
#

config NET_VENDOR_AMD
	bool "AMD devices"
	default y
	depends on DIO || MACH_DECSTATION || MVME147 || ATARI || SUN3 || \
		   SUN3X || SBUS || PCI || ZORRO || (ISA && ISA_DMA_API) || \
		   (ARM && ARCH_EBSA110) || ISA || EISA || PCMCIA || ARM64
	---help---
	  If you have a network (Ethernet) chipset belonging to this class,
	  say Y.

	  Note that the answer to this question does not directly affect
	  the kernel: saying N will just case the configurator to skip all
	  the questions regarding AMD chipsets. If you say Y, you will be asked
	  for your specific chipset/driver in the following questions.

if NET_VENDOR_AMD

config A2065
	tristate "A2065 support"
	depends on ZORRO
	select CRC32
	---help---
	  If you have a Commodore A2065 Ethernet adapter, say Y. Otherwise,
	  say N.

	  To compile this driver as a module, choose M here: the module
	  will be called a2065.

config AMD8111_ETH
	tristate "AMD 8111 (new PCI LANCE) support"
	depends on PCI
	select CRC32
	select MII
	---help---
	  If you have an AMD 8111-based PCI LANCE ethernet card,
	  answer Y here.

	  To compile this driver as a module, choose M here. The module
	  will be called amd8111e.

config LANCE
	tristate "AMD LANCE and PCnet (AT1500 and NE2100) support"
	depends on ISA && ISA_DMA_API && !ARM
	---help---
	  If you have a network (Ethernet) card of this type, say Y here.
	  Some LinkSys cards are of this type.

	  To compile this driver as a module, choose M here: the module
	  will be called lance.  This is recommended.

config PCNET32
	tristate "AMD PCnet32 PCI support"
	depends on PCI
	select CRC32
	select MII
	---help---
	  If you have a PCnet32 or PCnetPCI based network (Ethernet) card,
	  answer Y here.

	  To compile this driver as a module, choose M here. The module
	  will be called pcnet32.

config ARIADNE
	tristate "Ariadne support"
	depends on ZORRO
	---help---
	  If you have a Village Tronic Ariadne Ethernet adapter, say Y.
	  Otherwise, say N.

	  To compile this driver as a module, choose M here: the module
	  will be called ariadne.

config ARM_AM79C961A
	bool "ARM EBSA110 AM79C961A support"
	depends on ARM && ARCH_EBSA110
	select CRC32
	---help---
	  If you wish to compile a kernel for the EBSA-110, then you should
	  always answer Y to this.

config ATARILANCE
	tristate "Atari LANCE support"
	depends on ATARI
	---help---
	  Say Y to include support for several Atari Ethernet adapters based
	  on the AMD LANCE chipset: RieblCard (with or without battery), or
	  PAMCard VME (also the version by Rhotron, with different addresses).

config DECLANCE
	tristate "DEC LANCE ethernet controller support"
	depends on MACH_DECSTATION
	select CRC32
	---help---
	  This driver is for the series of Ethernet controllers produced by
	  DEC (now Compaq) based on the AMD LANCE chipset, including the
	  DEPCA series.  (This chipset is better known via the NE2100 cards.)

config HPLANCE
	tristate "HP on-board LANCE support"
	depends on DIO
	select CRC32
	---help---
	  If you want to use the builtin "LANCE" Ethernet controller on an
	  HP300 machine, say Y here.

config MIPS_AU1X00_ENET
	tristate "MIPS AU1000 Ethernet support"
	depends on MIPS_ALCHEMY
	select PHYLIB
	select CRC32
	---help---
	  If you have an Alchemy Semi AU1X00 based system
	  say Y.  Otherwise, say N.

config MVME147_NET
	tristate "MVME147 (LANCE) Ethernet support"
	depends on MVME147
	select CRC32
	---help---
	  Support for the on-board Ethernet interface on the Motorola MVME147
	  single-board computer.  Say Y here to include the
	  driver for this chip in your kernel.
	  To compile this driver as a module, choose M here.

config PCMCIA_NMCLAN
	tristate "New Media PCMCIA support"
	depends on PCMCIA
	help
	  Say Y here if you intend to attach a New Media Ethernet or LiveWire
	  PCMCIA (PC-card) Ethernet card to your computer.

	  To compile this driver as a module, choose M here: the module will be
	  called nmclan_cs.  If unsure, say N.

config NI65
	tristate "NI6510 support"
	depends on ISA && ISA_DMA_API && !ARM
	---help---
	  If you have a network (Ethernet) card of this type, say Y here.

	  To compile this driver as a module, choose M here. The module
	  will be called ni65.

config SUN3LANCE
	tristate "Sun3/Sun3x on-board LANCE support"
	depends on (SUN3 || SUN3X)
	---help---
	  Most Sun3 and Sun3x motherboards (including the 3/50, 3/60 and 3/80)
	  featured an AMD LANCE 10Mbit Ethernet controller on board; say Y
	  here to compile in the Linux driver for this and enable Ethernet.
	  General Linux information on the Sun 3 and 3x series (now
	  discontinued) is at
	  <http://www.angelfire.com/ca2/tech68k/sun3.html>.

	  If you're not building a kernel for a Sun 3, say N.

config SUNLANCE
	tristate "Sun LANCE support"
	depends on SBUS
	select CRC32
	---help---
	  This driver supports the "le" interface present on all 32-bit Sparc
	  systems, on some older Ultra systems and as an Sbus option.  These
	  cards are based on the AMD LANCE chipset, which is better known
	  via the NE2100 cards.

	  To compile this driver as a module, choose M here: the module
	  will be called sunlance.

config AMD_XGBE
	tristate "AMD 10GbE Ethernet driver"
	depends on ((OF_NET && OF_ADDRESS) || ACPI || PCI) && HAS_IOMEM && HAS_DMA
	depends on X86 || ARM64 || COMPILE_TEST
	select BITREVERSE
	select CRC32
	select PTP_1588_CLOCK
	select PHYLIB
	select AMD_XGBE_HAVE_ECC if X86
	---help---
	  This driver supports the AMD 10GbE Ethernet device found on an
	  AMD SoC.

	  To compile this driver as a module, choose M here: the module
	  will be called amd-xgbe.

config AMD_XGBE_DCB
	bool "Data Center Bridging (DCB) support"
	default n
	depends on AMD_XGBE && DCB
	---help---
	  Say Y here to enable Data Center Bridging (DCB) support in the
	  driver.

	  If unsure, say N.

config AMD_XGBE_HAVE_ECC
	bool
	default n

endif # NET_VENDOR_AMD
```

## drivers/net/ethernet/apm/Kconfig
```kconfig
# SPDX-License-Identifier: GPL-2.0-only
source "drivers/net/ethernet/apm/xgene/Kconfig"
source "drivers/net/ethernet/apm/xgene-v2/Kconfig"
```

## drivers/net/ethernet/apm/xgene-v2/Kconfig
```kconfig
config NET_XGENE_V2
	tristate "APM X-Gene SoC Ethernet-v2 Driver"
	depends on ARCH_XGENE || COMPILE_TEST
	help
	  This is the Ethernet driver for the on-chip ethernet interface
	  which uses a linked list of DMA descriptor architecture (v2) for
	  APM X-Gene SoCs.

	  To compile this driver as a module, choose M here. This module will
	  be called xgene-enet-v2.
```

## drivers/net/ethernet/apm/xgene/Kconfig
```kconfig
config NET_XGENE
	tristate "APM X-Gene SoC Ethernet Driver"
	depends on HAS_DMA
	depends on ARCH_XGENE || COMPILE_TEST
	select PHYLIB
	select MDIO_XGENE
	select GPIOLIB
	help
	  This is the Ethernet driver for the on-chip ethernet interface on the
	  APM X-Gene SoC.

	  To compile this driver as a module, choose M here. This module will
	  be called xgene_enet.
```

## drivers/net/ethernet/apple/Kconfig
```kconfig
# SPDX-License-Identifier: GPL-2.0-only
#
# Apple device configuration
#

config NET_VENDOR_APPLE
	bool "Apple devices"
	default y
	depends on (PPC_PMAC && PPC32) || MAC
	help
	  If you have a network (Ethernet) card belonging to this class, say Y.

	  Note that the answer to this question doesn't directly affect the
	  kernel: saying N will just cause the configurator to skip all the
	  questions about Apple devices. If you say Y, you will be asked for
	  your specific card in the following questions.

if NET_VENDOR_APPLE

config MACE
	tristate "MACE (Power Mac ethernet) support"
	depends on PPC_PMAC && PPC32
	select CRC32
	help
	  Power Macintoshes and clones with Ethernet built-in on the
	  motherboard will usually use a MACE (Medium Access Control for
	  Ethernet) interface. Say Y to include support for the MACE chip.

	  To compile this driver as a module, choose M here: the module
	  will be called mace.

config MACE_AAUI_PORT
	bool "Use AAUI port instead of TP by default"
	depends on MACE
	help
	  Some Apple machines (notably the Apple Network Server) which use the
	  MACE ethernet chip have an Apple AUI port (small 15-pin connector),
	  instead of an 8-pin RJ45 connector for twisted-pair ethernet.  Say
	  Y here if you have such a machine.  If unsure, say N.
	  The driver will default to AAUI on ANS anyway, and if you use it as
	  a module, you can provide the port_aaui=0|1 to force the driver.

config BMAC
	tristate "BMAC (G3 ethernet) support"
	depends on PPC_PMAC && PPC32
	select CRC32
	help
	  Say Y for support of BMAC Ethernet interfaces. These are used on G3
	  computers.

	  To compile this driver as a module, choose M here: the module
	  will be called bmac.

config MACMACE
	tristate "Macintosh (AV) onboard MACE ethernet"
	depends on MAC
	select CRC32
	help
	  Support for the onboard AMD 79C940 MACE Ethernet controller used in
	  the 660AV and 840AV Macintosh.  If you have one of these Macintoshes
	  say Y here.

endif # NET_VENDOR_APPLE
```

## drivers/net/ethernet/aquantia/Kconfig
```kconfig
#
# aQuantia device configuration
#

config NET_VENDOR_AQUANTIA
	bool "aQuantia devices"
	default y
	---help---
	  Set this to y if you have an Ethernet network cards that uses the aQuantia
	  AQC107/AQC108 chipset.

	  This option does not build any drivers; it causes the aQuantia
	  drivers that can be built to appear in the list of Ethernet drivers.


if NET_VENDOR_AQUANTIA

config AQTION
	tristate "aQuantia AQtion(tm) Support"
	depends on PCI
	depends on X86_64 || ARM64 || COMPILE_TEST
	---help---
	  This enables the support for the aQuantia AQtion(tm) Ethernet card.

endif # NET_VENDOR_AQUANTIA
```

## drivers/net/ethernet/arc/Kconfig
```kconfig
#
# ARC EMAC network device configuration
#

config NET_VENDOR_ARC
	bool "ARC devices"
	default y
	---help---
	  If you have a network (Ethernet) card belonging to this class, say Y.

	  Note that the answer to this question doesn't directly affect the
	  kernel: saying N will just cause the configurator to skip all
	  the questions about ARC cards. If you say Y, you will be asked for
	  your specific card in the following questions.

if NET_VENDOR_ARC

config ARC_EMAC_CORE
	tristate
	depends on ARC || ARCH_ROCKCHIP || COMPILE_TEST
	select MII
	select PHYLIB

config ARC_EMAC
	tristate "ARC EMAC support"
	select ARC_EMAC_CORE
	depends on OF_IRQ && OF_NET
	depends on ARC || COMPILE_TEST
	---help---
	  On some legacy ARC (Synopsys) FPGA boards such as ARCAngel4/ML50x
	  non-standard on-chip ethernet device ARC EMAC 10/100 is used.
	  Say Y here if you have such a board.  If unsure, say N.

config EMAC_ROCKCHIP
	tristate "Rockchip EMAC support"
	select ARC_EMAC_CORE
	depends on OF_IRQ && OF_NET && REGULATOR
	depends on ARCH_ROCKCHIP || COMPILE_TEST
	---help---
	  Support for Rockchip RK3036/RK3066/RK3188 EMAC ethernet controllers.
	  This selects Rockchip SoC glue layer support for the
	  emac device driver. This driver is used for RK3036/RK3066/RK3188
	  EMAC ethernet controller.

endif # NET_VENDOR_ARC
```

## drivers/net/ethernet/asix/Kconfig
```kconfig
#
# Asix network device configuration
#

config NET_VENDOR_ASIX
	bool "Asix devices"
	default y
	help
	  If you have a network (Ethernet, non-USB, not NE2000 compatible)
	  interface based on a chip from ASIX, say Y.

if NET_VENDOR_ASIX

config SPI_AX88796C
	tristate "Asix AX88796C-SPI support"
	select PHYLIB
	depends on SPI
	depends on GPIOLIB
	help
	  Say Y here if you intend to use ASIX AX88796C attached in SPI mode.

config SPI_AX88796C_COMPRESSION
	bool "SPI transfer compression"
	default n
	depends on SPI_AX88796C
	help
	  Say Y here to enable SPI transfer compression. It saves up
	  to 24 dummy cycles during each transfer which may noticeably
	  speed up short transfers. This sets the default value that is
	  inherited by network interfaces during probe. It can be
	  changed at run time via spi-compression ethtool tunable.

	  If unsure say N.

endif # NET_VENDOR_ASIX
```

## drivers/net/ethernet/atheros/Kconfig
```kconfig
#
# Atheros device configuration
#

config NET_VENDOR_ATHEROS
	bool "Atheros devices"
	default y
	depends on PCI
	---help---
	  If you have a network (Ethernet) card belonging to this class, say Y.

	  Note that the answer to this question doesn't directly affect the
	  kernel: saying N will just cause the configurator to skip all
	  the questions about Atheros devices. If you say Y, you will be asked
	  for your specific card in the following questions.

if NET_VENDOR_ATHEROS

config ATL2
	tristate "Atheros L2 Fast Ethernet support"
	depends on PCI
	select CRC32
	select MII
	---help---
	  This driver supports the Atheros L2 fast ethernet adapter.

	  To compile this driver as a module, choose M here.  The module
	  will be called atl2.

config ATL1
	tristate "Atheros/Attansic L1 Gigabit Ethernet support"
	depends on PCI
	select CRC32
	select MII
	---help---
	  This driver supports the Atheros/Attansic L1 gigabit ethernet
	  adapter.

	  To compile this driver as a module, choose M here.  The module
	  will be called atl1.

config ATL1E
	tristate "Atheros L1E Gigabit Ethernet support"
	depends on PCI
	select CRC32
	select MII
	---help---
	  This driver supports the Atheros L1E gigabit ethernet adapter.

	  To compile this driver as a module, choose M here.  The module
	  will be called atl1e.

config ATL1C
	tristate "Atheros L1C Gigabit Ethernet support"
	depends on PCI
	select CRC32
	select MII
	---help---
	  This driver supports the Atheros L1C gigabit ethernet adapter.

	  To compile this driver as a module, choose M here.  The module
	  will be called atl1c.

config ALX
	tristate "Qualcomm Atheros AR816x/AR817x support"
	depends on PCI
	select CRC32
	select MDIO
	help
	  This driver supports the Qualcomm Atheros L1F ethernet adapter,
	  i.e. the following chipsets:

	  1969:1091 - AR8161 Gigabit Ethernet
	  1969:1090 - AR8162 Fast Ethernet
	  1969:10A1 - AR8171 Gigabit Ethernet
	  1969:10A0 - AR8172 Fast Ethernet

	  To compile this driver as a module, choose M here.  The module
	  will be called alx.

endif # NET_VENDOR_ATHEROS
```

## drivers/net/ethernet/aurora/Kconfig
```kconfig
# SPDX-License-Identifier: GPL-2.0-only
config NET_VENDOR_AURORA
	bool "Aurora VLSI devices"
	default y
	help
	  If you have a network (Ethernet) device belonging to this class,
	  say Y.

	  Note that the answer to this question doesn't directly affect the
	  kernel: saying N will just cause the configurator to skip all
	  questions about Aurora devices. If you say Y, you will be asked
	  for your specific device in the following questions.

if NET_VENDOR_AURORA

config AURORA_NB8800
	tristate "Aurora AU-NB8800 support"
	depends on HAS_DMA
	select PHYLIB
	help
	 Support for the AU-NB8800 gigabit Ethernet controller.

endif
```
