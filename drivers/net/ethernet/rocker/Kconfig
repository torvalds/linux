## drivers/net/ethernet/rocker/Kconfig
```kconfig
# SPDX-License-Identifier: GPL-2.0-only
#
# Rocker device configuration
#

config NET_VENDOR_ROCKER
	bool "Rocker devices"
	default y
	help
	  If you have a network device belonging to this class, say Y.

	  Note that the answer to this question doesn't directly affect the
	  kernel: saying N will just cause the configurator to skip all
	  the questions about Rocker devices. If you say Y, you will be asked for
	  your specific card in the following questions.

if NET_VENDOR_ROCKER

config ROCKER
	tristate "Rocker switch driver (EXPERIMENTAL)"
	depends on PCI && NET_SWITCHDEV && BRIDGE
	select CRC32
	help
	  This driver supports Rocker switch device.

	  To compile this driver as a module, choose M here: the
	  module will be called rocker.

endif # NET_VENDOR_ROCKER
```

## drivers/net/ethernet/samsung/Kconfig
```kconfig
#
# Samsung Ethernet device configuration
#

config NET_VENDOR_SAMSUNG
	bool "Samsung Ethernet devices"
	default y
	---help---
	  If you have a network (Ethernet) chipset belonging to this class,
	  say Y.

	  Note that the answer to this question does not directly affect
	  the kernel: saying N will just case the configurator to skip all
	  the questions about Samsung chipsets. If you say Y, you will be asked
	  for your specific chipset/driver in the following questions.

if NET_VENDOR_SAMSUNG

config SXGBE_ETH
	tristate "Samsung 10G/2.5G/1G SXGBE Ethernet driver"
	depends on HAS_IOMEM && HAS_DMA
	select PHYLIB
	select CRC32
	imply PTP_1588_CLOCK
	---help---
	  This is the driver for the SXGBE 10G Ethernet IP block found on
	  Samsung platforms.

	  To compile this driver as a module, choose M here: the module
	  will be called samsung-sxgbe.

endif # NET_VENDOR_SAMSUNG
```

## drivers/net/ethernet/samsung/sxgbe/Kconfig
```kconfig
config SXGBE_ETH
	tristate "Samsung 10G/2.5G/1G SXGBE Ethernet driver"
	depends on HAS_IOMEM && HAS_DMA
	select PHYLIB
	select CRC32
	select PTP_1588_CLOCK
	---help---
	  This is the driver for the SXGBE 10G Ethernet IP block found on Samsung
	  platforms.
```

## drivers/net/ethernet/seeq/Kconfig
```kconfig
# SPDX-License-Identifier: GPL-2.0-only
#
# SEEQ device configuration
#

config NET_VENDOR_SEEQ
	bool "SEEQ devices"
	default y
	depends on HAS_IOMEM
	---help---
	  If you have a network (Ethernet) card belonging to this class, say Y.

	  Note that the answer to this question doesn't directly affect the
	  kernel: saying N will just cause the configurator to skip all
	  the questions about SEEQ devices. If you say Y, you will be asked for
	  your specific card in the following questions.

if NET_VENDOR_SEEQ

config ARM_ETHER3
	tristate "Acorn/ANT Ether3 support"
	depends on ARM && ARCH_ACORN
	---help---
	  If you have an Acorn system with one of these network cards, you
	  should say Y to this option if you wish to use it with Linux.

config SGISEEQ
	tristate "SGI Seeq ethernet controller support"
	depends on SGI_HAS_SEEQ
	---help---
	  Say Y here if you have an Seeq based Ethernet network card. This is
	  used in many Silicon Graphics machines.

endif # NET_VENDOR_SEEQ
```

## drivers/net/ethernet/sfc/Kconfig
```kconfig
# SPDX-License-Identifier: GPL-2.0-only
#
# Solarflare device configuration
#

config NET_VENDOR_SOLARFLARE
	bool "Solarflare devices"
	default y
	help
	  If you have a network (Ethernet) card belonging to this class, say Y.

	  Note that the answer to this question doesn't directly affect the
	  kernel: saying N will just cause the configurator to skip all
	  the questions about Solarflare devices. If you say Y, you will be asked
	  for your specific card in the following questions.

if NET_VENDOR_SOLARFLARE

config SFC
	tristate "Solarflare SFC9000/SFC9100-family support"
	depends on PCI
	select MDIO
	select CRC32
	imply PTP_1588_CLOCK
	help
	  This driver supports 10/40-gigabit Ethernet cards based on
	  the Solarflare SFC9000-family and SFC9100-family controllers.

	  To compile this driver as a module, choose M here.  The module
	  will be called sfc.
config SFC_MTD
	bool "Solarflare SFC9000/SFC9100-family MTD support"
	depends on SFC && MTD && !(SFC=y && MTD=m)
	default y
	help
	  This exposes the on-board flash and/or EEPROM as MTD devices
	  (e.g. /dev/mtd1).  This is required to update the firmware or
	  the boot configuration under Linux.
config SFC_MCDI_MON
	bool "Solarflare SFC9000/SFC9100-family hwmon support"
	depends on SFC && HWMON && !(SFC=y && HWMON=m)
	default y
	help
	  This exposes the on-board firmware-managed sensors as a
	  hardware monitor device.
config SFC_SRIOV
	bool "Solarflare SFC9000-family SR-IOV support"
	depends on SFC && PCI_IOV
	default y
	help
	  This enables support for the SFC9000 I/O Virtualization
	  features, allowing accelerated network performance in
	  virtualized environments.
config SFC_MCDI_LOGGING
	bool "Solarflare SFC9000/SFC9100-family MCDI logging support"
	depends on SFC
	default y
	help
	  This enables support for tracing of MCDI (Management-Controller-to-
	  Driver-Interface) commands and responses, allowing debugging of
	  driver/firmware interaction.  The tracing is actually enabled by
	  a sysfs file 'mcdi_logging' under the PCI device.

source "drivers/net/ethernet/sfc/falcon/Kconfig"

endif # NET_VENDOR_SOLARFLARE
```

## drivers/net/ethernet/sfc/falcon/Kconfig
```kconfig
# SPDX-License-Identifier: GPL-2.0-only
config SFC_FALCON
	tristate "Solarflare SFC4000 support"
	depends on PCI
	select MDIO
	select CRC32
	select I2C
	select I2C_ALGOBIT
	---help---
	  This driver supports 10-gigabit Ethernet cards based on
	  the Solarflare SFC4000 controller.

	  To compile this driver as a module, choose M here.  The module
	  will be called sfc-falcon.
config SFC_FALCON_MTD
	bool "Solarflare SFC4000 MTD support"
	depends on SFC_FALCON && MTD && !(SFC_FALCON=y && MTD=m)
	default y
	---help---
	  This exposes the on-board flash and/or EEPROM as MTD devices
	  (e.g. /dev/mtd1).  This is required to update the boot
	  configuration under Linux.
```

## drivers/net/ethernet/sfc/siena/Kconfig
```kconfig
# SPDX-License-Identifier: GPL-2.0-only
config SFC_SIENA
	tristate "Solarflare SFC9000 support"
	depends on PCI
	select MDIO
	select CRC32
	help
	  This driver supports 10-gigabit Ethernet cards based on
	  the Solarflare SFC9000 controller.

	  To compile this driver as a module, choose M here.  The module
	  will be called sfc-siena.
config SFC_SIENA_MTD
	bool "Solarflare SFC9000-family MTD support"
	depends on SFC_SIENA && MTD && !(SFC_SIENA=y && MTD=m)
	default y
	help
	  This exposes the on-board flash and/or EEPROM as MTD devices
	  (e.g. /dev/mtd1).  This is required to update the firmware or
	  the boot configuration under Linux.
config SFC_SIENA_MCDI_MON
	bool "Solarflare SFC9000-family hwmon support"
	depends on SFC_SIENA && HWMON && !(SFC_SIENA=y && HWMON=m)
	default y
	help
	  This exposes the on-board firmware-managed sensors as a
	  hardware monitor device.
config SFC_SIENA_SRIOV
	bool "Solarflare SFC9000-family SR-IOV support"
	depends on SFC_SIENA && PCI_IOV
	default n
	help
	  This enables support for the Single Root I/O Virtualization
	  features, allowing accelerated network performance in
	  virtualized environments.
config SFC_SIENA_MCDI_LOGGING
	bool "Solarflare SFC9000-family MCDI logging support"
	depends on SFC_SIENA
	default y
	help
	  This enables support for tracing of MCDI (Management-Controller-to-
	  Driver-Interface) commands and responses, allowing debugging of
	  driver/firmware interaction.  The tracing is actually enabled by
	  a sysfs file 'mcdi_logging' under the PCI device, or via module
	  parameter mcdi_logging_default.
```

## drivers/net/ethernet/sgi/Kconfig
```kconfig
# SPDX-License-Identifier: GPL-2.0-only
#
# SGI device configuration
#

config NET_VENDOR_SGI
	bool "SGI devices"
	default y
	depends on (PCI && SGI_MFD_IOC3) ||  SGI_IP32
	help
	  If you have a network (Ethernet) card belonging to this class, say Y.

	  Note that the answer to this question doesn't directly affect the
	  kernel: saying N will just cause the configurator to skip all
	  the questions about SGI devices. If you say Y, you will be asked for
	  your specific card in the following questions.

if NET_VENDOR_SGI

config SGI_IOC3_ETH
	bool "SGI IOC3 Ethernet"
	depends on PCI && SGI_MFD_IOC3
	select CRC16
	select CRC32
	select MII
	help
	  If you have a network (Ethernet) card of this type, say Y here.

config SGI_O2MACE_ETH
	tristate "SGI O2 MACE Fast Ethernet support"
	depends on SGI_IP32=y

endif # NET_VENDOR_SGI
```

## drivers/net/ethernet/silan/Kconfig
```kconfig
#
# Silan device configuration
#

config NET_VENDOR_SILAN
	bool "Silan devices"
	default y
	depends on PCI
	---help---
	  If you have a network (Ethernet) card belonging to this class, say Y
	  and read the Ethernet-HOWTO, available from
	  <http://www.tldp.org/docs.html#howto>.

	  Note that the answer to this question doesn't directly affect the
	  kernel: saying N will just cause the configurator to skip all
	  the questions about Silan devices. If you say Y, you will be asked for
	  your specific card in the following questions.

if NET_VENDOR_SILAN

config SC92031
	tristate "Silan SC92031 PCI Fast Ethernet Adapter driver"
	depends on PCI
	select CRC32
	---help---
	  This is a driver for the Fast Ethernet PCI network cards based on
	  the Silan SC92031 chip (sometimes also called Rsltek 8139D). If you
	  have one of these, say Y here.

	  To compile this driver as a module, choose M here: the module
	  will be called sc92031.  This is recommended.

endif # NET_VENDOR_SILAN
```

## drivers/net/ethernet/sis/Kconfig
```kconfig
#
# Silicon Integrated Systems (SiS) device configuration
#

config NET_VENDOR_SIS
	bool "Silicon Integrated Systems (SiS) devices"
	default y
	depends on PCI
	---help---
	  If you have a network (Ethernet) card belonging to this class, say Y
	  and read the Ethernet-HOWTO, available from
	  <http://www.tldp.org/docs.html#howto>.

	  Note that the answer to this question doesn't directly affect the
	  kernel: saying N will just cause the configurator to skip all
	  the questions about SiS devices. If you say Y, you will be asked for
	  your specific card in the following questions.

if NET_VENDOR_SIS

config SIS900
	tristate "SiS 900/7016 PCI Fast Ethernet Adapter support"
	depends on PCI
	select CRC32
	select NET_CORE
	select MII
	---help---
	  This is a driver for the Fast Ethernet PCI network cards based on
	  the SiS 900 and SiS 7016 chips. The SiS 900 core is also embedded in
	  SiS 630 and SiS 540 chipsets.

	  This driver also supports AMD 79C901 HomePNA so that you can use
	  your phone line as a network cable.

	  To compile this driver as a module, choose M here: the module
	  will be called sis900.  This is recommended.

config SIS190
	tristate "SiS190/SiS191 gigabit ethernet support"
	depends on PCI
	select CRC32
	select NET_CORE
	select MII
	---help---
	  Say Y here if you have a SiS 190 PCI Fast Ethernet adapter or
	  a SiS 191 PCI Gigabit Ethernet adapter. Both are expected to
	  appear in lan on motherboard designs which are based on SiS 965
	  and SiS 966 south bridge.

	  To compile this driver as a module, choose M here: the module
	  will be called sis190.  This is recommended.

endif # NET_VENDOR_SIS
```

## drivers/net/ethernet/socionext/Kconfig
```kconfig
config NET_VENDOR_SOCIONEXT
	bool "Socionext ethernet drivers"
	default y
	---help---
	  Option to select ethernet drivers for Socionext platforms.

	  Note that the answer to this question doesn't directly affect the
	  kernel: saying N will just cause the configurator to skip all
	  the questions about Socionext devices. If you say Y, you will be asked
	  for your specific card in the following questions.

if NET_VENDOR_SOCIONEXT

config SNI_AVE
	tristate "Socionext AVE ethernet support"
	depends on (ARCH_UNIPHIER || COMPILE_TEST) && OF
	depends on HAS_IOMEM
	select MFD_SYSCON
	select PHYLIB
	---help---
	  Driver for gigabit ethernet MACs, called AVE, in the
	  Socionext UniPhier family.

config SNI_NETSEC
	tristate "Socionext NETSEC ethernet support"
	depends on (ARCH_SYNQUACER || COMPILE_TEST) && OF
	select PHYLIB
	select MII
	---help---
	  Enable to add support for the SocioNext NetSec Gigabit Ethernet
	  controller + PHY, as found on the Synquacer SC2A11 SoC

	  To compile this driver as a module, choose M here: the module will be
	  called netsec.  If unsure, say N.

endif #NET_VENDOR_SOCIONEXT
```

## drivers/net/ethernet/spacemit/Kconfig
```kconfig
config NET_VENDOR_SPACEMIT
	bool "SpacemiT devices"
	default y
	depends on ARCH_SPACEMIT || COMPILE_TEST
	help
	  If you have a network (Ethernet) device belonging to this class,
	  say Y.

	  Note that the answer to this question does not directly affect
	  the kernel: saying N will just cause the configurator to skip all
	  the questions regarding SpacemiT devices. If you say Y, you will
	  be asked for your specific chipset/driver in the following questions.

if NET_VENDOR_SPACEMIT

config SPACEMIT_K1_EMAC
	tristate "SpacemiT K1 Ethernet MAC driver"
	depends on ARCH_SPACEMIT || COMPILE_TEST
	depends on MFD_SYSCON
	depends on OF
	default m if ARCH_SPACEMIT
	select PHYLIB
	help
	  This driver supports the Ethernet MAC in the SpacemiT K1 SoC.

	  To compile this driver as a module, choose M here: the module
	  will be called k1_emac.

endif # NET_VENDOR_SPACEMIT
```

## drivers/net/ethernet/stmicro/Kconfig
```kconfig
# SPDX-License-Identifier: GPL-2.0-only
#
# STMicroelectronics device configuration
#

config NET_VENDOR_STMICRO
	bool "STMicroelectronics devices"
	default y
	depends on HAS_IOMEM
	---help---
	  If you have a network (Ethernet) card based on Synopsys Ethernet IP
	  Cores, say Y.

	  Note that the answer to this question doesn't directly affect the
	  kernel: saying N will just cause the configurator to skip all
	  the questions about STMicroelectronics cards. If you say Y, you will
	  be asked for your specific card in the following questions.

if NET_VENDOR_STMICRO

source "drivers/net/ethernet/stmicro/stmmac/Kconfig"

endif # NET_VENDOR_STMICRO
```
