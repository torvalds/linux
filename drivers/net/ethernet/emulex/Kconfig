## drivers/net/ethernet/emulex/Kconfig
```kconfig
#
# Emulex driver configuration
#

config NET_VENDOR_EMULEX
	bool "Emulex devices"
	default y
	depends on PCI
	---help---
	  If you have a network (Ethernet) card belonging to this class, say Y.

	  Note that the answer to this question doesn't directly affect the
	  kernel: saying N will just cause the configurator to skip all
	  the questions about Emulex cards. If you say Y, you will be asked for
	  your specific card in the following questions.

if NET_VENDOR_EMULEX

source "drivers/net/ethernet/emulex/benet/Kconfig"

endif # NET_VENDOR_EMULEX
```

## drivers/net/ethernet/emulex/benet/Kconfig
```kconfig
# SPDX-License-Identifier: GPL-2.0-only
config BE2NET
	tristate "ServerEngines' 10Gbps NIC - BladeEngine"
	depends on PCI
	help
	  This driver implements the NIC functionality for ServerEngines'
	  10Gbps network adapter - BladeEngine.

config BE2NET_HWMON
	bool "HWMON support for be2net driver"
	depends on BE2NET && HWMON
	depends on !(BE2NET=y && HWMON=m)
	default y
	help
	  Say Y here if you want to expose thermal sensor data on
	  be2net network adapter.

config BE2NET_BE2
	bool "Support for BE2 chipsets"
	depends on BE2NET
	default y
	help
	  Say Y here if you want to use devices based on BE2
	  chipsets. (e.g. OneConnect OCe10xxx)

config BE2NET_BE3
	bool "Support for BE3 chipsets"
	depends on BE2NET
	default y
	help
	  Say Y here if you want to use devices based on BE3
	  chipsets. (e.g. OneConnect OCe11xxx)

config BE2NET_LANCER
	bool "Support for Lancer chipsets"
	depends on BE2NET
	default y
	help
	  Say Y here if you want to use devices based on Lancer
	  chipsets. (e.g LightPulse LPe12xxx)

config BE2NET_SKYHAWK
	bool "Support for Skyhawk chipsets"
	depends on BE2NET
	default y
	help
	  Say Y here if you want to use devices based on Skyhawk
	  chipsets. (e.g. OneConnect OCe14xxx)

comment "WARNING: be2net is useless without any enabled chip"
	depends on BE2NET_BE2=n && BE2NET_BE3=n && BE2NET_LANCER=n && \
	BE2NET_SKYHAWK=n && BE2NET
```

## drivers/net/ethernet/engleder/Kconfig
```kconfig
# SPDX-License-Identifier: GPL-2.0
#
# Engleder network device configuration
#

config NET_VENDOR_ENGLEDER
	bool "Engleder devices"
	default y
	help
	  If you have a network (Ethernet) card belonging to this class, say Y.

	  Note that the answer to this question doesn't directly affect the
	  kernel: saying N will just cause the configurator to skip all
	  the questions about Engleder devices. If you say Y, you will be asked
	  for your specific card in the following questions.

if NET_VENDOR_ENGLEDER

config TSNEP
	tristate "TSN endpoint support"
	depends on HAS_IOMEM && HAS_DMA
	depends on PTP_1588_CLOCK_OPTIONAL
	select PHYLIB
	select PAGE_POOL
	help
	  Support for the Engleder TSN endpoint Ethernet MAC IP Core.

	  To compile this driver as a module, choose M here. The module will be
	  called tsnep.

config TSNEP_SELFTESTS
	bool "TSN endpoint self test support"
	default n
	depends on TSNEP
	help
	  This enables self test support within the TSN endpoint driver.

	  If unsure, say N.

endif # NET_VENDOR_ENGLEDER
```

## drivers/net/ethernet/ezchip/Kconfig
```kconfig
# SPDX-License-Identifier: GPL-2.0-only
#
# EZchip network device configuration
#

config NET_VENDOR_EZCHIP
	bool "EZchip devices"
	default y
	help
	  If you have a network (Ethernet) device belonging to this class, say Y.

	  Note that the answer to this question doesn't directly affect the
	  kernel: saying N will just cause the configurator to skip all
	  the questions about EZchip devices. If you say Y, you will be asked for
	  your specific device in the following questions.

if NET_VENDOR_EZCHIP

config EZCHIP_NPS_MANAGEMENT_ENET
	tristate "EZchip NPS management enet support"
	depends on OF_IRQ
	depends on HAS_IOMEM
	help
	  Simple LAN device for debug or management purposes.
	  Device supports interrupts for RX and TX(completion).
	  Device does not have DMA ability.

endif
```

## drivers/net/ethernet/faraday/Kconfig
```kconfig
# SPDX-License-Identifier: GPL-2.0-only
#
# Faraday device configuration
#

config NET_VENDOR_FARADAY
	bool "Faraday devices"
	default y
	depends on ARM || COMPILE_TEST
	help
	  If you have a network (Ethernet) card belonging to this class, say Y.

	  Note that the answer to this question doesn't directly affect the
	  kernel: saying N will just cause the configurator to skip all
	  the questions about Faraday cards. If you say Y, you will be asked for
	  your specific card in the following questions.

if NET_VENDOR_FARADAY

config FTMAC100
	tristate "Faraday FTMAC100 10/100 Ethernet support"
	depends on ARM || COMPILE_TEST
	depends on !64BIT || BROKEN
	select MII
	help
	  This driver supports the FTMAC100 10/100 Ethernet controller
	  from Faraday. It is used on Faraday A320 and some other ARM SoC's.

config FTGMAC100
	tristate "Faraday FTGMAC100 Gigabit Ethernet support"
	depends on ARM || COMPILE_TEST
	depends on !64BIT || BROKEN
	select PHYLIB
	select MDIO_ASPEED if MACH_ASPEED_G6
	select CRC32
	help
	  This driver supports the FTGMAC100 Gigabit Ethernet controller
	  from Faraday. It is used on Faraday A369 and some other ARM SoC's.

endif # NET_VENDOR_FARADAY
```

## drivers/net/ethernet/freescale/Kconfig
```kconfig
#
# Freescale device configuration
#

config NET_VENDOR_FREESCALE
	bool "Freescale devices"
	default y
	depends on FSL_SOC || QUICC_ENGINE || CPM1 || CPM2 || PPC_MPC512x || \
		   M523x || M527x || M5272 || M528x || M520x || M532x || \
		   ARCH_MXC || ARCH_MXS || (PPC_MPC52xx && PPC_BESTCOMM) || \
		   ARCH_LAYERSCAPE || COMPILE_TEST
	---help---
	  If you have a network (Ethernet) card belonging to this class, say Y.

	  Note that the answer to this question doesn't directly affect the
	  kernel: saying N will just cause the configurator to skip all
	  the questions about Freescale devices. If you say Y, you will be
	  asked for your specific card in the following questions.

if NET_VENDOR_FREESCALE

config FEC
	tristate "FEC ethernet controller (of ColdFire and some i.MX CPUs)"
	depends on (M523x || M527x || M5272 || M528x || M520x || M532x || \
		   ARCH_MXC || SOC_IMX28 || COMPILE_TEST)
	default ARCH_MXC || SOC_IMX28 if ARM
	select PHYLIB
	imply PTP_1588_CLOCK
	---help---
	  Say Y here if you want to use the built-in 10/100 Fast ethernet
	  controller on some Motorola ColdFire and Freescale i.MX processors.

config FEC_MPC52xx
	tristate "FEC MPC52xx driver"
	depends on PPC_MPC52xx && PPC_BESTCOMM
	select CRC32
	select PHYLIB
	select PPC_BESTCOMM_FEC
	---help---
	  This option enables support for the MPC5200's on-chip
	  Fast Ethernet Controller
	  If compiled as module, it will be called fec_mpc52xx.

config FEC_MPC52xx_MDIO
	bool "FEC MPC52xx MDIO bus driver"
	depends on FEC_MPC52xx
	default y
	---help---
	  The MPC5200's FEC can connect to the Ethernet either with
	  an external MII PHY chip or 10 Mbps 7-wire interface
	  (Motorola? industry standard).
	  If your board uses an external PHY connected to FEC, enable this.
	  If not sure, enable.
	  If compiled as module, it will be called fec_mpc52xx_phy.

source "drivers/net/ethernet/freescale/fs_enet/Kconfig"
source "drivers/net/ethernet/freescale/fman/Kconfig"

config FSL_PQ_MDIO
	tristate "Freescale PQ MDIO"
	select PHYLIB
	---help---
	  This driver supports the MDIO bus used by the gianfar and UCC drivers.

config FSL_XGMAC_MDIO
	tristate "Freescale XGMAC MDIO"
	select PHYLIB
	depends on OF
	select OF_MDIO
	---help---
	  This driver supports the MDIO bus on the Fman 10G Ethernet MACs, and
	  on the FMan mEMAC (which supports both Clauses 22 and 45)

config UCC_GETH
	tristate "Freescale QE Gigabit Ethernet"
	depends on QUICC_ENGINE
	select FSL_PQ_MDIO
	select PHYLIB
	---help---
	  This driver supports the Gigabit Ethernet mode of the QUICC Engine,
	  which is available on some Freescale SOCs.

config UGETH_TX_ON_DEMAND
	bool "Transmit on Demand support"
	depends on UCC_GETH

config GIANFAR
	tristate "Gianfar Ethernet"
	depends on HAS_DMA
	select FSL_PQ_MDIO
	select PHYLIB
	select CRC32
	---help---
	  This driver supports the Gigabit TSEC on the MPC83xx, MPC85xx,
	  and MPC86xx family of chips, the eTSEC on LS1021A and the FEC
	  on the 8540.

source "drivers/net/ethernet/freescale/dpaa/Kconfig"

endif # NET_VENDOR_FREESCALE
```

## drivers/net/ethernet/freescale/dpaa/Kconfig
```kconfig
# SPDX-License-Identifier: GPL-2.0-only
menuconfig FSL_DPAA_ETH
	tristate "DPAA Ethernet"
	depends on FSL_DPAA && FSL_FMAN
	select PHYLINK
	select PCS_LYNX
	help
	  Data Path Acceleration Architecture Ethernet driver,
	  supporting the Freescale QorIQ chips.
	  Depends on Freescale Buffer Manager and Queue Manager
	  driver and Frame Manager Driver.
```

## drivers/net/ethernet/freescale/dpaa2/Kconfig
```kconfig
# SPDX-License-Identifier: GPL-2.0-only
config FSL_DPAA2_ETH
	tristate "Freescale DPAA2 Ethernet"
	depends on FSL_MC_BUS && FSL_MC_DPIO
	select PHYLINK
	select PCS_LYNX
	help
	  This is the DPAA2 Ethernet driver supporting Freescale SoCs
	  with DPAA2 (DataPath Acceleration Architecture v2).
	  The driver manages network objects discovered on the Freescale
	  MC bus.

if FSL_DPAA2_ETH
config FSL_DPAA2_ETH_DCB
	bool "Data Center Bridging (DCB) Support"
	default n
	depends on DCB
	help
	  Enable Priority-Based Flow Control (PFC) support for DPAA2 Ethernet
	  devices.
endif

config FSL_DPAA2_PTP_CLOCK
	tristate "Freescale DPAA2 PTP Clock"
	depends on FSL_DPAA2_ETH && PTP_1588_CLOCK_QORIQ
	default y
	help
	  This driver adds support for using the DPAA2 1588 timer module
	  as a PTP clock.
```

## drivers/net/ethernet/freescale/enetc/Kconfig
```kconfig
# SPDX-License-Identifier: GPL-2.0
config FSL_ENETC_CORE
	tristate
	help
	  This module supports common functionality between the PF and VF
	  drivers for the NXP ENETC controller.

	  If compiled as module (M), the module name is fsl-enetc-core.

config NXP_ENETC_PF_COMMON
	tristate
	help
	  This module supports common functionality between drivers of
	  different versions of NXP ENETC PF controllers.

	  If compiled as module (M), the module name is nxp-enetc-pf-common.

config FSL_ENETC
	tristate "ENETC PF driver"
	depends on PCI_MSI
	select MDIO_DEVRES
	select FSL_ENETC_CORE
	select FSL_ENETC_IERB
	select FSL_ENETC_MDIO
	select NXP_ENETC_PF_COMMON
	select PHYLINK
	select PCS_LYNX
	select DIMLIB
	help
	  This driver supports NXP ENETC gigabit ethernet controller PCIe
	  physical function (PF) devices, managing ENETC Ports at a privileged
	  level.

	  If compiled as module (M), the module name is fsl-enetc.

config NXP_ENETC4
	tristate "ENETC4 PF driver"
	depends on PCI_MSI
	select MDIO_DEVRES
	select FSL_ENETC_CORE
	select FSL_ENETC_MDIO
	select NXP_ENETC_PF_COMMON
	select PHYLINK
	select DIMLIB
	help
	  This driver supports NXP ENETC devices with major revision 4. ENETC is
	  as the NIC functionality in NETC, it supports virtualization/isolation
	  based on PCIe Single Root IO Virtualization (SR-IOV) and a full range
	  of TSN standards and NIC offload capabilities.

	  If compiled as module (M), the module name is nxp-enetc4.

config FSL_ENETC_VF
	tristate "ENETC VF driver"
	depends on PCI_MSI
	select FSL_ENETC_CORE
	select FSL_ENETC_MDIO
	select PHYLINK
	select DIMLIB
	help
	  This driver supports NXP ENETC gigabit ethernet controller PCIe
	  virtual function (VF) devices enabled by the ENETC PF driver.

	  If compiled as module (M), the module name is fsl-enetc-vf.

config FSL_ENETC_IERB
	tristate "ENETC IERB driver"
	help
	  This driver configures the Integrated Endpoint Register Block on NXP
	  LS1028A.

	  If compiled as module (M), the module name is fsl-enetc-ierb.

config FSL_ENETC_MDIO
	tristate "ENETC MDIO driver"
	depends on PCI && MDIO_DEVRES && MDIO_BUS
	help
	  This driver supports NXP ENETC Central MDIO controller as a PCIe
	  physical function (PF) device.

	  If compiled as module (M), the module name is fsl-enetc-mdio.

config FSL_ENETC_PTP_CLOCK
	tristate "ENETC PTP clock driver"
	depends on PTP_1588_CLOCK_QORIQ && (FSL_ENETC || FSL_ENETC_VF)
	default y
	help
	  This driver adds support for using the ENETC 1588 timer
	  as a PTP clock. This clock is only useful if your PTP
	  programs are getting hardware time stamps on the PTP Ethernet
	  packets using the SO_TIMESTAMPING API.

	  If compiled as module (M), the module name is fsl-enetc-ptp.

config FSL_ENETC_QOS
	bool "ENETC hardware Time-sensitive Network support"
	depends on (FSL_ENETC || FSL_ENETC_VF) && (NET_SCH_TAPRIO || NET_SCH_CBS)
	help
	  There are Time-Sensitive Network(TSN) capabilities(802.1Qbv/802.1Qci
	  /802.1Qbu etc.) supported by ENETC. These TSN capabilities can be set
	  enable/disable from user space via Qos commands(tc). In the kernel
	  side, it can be loaded by Qos driver. Currently, it is only support
	  taprio(802.1Qbv) and Credit Based Shaper(802.1Qbu).

config NXP_NETC_BLK_CTRL
	tristate "NETC blocks control driver"
	help
	  This driver configures Integrated Endpoint Register Block (IERB) and
	  Privileged Register Block (PRB) of NETC. For i.MX platforms, it also
	  includes the configuration of NETCMIX block.
	  The IERB contains registers that are used for pre-boot initialization,
	  debug, and non-customer configuration. The PRB controls global reset
	  and global error handling for NETC. The NETCMIX block is mainly used
	  to set MII protocol and PCS protocol of the links, it also contains
	  settings for some other functions.

	  If compiled as module (M), the module name is nxp-netc-blk-ctrl.
```

## drivers/net/ethernet/freescale/fman/Kconfig
```kconfig
# SPDX-License-Identifier: GPL-2.0-only
config FSL_FMAN
	tristate "FMan support"
	depends on FSL_SOC || ARCH_LAYERSCAPE || COMPILE_TEST
	select GENERIC_ALLOCATOR
	select PHYLIB
	default n
	help
		Freescale Data-Path Acceleration Architecture Frame Manager
		(FMan) support

config DPAA_ERRATUM_A050385
	bool
	depends on ARM64 && FSL_DPAA
	default y
	help
		DPAA FMan erratum A050385 software workaround implementation:
		align buffers, data start, SG fragment length to avoid FMan DMA
		splits.
		FMAN DMA read or writes under heavy traffic load may cause FMAN
		internal resource leak thus stopping further packet processing.
		The FMAN internal queue can overflow when FMAN splits single
		read or write transactions into multiple smaller transactions
		such that more than 17 AXI transactions are in flight from FMAN
		to interconnect. When the FMAN internal queue overflows, it can
		stall further packet processing. The issue can occur with any
		one of the following three conditions:
		1. FMAN AXI transaction crosses 4K address boundary (Errata
		A010022)
		2. FMAN DMA address for an AXI transaction is not 16 byte
		aligned, i.e. the last 4 bits of an address are non-zero
		3. Scatter Gather (SG) frames have more than one SG buffer in
		the SG list and any one of the buffers, except the last
		buffer in the SG list has data size that is not a multiple
		of 16 bytes, i.e., other than 16, 32, 48, 64, etc.
		With any one of the above three conditions present, there is
		likelihood of stalled FMAN packet processing, especially under
		stress with multiple ports injecting line-rate traffic.
```
