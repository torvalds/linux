## drivers/net/ethernet/fujitsu/Kconfig
```kconfig
# SPDX-License-Identifier: GPL-2.0-only
#
# Fujitsu Network device configuration
#

config NET_VENDOR_FUJITSU
	bool "Fujitsu devices"
	default y
	depends on PCMCIA
	help
	  If you have a network (Ethernet) card belonging to this class, say Y.

	  Note that the answer to this question doesn't directly affect the
	  the questions about Fujitsu cards. If you say Y, you will be asked for
	  your specific card in the following questions.

if NET_VENDOR_FUJITSU

config PCMCIA_FMVJ18X
	tristate "Fujitsu FMV-J18x PCMCIA support"
	depends on PCMCIA
	select CRC32
	help
	  Say Y here if you intend to attach a Fujitsu FMV-J18x or compatible
	  PCMCIA (PC-card) Ethernet card to your computer.

	  To compile this driver as a module, choose M here: the module will be
	  called fmvj18x_cs.  If unsure, say N.

endif # NET_VENDOR_FUJITSU
```

## drivers/net/ethernet/fungible/Kconfig
```kconfig
# SPDX-License-Identifier: GPL-2.0-only
#
# Fungible network driver configuration
#

config NET_VENDOR_FUNGIBLE
	bool "Fungible devices"
	default y
	help
	  If you have a Fungible network device, say Y.

	  Note that the answer to this question doesn't directly affect the
	  kernel: saying N will just cause the configurator to skip all
	  the questions about Fungible cards. If you say Y, you will be asked
	  for your specific card in the following questions.

if NET_VENDOR_FUNGIBLE

config FUN_CORE
	tristate
	select SBITMAP
	help
	  A service module offering basic common services to Fungible
	  device drivers.

source "drivers/net/ethernet/fungible/funeth/Kconfig"

endif # NET_VENDOR_FUNGIBLE
```

## drivers/net/ethernet/fungible/funeth/Kconfig
```kconfig
# SPDX-License-Identifier: GPL-2.0-only
#
# Fungible Ethernet driver configuration
#

config FUN_ETH
	tristate "Fungible Ethernet device driver"
	depends on PCI && PCI_MSI
	depends on TLS && TLS_DEVICE || TLS_DEVICE=n
	select NET_DEVLINK
	select FUN_CORE
	help
	  This driver supports the Ethernet functionality of Fungible adapters.
	  It works with both physical and virtual functions.

	  To compile this driver as a module, choose M here. The module
          will be called funeth.
```

## drivers/net/ethernet/google/Kconfig
```kconfig
#
# Google network device configuration
#

config NET_VENDOR_GOOGLE
	bool "Google Devices"
	default y
	help
	  If you have a network (Ethernet) device belonging to this class, say Y.

	  Note that the answer to this question doesn't directly affect the
	  kernel: saying N will just cause the configurator to skip all
	  the questions about Google devices. If you say Y, you will be asked
	  for your specific device in the following questions.

if NET_VENDOR_GOOGLE

config GVE
	tristate "Google Virtual NIC (gVNIC) support"
	depends on (PCI_MSI && (X86 || CPU_LITTLE_ENDIAN))
	select PAGE_POOL
	help
	  This driver supports Google Virtual NIC (gVNIC)"

	  To compile this driver as a module, choose M here.
	  The module will be called gve.

endif #NET_VENDOR_GOOGLE
```

## drivers/net/ethernet/hisilicon/Kconfig
```kconfig
#
# HISILICON device configuration
#

config NET_VENDOR_HISILICON
	bool "Hisilicon devices"
	default y
	depends on OF || ACPI
	depends on ARM || ARM64 || COMPILE_TEST
	---help---
	  If you have a network (Ethernet) card belonging to this class, say Y.

	  Note that the answer to this question doesn't directly affect the
	  kernel: saying N will just cause the configurator to skip all
	  the questions about Hisilicon devices. If you say Y, you will be asked
	  for your specific card in the following questions.

if NET_VENDOR_HISILICON

config HIX5HD2_GMAC
	tristate "Hisilicon HIX5HD2 Family Network Device Support"
	select PHYLIB
	help
	  This selects the hix5hd2 mac family network device.

config HISI_FEMAC
	tristate "Hisilicon Fast Ethernet MAC device support"
	depends on HAS_IOMEM
	select PHYLIB
	select RESET_CONTROLLER
	help
	  This selects the Hisilicon Fast Ethernet MAC device(FEMAC).
	  The FEMAC receives and transmits data over Ethernet
	  ports at 10/100 Mbps in full-duplex or half-duplex mode.
	  The FEMAC exchanges data with the CPU, and supports
	  the energy efficient Ethernet (EEE).

config HIP04_ETH
	tristate "HISILICON P04 Ethernet support"
	depends on HAS_IOMEM	# For MFD_SYSCON
	select MARVELL_PHY
	select MFD_SYSCON
	select HNS_MDIO
	---help---
	  If you wish to compile a kernel for a hardware with hisilicon p04 SoC and
	  want to use the internal ethernet then you should answer Y to this.

config HNS_MDIO
	tristate
	select PHYLIB
	---help---
	  This selects the HNS MDIO support. It is needed by HNS_DSAF to access
	  the PHY

config HNS
	tristate "Hisilicon Network Subsystem Support (Framework)"
	---help---
	  This selects the framework support for Hisilicon Network Subsystem. It
	  is needed by any driver which provides HNS acceleration engine or make
	  use of the engine

config HNS_DSAF
	tristate "Hisilicon HNS DSAF device Support"
	select HNS
	select HNS_MDIO
	---help---
	  This selects the DSAF (Distributed System Area Frabric) network
	  acceleration engine support. The engine is used in Hisilicon hip05,
	  Hi1610 and further ICT SoC

config HNS_ENET
	tristate "Hisilicon HNS Ethernet Device Support"
	select PHYLIB
	select HNS
	---help---
	  This selects the general ethernet driver for HNS.  This module make
	  use of any HNS AE driver, such as HNS_DSAF

config HNS3
	tristate "Hisilicon Network Subsystem Support HNS3 (Framework)"
	depends on PCI
	---help---
	  This selects the framework support for Hisilicon Network Subsystem 3.
	  This layer facilitates clients like ENET, RoCE and user-space ethernet
	  drivers(like ODP)to register with HNAE devices and their associated
	  operations.

if HNS3

config HNS3_HCLGE
	tristate "Hisilicon HNS3 HCLGE Acceleration Engine & Compatibility Layer Support"
	default m
	depends on PCI_MSI
	---help---
	  This selects the HNS3_HCLGE network acceleration engine & its hardware
	  compatibility layer. The engine would be used in Hisilicon hip08 family of
	  SoCs and further upcoming SoCs.

config HNS3_DCB
	bool "Hisilicon HNS3 Data Center Bridge Support"
	default n
	depends on HNS3_HCLGE && DCB
	---help---
	  Say Y here if you want to use Data Center Bridging (DCB) in the HNS3 driver.

	  If unsure, say N.

config HNS3_HCLGEVF
	tristate "Hisilicon HNS3VF Acceleration Engine & Compatibility Layer Support"
	depends on PCI_MSI
	depends on HNS3_HCLGE
    ---help---
	  This selects the HNS3 VF drivers network acceleration engine & its hardware
	  compatibility layer. The engine would be used in Hisilicon hip08 family of
	  SoCs and further upcoming SoCs.

config HNS3_ENET
	tristate "Hisilicon HNS3 Ethernet Device Support"
	default m
	depends on 64BIT && PCI
	---help---
	  This selects the Ethernet Driver for Hisilicon Network Subsystem 3 for hip08
	  family of SoCs. This module depends upon HNAE3 driver to access the HNAE3
	  devices and their associated operations.

endif #HNS3

endif # NET_VENDOR_HISILICON
```

## drivers/net/ethernet/hp/Kconfig
```kconfig
#
# HP network device configuration
#

config NET_VENDOR_HP
	bool "HP devices"
	default y
	depends on ISA || EISA || PCI
	---help---
	  If you have a network (Ethernet) card belonging to this class, say Y.

	  Note that the answer to this question doesn't directly affect the
	  kernel: saying N will just cause the configurator to skip all
	  the questions about HP cards. If you say Y, you will be asked for
	  your specific card in the following questions.

if NET_VENDOR_HP

config HP100
	tristate "HP 10/100VG PCLAN (ISA, EISA, PCI) support"
	depends on (ISA || EISA || PCI)
	---help---
	  If you have a network (Ethernet) card of this type, say Y here.

	  To compile this driver as a module, choose M here. The module
	  will be called hp100.

endif # NET_VENDOR_HP
```

## drivers/net/ethernet/huawei/Kconfig
```kconfig
#
# Huawei driver configuration
#

config NET_VENDOR_HUAWEI
	bool "Huawei devices"
	default y
	---help---
	  If you have a network (Ethernet) card belonging to this class, say Y.
	  Note that the answer to this question doesn't directly affect the
	  kernel: saying N will just cause the configurator to skip all
	  the questions about Huawei cards. If you say Y, you will be asked
	  for your specific card in the following questions.

if NET_VENDOR_HUAWEI

source "drivers/net/ethernet/huawei/hinic/Kconfig"

endif # NET_VENDOR_HUAWEI
```

## drivers/net/ethernet/huawei/hinic/Kconfig
```kconfig
# SPDX-License-Identifier: GPL-2.0-only
#
# Huawei driver configuration
#

config HINIC
	tristate "Huawei Intelligent PCIE Network Interface Card"
	depends on (PCI_MSI && (X86 || ARM64))
	help
	  This driver supports HiNIC PCIE Ethernet cards.
	  To compile this driver as part of the kernel, choose Y here.
	  If unsure, choose N.
	  The default is compiled as module.
```

## drivers/net/ethernet/huawei/hinic3/Kconfig
```kconfig
# SPDX-License-Identifier: GPL-2.0-only
#
# Huawei driver configuration
#

config HINIC3
	tristate "Huawei 3rd generation network adapters (HINIC3) support"
	# Fields of HW and management structures are little endian and are
	# currently not converted
	depends on !CPU_BIG_ENDIAN
	depends on X86 || ARM64 || COMPILE_TEST
	depends on PCI_MSI && 64BIT
	select AUXILIARY_BUS
	select PAGE_POOL
	help
	  This driver supports HiNIC 3rd gen Network Adapter (HINIC3).
	  The driver is supported on X86_64 and ARM64 little endian.

	  To compile this driver as a module, choose M here.
	  The module will be called hinic3.
```

## drivers/net/ethernet/i825xx/Kconfig
```kconfig
#
# Intel 82596/82593/82596 network device configuration
#

config NET_VENDOR_I825XX
	bool "Intel (82586/82593/82596) devices"
	default y
	depends on NET_VENDOR_INTEL
	---help---
	  If you have a network (Ethernet) card belonging to this class, say Y
	  and read the Ethernet-HOWTO, available from
	  <http://www.tldp.org/docs.html#howto>.

	  Note that the answer to this question does not directly affect the
	  kernel: saying N will just cause the configurator to skip all
	  the questions about these devices. If you say Y, you will be asked for
	  your specific card in the following questions.

if NET_VENDOR_I825XX

config ARM_ETHER1
	tristate "Acorn Ether1 support"
	depends on ARM && ARCH_ACORN
	---help---
	  If you have an Acorn system with one of these (AKA25) network cards,
	  you should say Y to this option if you wish to use it with Linux.

config BVME6000_NET
	tristate "BVME6000 Ethernet support"
	depends on BVME6000
	---help---
	  This is the driver for the Ethernet interface on BVME4000 and
	  BVME6000 VME boards.  Say Y here to include the driver for this chip
	  in your kernel.
	  To compile this driver as a module, choose M here.

config LASI_82596
	tristate "Lasi ethernet"
	depends on GSC
	---help---
	  Say Y here to support the builtin Intel 82596 ethernet controller
	  found in Hewlett-Packard PA-RISC machines with 10Mbit ethernet.

config MVME16x_NET
	tristate "MVME16x Ethernet support"
	depends on MVME16x
	---help---
	  This is the driver for the Ethernet interface on the Motorola
	  MVME162, 166, 167, 172 and 177 boards.  Say Y here to include the
	  driver for this chip in your kernel.
	  To compile this driver as a module, choose M here.

config SNI_82596
	tristate "SNI RM ethernet"
	depends on SNI_RM
	---help---
	  Say Y here to support the on-board Intel 82596 ethernet controller
	  built into SNI RM machines.

config SUN3_82586
	bool "Sun3 on-board Intel 82586 support"
	depends on SUN3
	---help---
	  This driver enables support for the on-board Intel 82586 based
	  Ethernet adapter found on Sun 3/1xx and 3/2xx motherboards.  Note
	  that this driver does not support 82586-based adapters on additional
	  VME boards.

endif # NET_VENDOR_I825XX
```

## drivers/net/ethernet/ibm/Kconfig
```kconfig
# SPDX-License-Identifier: GPL-2.0-only
#
# IBM device configuration.
#

config NET_VENDOR_IBM
	bool "IBM devices"
	default y
	depends on PPC_PSERIES || PPC_DCR || (IBMEBUS && SPARSEMEM)
	help
	  If you have a network (Ethernet) card belonging to this class, say Y.

	  Note that the answer to this question doesn't directly affect the
	  kernel: saying N will just cause the configurator to skip all
	  the questions about IBM devices. If you say Y, you will be asked for
	  your specific card in the following questions.

if NET_VENDOR_IBM

config IBMVETH
	tristate "IBM LAN Virtual Ethernet support"
	depends on PPC_PSERIES
	help
	  This driver supports virtual ethernet adapters on newer IBM iSeries
	  and pSeries systems.

	  To compile this driver as a module, choose M here. The module will
	  be called ibmveth.

config IBMVETH_KUNIT_TEST
	bool "KUnit test for IBM LAN Virtual Ethernet support" if !KUNIT_ALL_TESTS
	depends on KUNIT
	depends on KUNIT=y && IBMVETH=y
	default KUNIT_ALL_TESTS
	help
	  This builds unit tests for the IBM LAN Virtual Ethernet driver.

	  For more information on KUnit and unit tests in general, please refer
	  to the KUnit documentation in Documentation/dev-tools/kunit/.

	  If unsure, say N.

source "drivers/net/ethernet/ibm/emac/Kconfig"

config EHEA
	tristate "eHEA Ethernet support"
	depends on IBMEBUS && SPARSEMEM
	help
	  This driver supports the IBM pSeries eHEA ethernet adapter.

	  To compile the driver as a module, choose M here. The module
	  will be called ehea.

config IBMVNIC
	tristate "IBM Virtual NIC support"
	depends on PPC_PSERIES
	help
	  This driver supports Virtual NIC adapters on IBM i and IBM System p
	  systems.

	  To compile this driver as a module, choose M here. The module will
	  be called ibmvnic.

endif # NET_VENDOR_IBM
```

## drivers/net/ethernet/icplus/Kconfig
```kconfig
#
# IC Plus device configuration
#

config IP1000
	tristate "IP1000 Gigabit Ethernet support"
	depends on PCI
	select MII
	---help---
	  This driver supports IP1000 gigabit Ethernet cards.

	  To compile this driver as a module, choose M here: the module
	  will be called ipg.  This is recommended.
```
