## drivers/net/ethernet/wiznet/Kconfig
```kconfig
# SPDX-License-Identifier: GPL-2.0-only
#
# WIZnet devices configuration
#

config NET_VENDOR_WIZNET
	bool "WIZnet devices"
	default y
	help
	  If you have a network (Ethernet) card belonging to this class, say Y.

	  Note that the answer to this question doesn't directly affect the
	  kernel: saying N will just cause the configurator to skip all
	  the questions about WIZnet devices. If you say Y, you will be asked
	  for your specific card in the following questions.

if NET_VENDOR_WIZNET

config WIZNET_W5100
	tristate "WIZnet W5100/W5200/W5500 Ethernet support for SPI mode"
	depends on SPI
	help
	  Support for WIZnet W5100 chips.

	  W5100 is a single chip with integrated 10/100 Ethernet MAC,
	  PHY and hardware TCP/IP stack, but this driver is limited to
	  the MAC and PHY functions only, onchip TCP/IP is unused.

	  To compile this driver as a module, choose M here: the module
	  will be called w5100.

endif # NET_VENDOR_WIZNET
```

## drivers/net/ethernet/xilinx/Kconfig
```kconfig
# SPDX-License-Identifier: GPL-2.0-only
#
# Xilink device configuration
#

config NET_VENDOR_XILINX
	bool "Xilinx devices"
	default y
	help
	  If you have a network (Ethernet) card belonging to this class, say Y.

	  Note that the answer to this question doesn't directly affect the
	  kernel: saying N will just cause the configurator to skip all
	  the questions about Xilinx devices. If you say Y, you will be asked
	  for your specific card in the following questions.

if NET_VENDOR_XILINX

config XILINX_EMACLITE
	tristate "Xilinx 10/100 Ethernet Lite support"
	depends on HAS_IOMEM
	select PHYLIB
	help
	  This driver supports the 10/100 Ethernet Lite from Xilinx.

config XILINX_AXI_EMAC
	tristate "Xilinx 10/100/1000 AXI Ethernet support"
	depends on HAS_IOMEM
	select PHYLINK
	help
	  This driver supports the 10/100/1000 Ethernet from Xilinx for the
	  AXI bus interface used in Xilinx Virtex FPGAs and Soc's.

config XILINX_LL_TEMAC
	tristate "Xilinx LL TEMAC (LocalLink Tri-mode Ethernet MAC) driver"
	depends on HAS_IOMEM
	select PHYLIB
	help
	  This driver supports the Xilinx 10/100/1000 LocalLink TEMAC
	  core used in Xilinx Spartan and Virtex FPGAs

endif # NET_VENDOR_XILINX
```

## drivers/net/ethernet/xircom/Kconfig
```kconfig
# SPDX-License-Identifier: GPL-2.0-only
#
# Xircom network device configuration
#

config NET_VENDOR_XIRCOM
	bool "Xircom devices"
	default y
	depends on PCMCIA
	help
	  If you have a network (Ethernet) card belonging to this class, say Y.

	  Note that the answer to this question doesn't directly affect the
	  kernel: saying N will just cause the configurator to skip all
	  the questions about Xircom cards. If you say Y, you will be asked for
	  your specific card in the following questions.

if NET_VENDOR_XIRCOM

config PCMCIA_XIRC2PS
	tristate "Xircom 16-bit PCMCIA support"
	depends on PCMCIA
	help
	  Say Y here if you intend to attach a Xircom 16-bit PCMCIA (PC-card)
	  Ethernet or Fast Ethernet card to your computer.

	  To compile this driver as a module, choose M here: the module will be
	  called xirc2ps_cs.  If unsure, say N.

endif # NET_VENDOR_XIRCOM
```

## drivers/net/ethernet/xscale/Kconfig
```kconfig
# SPDX-License-Identifier: GPL-2.0-only
#
# Intel XScale IXP device configuration
#

config NET_VENDOR_XSCALE
	bool "Intel XScale IXP devices"
	default y
	depends on NET_VENDOR_INTEL && (ARM && ARCH_IXP4XX && \
		   IXP4XX_NPE && IXP4XX_QMGR)
	help
	  If you have a network (Ethernet) card belonging to this class, say Y.

	  Note that the answer to this question does not directly affect the
	  kernel: saying N will just cause the configurator to skip all
	  the questions about XScale IXP devices. If you say Y, you will be
	  asked for your specific card in the following questions.

if NET_VENDOR_XSCALE

config IXP4XX_ETH
	tristate "Intel IXP4xx Ethernet support"
	depends on ARM && ARCH_IXP4XX && IXP4XX_NPE && IXP4XX_QMGR
	select PHYLIB
	select NET_PTP_CLASSIFY
	help
	  Say Y here if you want to use built-in Ethernet ports
	  on IXP4xx processor.

config PTP_1588_CLOCK_IXP46X
	tristate "Intel IXP46x as PTP clock"
	depends on IXP4XX_ETH
	depends on PTP_1588_CLOCK
	default y
	help
	  This driver adds support for using the IXP46X as a PTP
	  clock. This clock is only useful if your PTP programs are
	  getting hardware time stamps on the PTP Ethernet packets
	  using the SO_TIMESTAMPING API.

	  To compile this driver as a module, choose M here: the module
	  will be called ptp_ixp46x.

endif # NET_VENDOR_XSCALE
```

## drivers/net/fddi/Kconfig
```kconfig
# SPDX-License-Identifier: GPL-2.0-only
#
# FDDI network device configuration
#

config FDDI
	tristate "FDDI driver support"
	depends on PCI || EISA || TC
	help
	  Fiber Distributed Data Interface is a high speed local area network
	  design; essentially a replacement for high speed Ethernet. FDDI can
	  run over copper or fiber. If you are connected to such a network and
	  want a driver for the FDDI card in your computer, say Y here (and
	  then also Y to the driver for your FDDI card, below). Most people
	  will say N.

if FDDI

config DEFZA
	tristate "DEC FDDIcontroller 700/700-C (DEFZA-xx) support"
	depends on FDDI && TC
	help
	  This is support for the DEC FDDIcontroller 700 (DEFZA-AA, fiber)
	  and 700-C (DEFZA-CA, copper) TURBOchannel network cards which
	  can connect you to a local FDDI network.

	  To compile this driver as a module, choose M here: the module
	  will be called defza.  If unsure, say N.

config DEFXX
	tristate "Digital DEFTA/DEFEA/DEFPA adapter support"
	depends on FDDI && (PCI || EISA || TC)
	help
	  This is support for the DIGITAL series of TURBOchannel (DEFTA),
	  EISA (DEFEA) and PCI (DEFPA) controllers which can connect you
	  to a local FDDI network.

	  To compile this driver as a module, choose M here: the module
	  will be called defxx.  If unsure, say N.

config DEFXX_MMIO
	bool
	prompt "Use MMIO instead of PIO" if PCI || EISA
	depends on DEFXX
	default n if PCI || EISA
	default y
	help
	  This instructs the driver to use EISA or PCI memory-mapped I/O
	  (MMIO) as appropriate instead of programmed I/O ports (PIO).
	  Enabling this gives an improvement in processing time in parts
	  of the driver, but it may cause problems with EISA (DEFEA)
	  adapters.  TURBOchannel does not have the concept of I/O ports,
	  so MMIO is always used for these (DEFTA) adapters.

	  If unsure, say N.

config SKFP
	tristate "SysKonnect FDDI PCI support"
	depends on FDDI && PCI
	select BITREVERSE
	help
	  Say Y here if you have a SysKonnect FDDI PCI adapter.
	  The following adapters are supported by this driver:
	  - SK-5521 (SK-NET FDDI-UP)
	  - SK-5522 (SK-NET FDDI-UP DAS)
	  - SK-5541 (SK-NET FDDI-FP)
	  - SK-5543 (SK-NET FDDI-LP)
	  - SK-5544 (SK-NET FDDI-LP DAS)
	  - SK-5821 (SK-NET FDDI-UP64)
	  - SK-5822 (SK-NET FDDI-UP64 DAS)
	  - SK-5841 (SK-NET FDDI-FP64)
	  - SK-5843 (SK-NET FDDI-LP64)
	  - SK-5844 (SK-NET FDDI-LP64 DAS)
	  - Netelligent 100 FDDI DAS Fibre SC
	  - Netelligent 100 FDDI SAS Fibre SC
	  - Netelligent 100 FDDI DAS UTP
	  - Netelligent 100 FDDI SAS UTP
	  - Netelligent 100 FDDI SAS Fibre MIC

	  Read <file:Documentation/networking/skfp.rst> for information about
	  the driver.

	  Questions concerning this driver can be addressed to:
	  <linux@syskonnect.de>

	  To compile this driver as a module, choose M here: the module
	  will be called skfp.  This is recommended.

endif # FDDI
```

## drivers/net/fec_8xx/Kconfig
```kconfig
config FEC_8XX
	tristate "Motorola 8xx FEC driver"
	depends on 8XX
	select MII

config FEC_8XX_GENERIC_PHY
	bool "Support any generic PHY"
	depends on FEC_8XX
	default y

config FEC_8XX_DM9161_PHY
	bool "Support DM9161 PHY"
	depends on FEC_8XX
	default n

config FEC_8XX_LXT971_PHY
	bool "Support LXT971/LXT972 PHY"
	depends on FEC_8XX
	default n
```

## drivers/net/fs_enet/Kconfig
```kconfig
config FS_ENET
       tristate "Freescale Ethernet Driver"
       depends on CPM1 || CPM2 || PPC_MPC512x
       select MII
       select PHYLIB

config FS_ENET_MPC5121_FEC
	def_bool y if (FS_ENET && PPC_MPC512x)
	select FS_ENET_HAS_FEC

config FS_ENET_HAS_SCC
	bool "Chip has an SCC usable for ethernet"
	depends on FS_ENET && (CPM1 || CPM2)
	default y

config FS_ENET_HAS_FCC
	bool "Chip has an FCC usable for ethernet"
	depends on FS_ENET && CPM2
	default y

config FS_ENET_HAS_FEC
	bool "Chip has an FEC usable for ethernet"
	depends on FS_ENET && (CPM1 || FS_ENET_MPC5121_FEC)
	select FS_ENET_MDIO_FEC
	default y

config FS_ENET_MDIO_FEC
	tristate "MDIO driver for FEC"
	depends on FS_ENET && (CPM1 || FS_ENET_MPC5121_FEC)

config FS_ENET_MDIO_FCC
	tristate "MDIO driver for FCC"
	depends on FS_ENET && CPM2
	select MDIO_BITBANG
```
