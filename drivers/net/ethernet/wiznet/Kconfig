## drivers/net/ieee802154/Kconfig
```kconfig
menuconfig IEEE802154_DRIVERS
	tristate "IEEE 802.15.4 drivers"
	depends on NETDEVICES && IEEE802154
	default y
	---help---
	  Say Y here to get to see options for IEEE 802.15.4 Low-Rate
	  Wireless Personal Area Network device drivers. This option alone
	  does not add any kernel code.

	  If you say N, all options in this submenu will be skipped and
	  disabled.

config IEEE802154_FAKELB
	depends on IEEE802154_DRIVERS && MAC802154
	tristate "IEEE 802.15.4 loopback driver"
	---help---
	  Say Y here to enable the fake driver that can emulate a net
	  of several interconnected radio devices.

	  This driver can also be built as a module. To do so say M here.
	  The module will be called 'fakelb'.

config IEEE802154_AT86RF230
	depends on IEEE802154_DRIVERS && MAC802154
	tristate "AT86RF230/231/233/212 transceiver driver"
	depends on SPI
	select REGMAP_SPI
	---help---
	  Say Y here to enable the at86rf230/231/233/212 SPI 802.15.4 wireless
	  controller.

	  This driver can also be built as a module. To do so, say M here.
	  the module will be called 'at86rf230'.

config IEEE802154_AT86RF230_DEBUGFS
	depends on IEEE802154_AT86RF230
	bool "AT86RF230 debugfs interface"
	depends on DEBUG_FS
	---help---
	  This option compiles debugfs code for the at86rf230 driver.

config IEEE802154_MRF24J40
	tristate "Microchip MRF24J40 transceiver driver"
	depends on IEEE802154_DRIVERS && MAC802154
	depends on SPI
	select REGMAP_SPI
	---help---
	  Say Y here to enable the MRF24J20 SPI 802.15.4 wireless
	  controller.

	  This driver can also be built as a module. To do so, say M here.
	  the module will be called 'mrf24j40'.

config IEEE802154_CC2520
	depends on IEEE802154_DRIVERS && MAC802154
	tristate "CC2520 transceiver driver"
	depends on SPI
	---help---
	  Say Y here to enable the CC2520 SPI 802.15.4 wireless
	  controller.

	  This driver can also be built as a module. To do so, say M here.
	  the module will be called 'cc2520'.

config IEEE802154_ATUSB
	tristate "ATUSB transceiver driver"
	depends on IEEE802154_DRIVERS && MAC802154 && USB
	---help---
	  Say Y here to enable the ATUSB IEEE 802.15.4 wireless
	  controller.

	  This driver can also be built as a module. To do so say M here.
	  The module will be called 'atusb'.

config IEEE802154_ADF7242
       tristate "ADF7242 transceiver driver"
       depends on IEEE802154_DRIVERS && MAC802154
       depends on SPI
	---help---
	  Say Y here to enable the ADF7242 SPI 802.15.4 wireless
	  controller.

	  This driver can also be built as a module. To do so, say M here.
	  the module will be called 'adf7242'.

config IEEE802154_CA8210
	tristate "Cascoda CA8210 transceiver driver"
	depends on IEEE802154_DRIVERS && MAC802154
	depends on COMMON_CLK
	depends on SPI
	---help---
	  Say Y here to enable the CA8210 SPI 802.15.4 wireless
	  controller.

	  This driver can also be built as a module. To do so, say M here.
	  the module will be called 'ca8210'.

config IEEE802154_CA8210_DEBUGFS
	bool "CA8210 debugfs interface"
	depends on IEEE802154_CA8210
	depends on DEBUG_FS
	---help---
	  This option compiles debugfs code for the ca8210 driver. This
	  exposes a debugfs node for each CA8210 instance which allows
	  direct use of the Cascoda API, exposing the 802.15.4 MAC
	  management entities.

config IEEE802154_MCR20A
       tristate "MCR20A transceiver driver"
       depends on IEEE802154_DRIVERS && MAC802154
       depends on SPI
	---help---
	  Say Y here to enable the MCR20A SPI 802.15.4 wireless
	  controller.

	  This driver can also be built as a module. To do so, say M here.
	  the module will be called 'mcr20a'.
```

## drivers/net/ipa/Kconfig
```kconfig
config QCOM_IPA
	tristate "Qualcomm IPA support"
	depends on NET && QCOM_SMEM
	depends on ARCH_QCOM || COMPILE_TEST
	depends on QCOM_RPROC_COMMON || (QCOM_RPROC_COMMON=n && COMPILE_TEST)
	select QCOM_MDT_LOADER if ARCH_QCOM
	select QCOM_SCM
	select QCOM_QMI_HELPERS
	help
	  Choose Y or M here to include support for the Qualcomm
	  IP Accelerator (IPA), a hardware block present in some
	  Qualcomm SoCs.  The IPA is a programmable protocol processor
	  that is capable of generic hardware handling of IP packets,
	  including routing, filtering, and NAT.  Currently the IPA
	  driver supports only basic transport of network traffic
	  between the AP and modem.

	  Note that if selected, the selection type must match that
	  of QCOM_Q6V5_COMMON (Y or M).

	  If unsure, say N.
```

## drivers/net/ipa2-lite/Kconfig
```kconfig
config QCOM_IPA2_LITE
	tristate "Qualcomm IPA 2.X support"
	depends on NET
	depends on ARCH_QCOM || COMPILE_TEST
	depends on QCOM_RPROC_COMMON || (QCOM_RPROC_COMMON=n && COMPILE_TEST)
	select QCOM_QMI_HELPERS
	help
	  Choose Y or M here to include support for the Qualcomm
	  IP Abductor (IPA), a hardware block present in some
	  Qualcomm SoCs.  The IPA is a programmable protocol processor
	  that is capable abducting your IP packets or annihilating
	  the system if it's not pleased.

	  Note that if selected, the selection type must match that
	  of QCOM_Q6V5_COMMON (Y or M).

	  If unsure, say N.
```
