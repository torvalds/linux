## drivers/net/ethernet/mucse/Kconfig
```kconfig
# SPDX-License-Identifier: GPL-2.0-only
#
# Mucse network device configuration
#

config NET_VENDOR_MUCSE
	bool "Mucse devices"
	default y
	help
	  If you have a network (Ethernet) card from Mucse(R), say Y.

	  Note that the answer to this question doesn't directly affect the
	  kernel: saying N will just cause the configurator to skip all
	  the questions about Mucse(R) cards. If you say Y, you will
	  be asked for your specific card in the following questions.

if NET_VENDOR_MUCSE

config MGBE
	tristate "Mucse(R) 1GbE PCI Express adapters support"
	depends on PCI
	help
	  This driver supports Mucse(R) 1GbE PCI Express family of
	  adapters.

	  More specific information on configuring the driver is in
	  <file:Documentation/networking/device_drivers/ethernet/mucse/rnpgbe.rst>.

	  To compile this driver as a module, choose M here. The module
	  will be called rnpgbe.

endif # NET_VENDOR_MUCSE
```

## drivers/net/ethernet/myricom/Kconfig
```kconfig
#
# Myricom device configuration
#

config NET_VENDOR_MYRI
	bool "Myricom devices"
	default y
	depends on PCI && INET
	---help---
	  If you have a network (Ethernet) card belonging to this class, say
	  Y and read the Ethernet-HOWTO, available from
	  <http://www.tldp.org/docs.html#howto>.

	  Note that the answer to this question doesn't directly affect the
	  kernel: saying N will just cause the configurator to skip all
	  the questions about Myricom cards. If you say Y, you will be asked for
	  your specific card in the following questions.

if NET_VENDOR_MYRI

config MYRI10GE
	tristate "Myricom Myri-10G Ethernet support"
	depends on PCI && INET
	select FW_LOADER
	select CRC32
	---help---
	  This driver supports Myricom Myri-10G Dual Protocol interface in
	  Ethernet mode. If the eeprom on your board is not recent enough,
	  you will need a newer firmware image.
	  You may get this image or more information, at:

	  <http://www.myri.com/scs/download-Myri10GE.html>

	  To compile this driver as a module, choose M here. The module
	  will be called myri10ge.

config MYRI10GE_DCA
	bool "Direct Cache Access (DCA) Support"
	default y
	depends on MYRI10GE && DCA && !(MYRI10GE=y && DCA=m)
	---help---
	  Say Y here if you want to use Direct Cache Access (DCA) in the
	  driver.  DCA is a method for warming the CPU cache before data
	  is used, with the intent of lessening the impact of cache misses.

endif # NET_VENDOR_MYRI
```

## drivers/net/ethernet/natsemi/Kconfig
```kconfig
# SPDX-License-Identifier: GPL-2.0-only
#
# National Semiconductor device configuration
#

config NET_VENDOR_NATSEMI
	bool "National Semiconductor devices"
	default y
	---help---
	  If you have a network (Ethernet) card belonging to this class, say Y.

	  Note that the answer to this question doesn't directly affect the
	  kernel: saying N will just cause the configurator to skip all
	  the questions about National Semiconductor devices. If you say Y,
	  you will be asked for your specific card in the following questions.

if NET_VENDOR_NATSEMI

config MACSONIC
	tristate "Macintosh SONIC based ethernet (onboard, NuBus, LC, CS)"
	depends on MAC
	---help---
	  Support for NatSemi SONIC based Ethernet devices.  This includes
	  the onboard Ethernet in many Quadras as well as some LC-PDS,
	  a few Nubus and all known Comm Slot Ethernet cards.  If you have
	  one of these say Y here.

	  To compile this driver as a module, choose M here. This module will
	  be called macsonic.

config MIPS_JAZZ_SONIC
	tristate "MIPS JAZZ onboard SONIC Ethernet support"
	depends on MACH_JAZZ
	---help---
	  This is the driver for the onboard card of MIPS Magnum 4000,
	  Acer PICA, Olivetti M700-10 and a few other identical OEM systems.

config NATSEMI
	tristate "National Semiconductor DP8381x series PCI Ethernet support"
	depends on PCI
	select CRC32
	---help---
	  This driver is for the National Semiconductor DP83810 series,
	  which is used in cards from PureData, NetGear, Linksys
	  and others, including the 83815 chip.
	  More specific information and updates are available from
	  <http://www.scyld.com/network/natsemi.html>.

config NS83820
	tristate "National Semiconductor DP83820 support"
	depends on PCI
	---help---
	  This is a driver for the National Semiconductor DP83820 series
	  of gigabit ethernet MACs.  Cards using this chipset include
	  the D-Link DGE-500T, PureData's PDP8023Z-TG, SMC's SMC9462TX,
	  SOHO-GA2000T, SOHO-GA2500T.  The driver supports the use of
	  zero copy.

config XTENSA_XT2000_SONIC
	tristate "Xtensa XT2000 onboard SONIC Ethernet support"
	depends on XTENSA_PLATFORM_XT2000
	---help---
	  This is the driver for the onboard card of the Xtensa XT2000 board.

endif # NET_VENDOR_NATSEMI
```

## drivers/net/ethernet/neterion/Kconfig
```kconfig
# SPDX-License-Identifier: GPL-2.0-only
#
# Exar device configuration
#

config NET_VENDOR_NETERION
	bool "Neterion (Exar) devices"
	default y
	depends on PCI
	help
	  If you have a network (Ethernet) card belonging to this class, say Y.

	  Note that the answer to this question doesn't directly affect the
	  kernel: saying N will just cause the configurator to skip all
	  the questions about Neterion/Exar cards. If you say Y, you will be
	  asked for your specific card in the following questions.

if NET_VENDOR_NETERION

config S2IO
	tristate "Neterion (Exar) Xframe 10Gb Ethernet Adapter"
	depends on PCI
	help
	  This driver supports Exar Corp's Xframe Series 10Gb Ethernet Adapters.
	  These were originally released from S2IO, which renamed itself
	  Neterion.  So, the adapters might be labeled as either one, depending
	  on its age.

	  More specific information on configuring the driver is in
	  <file:Documentation/networking/device_drivers/ethernet/neterion/s2io.rst>.

	  To compile this driver as a module, choose M here. The module
	  will be called s2io.

endif # NET_VENDOR_NETERION
```

## drivers/net/ethernet/netronome/Kconfig
```kconfig
# SPDX-License-Identifier: GPL-2.0-only
#
# Netronome device configuration
#

config NET_VENDOR_NETRONOME
	bool "Netronome(R) devices"
	default y
	help
	  If you have a Netronome(R) network (Ethernet) card or device, say Y.

	  Note that the answer to this question doesn't directly affect the
	  kernel: saying N will just cause the configurator to skip all
	  the questions about Netronome(R) cards. If you say Y, you will be
	  asked for your specific card in the following questions.

if NET_VENDOR_NETRONOME

config NFP
	tristate "Netronome(R) NFP4000/NFP6000 NIC driver"
	depends on PCI_MSI
	depends on VXLAN || VXLAN=n
	depends on TLS && TLS_DEVICE || TLS_DEVICE=n
	select NET_DEVLINK
	select CRC32
	select DIMLIB
	help
	  This driver supports the Netronome(R) NFP4000/NFP6000 based
	  cards working as a advanced Ethernet NIC.  It works with both
	  SR-IOV physical and virtual functions.

config NFP_APP_FLOWER
	bool "NFP4000/NFP6000 TC Flower offload support"
	depends on NFP
	depends on NET_SWITCHDEV
	depends on IPV6!=m || NFP=m
	default y
	help
	  Enable driver support for TC Flower offload on NFP4000 and NFP6000.
	  Say Y, if you are planning to make use of TC Flower offload
	  either directly, with Open vSwitch, or any other way.  Note that
	  TC Flower offload requires specific FW to work.

config NFP_APP_ABM_NIC
	bool "NFP4000/NFP6000 Advanced buffer management NIC support"
	depends on NFP
	depends on NET_SWITCHDEV
	default y
	help
	  Enable driver support for Advanced buffer management NIC on NFP.
	  ABM NIC allows advanced configuration of queuing and scheduling
	  of packets, including ECN marking. Say Y, if you are planning to
	  use one of the NFP4000 and NFP6000 platforms which support this
	  functionality.
	  Code will be built into the nfp.ko driver.

config NFP_NET_IPSEC
	bool "NFP IPsec crypto offload support"
	depends on NFP
	depends on XFRM_OFFLOAD
	default y
	help
	  Enable driver support IPsec crypto offload on NFP NIC.
	  Say Y, if you are planning to make use of IPsec crypto
	  offload. NOTE that IPsec crypto offload on NFP NIC
	  requires specific FW to work.

config NFP_DEBUG
	bool "Debug support for Netronome(R) NFP4000/NFP6000 NIC drivers"
	depends on NFP
	help
	  Enable extra sanity checks and debugfs support in
	  Netronome(R) NFP4000/NFP6000 NIC drivers.
	  Note: selecting this option may adversely impact
		performance.

endif
```

## drivers/net/ethernet/ni/Kconfig
```kconfig
#
# National Instuments network device configuration
#

config NET_VENDOR_NI
	bool "National Instruments Devices"
	default y
	help
	  If you have a network (Ethernet) device belonging to this class, say Y.

	  Note that the answer to this question doesn't directly affect the
	  kernel: saying N will just cause the configurator to skip all
	  the questions about National Instrument devices.
	  If you say Y, you will be asked for your specific device in the
	  following questions.

if NET_VENDOR_NI

config NI_XGE_MANAGEMENT_ENET
	tristate "National Instruments XGE management enet support"
	depends on HAS_IOMEM && HAS_DMA
	select PHYLIB
	select OF_MDIO if OF
	help
	  Simple LAN device for debug or management purposes. Can
	  support either 10G or 1G PHYs via SFP+ ports.

endif
```

## drivers/net/ethernet/nuvoton/Kconfig
```kconfig
# SPDX-License-Identifier: GPL-2.0-only
#
# Nuvoton network device configuration
#

config NET_VENDOR_NUVOTON
	bool "Nuvoton devices"
	default y
	depends on ARM && (ARCH_W90X900 || ARCH_NPCM7XX)
	help
	   If you have a network (Ethernet) card belonging to this class, say Y.

if NET_VENDOR_NUVOTON

config NPCM7XX_EMC_ETH
	bool "Nuvoton NPCM7XX Ethernet EMC"
	depends on ARM && ARCH_NPCM7XX
	select PHYLIB
	select MII
	help
	  Say Y here if you want to use built-in Ethernet MAC
	  on NPCM750 MCU.

config NPCM7XX_EMC_ETH_DEBUG
	bool "Nuvoton NPCM7XX Ethernet EMC debug"
	depends on NPCM7XX_EMC_ETH
	help
	  Say Y here if you want debug info via /proc/driver/npcm7xx_emc.x

endif # NET_VENDOR_NUVOTON
```

## drivers/net/ethernet/nvidia/Kconfig
```kconfig
# SPDX-License-Identifier: GPL-2.0-only
#
# NVIDIA network device configuration
#

config NET_VENDOR_NVIDIA
	bool "NVIDIA devices"
	default y
	depends on PCI
	---help---
	  If you have a network (Ethernet) card belonging to this class, say Y.

	  Note that the answer to this question doesn't directly affect the
	  kernel: saying N will just cause the configurator to skip all
	  the questions about NVIDIA cards. If you say Y, you will be asked for
	  your specific card in the following questions.

if NET_VENDOR_NVIDIA

config FORCEDETH
	tristate "nForce Ethernet support"
	depends on PCI
	---help---
	  If you have a network (Ethernet) controller of this type, say Y here.

	  To compile this driver as a module, choose M here. The module
	  will be called forcedeth.

endif # NET_VENDOR_NVIDIA
```

## drivers/net/ethernet/nxp/Kconfig
```kconfig
# SPDX-License-Identifier: GPL-2.0-only
config LPC_ENET
        tristate "NXP ethernet MAC on LPC devices"
        depends on ARCH_LPC32XX
        select PHYLIB
        help
	  Say Y or M here if you want to use the NXP ethernet MAC included on
	  some NXP LPC devices. You can safely enable this option for LPC32xx
	  SoC. Also available as a module.
```

## drivers/net/ethernet/oki-semi/Kconfig
```kconfig
# SPDX-License-Identifier: GPL-2.0-only
#
# OKI Semiconductor device configuration
#

config NET_VENDOR_OKI
	bool "OKI Semiconductor devices"
	default y
	depends on PCI
	---help---
	  If you have a network (Ethernet) card belonging to this class, say Y.

	  Note that the answer to this question doesn't directly affect the
	  kernel: saying N will just cause the configurator to skip all
	  the questions about OKI Semiconductor cards. If you say Y, you will
	  be asked for your specific card in the following questions.

if NET_VENDOR_OKI

source "drivers/net/ethernet/oki-semi/pch_gbe/Kconfig"

endif # NET_VENDOR_OKI
```

## drivers/net/ethernet/oki-semi/pch_gbe/Kconfig
```kconfig
# SPDX-License-Identifier: GPL-2.0-only
#
# OKI Semiconductor device configuration
#

config PCH_GBE
	tristate "OKI SEMICONDUCTOR IOH(ML7223/ML7831) GbE"
	depends on PCI && (X86_32 || COMPILE_TEST)
	depends on PTP_1588_CLOCK
	select MII
	select PTP_1588_CLOCK_PCH
	select NET_PTP_CLASSIFY
	help
	  This is a gigabit ethernet driver for EG20T PCH.
	  EG20T PCH is the platform controller hub that is used in Intel's
	  general embedded platform.  EG20T PCH has Gigabit Ethernet interface.
	  Using this interface, it is able to access system devices connected
	  to Gigabit Ethernet.  This driver enables Gigabit Ethernet function.

	  This driver also can be used for OKI SEMICONDUCTOR IOH(Input/
	  Output Hub), ML7223/ML7831.
	  ML7223 IOH is for MP(Media Phone) use. ML7831 IOH is for general
	  purpose use.
	  ML7223/ML7831 is companion chip for Intel Atom E6xx series.
	  ML7223/ML7831 is completely compatible for Intel EG20T PCH.
```

## drivers/net/ethernet/packetengines/Kconfig
```kconfig
#
# Packet engine device configuration
#

config NET_PACKET_ENGINE
	bool "Packet Engine devices"
	default y
	depends on PCI
	---help---
	  If you have a network (Ethernet) card belonging to this class, say Y.

	  Note that the answer to this question doesn't directly affect the
	  kernel: saying N will just cause the configurator to skip all
	  the questions about packet engine devices. If you say Y, you will
	  be asked for your specific card in the following questions.

if NET_PACKET_ENGINE

config HAMACHI
	tristate "Packet Engines Hamachi GNIC-II support"
	depends on PCI
	select MII
	---help---
	  If you have a Gigabit Ethernet card of this type, say Y here.

	  To compile this driver as a module, choose M here. The module will be
	  called hamachi.

config YELLOWFIN
	tristate "Packet Engines Yellowfin Gigabit-NIC support"
	depends on PCI
	select CRC32
	---help---
	  Say Y here if you have a Packet Engines G-NIC PCI Gigabit Ethernet
	  adapter or the SYM53C885 Ethernet controller. The Gigabit adapter is
	  used by the Beowulf Linux cluster project.  See
	  <http://cesdis.gsfc.nasa.gov/linux/drivers/yellowfin.html> for more
	  information about this driver in particular and Beowulf in general.

	  To compile this driver as a module, choose M here: the module
	  will be called yellowfin.  This is recommended.

endif # NET_PACKET_ENGINE
```

## drivers/net/ethernet/pasemi/Kconfig
```kconfig
# SPDX-License-Identifier: GPL-2.0-only
#
# PA Semi network device configuration
#

config NET_VENDOR_PASEMI
	bool "PA Semi devices"
	default y
	depends on PPC_PASEMI && PCI
	help
	  If you have a network (Ethernet) card belonging to this class, say Y.

	  Note that the answer to this question doesn't directly affect the
	  kernel: saying N will just cause the configurator to skip all
	  the questions about PA Semi cards. If you say Y, you will be asked for
	  your specific card in the following questions.

if NET_VENDOR_PASEMI

config PASEMI_MAC
	tristate "PA Semi 1/10Gbit MAC"
	depends on PPC_PASEMI && PCI
	select PHYLIB
	help
	  This driver supports the on-chip 1/10Gbit Ethernet controller on
	  PA Semi's PWRficient line of chips.

endif # NET_VENDOR_PASEMI
```
