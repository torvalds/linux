## drivers/net/ethernet/pensando/Kconfig
```kconfig
# SPDX-License-Identifier: GPL-2.0
# Copyright (c) 2019 Pensando Systems, Inc
#
# Pensando device configuration
#

config NET_VENDOR_PENSANDO
	bool "Pensando devices"
	default y
	help
	  If you have a network (Ethernet) card belonging to this class, say Y.

	  Note that the answer to this question doesn't directly affect the
	  kernel: saying N will just cause the configurator to skip all
	  the questions about Pensando cards. If you say Y, you will be asked
	  for your specific card in the following questions.

if NET_VENDOR_PENSANDO

config IONIC
	tristate "Pensando Ethernet IONIC Support"
	depends on 64BIT && PCI
	depends on PTP_1588_CLOCK_OPTIONAL
	select NET_DEVLINK
	select DIMLIB
	help
	  This enables the support for the Pensando family of Ethernet
	  adapters.  More specific information on this driver can be
	  found in
	  <file:Documentation/networking/device_drivers/ethernet/pensando/ionic.rst>.

	  To compile this driver as a module, choose M here. The module
	  will be called ionic.

endif # NET_VENDOR_PENSANDO
```

## drivers/net/ethernet/qlogic/Kconfig
```kconfig
# SPDX-License-Identifier: GPL-2.0-only
#
# QLogic network device configuration
#

config NET_VENDOR_QLOGIC
	bool "QLogic devices"
	default y
	depends on PCI
	---help---
	  If you have a network (Ethernet) card belonging to this class, say Y.

	  Note that the answer to this question doesn't directly affect the
	  kernel: saying N will just cause the configurator to skip all
	  the questions about QLogic cards. If you say Y, you will be asked for
	  your specific card in the following questions.

if NET_VENDOR_QLOGIC

config QLA3XXX
	tristate "QLogic QLA3XXX Network Driver Support"
	depends on PCI
	---help---
	  This driver supports QLogic ISP3XXX gigabit Ethernet cards.

	  To compile this driver as a module, choose M here: the module
	  will be called qla3xxx.

config QLCNIC
	tristate "QLOGIC QLCNIC 1/10Gb Converged Ethernet NIC Support"
	depends on PCI
	select FW_LOADER
	---help---
	  This driver supports QLogic QLE8240 and QLE8242 Converged Ethernet
	  devices.

config QLCNIC_SRIOV
	bool "QLOGIC QLCNIC 83XX family SR-IOV Support"
	depends on QLCNIC && PCI_IOV
	default y
	---help---
	  This configuration parameter enables Single Root Input Output
	  Virtualization support for QLE83XX Converged Ethernet devices.
	  This allows for virtual function acceleration in virtualized
	  environments.

config QLCNIC_DCB
	bool "QLOGIC QLCNIC 82XX and 83XX family DCB Support"
	depends on QLCNIC && DCB
	default y
	---help---
	  This configuration parameter enables DCB support in QLE83XX
	  and QLE82XX Converged Ethernet devices. This allows for DCB
	  get operations support through rtNetlink interface. Only CEE
	  mode of DCB is supported. PG and PFC values are related only
	  to Tx.

config QLCNIC_HWMON
	bool "QLOGIC QLCNIC 82XX and 83XX family HWMON support"
	depends on QLCNIC && HWMON && !(QLCNIC=y && HWMON=m)
	default y
	---help---
	  This configuration parameter can be used to read the
	  board temperature in Converged Ethernet devices
	  supported by qlcnic.

	  This data is available via the hwmon sysfs interface.

config QLGE
	tristate "QLogic QLGE 10Gb Ethernet Driver Support"
	depends on PCI
	---help---
	  This driver supports QLogic ISP8XXX 10Gb Ethernet cards.

	  To compile this driver as a module, choose M here: the module
	  will be called qlge.

config NETXEN_NIC
	tristate "NetXen Multi port (1/10) Gigabit Ethernet NIC"
	depends on PCI
	select FW_LOADER
	---help---
	  This enables the support for NetXen's Gigabit Ethernet card.

config QED
	tristate "QLogic QED 25/40/100Gb core driver"
	depends on PCI
	select ZLIB_INFLATE
	select CRC8
	---help---
	  This enables the support for ...

config QED_LL2
	bool

config QED_SRIOV
	bool "QLogic QED 25/40/100Gb SR-IOV support"
	depends on QED && PCI_IOV
	default y
	---help---
	  This configuration parameter enables Single Root Input Output
	  Virtualization support for QED devices.
	  This allows for virtual function acceleration in virtualized
	  environments.

config QEDE
	tristate "QLogic QED 25/40/100Gb Ethernet NIC"
	depends on QED
	imply PTP_1588_CLOCK
	---help---
	  This enables the support for ...

config QED_RDMA
	bool

config QED_ISCSI
	bool

config QED_FCOE
	bool

config QED_OOO
	bool

endif # NET_VENDOR_QLOGIC
```

## drivers/net/ethernet/qualcomm/Kconfig
```kconfig
# SPDX-License-Identifier: GPL-2.0-only
#
# Qualcomm network device configuration
#

config NET_VENDOR_QUALCOMM
	bool "Qualcomm devices"
	default y
	help
	  If you have a network (Ethernet) card belonging to this class, say Y.

	  Note that the answer to this question doesn't directly affect the
	  kernel: saying N will just cause the configurator to skip all
	  the questions about Qualcomm cards. If you say Y, you will be asked
	  for your specific card in the following questions.

if NET_VENDOR_QUALCOMM

config QCA7000
	tristate
	help
	  This enables support for the Qualcomm Atheros QCA7000.

config QCA7000_SPI
	tristate "Qualcomm Atheros QCA7000 SPI support"
	select QCA7000
	depends on SPI_MASTER && OF
	help
	  This SPI protocol driver supports the Qualcomm Atheros QCA7000.

	  To compile this driver as a module, choose M here. The module
	  will be called qcaspi.

config QCA7000_UART
	tristate "Qualcomm Atheros QCA7000 UART support"
	select QCA7000
	depends on SERIAL_DEV_BUS && OF
	help
	  This UART protocol driver supports the Qualcomm Atheros QCA7000.

	  Currently the driver assumes these device UART settings:
	    Data bits: 8
	    Parity: None
	    Stop bits: 1
	    Flow control: None

	  To compile this driver as a module, choose M here. The module
	  will be called qcauart.

config QCOM_EMAC
	tristate "Qualcomm Technologies, Inc. EMAC Gigabit Ethernet support"
	depends on HAS_DMA && HAS_IOMEM
	select CRC32
	select PHYLIB
	help
	  This driver supports the Qualcomm Technologies, Inc. Gigabit
	  Ethernet Media Access Controller (EMAC). The controller
	  supports IEEE 802.3-2002, half-duplex mode at 10/100 Mb/s,
	  full-duplex mode at 10/100/1000Mb/s, Wake On LAN (WOL) for
	  low power, Receive-Side Scaling (RSS), and IEEE 1588-2008
	  Precision Clock Synchronization Protocol.

config QCOM_PPE
	tristate "Qualcomm Technologies, Inc. PPE Ethernet support"
	depends on COMMON_CLK && HAS_IOMEM && OF
	depends on ARCH_QCOM || COMPILE_TEST
	select REGMAP_MMIO
	help
	  This driver supports the Qualcomm Technologies, Inc. packet
	  process engine (PPE) available with IPQ SoC. The PPE includes
	  the Ethernet MACs, Ethernet DMA (EDMA) and switch core that
	  supports L3 flow offload, L2 switch function, RSS and tunnel
	  offload.

	  To compile this driver as a module, choose M here. The module
	  will be called qcom-ppe.

source "drivers/net/ethernet/qualcomm/rmnet/Kconfig"

endif # NET_VENDOR_QUALCOMM
```

## drivers/net/ethernet/qualcomm/rmnet/Kconfig
```kconfig
#
# RMNET MAP driver
#

menuconfig RMNET
	tristate "RmNet MAP driver"
	default n
	select GRO_CELLS
	---help---
	  If you select this, you will enable the RMNET module which is used
	  for handling data in the multiplexing and aggregation protocol (MAP)
	  format in the embedded data path. RMNET devices can be attached to
	  any IP mode physical device.
```

## drivers/net/ethernet/racal/Kconfig
```kconfig
#
# Racal-Interlan device configuration
#

config NET_VENDOR_RACAL
	bool "Racal-Interlan (Micom) NI devices"
	default y
	depends on ISA
	---help---
	  If you have a network (Ethernet) card belonging to this class, such
	  as the NI5010, NI5210 or NI6210, say Y and read the Ethernet-HOWTO,
	  available from <http://www.tldp.org/docs.html#howto>.

	  Note that the answer to this question doesn't directly affect the
	  kernel: saying N will just cause the configurator to skip all
	  the questions about NI cards. If you say Y, you will be asked for
	  your specific card in the following questions.

if NET_VENDOR_RACAL

config NI5010
	tristate "NI5010 support (EXPERIMENTAL)"
	depends on ISA && EXPERIMENTAL && BROKEN_ON_SMP
	---help---
	  If you have a network (Ethernet) card of this type, say Y and read
	  the Ethernet-HOWTO, available from
	  <http://www.tldp.org/docs.html#howto>. Note that this is still
	  experimental code.

	  To compile this driver as a module, choose M here. The module
	  will be called ni5010.

endif # NET_VENDOR_RACAL
```

## drivers/net/ethernet/rdc/Kconfig
```kconfig
# SPDX-License-Identifier: GPL-2.0-only
#
# RDC network device configuration
#

config NET_VENDOR_RDC
	bool "RDC devices"
	default y
	depends on PCI
	---help---
	  If you have a network (Ethernet) card belonging to this class, say Y.

	  Note that the answer to this question doesn't directly affect the
	  kernel: saying N will just cause the configurator to skip all
	  the questions about RDC cards. If you say Y, you will be asked for
	  your specific card in the following questions.

if NET_VENDOR_RDC

config R6040
	tristate "RDC R6040 Fast Ethernet Adapter support"
	depends on PCI
	select CRC32
	select MII
	select PHYLIB
	---help---
	  This is a driver for the R6040 Fast Ethernet MACs found in the
	  the RDC R-321x System-on-chips.

	  To compile this driver as a module, choose M here: the module
	  will be called r6040. This is recommended.

endif # NET_VENDOR_RDC
```

## drivers/net/ethernet/realtek/Kconfig
```kconfig
#
# Realtek device configuration
#

config NET_VENDOR_REALTEK
	bool "Realtek devices"
	default y
	depends on PCI || (PARPORT && X86)
	---help---
	  If you have a network (Ethernet) card belonging to this class, say Y
	  and read the Ethernet-HOWTO, available from
	  <http://www.tldp.org/docs.html#howto>.

	  Note that the answer to this question doesn't directly affect the
	  kernel: saying N will just cause the configurator to skip all
	  the questions about Realtek devices. If you say Y, you will be asked for
	  your specific card in the following questions.

if NET_VENDOR_REALTEK

config ATP
	tristate "AT-LAN-TEC/RealTek pocket adapter support"
	depends on PARPORT && X86
	select CRC32
	---help---
	  This is a network (Ethernet) device which attaches to your parallel
	  port. Read <file:drivers/net/atp.c> as well as the Ethernet-HOWTO,
	  available from <http://www.tldp.org/docs.html#howto>, if you
	  want to use this.  If you intend to use this driver, you should have
	  said N to the "Parallel printer support", because the two drivers
	  don't like each other.

	  To compile this driver as a module, choose M here: the module
	  will be called atp.

config 8139CP
	tristate "RealTek RTL-8139 C+ PCI Fast Ethernet Adapter support (EXPERIMENTAL)"
	depends on PCI && EXPERIMENTAL
	select CRC32
	select NET_CORE
	select MII
	---help---
	  This is a driver for the Fast Ethernet PCI network cards based on
	  the RTL8139C+ chips. If you have one of those, say Y and read
	  the Ethernet-HOWTO, available from
	  <http://www.tldp.org/docs.html#howto>.

	  To compile this driver as a module, choose M here: the module
	  will be called 8139cp.  This is recommended.

config 8139TOO
	tristate "RealTek RTL-8129/8130/8139 PCI Fast Ethernet Adapter support"
	depends on PCI
	select CRC32
	select NET_CORE
	select MII
	---help---
	  This is a driver for the Fast Ethernet PCI network cards based on
	  the RTL 8129/8130/8139 chips. If you have one of those, say Y and
	  read the Ethernet-HOWTO <http://www.tldp.org/docs.html#howto>.

	  To compile this driver as a module, choose M here: the module
	  will be called 8139too.  This is recommended.

config 8139TOO_PIO
	bool "Use PIO instead of MMIO"
	default y
	depends on 8139TOO
	---help---
	  This instructs the driver to use programmed I/O ports (PIO) instead
	  of PCI shared memory (MMIO).  This can possibly solve some problems
	  in case your mainboard has memory consistency issues.  If unsure,
	  say N.

config 8139TOO_TUNE_TWISTER
	bool "Support for uncommon RTL-8139 rev. K (automatic channel equalization)"
	depends on 8139TOO
	---help---
	  This implements a function which might come in handy in case you
	  are using low quality on long cabling. It is required for RealTek
	  RTL-8139 revision K boards, and totally unused otherwise.  It tries
	  to match the transceiver to the cable characteristics. This is
	  experimental since hardly documented by the manufacturer.
	  If unsure, say Y.

config 8139TOO_8129
	bool "Support for older RTL-8129/8130 boards"
	depends on 8139TOO
	---help---
	  This enables support for the older and uncommon RTL-8129 and
	  RTL-8130 chips, which support MII via an external transceiver,
	  instead of an internal one.  Disabling this option will save some
	  memory by making the code size smaller.  If unsure, say Y.

config 8139_OLD_RX_RESET
	bool "Use older RX-reset method"
	depends on 8139TOO
	---help---
	  The 8139too driver was recently updated to contain a more rapid
	  reset sequence, in the face of severe receive errors.  This "new"
	  RX-reset method should be adequate for all boards.  But if you
	  experience problems, you can enable this option to restore the
	  old RX-reset behavior.  If unsure, say N.

config R8169
	tristate "Realtek 8169 gigabit ethernet support"
	depends on PCI
	select FW_LOADER
	select CRC32
	select NET_CORE
	select MII
	---help---
	  Say Y here if you have a Realtek 8169 PCI Gigabit Ethernet adapter.

	  To compile this driver as a module, choose M here: the module
	  will be called r8169.  This is recommended.

endif # NET_VENDOR_REALTEK
```

## drivers/net/ethernet/renesas/Kconfig
```kconfig
# SPDX-License-Identifier: GPL-2.0
#
# Renesas network device configuration
#

config NET_VENDOR_RENESAS
	bool "Renesas devices"
	default y
	help
	  If you have a network (Ethernet) card belonging to this class, say Y.

	  Note that the answer to this question doesn't directly affect the
	  kernel: saying N will just cause the configurator to skip all
	  the questions about Renesas devices. If you say Y, you will be asked
	  for your specific device in the following questions.

if NET_VENDOR_RENESAS

config SH_ETH
	tristate "Renesas SuperH Ethernet support"
	depends on ARCH_RENESAS || SUPERH || COMPILE_TEST
	select CRC32
	select MII
	select MDIO_BITBANG
	select PHYLIB
	help
	  Renesas SuperH Ethernet device driver.

config RAVB
	tristate "Renesas Ethernet AVB support"
	depends on ARCH_RENESAS || COMPILE_TEST
	depends on PTP_1588_CLOCK_OPTIONAL
	select CRC32
	select MII
	select MDIO_BITBANG
	select PHYLIB
	help
	  Renesas Ethernet AVB device driver.

config RENESAS_ETHER_SWITCH
	tristate "Renesas Ethernet Switch support"
	depends on ARCH_RENESAS || COMPILE_TEST
	depends on PTP_1588_CLOCK_OPTIONAL
	select CRC32
	select MII
	select PHYLINK
	help
	  Renesas Ethernet Switch device driver.

endif # NET_VENDOR_RENESAS
```

## drivers/net/ethernet/rk/Kconfig
```kconfig
#
# rockchip device configuration
#

config NET_VENDOR_ROCKCHIP
	bool "Rockchip devices"
	default y
	depends on HAS_IOMEM
	---help---
	  Rockchip devices

if NET_VENDOR_ROCKCHIP

source "drivers/net/ethernet/rk/vmac/Kconfig"

endif # NET_VENDOR_ROCKCHIP
```

## drivers/net/ethernet/rockchip/Kconfig
```kconfig
# SPDX-License-Identifier: GPL-2.0
#
# rockchip device configuration
#

config NET_VENDOR_ROCKCHIP
	bool "Rockchip devices"
	default y
	depends on HAS_IOMEM
	---help---
	  Rockchip devices

if NET_VENDOR_ROCKCHIP

source "drivers/net/ethernet/rockchip/vmac/Kconfig"
source "drivers/net/ethernet/rockchip/gmac/Kconfig"

endif # NET_VENDOR_ROCKCHIP
```
