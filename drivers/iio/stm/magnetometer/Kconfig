## drivers/infiniband/Kconfig
```kconfig
# SPDX-License-Identifier: GPL-2.0-only
menuconfig INFINIBAND
	tristate "InfiniBand support"
	depends on HAS_IOMEM && HAS_DMA
	depends on NET
	depends on INET
	depends on m || IPV6 != m
	depends on !ALPHA
	select IRQ_POLL
	select DIMLIB
	help
	  Core support for InfiniBand (IB).  Make sure to also select
	  any protocols you wish to use as well as drivers for your
	  InfiniBand hardware.

if INFINIBAND

config INFINIBAND_USER_MAD
	tristate "InfiniBand userspace MAD support"
	depends on INFINIBAND
	help
	  Userspace InfiniBand Management Datagram (MAD) support.  This
	  is the kernel side of the userspace MAD support, which allows
	  userspace processes to send and receive MADs. You will also
	  need libibumad from rdma-core
	  <https://github.com/linux-rdma/rdma-core>.

config INFINIBAND_USER_ACCESS
	tristate "InfiniBand userspace access (verbs and CM)"
	depends on MMU
	help
	  Userspace InfiniBand access support.  This enables the
	  kernel side of userspace verbs and the userspace
	  communication manager (CM).  This allows userspace processes
	  to set up connections and directly access InfiniBand
	  hardware for fast-path operations.  You will also need
	  libibverbs, libibcm and a hardware driver library from
	  rdma-core <https://github.com/linux-rdma/rdma-core>.

config INFINIBAND_USER_MEM
	bool
	depends on INFINIBAND_USER_ACCESS != n
	depends on MMU
	default y

config INFINIBAND_ON_DEMAND_PAGING
	bool "InfiniBand on-demand paging support"
	depends on INFINIBAND_USER_MEM
	select MMU_NOTIFIER
	select INTERVAL_TREE
	select HMM_MIRROR
	default y
	help
	  On demand paging support for the InfiniBand subsystem.
	  Together with driver support this allows registration of
	  memory regions without pinning their pages, fetching the
	  pages on demand instead.

config INFINIBAND_ADDR_TRANS
	bool "RDMA/CM"
	depends on INFINIBAND
	default y
	help
	  Support for RDMA communication manager (CM).
	  This allows for a generic connection abstraction over RDMA.

config INFINIBAND_ADDR_TRANS_CONFIGFS
	bool
	depends on INFINIBAND_ADDR_TRANS && CONFIGFS_FS && !(INFINIBAND=y && CONFIGFS_FS=m)
	default y
	help
	  ConfigFS support for RDMA communication manager (CM).
	  This allows the user to config the default GID type that the CM
	  uses for each device, when initiaing new connections.

config INFINIBAND_VIRT_DMA
	def_bool !HIGHMEM

if INFINIBAND_USER_ACCESS || !INFINIBAND_USER_ACCESS
source "drivers/infiniband/hw/mthca/Kconfig"
source "drivers/infiniband/hw/qib/Kconfig"
source "drivers/infiniband/hw/cxgb4/Kconfig"
source "drivers/infiniband/hw/efa/Kconfig"
source "drivers/infiniband/hw/i40iw/Kconfig"
source "drivers/infiniband/hw/mlx4/Kconfig"
source "drivers/infiniband/hw/mlx5/Kconfig"
source "drivers/infiniband/hw/ocrdma/Kconfig"
source "drivers/infiniband/hw/vmw_pvrdma/Kconfig"
source "drivers/infiniband/hw/usnic/Kconfig"
source "drivers/infiniband/hw/hns/Kconfig"
source "drivers/infiniband/hw/bnxt_re/Kconfig"
source "drivers/infiniband/hw/hfi1/Kconfig"
source "drivers/infiniband/hw/qedr/Kconfig"
source "drivers/infiniband/sw/rdmavt/Kconfig"
source "drivers/infiniband/sw/rxe/Kconfig"
source "drivers/infiniband/sw/siw/Kconfig"
endif

source "drivers/infiniband/ulp/ipoib/Kconfig"

source "drivers/infiniband/ulp/srp/Kconfig"
source "drivers/infiniband/ulp/srpt/Kconfig"

source "drivers/infiniband/ulp/iser/Kconfig"
source "drivers/infiniband/ulp/isert/Kconfig"
source "drivers/infiniband/ulp/rtrs/Kconfig"

source "drivers/infiniband/ulp/opa_vnic/Kconfig"

endif # INFINIBAND
```

## drivers/infiniband/hw/amso1100/Kconfig
```kconfig
config INFINIBAND_AMSO1100
	tristate "Ammasso 1100 HCA support"
	depends on PCI && INET
	---help---
	  This is a low-level driver for the Ammasso 1100 host
	  channel adapter (HCA).

config INFINIBAND_AMSO1100_DEBUG
	bool "Verbose debugging output"
	depends on INFINIBAND_AMSO1100
	default n
	---help---
	  This option causes the amso1100 driver to produce a bunch of
	  debug messages.  Select this if you are developing the driver
	  or trying to diagnose a problem.
```

## drivers/infiniband/hw/bng_re/Kconfig
```kconfig
# SPDX-License-Identifier: GPL-2.0-only
config INFINIBAND_BNG_RE
	tristate "Broadcom Next generation RoCE HCA support"
	depends on 64BIT
	depends on INET && DCB && BNGE
	help
	  This driver supports Broadcom Next generation
	  50/100/200/400/800 gigabit RoCE HCAs. The module
	  will be called bng_re. To compile this driver
	  as a module, choose M here.
```

## drivers/infiniband/hw/bnxt_re/Kconfig
```kconfig
# SPDX-License-Identifier: GPL-2.0-only
config INFINIBAND_BNXT_RE
        tristate "Broadcom Netxtreme HCA support"
        depends on 64BIT
        depends on ETHERNET && NETDEVICES && PCI && INET && DCB
        select NET_VENDOR_BROADCOM
        select BNXT
        ---help---
	  This driver supports Broadcom NetXtreme-E 10/25/40/50 gigabit
	  RoCE HCAs.  To compile this driver as a module, choose M here:
	  the module will be called bnxt_re.
```

## drivers/infiniband/hw/cxgb3/Kconfig
```kconfig
config INFINIBAND_CXGB3
	tristate "Chelsio RDMA Driver"
	depends on CHELSIO_T3
	select GENERIC_ALLOCATOR
	---help---
	  This is an iWARP/RDMA driver for the Chelsio T3 1GbE and
	  10GbE adapters.

	  For general information about Chelsio and our products, visit
	  our website at <http://www.chelsio.com>.

	  For customer support, please visit our customer support page at
	  <http://www.chelsio.com/support.html>.

	  Please send feedback to <linux-bugs@chelsio.com>.

	  To compile this driver as a module, choose M here: the module
	  will be called iw_cxgb3.
```

## drivers/infiniband/hw/cxgb4/Kconfig
```kconfig
config INFINIBAND_CXGB4
	tristate "Chelsio T4/T5 RDMA Driver"
	depends on CHELSIO_T4 && INET
	select CHELSIO_LIB
	select GENERIC_ALLOCATOR
	---help---
	  This is an iWARP/RDMA driver for the Chelsio T4 and T5
	  1GbE, 10GbE adapters and T5 40GbE adapter.

	  For general information about Chelsio and our products, visit
	  our website at <http://www.chelsio.com>.

	  For customer support, please visit our customer support page at
	  <http://www.chelsio.com/support.html>.

	  Please send feedback to <linux-bugs@chelsio.com>.

	  To compile this driver as a module, choose M here: the module
	  will be called iw_cxgb4.
```

## drivers/infiniband/hw/efa/Kconfig
```kconfig
# SPDX-License-Identifier: GPL-2.0 OR BSD-2-Clause
# Copyright 2018-2019 Amazon.com, Inc. or its affiliates. All rights reserved.
#
# Amazon fabric device configuration
#

config INFINIBAND_EFA
	tristate "Amazon Elastic Fabric Adapter (EFA) support"
	depends on PCI_MSI && 64BIT && !CPU_BIG_ENDIAN
	depends on INFINIBAND_USER_ACCESS
	help
	  This driver supports Amazon Elastic Fabric Adapter (EFA).

	  To compile this driver as a module, choose M here.
	  The module will be called efa.
```

## drivers/infiniband/hw/ehca/Kconfig
```kconfig
config INFINIBAND_EHCA
	tristate "eHCA support"
	depends on IBMEBUS && INFINIBAND
	---help---
	This driver supports the IBM pSeries eHCA InfiniBand adapter.

	To compile the driver as a module, choose M here. The module
	will be called ib_ehca.
```

## drivers/infiniband/hw/erdma/Kconfig
```kconfig
# SPDX-License-Identifier: GPL-2.0-only
config INFINIBAND_ERDMA
	tristate "Alibaba Elastic RDMA Adapter (ERDMA) support"
	depends on PCI_MSI && 64BIT
	depends on INFINIBAND_ADDR_TRANS
	depends on INFINIBAND_USER_ACCESS
	help
	  This is a RDMA/iWarp driver for Alibaba Elastic RDMA Adapter(ERDMA),
	  which supports RDMA features in Alibaba cloud environment.

	  To compile this driver as module, choose M here. The module will be
	  called erdma.
```

## drivers/infiniband/hw/hfi1/Kconfig
```kconfig
config INFINIBAND_HFI1
	tristate "Intel OPA Gen1 support"
	depends on X86_64 && INFINIBAND_RDMAVT && I2C
	select MMU_NOTIFIER
	select CRC32
	select I2C_ALGOBIT
	---help---
	This is a low-level driver for Intel OPA Gen1 adapter.
config HFI1_DEBUG_SDMA_ORDER
	bool "HFI1 SDMA Order debug"
	depends on INFINIBAND_HFI1
	default n
	---help---
	This is a debug flag to test for out of order
	sdma completions for unit testing
config SDMA_VERBOSITY
	bool "Config SDMA Verbosity"
	depends on INFINIBAND_HFI1
	default n
	---help---
	This is a configuration flag to enable verbose
	SDMA debug
```

## drivers/infiniband/hw/hns/Kconfig
```kconfig
# SPDX-License-Identifier: GPL-2.0-only
config INFINIBAND_HNS_HIP08
	tristate "Hisilicon Hip08 Family RoCE support"
	depends on ARM64 || (COMPILE_TEST && 64BIT)
	depends on PCI && HNS3
	help
	  RoCE driver support for Hisilicon RoCE engine in Hisilicon Hip08 SoC.
	  The RoCE engine is a PCI device.

	  To compile this driver, choose M here. This module will be called
	  hns-roce-hw-v2.
```

## drivers/infiniband/hw/i40iw/Kconfig
```kconfig
config INFINIBAND_I40IW
	tristate "Intel(R) Ethernet X722 iWARP Driver"
	depends on INET && I40E
	depends on PCI
	select GENERIC_ALLOCATOR
	---help---
	Intel(R) Ethernet X722 iWARP Driver
```

## drivers/infiniband/hw/ionic/Kconfig
```kconfig
# SPDX-License-Identifier: GPL-2.0
# Copyright (C) 2018-2025, Advanced Micro Devices, Inc.

config INFINIBAND_IONIC
	tristate "AMD Pensando DSC RDMA/RoCE Support"
	depends on NETDEVICES && ETHERNET && PCI && INET && IONIC
	help
	  This enables RDMA/RoCE support for the AMD Pensando family of
	  Distributed Services Cards (DSCs).

	  To learn more, visit our website at
	  <https://www.amd.com/en/products/accelerators/pensando.html>.

	  To compile this driver as a module, choose M here. The module
	  will be called ionic_rdma.
```

## drivers/infiniband/hw/ipath/Kconfig
```kconfig
config INFINIBAND_IPATH
	tristate "QLogic HTX HCA support"
	depends on 64BIT && NET && HT_IRQ
	---help---
	This is a driver for the obsolete QLogic Hyper-Transport
	IB host channel adapter (model QHT7140),
	including InfiniBand verbs support.  This driver allows these
	devices to be used with both kernel upper level protocols such
	as IP-over-InfiniBand as well as with userspace applications
	(in conjunction with InfiniBand userspace access).
	For QLogic PCIe QLE based cards, use the QIB driver instead.

	If you have this hardware you will need to boot with PAT disabled
	on your x86-64 systems, use the nopat kernel parameter.
```

## drivers/infiniband/hw/irdma/Kconfig
```kconfig
# SPDX-License-Identifier: GPL-2.0-only
config INFINIBAND_IRDMA
	tristate "Intel(R) Ethernet Protocol Driver for RDMA"
	depends on INET
	depends on IPV6 || !IPV6
	depends on PCI
	depends on IDPF && ICE && I40E
	select GENERIC_ALLOCATOR
	select AUXILIARY_BUS
	select CRC32
	help
	  This is an Intel(R) Ethernet Protocol Driver for RDMA that
	  supports IPU E2000 (RoCEv2), E810 (iWARP/RoCEv2) and X722 (iWARP)
	  network devices.
```

## drivers/infiniband/hw/mana/Kconfig
```kconfig
# SPDX-License-Identifier: GPL-2.0-only
config MANA_INFINIBAND
	tristate "Microsoft Azure Network Adapter support"
	depends on NETDEVICES && ETHERNET && PCI && MICROSOFT_MANA
	help
	  This driver provides low-level RDMA support for Microsoft Azure
	  Network Adapter (MANA). MANA supports RDMA features that can be used
	  for workloads (e.g. DPDK, MPI etc) that uses RDMA verbs to directly
	  access hardware from user-mode processes in Microsoft Azure cloud
	  environment.
```

## drivers/infiniband/hw/mlx4/Kconfig
```kconfig
# SPDX-License-Identifier: GPL-2.0-only
config MLX4_INFINIBAND
	tristate "Mellaanalx ConnectX HCA support"
	depends on NETDEVICES && ETHERNET && PCI && INET
	select NET_VENDOR_MELLAANALX
	select MLX4_CORE
	help
	  This driver provides low-level InfiniBand support for
	  Mellaanalx ConnectX PCI Express host channel adapters (HCAs).
	  This is required to use InfiniBand protocols such as
	  IP-over-IB or SRP with these devices.
```
