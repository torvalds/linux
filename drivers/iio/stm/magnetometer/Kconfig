## drivers/iio/stm/magnetometer/Kconfig
```kconfig
# SPDX-License-Identifier: GPL-2.0-only
#
# Magnetometer sensors
#
# When adding new entries keep the list in alphabetical order

menu "Magnetometer sensors"

config ST_MAG3D_IIO
        tristate "STMicroelectronics LIS3MDL/LSM9DS1 mag sensor"
        depends on (I2C || SPI) && SYSFS
        select IIO_BUFFER
        select IIO_TRIGGERED_BUFFER
        select ST_MAG3D_I2C_IIO if (I2C)
        select ST_MAG3D_SPI_IIO if (SPI)
        help
          Say yes here to build support for STMicroelectronics magnetometers:
          LIS3MDL, LSM9DS1 mag sensor

          To compile this driver as a module, choose M here. The module
          will be called st_mag3d

config ST_MAG3D_I2C_IIO
        tristate
        depends on ST_MAG3D_IIO
        depends on I2C

config ST_MAG3D_SPI_IIO
        tristate
        depends on ST_MAG3D_IIO
        depends on SPI

config ST_MAG40_IIO
	tristate "STMicroelectronics LIS2MDL/LSM303AH/LSM303AGR/ISM303DAC/IIS2MDC sensor"
	depends on (I2C || SPI) && SYSFS
	select IIO_BUFFER
	select IIO_TRIGGERED_BUFFER
	select ST_MAG40_I2C_IIO if (I2C)
	select ST_MAG40_SPI_IIO if (SPI)
	help
	  Say yes here to build support for STMicroelectronics magnetometers:
	  LIS2MDL, LSM303AH, LSM303AGR, ISM303DAC, IIS2MDC.

	  To compile this driver as a module, choose M here. The module
	  will be called st_mag40.

config ST_MAG40_I2C_IIO
	tristate
	depends on ST_MAG40_IIO
	depends on I2C

config ST_MAG40_SPI_IIO
	tristate
	depends on ST_MAG40_IIO
	depends on SPI

endmenu
```

## drivers/iio/stm/pressure/Kconfig
```kconfig
# SPDX-License-Identifier: GPL-2.0-only
#
# Pressure drivers
#
# When adding new entries keep the list in alphabetical order

menu "Pressure sensors"

config ST_LPS22HH_IIO
	tristate "STMicroelectronics LPS22CH/LPS22HH/LPS27HHW sensor"
	depends on (I2C || SPI_MASTER) && SYSFS
	select IIO_BUFFER
	select IIO_KFIFO_BUF
	select ST_LPS22HH_I2C_IIO if (I2C)
	select ST_LPS22HH_SPI_IIO if (SPI)
	help
	  This driver supports LPS22HH sensors. This driver can be
	  built as a module. The module will be called st-lps22hh.

config ST_LPS22HH_I2C_IIO
	tristate
	depends on ST_LPS22HH_IIO

config ST_LPS22HH_SPI_IIO
	tristate
	depends on ST_LPS22HH_IIO

config ST_LPS22DF_IIO
        tristate "STMicroelectronics LPS22DF/LPS28DFW sensor"
        depends on (I2C || SPI_MASTER) && SYSFS
        select IIO_BUFFER
        select IIO_KFIFO_BUF
        select ST_LPS22DF_I2C_IIO if (I2C)
        select ST_LPS22DF_SPI_IIO if (SPI)
        help
          Say yes here to build support for the ST MEMS LPS22DF/LPS28DFW
	  pressure and temperature  sensor.

          This driver can be built as a module. The module will be called
          st-lps22df.

config ST_LPS22DF_I2C_IIO
        tristate
        depends on ST_LPS22DF_IIO

config ST_LPS22DF_SPI_IIO
        tristate
        depends on ST_LPS22DF_IIO

config ST_LPS22HB_IIO
        tristate "STMicroelectronics LPS22HB sensor"
        depends on (I2C || SPI_MASTER) && SYSFS
        select IIO_BUFFER
        select IIO_KFIFO_BUF
        select ST_LPS22HB_I2C_IIO if (I2C)
        select ST_LPS22HB_SPI_IIO if (SPI)
        help
          This driver supports LPS22HB pressure sensor. This driver can be
          built as a module. The module will be called st-lps22hb.

config ST_LPS22HB_I2C_IIO
        tristate
        depends on ST_LPS22HB_IIO

config ST_LPS22HB_SPI_IIO
        tristate
        depends on ST_LPS22HB_IIO

config ST_LPS33HW_IIO
        tristate "STMicroelectronics LPS33HW sensor"
        depends on (I2C || SPI_MASTER) && SYSFS
        select IIO_BUFFER
        select IIO_KFIFO_BUF
        select ST_LPS33HW_I2C_IIO if (I2C)
        select ST_LPS33HW_SPI_IIO if (SPI)
        help
          This driver supports LPS33HW pressure sensors. This driver can be
          built as a module. The module will be called st-lps33hw.

config ST_LPS33HW_I2C_IIO
        tristate
        depends on ST_LPS33HW_IIO

config ST_LPS33HW_SPI_IIO
        tristate
        depends on ST_LPS33HW_IIO

config ST_ILPS22QS_IIO
	tristate "STMicroelectronics ILPS22QS sensor"
	depends on (I2C || SPI_MASTER) && SYSFS
	select IIO_BUFFER
	select IIO_KFIFO_BUF
	select ST_ILPS22QS_I2C_IIO if (I2C)
	select ST_ILPS22QS_SPI_IIO if (SPI)
	help
	  This driver supports ILPS22QS sensor. This driver can be
	  built as a module. The module will be called st-ilps22qs.

config ST_ILPS22QS_I2C_IIO
	tristate
	depends on ST_ILPS22QS_IIO

config ST_ILPS22QS_SPI_IIO
	tristate
	depends on ST_ILPS22QS_IIO

endmenu
```

## drivers/iio/stm/temperature/Kconfig
```kconfig
# SPDX-License-Identifier: GPL-2.0-only
#
# Temperature sensor drivers
#
menu "Temperature sensors"

config IIO_STTS22H
	tristate "STTS22H ST MEMS temperature sensor"
	depends on I2C
	help
	  If you say yes here you get support for STTS22H ST MEMS I2C
	  temperature sensor.

	  This driver can also be built as a module. If so, the module
	  will be called stts22h.

endmenu
```

## drivers/iio/stm/tmos/Kconfig
```kconfig
# SPDX-License-Identifier: GPL-2.0-only
#
# IIO tmos drivers configuration
#
# When adding new entries keep the list in alphabetical order

menu "Tmos"

source "drivers/iio/stm/tmos/st_sths34pf80/Kconfig"

endmenu
```

## drivers/iio/stm/tmos/st_sths34pf80/Kconfig
```kconfig
# SPDX-License-Identifier: GPL-2.0-only

config IIO_ST_STHS34PF80
	tristate "STMicroelectronics STHS34PF80 sensor"
	depends on (I2C || SPI)
	select IIO_BUFFER
	select IIO_KFIFO_BUF
	select IIO_ST_STHS34PF80_I2C if (I2C)
	select IIO_ST_STHS34PF80_SPI if (SPI_MASTER)
	help
	  Say yes here to build support for STMicroelectronics
	  STHS34PF80 tmos sensor.

	  To compile this driver as a module, choose M here: the module
	  will be called st_sths34pf80.

config IIO_ST_STHS34PF80_I2C
	tristate
	select REGMAP_I2C
	depends on IIO_ST_STHS34PF80

config IIO_ST_STHS34PF80_SPI
	tristate
	select REGMAP_SPI
	depends on IIO_ST_STHS34PF80
```

## drivers/iio/temperature/Kconfig
```kconfig
# SPDX-License-Identifier: GPL-2.0-only
#
# Temperature sensor drivers
#
menu "Temperature sensors"

config LTC2983
	tristate "Analog Devices Multi-Sensor Digital Temperature Measurement System"
	depends on SPI
	select REGMAP_SPI
	help
	  Say yes here to build support for the LTC2983 Multi-Sensor
	  high accuracy digital temperature measurement system.

	  To compile this driver as a module, choose M here: the module
	  will be called ltc2983.

config MAXIM_THERMOCOUPLE
	tristate "Maxim thermocouple sensors"
	depends on SPI
	select IIO_BUFFER
	select IIO_TRIGGERED_BUFFER
	help
	  If you say yes here you get support for the Maxim series of
	  thermocouple sensors connected via SPI.

	  Supported sensors:
	   * MAX6675
	   * MAX31855

	  This driver can also be built as a module. If so, the module will
	  be called maxim_thermocouple.

config HID_SENSOR_TEMP
	tristate "HID Environmental temperature sensor"
	depends on HID_SENSOR_HUB
	select IIO_BUFFER
	select IIO_TRIGGERED_BUFFER
	select HID_SENSOR_IIO_COMMON
	select HID_SENSOR_IIO_TRIGGER
	help
	  Say yes here to build support for the HID SENSOR
	  temperature driver

	  To compile this driver as a module, choose M here: the module
	  will be called hid-sensor-temperature.

config MLX90614
	tristate "MLX90614 contact-less infrared sensor"
	depends on I2C
	help
	  If you say yes here you get support for the Melexis
	  MLX90614 contact-less infrared sensor connected with I2C.

	  This driver can also be built as a module. If so, the module will
	  be called mlx90614.

config MLX90632
	tristate "MLX90632 contact-less infrared sensor with medical accuracy"
	depends on I2C
	select REGMAP_I2C
	help
	  If you say yes here you get support for the Melexis
	  MLX90632 contact-less infrared sensor with medical accuracy
	  connected with I2C.

	  This driver can also be built as a module. If so, the module will
	  be called mlx90632.

config TMP006
	tristate "TMP006 infrared thermopile sensor"
	depends on I2C
	help
	  If you say yes here you get support for the Texas Instruments
	  TMP006 infrared thermopile sensor.

	  This driver can also be built as a module. If so, the module will
	  be called tmp006.

config TMP007
	tristate "TMP007 infrared thermopile sensor with Integrated Math Engine"
	depends on I2C
	help
	  If you say yes here you get support for the Texas Instruments
	  TMP007 infrared thermopile sensor with Integrated Math Engine.

	  This driver can also be built as a module. If so, the module will
	  be called tmp007.

config TSYS01
	tristate "Measurement Specialties TSYS01 temperature sensor using I2C bus connection"
	depends on I2C
	select IIO_MS_SENSORS_I2C
	help
	  If you say yes here you get support for the Measurement Specialties
	  TSYS01 I2C temperature sensor.

	  This driver can also be built as a module. If so, the module will
	  be called tsys01.

config TSYS02D
	tristate "Measurement Specialties TSYS02D temperature sensor"
	depends on I2C
	select IIO_MS_SENSORS_I2C
	help
	  If you say yes here you get support for the Measurement Specialties
	  TSYS02D temperature sensor.

	  This driver can also be built as a module. If so, the module will
	  be called tsys02d.

config MAX31856
	tristate "MAX31856 thermocouple sensor"
	depends on SPI
	help
	  If you say yes here you get support for MAX31856
	  thermocouple sensor chip connected via SPI.

	  This driver can also be built as a module.  If so, the module
	  will be called max31856.

endmenu
```

## drivers/iio/test/Kconfig
```kconfig
# SPDX-License-Identifier: GPL-2.0-only
#
# Industrial I/O subsystem unit tests configuration
#

# Keep in alphabetical order
config IIO_RESCALE_KUNIT_TEST
	tristate "Test IIO rescale conversion functions" if !KUNIT_ALL_TESTS
	depends on KUNIT && IIO_RESCALE
	default KUNIT_ALL_TESTS
	help
	  Build unit tests for the iio-rescale code.

	  For more information on KUnit and unit tests in general, please refer
	  to the KUnit documentation in Documentation/dev-tools/kunit/.

	  If unsure, say N.

config IIO_FORMAT_KUNIT_TEST
	tristate "Test IIO formatting functions" if !KUNIT_ALL_TESTS
	depends on KUNIT
	default KUNIT_ALL_TESTS
	help
	  build unit tests for the IIO formatting functions.

	  For more information on KUnit and unit tests in general, please refer
	  to the KUnit documentation in Documentation/dev-tools/kunit/.

	  If unsure, say N.
```

## drivers/iio/trigger/Kconfig
```kconfig
# SPDX-License-Identifier: GPL-2.0-only
#
# Industrial I/O standalone triggers
#
# When adding new entries keep the list in alphabetical order

menu "Triggers - standalone"

config IIO_HRTIMER_TRIGGER
	tristate "High resolution timer trigger"
	depends on IIO_SW_TRIGGER
	help
	  Provides a frequency based IIO trigger using high resolution
	  timers as interrupt source.

	  To compile this driver as a module, choose M here: the
	  module will be called iio-trig-hrtimer.

config IIO_INTERRUPT_TRIGGER
	tristate "Generic interrupt trigger"
	help
	  Provides support for using an interrupt of any type as an IIO
	  trigger.  This may be provided by a gpio driver for example.

	  To compile this driver as a module, choose M here: the
	  module will be called iio-trig-interrupt.

config IIO_STM32_LPTIMER_TRIGGER
	tristate "STM32 Low-Power Timer Trigger"
	depends on MFD_STM32_LPTIMER || COMPILE_TEST
	help
	  Select this option to enable STM32 Low-Power Timer Trigger.
	  This can be used as trigger source for STM32 internal ADC
	  and/or DAC.

	  To compile this driver as a module, choose M here: the
	  module will be called stm32-lptimer-trigger.

config IIO_STM32_TIMER_TRIGGER
	tristate "STM32 Timer Trigger"
	depends on (ARCH_STM32 && OF && MFD_STM32_TIMERS) || COMPILE_TEST
	help
	  Select this option to enable STM32 Timer Trigger

	  To compile this driver as a module, choose M here: the
	  module will be called stm32-timer-trigger.

config IIO_TIGHTLOOP_TRIGGER
	tristate "A kthread based hammering loop trigger"
	depends on IIO_SW_TRIGGER
	help
	  An experimental trigger, used to allow sensors to be sampled as fast
	  as possible under the limitations of whatever else is going on.
	  Uses a tight loop in a kthread.  Will only work with lower half only
	  trigger consumers.

	  To compile this driver as a module, choose M here: the
	  module will be called iio-trig-loop.

config IIO_SYSFS_TRIGGER
	tristate "SYSFS trigger"
	depends on SYSFS
	select IRQ_WORK
	help
	  Provides support for using SYSFS entries as IIO triggers.
	  If unsure, say N (but it's safe to say "Y").

	  To compile this driver as a module, choose M here: the
	  module will be called iio-trig-sysfs.

endmenu
```
