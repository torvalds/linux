## drivers/iio/imu/Kconfig
```kconfig
# SPDX-License-Identifier: GPL-2.0-only
#
# IIO imu drivers configuration
#
# When adding new entries keep the list in alphabetical order

menu "Inertial measurement units"

config ADIS16400
	tristate "Analog Devices ADIS16400 and similar IMU SPI driver"
	depends on SPI
	select IIO_ADIS_LIB
	select IIO_ADIS_LIB_BUFFER if IIO_BUFFER
	help
	  Say yes here to build support for Analog Devices adis16300, adis16344,
	  adis16350, adis16354, adis16355, adis16360, adis16362, adis16364,
	  adis16365, adis16400 and adis16405 triaxial inertial sensors
	  (adis16400 series also have magnetometers).

config ADIS16460
	tristate "Analog Devices ADIS16460 and similar IMU driver"
	depends on SPI
	select IIO_ADIS_LIB
	select IIO_ADIS_LIB_BUFFER if IIO_BUFFER
	help
	  Say yes here to build support for Analog Devices ADIS16460 inertial
	  sensor.

	  To compile this driver as a module, choose M here: the module will be
	  called adis16460.

config ADIS16480
	tristate "Analog Devices ADIS16480 and similar IMU driver"
	depends on SPI
	select IIO_ADIS_LIB
	select IIO_ADIS_LIB_BUFFER if IIO_BUFFER
	help
	  Say yes here to build support for Analog Devices ADIS16375, ADIS16480,
	  ADIS16485, ADIS16488 inertial sensors.

source "drivers/iio/imu/bmi160/Kconfig"

config FXOS8700
	tristate

config FXOS8700_I2C
	tristate "NXP FXOS8700 I2C driver"
	depends on I2C
	select FXOS8700
	select REGMAP_I2C
	help
	  Say yes here to build support for the NXP FXOS8700 m+g combo
	  sensor on I2C.

	  This driver can also be built as a module. If so, the module will be
	  called fxos8700_i2c.

config FXOS8700_SPI
	tristate "NXP FXOS8700 SPI driver"
	depends on SPI
	select FXOS8700
	select REGMAP_SPI
	help
	  Say yes here to build support for the NXP FXOS8700 m+g combo
	  sensor on SPI.

	  This driver can also be built as a module. If so, the module will be
	  called fxos8700_spi.

config KMX61
	tristate "Kionix KMX61 6-axis accelerometer and magnetometer"
	depends on I2C
	select IIO_BUFFER
	select IIO_TRIGGERED_BUFFER
	help
	  Say Y here if you want to build a driver for Kionix KMX61 6-axis
	  accelerometer and magnetometer.
	  To compile this driver as module, choose M here: the module will
	  be called kmx61.

source "drivers/iio/imu/inv_mpu6050/Kconfig"
source "drivers/iio/imu/st_lsm6dsx/Kconfig"

endmenu

config IIO_ADIS_LIB
	tristate
	help
	  A set of IO helper functions for the Analog Devices ADIS* device family.

config IIO_ADIS_LIB_BUFFER
	bool
	select IIO_TRIGGERED_BUFFER
	help
	  A set of buffer helper functions for the Analog Devices ADIS* device
	  family.
```

## drivers/iio/imu/bmi160/Kconfig
```kconfig
# SPDX-License-Identifier: GPL-2.0-only
#
# BMI160 IMU driver
#

config BMI160
	tristate
	select IIO_BUFFER
	select IIO_TRIGGERED_BUFFER

config BMI160_I2C
	tristate "Bosch BMI160 I2C driver"
	depends on I2C
	select BMI160
	select REGMAP_I2C
	help
	  If you say yes here you get support for BMI160 IMU on I2C with
	  accelerometer, gyroscope and external BMG160 magnetometer.

	  This driver can also be built as a module. If so, the module will be
	  called bmi160_i2c.

config BMI160_SPI
	tristate "Bosch BMI160 SPI driver"
	depends on SPI
	select BMI160
	select REGMAP_SPI
	help
	  If you say yes here you get support for BMI160 IMU on SPI with
	  accelerometer, gyroscope and external BMG160 magnetometer.

	  This driver can also be built as a module. If so, the module will be
	  called bmi160_spi.
```

## drivers/iio/imu/bmi270/Kconfig
```kconfig
# SPDX-License-Identifier: GPL-2.0
#
# BMI270 IMU driver
#

config BMI270
	tristate
	select IIO_BUFFER
	select IIO_TRIGGERED_BUFFER

config BMI270_I2C
	tristate "Bosch BMI270 I2C driver"
	depends on I2C
	select BMI270
	select REGMAP_I2C
	help
	  Enable support for the Bosch BMI270 6-Axis IMU connected to I2C
	  interface.

	  This driver can also be built as a module. If so, the module will be
	  called bmi270_i2c.

config BMI270_SPI
	tristate "Bosch BMI270 SPI driver"
	depends on SPI
	select BMI270
	select REGMAP_SPI
	help
	  Enable support for the Bosch BMI270 6-Axis IMU connected to SPI
	  interface.

	  This driver can also be built as a module. If so, the module will be
	  called bmi270_spi.
```

## drivers/iio/imu/bmi323/Kconfig
```kconfig
# SPDX-License-Identifier: GPL-2.0
#
# BMI323 IMU driver
#

config BMI323
	tristate
	select IIO_BUFFER
	select IIO_TRIGGERED_BUFFER

config BMI323_I2C
	tristate "Bosch BMI323 I2C driver"
	depends on I2C
	select BMI323
	select REGMAP_I2C
	help
	  Enable support for the Bosch BMI323 6-Axis IMU connected to I2C
	  interface.

	  This driver can also be built as a module. If so, the module will be
	  called bmi323_i2c.

config BMI323_SPI
	tristate "Bosch BMI323 SPI driver"
	depends on SPI
	select BMI323
	select REGMAP_SPI
	help
	  Enable support for the Bosch BMI323 6-Axis IMU connected to SPI
	  interface.

	  This driver can also be built as a module. If so, the module will be
	  called bmi323_spi.
```

## drivers/iio/imu/bno055/Kconfig
```kconfig
# SPDX-License-Identifier: GPL-2.0

config BOSCH_BANAL055
	tristate
	select IIO_BUFFER
	select IIO_TRIGGERED_BUFFER

config BOSCH_BANAL055_SERIAL
	tristate "Bosch BANAL055 attached via UART"
	depends on SERIAL_DEV_BUS
	select REGMAP
	select BOSCH_BANAL055
	help
	  Enable this to support Bosch BANAL055 IMUs attached via UART.

	  This driver can also be built as a module. If so, the module will be
	  called banal055_sl.

config BOSCH_BANAL055_I2C
	tristate "Bosch BANAL055 attached via I2C bus"
	depends on I2C
	select REGMAP_I2C
	select BOSCH_BANAL055
	help
	  Enable this to support Bosch BANAL055 IMUs attached via I2C bus.

	  This driver can also be built as a module. If so, the module will be
	  called banal055_i2c.
```

## drivers/iio/imu/inv_icm42600/Kconfig
```kconfig
# SPDX-License-Identifier: GPL-2.0-or-later

config INV_ICM42600
	tristate
	select IIO_BUFFER

config INV_ICM42600_I2C
	tristate "InvenSense ICM-426xx I2C driver"
	depends on I2C
	select INV_ICM42600
	select REGMAP_I2C
	help
	  This driver supports the InvenSense ICM-426xx motion tracking
	  devices over I2C.

	  This driver can be built as a module. The module will be called
	  inv-icm42600-i2c.

config INV_ICM42600_SPI
	tristate "InvenSense ICM-426xx SPI driver"
	depends on SPI_MASTER
	select INV_ICM42600
	select REGMAP_SPI
	help
	  This driver supports the InvenSense ICM-426xx motion tracking
	  devices over SPI.

	  This driver can be built as a module. The module will be called
	  inv-icm42600-spi.
```

## drivers/iio/imu/inv_icm45600/Kconfig
```kconfig
# SPDX-License-Identifier: GPL-2.0-or-later

config INV_ICM45600
	tristate
	select IIO_BUFFER
	select IIO_KFIFO_BUF
	select IIO_INV_SENSORS_TIMESTAMP

config INV_ICM45600_I2C
	tristate "InvenSense ICM-456xx I2C driver"
	depends on I2C
	select INV_ICM45600
	select REGMAP_I2C
	help
	  This driver supports the InvenSense ICM-456xx motion tracking
	  devices over I2C.
	  Supported devices:
	  - ICM-45605
	  - ICM-45606
	  - ICM-45608
	  - ICM-45634
	  - ICM-45686
	  - ICM-45687
	  - ICM-45688-P
	  - ICM-45689

	  This driver can be built as a module. The module will be called
	  inv-icm45600-i2c.

config INV_ICM45600_SPI
	tristate "InvenSense ICM-456xx SPI driver"
	depends on SPI_MASTER
	select INV_ICM45600
	select REGMAP_SPI
	help
	  This driver supports the InvenSense ICM-456xx motion tracking
	  devices over SPI.
	  Supported devices:
	  - ICM-45605
	  - ICM-45606
	  - ICM-45608
	  - ICM-45634
	  - ICM-45686
	  - ICM-45687
	  - ICM-45688-P
	  - ICM-45689

	  This driver can be built as a module. The module will be called
	  inv-icm45600-spi.

config INV_ICM45600_I3C
	tristate "InvenSense ICM-456xx I3C driver"
	depends on I3C
	select INV_ICM45600
	select REGMAP_I3C
	help
	  This driver supports the InvenSense ICM-456xx motion tracking
	  devices over I3C.
	  Supported devices:
	  - ICM-45605
	  - ICM-45606
	  - ICM-45608
	  - ICM-45634
	  - ICM-45686
	  - ICM-45687
	  - ICM-45688-P
	  - ICM-45689

	  This driver can be built as a module. The module will be called
	  inv-icm45600-i3c.
```

## drivers/iio/imu/inv_mpu6050/Kconfig
```kconfig
# SPDX-License-Identifier: GPL-2.0-only
#
# inv-mpu6050 drivers for Invensense MPU devices and combos
#

config INV_MPU6050_IIO
	tristate
	select IIO_BUFFER
	select IIO_TRIGGERED_BUFFER

config INV_MPU6050_I2C
	tristate "Invensense MPU6050 devices (I2C)"
	depends on I2C
	select I2C_MUX
	select INV_MPU6050_IIO
	select REGMAP_I2C
	help
	  This driver supports the Invensense MPU6050/9150,
	  MPU6500/6515/6880/9250/9255, ICM20608(D)/20609/20689, ICM20602/ICM20690
	  and IAM20680 motion tracking devices over I2C.
	  This driver can be built as a module. The module will be called
	  inv-mpu6050-i2c.

config INV_MPU6050_SPI
	tristate "Invensense MPU6050 devices (SPI)"
	depends on SPI_MASTER
	select INV_MPU6050_IIO
	select REGMAP_SPI
	help
	  This driver supports the Invensense MPU6000,
	  MPU6500/6515/6880/9250/9255, ICM20608(D)/20609/20689, ICM20602/ICM20690
	  and IAM20680 motion tracking devices over SPI.
	  This driver can be built as a module. The module will be called
	  inv-mpu6050-spi.
```

## drivers/iio/imu/smi330/Kconfig
```kconfig
# SPDX-License-Identifier: GPL-2.0
#
# SMI330 IMU driver
#

config SMI330
	tristate
	select IIO_BUFFER
	select IIO_TRIGGERED_BUFFER

config SMI330_I2C
	tristate "Bosch SMI330 I2C driver"
	depends on I2C
	select SMI330
	select REGMAP_I2C
	help
	  Enable support for the Bosch SMI330 6-Axis IMU connected to I2C
	  interface.

	  This driver can also be built as a module. If so, the module will be
	  called smi330_i2c.

config SMI330_SPI
	tristate "Bosch SMI330 SPI driver"
	depends on SPI
	select SMI330
	select REGMAP_SPI
	help
	  Enable support for the Bosch SMI330 6-Axis IMU connected to SPI
	  interface.

	  This driver can also be built as a module. If so, the module will be
	  called smi330_spi.
```

## drivers/iio/imu/st_lsm6dsr/Kconfig
```kconfig
# SPDX-License-Identifier: GPL-2.0-only
config IIO_ST_LSM6DSR
	tristate "STMicroelectronics LSM6DSR sensor"
	depends on (I2C || SPI)
	select IIO_BUFFER
	select IIO_TRIGGERED_BUFFER
	select IIO_ST_LSM6DSR_I2C if (I2C)
	select IIO_ST_LSM6DSR_SPI if (SPI_MASTER)
	help
	  Say yes here to build support for STMicroelectronics LSM6DSR imu
	  sensor.

	  To compile this driver as a module, choose M here: the module
	  will be called st_lsm6dsr.

config IIO_ST_LSM6DSR_I2C
	tristate
	depends on IIO_ST_LSM6DSR

config IIO_ST_LSM6DSR_SPI
	tristate
	depends on IIO_ST_LSM6DSR

config IIO_ST_LSM6DSR_MAY_WAKEUP
	bool "Enable wake-up irq"
	depends on IIO_ST_LSM6DSR
	help
	  Say 'Y' to enable wake-up irq on interrupt line, this is for the
	  Power Management.

	  But this feature has not been fully implemented yet.

	  If unsure, say 'N'.
```

## drivers/iio/imu/st_lsm6dsx/Kconfig
```kconfig
# SPDX-License-Identifier: GPL-2.0-only

config IIO_ST_LSM6DSX
	tristate "ST_LSM6DSx driver for STM 6-axis IMU MEMS sensors"
	depends on (I2C || SPI || I3C)
	select IIO_BUFFER
	select IIO_TRIGGERED_BUFFER
	select IIO_KFIFO_BUF
	help
	  Say yes here to build support for STMicroelectronics LSM6DSx imu
	  sensor.
	  Supported devices:
	  - asm330lhb
	  - asm330lhh
	  - asm330lhhx
	  - asm330lhhxg1
	  - ism330dhcx
	  - ism330dlc
	  - ism330is
	  - lsm6ds0
	  - lsm6ds3
	  - lsm6ds3h
	  - lsm6ds3tr-c
	  - lsm6dsl
	  - lsm6dsm
	  - lsm6dso
	  - lsm6dso16is
	  - lsm6dsop
	  - lsm6dsox
	  - lsm6dsr
	  - lsm6dsrx
	  - lsm6dst
	  - lsm6dstx
	  - lsm6dsv
	  - lsm6dsv16x
	  - lsm9ds1

	  To compile this driver as a module, choose M here: the module
	  will be called st_lsm6dsx.

config IIO_ST_LSM6DSX_I2C
	tristate "ST_LSM6DSx driver for STM 6-axis IMU MEMS sensors I2C Interface"
	depends on I2C && IIO_ST_LSM6DSX
	default I2C && IIO_ST_LSM6DSX
	select REGMAP_I2C

config IIO_ST_LSM6DSX_SPI
	tristate "ST_LSM6DSx driver for STM 6-axis IMU MEMS sensors SPI Interface"
	depends on SPI_MASTER && IIO_ST_LSM6DSX
	default SPI_MASTER && IIO_ST_LSM6DSX
	select REGMAP_SPI

config IIO_ST_LSM6DSX_I3C
	tristate "ST_LSM6DSx driver for STM 6-axis IMU MEMS sensors I3C Interface"
	depends on I3C && IIO_ST_LSM6DSX
	default I3C && IIO_ST_LSM6DSX
	select REGMAP_I3C
```

## drivers/iio/imu/st_lsm9ds0/Kconfig
```kconfig
# SPDX-License-Identifier: GPL-2.0-only

config IIO_ST_LSM9DS0
	tristate "STMicroelectronics LSM9DS0 IMU driver"
	depends on (I2C || SPI_MASTER) && SYSFS
	depends on !SENSORS_LIS3_I2C
	depends on !SENSORS_LIS3_SPI
	select IIO_ST_ACCEL_3AXIS
	select IIO_ST_MAGN_3AXIS

	help
	  Say yes here to build support for STMicroelectronics LSM9DS0 IMU
	  sensor. Supported devices: accelerometer/magnetometer of lsm9ds0
	  and lsm303d.

	  To compile this driver as a module, choose M here: the module
	  will be called st_lsm9ds0.

	  Also need to enable at least one of I2C and SPI interface drivers

config IIO_ST_LSM9DS0_I2C
	tristate "STMicroelectronics LSM9DS0 IMU I2C interface"
	depends on I2C && IIO_ST_LSM9DS0
	default I2C && IIO_ST_LSM9DS0
	select IIO_ST_ACCEL_I2C_3AXIS
	select IIO_ST_MAGN_I2C_3AXIS
	select REGMAP_I2C
	help
	  Build support for STMicroelectronics LSM9DS0 IMU I2C interface.

	  To compile this driver as a module, choose M here. The module
	  will be called st_lsm9ds0_i2c.

config IIO_ST_LSM9DS0_SPI
	tristate "STMicroelectronics LSM9DS0 IMU SPI interface"
	depends on SPI_MASTER && IIO_ST_LSM9DS0
	default SPI_MASTER && IIO_ST_LSM9DS0
	select IIO_ST_ACCEL_SPI_3AXIS
	select IIO_ST_MAGN_SPI_3AXIS
	select REGMAP_SPI
	help
	  Build support for STMicroelectronics LSM9DS0 IMU I2C interface.

	  To compile this driver as a module, choose M here. The module
	  will be called st_lsm9ds0_spi.
```
