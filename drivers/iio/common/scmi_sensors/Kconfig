## drivers/iio/dummy/Kconfig
```kconfig
# SPDX-License-Identifier: GPL-2.0-only
#
# Industrial I/O subsystem Dummy Driver configuration
#
menu "IIO dummy driver"
	depends on IIO

config IIO_DUMMY_EVGEN
	select IRQ_SIM
	tristate

config IIO_SIMPLE_DUMMY
	tristate "An example driver with no hardware requirements"
	depends on IIO_SW_DEVICE
	help
	  Driver intended mainly as documentation for how to write
	  a driver. May also be useful for testing userspace code
	  without hardware.

if IIO_SIMPLE_DUMMY

config IIO_SIMPLE_DUMMY_EVENTS
	bool "Event generation support"
	select IIO_DUMMY_EVGEN
	help
	  Add some dummy events to the simple dummy driver.

	  The purpose of this is to generate 'fake' event interrupts thus
	  allowing that driver's code to be as close as possible to that
	  a normal driver talking to hardware.

config IIO_SIMPLE_DUMMY_BUFFER
	bool "Buffered capture support"
	select IIO_BUFFER
	select IIO_TRIGGER
	select IIO_KFIFO_BUF
	select IIO_TRIGGERED_BUFFER
	help
	  Add buffered data capture to the simple dummy driver.

	  Buffer handling elements of industrial I/O reference driver.
	  Uses the kfifo buffer.

endif # IIO_SIMPLE_DUMMY

endmenu
```

## drivers/iio/filter/Kconfig
```kconfig
#
# Filter drivers
#
# When adding new entries keep the list in alphabetical order

menu "Filters"

config ADMV8818
	tristate "Analog Devices ADMV8818 High-Pass and Low-Pass Filter"
	depends on SPI && COMMON_CLK && 64BIT
	select REGMAP_SPI
	help
	  Say yes here to build support for Analog Devices ADMV8818
	  2 GHz to 18 GHz, Digitally Tunable, High-Pass and Low-Pass Filter.

	  To compile this driver as a module, choose M here: the
	  modiule will be called admv8818.

endmenu
```

## drivers/iio/frequency/Kconfig
```kconfig
# SPDX-License-Identifier: GPL-2.0-only
#
# Frequency
#	Direct Digital Synthesis drivers (DDS)
#	Clock Distribution device drivers
#	Phase-Locked Loop (PLL) frequency synthesizers
#
# When adding new entries keep the list in alphabetical order

menu "Frequency Synthesizers DDS/PLL"

menu "Clock Generator/Distribution"

config AD9523
	tristate "Analog Devices AD9523 Low Jitter Clock Generator"
	depends on SPI
	help
	  Say yes here to build support for Analog Devices AD9523 Low Jitter
	  Clock Generator. The driver provides direct access via sysfs.

	  To compile this driver as a module, choose M here: the
	  module will be called ad9523.

endmenu

#
# Phase-Locked Loop (PLL) frequency synthesizers
#

menu "Phase-Locked Loop (PLL) frequency synthesizers"

config ADF4350
	tristate "Analog Devices ADF4350/ADF4351 Wideband Synthesizers"
	depends on SPI
	help
	  Say yes here to build support for Analog Devices  ADF4350/ADF4351
	  Wideband Synthesizers. The driver provides direct access via sysfs.

	  To compile this driver as a module, choose M here: the
	  module will be called adf4350.

config ADF4371
	tristate "Analog Devices ADF4371/ADF4372 Wideband Synthesizers"
	depends on SPI
	select REGMAP_SPI
	help
	  Say yes here to build support for Analog Devices ADF4371 and ADF4372
	  Wideband Synthesizers. The driver provides direct access via sysfs.

	  To compile this driver as a module, choose M here: the
	  module will be called adf4371.

config ADMV1013
	tristate "Analog Devices ADMV1013 Microwave Upconverter"
	depends on SPI && COMMON_CLK
	help
	  Say yes here to build support for Analog Devices ADMV1013
	  24 GHz to 44 GHz, Wideband, Microwave Upconverter.

	  To compile this driver as a module, choose M here: the
	  module will be called admv1013.

config ADRF6780
        tristate "Analog Devices ADRF6780 Microwave Upconverter"
        depends on SPI
        depends on COMMON_CLK
        help
          Say yes here to build support for Analog Devices ADRF6780
          5.9 GHz to 23.6 GHz, Wideband, Microwave Upconverter.

          To compile this driver as a module, choose M here: the
          module will be called adrf6780.

endmenu
endmenu
```

## drivers/iio/gyro/Kconfig
```kconfig
#
# IIO Digital Gyroscope Sensor drivers configuration
#
# When adding new entries keep the list in alphabetical order

menu "Digital gyroscope sensors"

config ADIS16080
	tristate "Analog Devices ADIS16080/100 Yaw Rate Gyroscope with SPI driver"
	depends on SPI
	help
	  Say yes here to build support for Analog Devices ADIS16080, ADIS16100 Yaw
	  Rate Gyroscope with SPI.

config ADIS16130
	tristate "Analog Devices ADIS16130 High Precision Angular Rate Sensor driver"
	depends on SPI
	help
	  Say yes here to build support for Analog Devices ADIS16130 High Precision
	  Angular Rate Sensor driver.

config ADIS16136
	tristate "Analog devices ADIS16136 and similar gyroscopes driver"
	depends on SPI_MASTER
	select IIO_ADIS_LIB
	select IIO_ADIS_LIB_BUFFER if IIO_BUFFER
	help
	  Say yes here to build support for the Analog Devices ADIS16133, ADIS16135,
	  ADIS16136 gyroscope devices.

config ADIS16260
	tristate "Analog Devices ADIS16260 Digital Gyroscope Sensor SPI driver"
	depends on SPI
	select IIO_ADIS_LIB
	select IIO_ADIS_LIB_BUFFER if IIO_BUFFER
	help
	  Say yes here to build support for Analog Devices ADIS16260 ADIS16265
	  ADIS16250 ADIS16255 and ADIS16251 programmable digital gyroscope sensors.

	  This driver can also be built as a module.  If so, the module
	  will be called adis16260.

config ADXRS450
	tristate "Analog Devices ADXRS450/3 Digital Output Gyroscope SPI driver"
	depends on SPI
	help
	  Say yes here to build support for Analog Devices ADXRS450 and ADXRS453
	  programmable digital output gyroscope.

	  This driver can also be built as a module.  If so, the module
	  will be called adxrs450.

config BMG160
	tristate "BOSCH BMG160 Gyro Sensor"
	depends on (I2C || SPI_MASTER)
	select IIO_BUFFER
	select IIO_TRIGGERED_BUFFER
	select BMG160_I2C if (I2C)
	select BMG160_SPI if (SPI)
	help
	  Say yes here to build support for BOSCH BMG160 Tri-axis Gyro Sensor
	  driver connected via I2C or SPI. This driver also supports BMI055
	  gyroscope.

	  This driver can also be built as a module.  If so, the module
	  will be called bmg160_i2c or bmg160_spi.

config BMG160_I2C
	tristate
	select REGMAP_I2C

config BMG160_SPI
	tristate
	select REGMAP_SPI

config FXAS21002C
       tristate "NXP FXAS21002C Gyro Sensor"
       select IIO_BUFFER
       select IIO_TRIGGERED_BUFFER
       select FXAS21002C_I2C if (I2C)
       select FXAS21002C_SPI if (SPI)
       depends on (I2C || SPI_MASTER)
       help
         Say yes here to build support for NXP FXAS21002C Tri-axis Gyro
         Sensor driver connected via I2C or SPI.

         This driver can also be built as a module.  If so, the module
         will be called fxas21002c_i2c or fxas21002c_spi.

config FXAS21002C_I2C
       tristate
       select REGMAP_I2C

config FXAS21002C_SPI
       tristate
       select REGMAP_SPI

config HID_SENSOR_GYRO_3D
	depends on HID_SENSOR_HUB
	select IIO_BUFFER
	select IIO_TRIGGERED_BUFFER
	select HID_SENSOR_IIO_COMMON
	select HID_SENSOR_IIO_TRIGGER
	tristate "HID Gyroscope 3D"
	help
	  Say yes here to build support for the HID SENSOR
	  Gyroscope 3D.

config MPU3050
	tristate
	select IIO_BUFFER
	select IIO_TRIGGERED_BUFFER
	select REGMAP

config MPU3050_I2C
	tristate "Invensense MPU3050 devices on I2C"
	depends on !(INPUT_MPU3050=y || INPUT_MPU3050=m)
	depends on I2C
	select MPU3050
	select REGMAP_I2C
	select I2C_MUX
	help
	  This driver supports the Invensense MPU3050 gyroscope over I2C.
	  This driver can be built as a module. The module will be called
	  inv-mpu3050-i2c.

config IIO_ST_GYRO_3AXIS
	tristate "STMicroelectronics gyroscopes 3-Axis Driver"
	depends on (I2C || SPI_MASTER) && SYSFS
	select IIO_ST_SENSORS_CORE
	select IIO_ST_GYRO_I2C_3AXIS if (I2C)
	select IIO_ST_GYRO_SPI_3AXIS if (SPI_MASTER)
	select IIO_TRIGGERED_BUFFER if (IIO_BUFFER)
	help
	  Say yes here to build support for STMicroelectronics gyroscopes:
	  L3G4200D, LSM330DL, L3GD20, LSM330DLC, L3G4IS, LSM330, LSM9DS0.

	  This driver can also be built as a module. If so, these modules
	  will be created:
	  - st_gyro (core functions for the driver [it is mandatory]);
	  - st_gyro_i2c (necessary for the I2C devices [optional*]);
	  - st_gyro_spi (necessary for the SPI devices [optional*]);

	  (*) one of these is necessary to do something.

config IIO_ST_GYRO_I2C_3AXIS
	tristate
	depends on IIO_ST_GYRO_3AXIS
	depends on IIO_ST_SENSORS_I2C

config IIO_ST_GYRO_SPI_3AXIS
	tristate
	depends on IIO_ST_GYRO_3AXIS
	depends on IIO_ST_SENSORS_SPI

config ITG3200
	tristate "InvenSense ITG3200 Digital 3-Axis Gyroscope I2C driver"
	depends on I2C
	select IIO_TRIGGERED_BUFFER if IIO_BUFFER
	help
	  Say yes here to add support for the InvenSense ITG3200 digital
	  3-axis gyroscope sensor.

endmenu
```

## drivers/iio/health/Kconfig
```kconfig
# SPDX-License-Identifier: GPL-2.0-only
#
# Health sensors
#
# When adding new entries keep the list in alphabetical order

menu "Health Sensors"

menu "Heart Rate Monitors"

config AFE4403
	tristate "TI AFE4403 Heart Rate Monitor"
	depends on SPI_MASTER
	select REGMAP_SPI
	select IIO_BUFFER
	select IIO_TRIGGERED_BUFFER
	help
	  Say yes to choose the Texas Instruments AFE4403
	  heart rate monitor and low-cost pulse oximeter.

	  To compile this driver as a module, choose M here: the
	  module will be called afe4403.

config AFE4404
	tristate "TI AFE4404 heart rate and pulse oximeter sensor"
	depends on I2C
	select REGMAP_I2C
	select IIO_BUFFER
	select IIO_TRIGGERED_BUFFER
	help
	  Say yes to choose the Texas Instruments AFE4404
	  heart rate monitor and low-cost pulse oximeter.

	  To compile this driver as a module, choose M here: the
	  module will be called afe4404.

config MAX30100
	tristate "MAX30100 heart rate and pulse oximeter sensor"
	depends on I2C
	select REGMAP_I2C
	select IIO_BUFFER
	select IIO_KFIFO_BUF
	help
	  Say Y here to build I2C interface support for the Maxim
	  MAX30100 heart rate, and pulse oximeter sensor.

	  To compile this driver as a module, choose M here: the
	  module will be called max30100.

config MAX30102
	tristate "MAX30102 heart rate and pulse oximeter sensor"
	depends on I2C
	select REGMAP_I2C
	select IIO_BUFFER
	select IIO_KFIFO_BUF
	help
	  Say Y here to build I2C interface support for the Maxim
	  MAX30102 heart rate, and pulse oximeter sensor.

	  To compile this driver as a module, choose M here: the
	  module will be called max30102.

endmenu

endmenu
```

## drivers/iio/humidity/Kconfig
```kconfig
#
# humidity sensor drivers
#
menu "Humidity sensors"

config AM2315
	tristate "Aosong AM2315 relative humidity and temperature sensor"
	depends on I2C
	select IIO_BUFFER
	select IIO_TRIGGERED_BUFFER
	help
	  If you say yes here you get support for the Aosong AM2315
	  relative humidity and ambient temperature sensor.

	  This driver can also be built as a module. If so, the module will
	  be called am2315.

config DHT11
	tristate "DHT11 (and compatible sensors) driver"
	depends on GPIOLIB || COMPILE_TEST
	help
	  This driver supports reading data via a single interrupt
	  generating GPIO line. Currently tested are DHT11 and DHT22.
	  Other sensors should work as well as long as they speak the
	  same protocol.

config HDC100X
	tristate "TI HDC100x relative humidity and temperature sensor"
	depends on I2C
	select IIO_BUFFER
	select IIO_TRIGGERED_BUFFER
	help
	  Say yes here to build support for the Texas Instruments
	  HDC1000, HDC1008, HDC1010, HDC1050, and HDC1080 relative
	  humidity and temperature sensors.

	  To compile this driver as a module, choose M here: the module
	  will be called hdc100x.

config HID_SENSOR_HUMIDITY
	tristate "HID Environmental humidity sensor"
	depends on HID_SENSOR_HUB
	select IIO_BUFFER
	select IIO_TRIGGERED_BUFFER
	select HID_SENSOR_IIO_COMMON
	select HID_SENSOR_IIO_TRIGGER
	help
	  Say yes here to build support for the HID SENSOR
	  humidity driver

	  To compile this driver as a module, choose M here: the module
	  will be called hid-sensor-humidity.

config HTS221
	tristate "STMicroelectronics HTS221 sensor Driver"
	depends on (I2C || SPI)
	select IIO_BUFFER
	select IIO_TRIGGERED_BUFFER
	select HTS221_I2C if (I2C)
	select HTS221_SPI if (SPI_MASTER)
	help
	  Say yes here to build support for STMicroelectronics HTS221
	  temperature-humidity sensor

	  To compile this driver as a module, choose M here: the module
	  will be called hts221.

config HTS221_I2C
	tristate
	depends on HTS221
	select REGMAP_I2C

config HTS221_SPI
	tristate
	depends on HTS221
	select REGMAP_SPI

config HTU21
	tristate "Measurement Specialties HTU21 humidity & temperature sensor"
	depends on I2C
	select IIO_MS_SENSORS_I2C
	help
	  If you say yes here you get support for the Measurement Specialties
	  HTU21 humidity and temperature sensor.
	  This driver is also used for MS8607 temperature, pressure & humidity
	  sensor

	  This driver can also be built as a module. If so, the module will
	  be called htu21.

config SI7005
	tristate "SI7005 relative humidity and temperature sensor"
	depends on I2C
	help
	  Say yes here to build support for the Silabs Si7005 relative
	  humidity and temperature sensor.

	  To compile this driver as a module, choose M here: the module
	  will be called si7005. This driver also
	  supports Hoperf TH02 Humidity and Temperature Sensor.

config SI7020
	tristate "Si7013/20/21 Relative Humidity and Temperature Sensors"
	depends on I2C
	help
	  Say yes here to build support for the Silicon Labs Si7013/20/21
	  Relative Humidity and Temperature Sensors. This driver also
	  supports Hoperf TH06 Humidity and Temperature Sensor.

	  To compile this driver as a module, choose M here: the module
	  will be called si7020.

endmenu
```
