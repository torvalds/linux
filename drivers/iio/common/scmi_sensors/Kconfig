## drivers/iio/common/scmi_sensors/Kconfig
```kconfig
#
# IIO over SCMI
#
# When adding new entries keep the list in alphabetical order

menu "IIO SCMI Sensors"

config IIO_SCMI
	tristate "IIO SCMI"
        depends on ARM_SCMI_PROTOCOL
        select IIO_BUFFER
        select IIO_KFIFO_BUF
	help
          Say yes here to build support for IIO SCMI Driver.
          This provides ARM SCMI Protocol based IIO device.
          This driver provides support for accelerometer and gyroscope
          sensors available on SCMI based platforms.
endmenu
```

## drivers/iio/common/ssp_sensors/Kconfig
```kconfig
# SPDX-License-Identifier: GPL-2.0-only
#
# SSP sensor drivers and commons configuration
#
menu "SSP Sensor Common"

config IIO_SSP_SENSORS_COMMONS
	tristate "Commons for all SSP Sensor IIO drivers"
	depends on IIO_SSP_SENSORHUB
	select IIO_BUFFER
	select IIO_KFIFO_BUF
	help
	  Say yes here to build commons for SSP sensors.
	  To compile this as a module, choose M here: the module
	  will be called ssp_iio.

config IIO_SSP_SENSORHUB
	tristate "Samsung Sensorhub driver"
	depends on SPI
	select MFD_CORE
	help
	  SSP driver for sensorhub.
	  If you say yes here you get ssp support for sensorhub.
	  To compile this driver as a module, choose M here: the
	  module will be called sensorhub.

endmenu
```

## drivers/iio/common/st_sensors/Kconfig
```kconfig
# SPDX-License-Identifier: GPL-2.0-only
#
# STMicroelectronics sensors common library
#

config IIO_ST_SENSORS_I2C
	tristate
	select REGMAP_I2C

config IIO_ST_SENSORS_SPI
	tristate
	select REGMAP_SPI

config IIO_ST_SENSORS_CORE
	tristate
```

## drivers/iio/counter/Kconfig
```kconfig
#
# Counter devices
#
# When adding new entries keep the list in alphabetical order

menu "Counters"

config STM32_LPTIMER_CNT
	tristate "STM32 LP Timer encoder counter driver"
	depends on MFD_STM32_LPTIMER || COMPILE_TEST
	help
	  Select this option to enable STM32 Low-Power Timer quadrature encoder
	  and counter driver.

	  To compile this driver as a module, choose M here: the
	  module will be called stm32-lptimer-cnt.
endmenu
```
