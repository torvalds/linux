## drivers/iio/stm/accel/Kconfig
```kconfig
# SPDX-License-Identifier: GPL-2.0-only
#
# Accelerometer drivers
#
# When adding new entries keep the list in alphabetical order

menu "Accelerometers"

config IIO_ST_ACC33
	tristate "STMicroelectronics LIS3DH/LIS2DH/LIS2DH12/LSM303AGR/IIS2DH Accelerometer driver"
	depends on (I2C || SPI_MASTER) && SYSFS
	select IIO_ST_ACC33_I2C if (I2C)
	select IIO_ST_ACC33_SPI if (SPI_MASTER)
	select IIO_BUFFER
	select IIO_KFIFO_BUF
	help
	  Say yes here to build support for STMicroelectronics accelerometers:
	  LIS3DH, LIS2DH, LIS2DH12, LSM303AGR, IIS2DH.

	  This driver can also be built as a module. If so, will be created
	  these modules:
	  - st_ac33_core (core functions for the driver [it is mandatory]);
	  - st_ac33_i2c (necessary for the I2C devices [optional*]);
	  - st_ac33_spi (necessary for the SPI devices [optional*]);

	  (*) one of these is necessary to do something.

config IIO_ST_ACC33_I2C
	tristate
	depends on IIO_ST_ACC33

config IIO_ST_ACC33_SPI
	tristate
	depends on IIO_ST_ACC33

menuconfig IIO_ST_LIS2DS12
	tristate "STMicroelectronics LIS2DS12/LSM303AH Accelerometer Driver"
	depends on (I2C || SPI_MASTER) && SYSFS
	select IIO_BUFFER
	select IIO_TRIGGERED_BUFFER
	select IIO_ST_LIS2DS12_I2C if (I2C)
	select IIO_ST_LIS2DS12_SPI if (SPI)
	help
	  Say yes here to build support for the LIS2DS12 and LSM303AH
	  accelerometers.

if IIO_ST_LIS2DS12
config IIO_ST_LIS2DS12_I2C
	tristate
	depends on IIO_ST_LIS2DS12
	depends on I2C

config IIO_ST_LIS2DS12_SPI
	tristate
	depends on IIO_ST_LIS2DS12
	depends on SPI

config ST_LIS2DS12_IIO_LIMIT_FIFO
	int "Limit fifo read lenght (#n byte)"
	depends on IIO_ST_LIS2DS12
	range 0 1536
	default 0
	help
	  Limit atomic fifo read to #n byte. In some platform i2c/spi read
	  can be limited by software or hardware.

	  Set 0 to disable the limit.

endif #IIO_ST_LIS2DS12

config IIO_ST_LIS2DW12
	tristate "STMicroelectronics LIS2DW12/IIS2DLPC/AIS2IH Accelerometer Driver"
	depends on (I2C || SPI)
	select IIO_BUFFER
	select IIO_KFIFO_BUF
	select IIO_ST_LIS2DW12_I2C if (I2C)
	select IIO_ST_LIS2DW12_SPI if (SPI)
	help
	  Say yes here to build support for the LIS2DW12, IIS2DLPC and AIS2IH accelerometer.

	  This driver can also be built as a module. If so, will be created
	  these modules:
	  - st_lis2dw12 (core functions for the driver [it is mandatory]);
	  - st_lis2dw12_i2c (necessary for the I2C devices [optional*]);
	  - st_lis2dw12_spi (necessary for the SPI devices [optional*]);

	  (*) one of these is necessary to do something.

config IIO_ST_LIS2DW12_I2C
	tristate
	depends on IIO_ST_LIS2DW12
	depends on I2C

config IIO_ST_LIS2DW12_SPI
	tristate
	depends on IIO_ST_LIS2DW12
	depends on SPI

menuconfig IIO_ST_ISM303DAC_ACCEL
        tristate "STMicroelectronics ISM303DAC Accelerometer Driver"
        depends on (I2C || SPI_MASTER) && SYSFS
        select IIO_BUFFER
        select IIO_TRIGGERED_BUFFER
        select IIO_ST_ISM303DAC_ACCEL_I2C if (I2C)
        select IIO_ST_ISM303DAC_ACCEL_SPI if (SPI)
        help
          Say yes here to build support for the ISM303DAC
          accelerometers.

config IIO_ST_ISM303DAC_ACCEL_I2C
        tristate
        depends on IIO_ST_ISM303DAC_ACCEL
        depends on I2C

config IIO_ST_ISM303DAC_ACCEL_SPI
        tristate
        depends on IIO_ST_ISM303DAC_ACCEL
        depends on SPI

config ST_ISM303DAC_ACCEL_IIO_LIMIT_FIFO
        int "Limit fifo read lenght (#n byte)"
        depends on IIO_ST_ISM303DAC_ACCEL
        range 0 1536
        default 0
        help
          Limit atomic fifo read to #n byte. In some platform i2c/spi read
          can be limited by software or hardware.

          Set 0 to disable the limit.

config IIO_ST_LIS3DHH
        tristate "STMicroelectronics LIS3DHH/IIS3DHHC Accelerometer driver"
        depends on SPI_MASTER && SYSFS
        select IIO_BUFFER
        select IIO_KFIFO_BUF
        help
          Say yes here to build support for STMicroelectronics LIS3DHH and
          IIS3DHHC accelerometers

          This driver can also be built as a module. If so, will be named
          st_lis3dhh

config IIO_ST_LIS2HH12
        tristate "STMicroelectronics LIS2HH12 Accelerometer driver"
        depends on (I2C || SPI_MASTER) && SYSFS
        select IIO_BUFFER
        select IIO_TRIGGERED_BUFFER
        select IIO_ST_LIS2HH12_I2C if (I2C)
        select IIO_ST_LIS2HH12_SPI if (SPI)
        help
          Say yes here to build support for the LIS2HH12 accelerometer.

config IIO_ST_LIS2HH12_I2C
        tristate
        depends on IIO_ST_LIS2HH12
        depends on I2C

config IIO_ST_LIS2HH12_SPI
        tristate
        depends on IIO_ST_LIS2HH12

config IIO_ST_LIS2DUXS12
        tristate "STMicroelectronics LIS2DUX12/LIS2DUXS12 sensors"
        depends on (I2C || SPI || I3C)
        select IIO_BUFFER
        select IIO_KFIFO_BUF
        select IIO_ST_LIS2DUXS12_I2C if (I2C)
        select IIO_ST_LIS2DUXS12_SPI if (SPI_MASTER)
        select IIO_ST_LIS2DUXS12_I3C if (I3C)
        help
          Say yes here to build support for STMicroelectronics LIS2DUX(S)12 accel
          sensors.

          To compile this driver as a module, choose M here: the module
          will be called lis2duxs12.

config IIO_ST_LIS2DUXS12_I2C
        tristate
        select REGMAP_I2C
        depends on IIO_ST_LIS2DUXS12

config IIO_ST_LIS2DUXS12_SPI
        tristate
        select REGMAP_SPI
        depends on IIO_ST_LIS2DUXS12

config IIO_ST_LIS2DUXS12_I3C
        tristate
        select REGMAP_I3C
        depends on IIO_ST_LIS2DUXS12

config IIO_ST_H3LIS331DL
        tristate "STMicroelectronics H3LIS331DL/LIS331DLH sensor"
        depends on (I2C || SPI)
        select IIO_BUFFER
        select IIO_KFIFO_BUF
        select IIO_TRIGGERED_BUFFER
        select IIO_ST_H3LIS331DL_I2C if (I2C)
        select IIO_ST_H3LIS331DL_SPI if (SPI_MASTER)
        help
          Say yes here to build support for STMicroelectronics H3LIS331DL and
          LIS331DLH accelerometer sensors.

          To compile this driver as a module, choose M here: the module
          will be called st_h3lis331dl.

config IIO_ST_H3LIS331DL_I2C
        tristate
        select REGMAP_I2C
        depends on IIO_ST_H3LIS331DL

config IIO_ST_H3LIS331DL_SPI
        tristate
        select REGMAP_SPI
        depends on IIO_ST_H3LIS331DL

config IIO_ST_LIS2DU12
        tristate "STMicroelectronics LIS2DU12 Accelerometer Driver"
        depends on (I2C || SPI || I3C)
        select IIO_BUFFER
        select IIO_KFIFO_BUF
        select IIO_ST_LIS2DU12_I2C if (I2C)
        select IIO_ST_LIS2DU12_SPI if (SPI)
        select IIO_ST_LIS2DU12_I3C if (I3C)
        help
          Say yes here to build support for the LIS2DU12 accelerometer.

          This driver can also be built as a module. If so, will be created
          these modules:
          - st_lisdu12 (core functions for the driver [it is mandatory]);
          - st_lisdu12_i2c (necessary for the I2C devices [optional*]);
          - st_lisdu12_spi (necessary for the SPI devices [optional*]);
          - st_lisdu12_i3c (necessary for the I3C devices [optional*]);

          (*) one of these is necessary to do something.

config IIO_ST_LIS2DU12_I2C
        tristate
        depends on IIO_ST_LIS2DU12
        depends on I2C

config IIO_ST_LIS2DU12_SPI
        tristate
        depends on IIO_ST_LIS2DU12
        depends on SPI

config IIO_ST_LIS2DU12_I3C
        tristate
        depends on IIO_ST_LIS2DU12
        depends on I3C

endmenu
```

## drivers/iio/stm/imu/Kconfig
```kconfig
# SPDX-License-Identifier: GPL-2.0-only
#
# IIO imu drivers configuration
#
# When adding new entries keep the list in alphabetical order

menu "Inertial measurement units"

source "drivers/iio/stm/imu/st_lsm6dsox/Kconfig"
source "drivers/iio/stm/imu/st_lsm6dsrx/Kconfig"
source "drivers/iio/stm/imu/st_ism330dhcx/Kconfig"
source "drivers/iio/stm/imu/st_asm330lhhx/Kconfig"
source "drivers/iio/stm/imu/st_imu68/Kconfig"
source "drivers/iio/stm/imu/st_ism330dlc/Kconfig"
source "drivers/iio/stm/imu/st_lsm6ds3/Kconfig"
source "drivers/iio/stm/imu/st_lsm6ds3h/Kconfig"
source "drivers/iio/stm/imu/st_lsm6dsm/Kconfig"
source "drivers/iio/stm/imu/st_lsm6dsvx/Kconfig"
source "drivers/iio/stm/imu/st_lsm6dso16is/Kconfig"
source "drivers/iio/stm/imu/st_lsm6dsv16bx/Kconfig"
source "drivers/iio/stm/imu/st_ism330is/Kconfig"

endmenu
```

## drivers/iio/stm/imu/st_asm330lhh/Kconfig
```kconfig
config IIO_ST_ASM330LHH
	tristate "STMicroelectronics ASM330LHH sensor"
	depends on (I2C || SPI)
	select IIO_BUFFER
	select IIO_KFIFO_BUF
	select IIO_TRIGGERED_BUFFER
	select IIO_ST_ASM330LHH_I2C if (I2C)
	select IIO_ST_ASM330LHH_SPI if (SPI_MASTER)
	help
	  Say yes here to build support for STMicroelectronics ASM330LHH imu
	  sensor.

	  To compile this driver as a module, choose M here: the module
	  will be called st_asm330lhh.

config IIO_ST_ASM330LHH_I2C
	tristate
	depends on IIO_ST_ASM330LHH

config IIO_ST_ASM330LHH_SPI
	tristate
	depends on IIO_ST_ASM330LHH

config IIO_ST_ASM330LHH_MAY_WAKEUP
	bool "Enable wake-up irq"
	depends on IIO_ST_ASM330LHH
	help
	  Enable wake-up irq on interrupt line

config IIO_ST_ASM330LHH_EN_TEMPERATURE
	bool "Enable internal temperature sensor"
	depends on IIO_ST_ASM330LHH
	help
	  Enable internal temperature sensor channel

config IIO_ST_ASM330LHH_EN_BASIC_FEATURES
	bool "Enable internal basic features event detection"
	depends on IIO_ST_ASM330LHH
	help
	  Enable internal basic features event detection sensor

config IIO_ST_ASM330LHH_EN_REGULATOR
	bool "Enable support to voltage regulator"
	depends on IIO_ST_ASM330LHH
	help
	  Enable support to voltage regulator to power up/down the sensor
	  Add the vdd-supply and vddio-supply entries into device tree to
	  automatically manage the sensor power supply.
```

## drivers/iio/stm/imu/st_asm330lhhx/Kconfig
```kconfig
# SPDX-License-Identifier: GPL-2.0-only

config IIO_ST_ASM330LHHX
	tristate "STMicroelectronics ASM330LHHX sensor"
	depends on (I2C || SPI)
	select IIO_BUFFER
	select IIO_KFIFO_BUF
	select IIO_TRIGGERED_BUFFER
	select IIO_ST_ASM330LHHX_I2C if (I2C)
	select IIO_ST_ASM330LHHX_SPI if (SPI_MASTER)
	help
	  Say yes here to build support for STMicroelectronics ASM330LHH,
	  ASM330LHHX, ASM330LHHXG1 imu sensors.

	  To compile this driver as a module, choose M here: the module
	  will be called st_asm330lhhx.

config IIO_ST_ASM330LHHX_I2C
	tristate
	select REGMAP_I2C
	depends on IIO_ST_ASM330LHHX

config IIO_ST_ASM330LHHX_SPI
	tristate
	select REGMAP_SPI
	depends on IIO_ST_ASM330LHHX

config IIO_ST_ASM330LHHX_EN_BASIC_FEATURES
	bool "Enable internal basic features event detection"
	depends on IIO_ST_ASM330LHHX
	help
	  Enable internal basic features event detection sensor

config IIO_ST_ASM330LHHX_ASYNC_HW_TIMESTAMP
       bool "Enable async hw timestamp read"
       depends on IIO_ST_ASM330LHHX
       help
         Enable async task that sends over hw timestamp events.

config IIO_ST_ASM330LHHX_MLC_PRELOAD
        bool "Preload some examples on MLC/FSM core"
        depends on IIO_ST_ASM330LHHX
        help
          Preload some examples on machine learning core and finite state
          machine. The examples code are hardcoded in to the driver.
```

## drivers/iio/stm/imu/st_imu68/Kconfig
```kconfig
# SPDX-License-Identifier: GPL-2.0-only

config IIO_ST_IMU68
	tristate "STMicroelectronics LSM9DS1 IMU sensor"
	depends on (I2C || SPI)
	select IIO_BUFFER
	select IIO_TRIGGERED_BUFFER
	select IIO_ST_IMU68_I2C if (I2C)
	select IIO_ST_IMU68_SPI if (SPI_MASTER)
	help
	  Say yes here to build support for STMicroelectronics IMU sensors:
	  LSM9DS1

	  To compile this driver as a module, choose M here: the module
	  will be called st_imu68.

config IIO_ST_IMU68_I2C
	tristate
	depends on IIO_ST_IMU68

config IIO_ST_IMU68_SPI
	tristate
	depends on IIO_ST_IMU68
```

## drivers/iio/stm/imu/st_ism330dhcx/Kconfig
```kconfig
# SPDX-License-Identifier: GPL-2.0-only
config IIO_ST_ISM330DHCX
	tristate "STMicroelectronics ISM330DHCX sensor"
	depends on (I2C || SPI)
	select IIO_BUFFER
	select IIO_TRIGGERED_BUFFER
	select IIO_ST_ISM330DHCX_I2C if (I2C)
	select IIO_ST_ISM330DHCX_SPI if (SPI_MASTER)
	help
	  Say yes here to build support for STMicroelectronics ISM330DHCX imu
	  sensor.

	  To compile this driver as a module, choose M here: the module
	  will be called st_ism330dhcx.

config IIO_ST_ISM330DHCX_I2C
	tristate
	depends on IIO_ST_ISM330DHCX

config IIO_ST_ISM330DHCX_SPI
	tristate
	depends on IIO_ST_ISM330DHCX
```

## drivers/iio/stm/imu/st_ism330dlc/Kconfig
```kconfig
# SPDX-License-Identifier: GPL-2.0-only

#
# st-ism330dlc drivers for STMicroelectronics combo sensor
#

menuconfig ST_ISM330DLC_IIO
	tristate "STMicroelectronics ISM330DLC sensor"
	depends on (I2C || SPI) && SYSFS
	select IIO_BUFFER
	select IIO_TRIGGERED_BUFFER
	select ST_ISM330DLC_I2C_IIO if (I2C)
	select ST_ISM330DLC_SPI_IIO if (SPI)
	help
	  This driver supports ISM330DLC sensors.
	  It is a gyroscope/accelerometer combo device.
	  This driver can be built as a module. The module will be called
	  st_ism330dlc.

if ST_ISM330DLC_IIO

config ST_ISM330DLC_I2C_IIO
	tristate
	depends on ST_ISM330DLC_IIO
	depends on I2C

config ST_ISM330DLC_SPI_IIO
	tristate
	depends on ST_ISM330DLC_IIO
	depends on SPI

config ST_ISM330DLC_IIO_LIMIT_FIFO
	int "Limit fifo read lenght (#n byte)"
	depends on ST_ISM330DLC_IIO
	range 0 4096
	default 0
	help
	  Limit atomic fifo read to #n byte. In some platform i2c/spi read
	  can be limited by software or hardware.

	  Set 0 to disable the limit.

menuconfig ST_ISM330DLC_IIO_MASTER_SUPPORT
	bool "I2C master controller"
	depends on I2C && ST_ISM330DLC_IIO
	default n
	help
	  Added support for I2C master controller. Only one slave sensor is
	  supported.

if ST_ISM330DLC_IIO_MASTER_SUPPORT

config ST_ISM330DLC_ENABLE_INTERNAL_PULLUP
	bool "Enabled internals pull-up resistors"
	default y

choice
	prompt "External sensor 0"
	default ST_ISM330DLC_IIO_EXT0_LIS3MDL
	help
	  Choose the external sensor 0 connected to I2C master.

config ST_ISM330DLC_IIO_EXT0_LIS3MDL
	bool "LIS3MDL"
config ST_ISM330DLC_IIO_EXT0_AKM09911
	bool "AKM09911"
config ST_ISM330DLC_IIO_EXT0_AKM09912
	bool "AKM09912"
config ST_ISM330DLC_IIO_EXT0_AKM09916
	bool "AKM09916"
config ST_ISM330DLC_IIO_EXT0_LPS22HB
	bool "LPS22HB"
config ST_ISM330DLC_IIO_EXT0_LIS2MDL
	bool "LIS2MDL"
endchoice

endif

config ST_ISM330DLC_XL_DATA_INJECTION
	bool "Enable XL data injection support"
	depends on ST_ISM330DLC_IIO
	default n
	help
	  This option enables the accelerometer data injection
	  support. The device functions may so use an injected
	  pattern instead of taking the real sensor data.

endif #ST_ISM330DLC_IIO
```

## drivers/iio/stm/imu/st_ism330is/Kconfig
```kconfig
# SPDX-License-Identifier: GPL-2.0-only

config IIO_ST_ISM330IS
	tristate "STMicroelectronics ISM330IS sensor"
	depends on (I2C || SPI)
	select IIO_BUFFER
	select IIO_TRIGGERED_BUFFER
	select IIO_ST_ISM330IS_I2C if (I2C)
	select IIO_ST_ISM330IS_SPI if (SPI_MASTER)
	help
	  Say yes here to build support for STMicroelectronics
	  ISM330IS imu sensors.

	  To compile this driver as a module, choose M here: the module
	  will be called st_ism330is.

config IIO_ST_ISM330IS_I2C
	tristate
	select REGMAP_I2C
	depends on IIO_ST_ISM330IS

config IIO_ST_ISM330IS_SPI
	tristate
	select REGMAP_SPI
	depends on IIO_ST_ISM330IS
```
