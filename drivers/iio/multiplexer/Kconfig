## drivers/iio/stm/imu/st_lsm6ds3/Kconfig
```kconfig
# SPDX-License-Identifier: GPL-2.0-only
#
# st-lsm6ds3 drivers for STMicroelectronics combo sensor
#

menuconfig ST_LSM6DS3_IIO
	tristate "STMicroelectronics LSM6DS3/LSM6DS33 sensor"
	depends on (I2C || SPI) && SYSFS
	select IIO_BUFFER
	select IIO_TRIGGERED_BUFFER
	select ST_LSM6DS3_I2C_IIO if (I2C)
	select ST_LSM6DS3_SPI_IIO if (SPI)
	help
	  This driver supports LSM6DS3 and LSM6DS33 sensors.
	  It is a gyroscope/accelerometer combo device.
	  This driver can be built as a module. The module will be called
	  st-lsm6ds3.

if ST_LSM6DS3_IIO

config ST_LSM6DS3_I2C_IIO
	tristate
	depends on ST_LSM6DS3_IIO
	depends on I2C

config ST_LSM6DS3_SPI_IIO
	tristate
	depends on ST_LSM6DS3_IIO
	depends on SPI

config ST_LSM6DS3_IIO_LIMIT_FIFO
	int "Limit fifo read lenght (#n byte)"
	depends on ST_LSM6DS3_IIO
	range 0 8192
	default 0
	help
	  Limit atomic fifo read to #n byte. In some platform i2c/spi read
	  can be limited by software or hardware.

	  Set 0 to disable the limit.

config ST_LSM6DS3_STEP_COUNTER_ON_DURING_SUSPEND
	bool "Keep Step counter on during suspend"
	depends on ST_LSM6DS3_IIO
	default n
	help
	  During suspend step counter is kept on if enabled. Only interrupt
	  is disabled.

menuconfig ST_LSM6DS3_IIO_MASTER_SUPPORT
	bool "I2C master controller"
	depends on I2C && ST_LSM6DS3_IIO
	default n
	help
	  Added support for I2C master controller. Supported sensors up
	  to 4.

if ST_LSM6DS3_IIO_MASTER_SUPPORT

config ST_LSM6DS3_ENABLE_INTERNAL_PULLUP
	bool "Enabled internals pull-up resistors"
	default y

choice
	prompt "External sensor 0"
	default ST_LSM6DS3_IIO_EXT0_LIS3MDL
	help
	  Choose the external sensor 0 connected to LSM6DS3.

config ST_LSM6DS3_IIO_EXT0_LIS3MDL
	bool "LIS3MDL"
config ST_LSM6DS3_IIO_EXT0_AKM09911
	bool "AKM09911"
config ST_LSM6DS3_IIO_EXT0_AKM09912
	bool "AKM09912"
config ST_LSM6DS3_IIO_EXT0_AKM09916
	bool "AKM09916"
config ST_LSM6DS3_IIO_EXT0_LPS22HB
	bool "LPS22HB"
config ST_LSM6DS3_IIO_EXT0_LIS2MDL
	bool "LIS2MDL"
endchoice

endif

config ST_LSM6DS3_XL_DATA_INJECTION
	bool "Enable XL data injection support"
	depends on ST_LSM6DS3_IIO
	default n
	help
	  This option enables the accelerometer data injection
	  support. The device functions may so use an injected
	  pattern instead of taking the real sensor data.

endif #ST_LSM6DS3_IIO
```

## drivers/iio/stm/imu/st_lsm6dso/Kconfig
```kconfig
# SPDX-License-Identifier: GPL-2.0-only

config IIO_ST_LSM6DSO
	tristate "STMicroelectronics LSM6DSO sensor"
	depends on (I2C || SPI)
	select IIO_BUFFER
	select IIO_TRIGGERED_BUFFER
	select IIO_ST_LSM6DSO_I2C if (I2C)
	select IIO_ST_LSM6DSO_SPI if (SPI_MASTER)
	help
	  Say yes here to build support for STMicroelectronics LSM6DSO imu
	  sensor.

	  To compile this driver as a module, choose M here: the module
	  will be called st_lsm6dso.

config IIO_ST_LSM6DSO_I2C
	tristate
	depends on IIO_ST_LSM6DSO

config IIO_ST_LSM6DSO_SPI
	tristate
	depends on IIO_ST_LSM6DSO

config IIO_ST_LSM6DSO_MAY_WAKEUP
	bool "Enable wake-up irq"
	depends on IIO_ST_LSM6DSO
	help
	  Enable wake-up irq on interrupt line
```

## drivers/iio/stm/imu/st_lsm6dso16is/Kconfig
```kconfig
# SPDX-License-Identifier: GPL-2.0-only

config IIO_ST_LSM6DSO16IS
	tristate "STMicroelectronics LSM6DSO16IS sensor"
	depends on (I2C || SPI)
	select IIO_BUFFER
	select IIO_TRIGGERED_BUFFER
	select IIO_ST_LSM6DSO16IS_I2C if (I2C)
	select IIO_ST_LSM6DSO16IS_SPI if (SPI_MASTER)
	help
	  Say yes here to build support for STMicroelectronics
	  LSM6DSO16IS imu sensors.

	  To compile this driver as a module, choose M here: the module
	  will be called st_lsm6dso16is.

config IIO_ST_LSM6DSO16IS_I2C
	tristate
	select REGMAP_I2C
	depends on IIO_ST_LSM6DSO16IS

config IIO_ST_LSM6DSO16IS_SPI
	tristate
	select REGMAP_SPI
	depends on IIO_ST_LSM6DSO16IS
```

## drivers/iio/stm/imu/st_lsm6dso32/Kconfig
```kconfig
# SPDX-License-Identifier: GPL-2.0-only

config IIO_ST_LSM6DSO32
	tristate "STMicroelectronics LSM6DSO32 sensor"
	depends on (I2C || SPI)
	select IIO_BUFFER
	select IIO_TRIGGERED_BUFFER
	select IIO_ST_LSM6DSO32_I2C if (I2C)
	select IIO_ST_LSM6DSO32_SPI if (SPI_MASTER)
	help
	  Say yes here to build support for STMicroelectronics LSM6DSO32 imu
	  sensor.

	  To compile this driver as a module, choose M here: the module
	  will be called st_lsm6dso32.

config IIO_ST_LSM6DSO32_I2C
	tristate
	depends on IIO_ST_LSM6DSO32

config IIO_ST_LSM6DSO32_SPI
	tristate
	depends on IIO_ST_LSM6DSO32

config IIO_ST_LSM6DSO32_MAY_WAKEUP
	bool "Enable wake-up irq"
	depends on IIO_ST_LSM6DSO32
	help
	  Enable wake-up irq on interrupt line
```

## drivers/iio/stm/imu/st_lsm6dsox/Kconfig
```kconfig
# SPDX-License-Identifier: GPL-2.0-only

config IIO_ST_LSM6DSOX
	tristate "STMicroelectronics LSM6DSOX sensor"
	depends on (I2C || SPI)
	select IIO_BUFFER
	select IIO_KFIFO_BUF
	select IIO_ST_LSM6DSOX_I2C if (I2C)
	select IIO_ST_LSM6DSOX_SPI if (SPI_MASTER)
	select IIO_ST_LSM6DSOX_I3C if (I3C)
	help
	  Say yes here to build support for STMicroelectronics
	  LSM6DSO/LSM6DSOX/LSM6DSO32/LSM6DSO32X imu sensors.

	  To compile this driver as a module, choose M here: the module
	  will be called st_lsm6dsox.

config IIO_ST_LSM6DSOX_I2C
	tristate
	select REGMAP_I2C
	depends on IIO_ST_LSM6DSOX

config IIO_ST_LSM6DSOX_SPI
	tristate
	select REGMAP_SPI
	depends on IIO_ST_LSM6DSOX

config IIO_ST_LSM6DSOX_I3C
	tristate
	depends on IIO_ST_LSM6DSOX
	select REGMAP_I3C

config IIO_ST_LSM6DSOX_ASYNC_HW_TIMESTAMP
	bool "Enable async hw timestamp read"
	depends on IIO_ST_LSM6DSOX
	help
	  Enable async task that sends over hw timestamp events.
```

## drivers/iio/stm/imu/st_lsm6dsrx/Kconfig
```kconfig
# SPDX-License-Identifier: GPL-2.0-only

config IIO_ST_LSM6DSRX
	tristate "STMicroelectronics LSM6DSRX sensor"
	depends on (I2C || SPI)
	select IIO_BUFFER
	select IIO_KFIFO_BUF
	select IIO_TRIGGERED_BUFFER
	select IIO_ST_LSM6DSRX_I2C if (I2C)
	select IIO_ST_LSM6DSRX_SPI if (SPI_MASTER)
	select IIO_ST_LSM6DSRX_I3C if (I3C)
	help
	  Say yes here to build support for STMicroelectronics LSM6DSRX imu
	  sensor.

	  To compile this driver as a module, choose M here: the module
	  will be called st_lsm6dsrx.

config IIO_ST_LSM6DSRX_I2C
	tristate
	select REGMAP_I2C
	depends on IIO_ST_LSM6DSRX

config IIO_ST_LSM6DSRX_SPI
	tristate
	select REGMAP_SPI
	depends on IIO_ST_LSM6DSRX

config IIO_ST_LSM6DSRX_I3C
	tristate
	depends on IIO_ST_LSM6DSRX
	select REGMAP_I3C

config IIO_ST_LSM6DSRX_MLC_PRELOAD
	bool "Preload some examples on MLC/FSM core"
	depends on IIO_ST_LSM6DSRX
	help
	  Select yes if you want to preload some examples on machine learning core
	  and finite state machine.

	  The examples code is a 6D position recognition and is hardcoded in the
	  driver in the mlcdata structure.

config IIO_ST_LSM6DSRX_ASYNC_HW_TIMESTAMP
	bool "Enable async hw timestamp read"
	depends on IIO_ST_LSM6DSRX
	help
	  Enable async task that sends over hw timestamp events.
```

## drivers/iio/stm/imu/st_lsm6dsv16bx/Kconfig
```kconfig
# SPDX-License-Identifier: GPL-2.0-only

config IIO_ST_LSM6DSV16BX
	tristate "STMicroelectronics LSM6DSV16BX sensor"
	depends on (I2C || SPI)
	select IIO_BUFFER
	select IIO_TRIGGERED_BUFFER
	select IIO_ST_LSM6DSV16BX_I2C if (I2C)
	select IIO_ST_LSM6DSV16BX_SPI if (SPI_MASTER)
	select IIO_ST_LSM6DSV16BX_I3C if (I3C)
	help
	  Say yes here to build support for STMicroelectronics LSM6DSV16BX imu
	  sensor.

	  To compile this driver as a module, choose M here: the module
	  will be called st_lsm6dsv16bx.

config IIO_ST_LSM6DSV16BX_I2C
	tristate
	depends on IIO_ST_LSM6DSV16BX

config IIO_ST_LSM6DSV16BX_SPI
	tristate
	depends on IIO_ST_LSM6DSV16BX

config IIO_ST_LSM6DSV16BX_I3C
	tristate
	depends on IIO_ST_LSM6DSV16BX
	select REGMAP_I3C

config IIO_ST_LSM6DSV16BX_MLC_PRELOAD
	bool "Preload some examples on MLC/FSM core"
	depends on IIO_ST_LSM6DSV16BX
	help
	  Select yes if you want to preload some examples on machine learning core
	  and finite state machine.

	  The examples code is a motion intensity recognition and is hardcoded in the
	  driver in the mlcdata structure.

config IIO_ST_LSM6DSV16BX_ASYNC_HW_TIMESTAMP
	bool "Enable async hw timestamp read"
	depends on IIO_ST_LSM6DSV16BX
	help
	  Enable async task that sends over hw timestamp events.
```

## drivers/iio/stm/imu/st_lsm6dsvx/Kconfig
```kconfig
# SPDX-License-Identifier: GPL-2.0-only

config IIO_ST_LSM6DSVX
	tristate "STMicroelectronics LSM6DSVX sensor"
	depends on (I2C || SPI)
	select IIO_BUFFER
	select IIO_TRIGGERED_BUFFER
	select IIO_ST_LSM6DSVX_I2C if (I2C)
	select IIO_ST_LSM6DSVX_SPI if (SPI_MASTER)
	select IIO_ST_LSM6DSVX_I3C if (I3C)
	help
	  Say yes here to build support for STMicroelectronics LSM6DSVX imu
	  sensor.

	  To compile this driver as a module, choose M here: the module
	  will be called st_lsm6dsvx.

config IIO_ST_LSM6DSVX_I2C
	tristate
	depends on IIO_ST_LSM6DSVX

config IIO_ST_LSM6DSVX_SPI
	tristate
	depends on IIO_ST_LSM6DSVX

config IIO_ST_LSM6DSVX_I3C
	tristate
	depends on IIO_ST_LSM6DSVX
	select REGMAP_I3C

config IIO_ST_LSM6DSVX_QVAR_IN_FIFO
	bool "use FIFO for QVAR"
	depends on IIO_ST_LSM6DSVX
	help
	  Enable support to QVAR sensor on internal HW FIFO

config IIO_ST_LSM6DSVX_MLC_PRELOAD
	bool "Preload some examples on MLC/FSM core"
	depends on IIO_ST_LSM6DSVX
	help
	  Select yes if you want to preload some examples on machine learning core
	  and finite state machine.

	  The examples code is a motion intensity recognition and is hardcoded in the
	  driver in the mlcdata structure.

config IIO_ST_LSM6DSVX_ASYNC_HW_TIMESTAMP
	bool "Enable async hw timestamp read"
	depends on IIO_ST_LSM6DSVX
	help
	  Enable async task that sends over hw timestamp events.
```
