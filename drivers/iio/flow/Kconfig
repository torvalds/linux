## drivers/pinctrl/starfive/Kconfig
```kconfig
# SPDX-License-Identifier: GPL-2.0-only

config PINCTRL_STARFIVE_JH7100
	tristate "Pinctrl and GPIO driver for the StarFive JH7100 SoC"
	depends on SOC_STARFIVE || COMPILE_TEST
	depends on OF
	select GENERIC_PINCTRL_GROUPS
	select GENERIC_PINMUX_FUNCTIONS
	select GENERIC_PINCONF
	select GPIOLIB
	select GPIOLIB_IRQCHIP
	default SOC_STARFIVE
	help
	  Say yes here to support pin control on the StarFive JH7100 SoC.
	  This also provides an interface to the GPIO pins not used by other
	  peripherals supporting inputs, outputs, configuring pull-up/pull-down
	  and interrupts on input changes.

config PINCTRL_STARFIVE_JH7110
	bool
	select GENERIC_PINCTRL_GROUPS
	select GENERIC_PINMUX_FUNCTIONS
	select GENERIC_PINCONF
	select GPIOLIB
	select GPIOLIB_IRQCHIP

config PINCTRL_STARFIVE_JH7110_SYS
	tristate "System pinctrl and GPIO driver for the StarFive JH7110 SoC"
	depends on SOC_STARFIVE  || COMPILE_TEST
	depends on OF
	select PINCTRL_STARFIVE_JH7110
	default SOC_STARFIVE
	help
	  Say yes here to support system pin control on the StarFive JH7110 SoC.
	  This also provides an interface to the GPIO pins not used by other
	  peripherals supporting inputs, outputs, configuring pull-up/pull-down
	  and interrupts on input changes.

config PINCTRL_STARFIVE_JH7110_AON
	tristate "Always-on pinctrl and GPIO driver for the StarFive JH7110 SoC"
	depends on SOC_STARFIVE  || COMPILE_TEST
	depends on OF
	select PINCTRL_STARFIVE_JH7110
	default SOC_STARFIVE
	help
	  Say yes here to support always-on pin control on the StarFive JH7110 SoC.
	  This also provides an interface to the GPIO pins not used by other
	  peripherals supporting inputs, outputs, configuring pull-up/pull-down
	  and interrupts on input changes.

config PINCTRL_STARFIVE_JHB100
	bool
	select GENERIC_PINCTRL
	select GPIOLIB
	select GPIOLIB_IRQCHIP

config PINCTRL_STARFIVE_JHB100_PER0
	tristate "StarFive JHB100 SoC Peripheral-0 pinctrl and GPIO driver"
	depends on ARCH_STARFIVE || COMPILE_TEST
	select PINCTRL_STARFIVE_JHB100
	default ARCH_STARFIVE
	help
	  Say yes here to support Peripheral-0 pin control on the StarFive JHB100 SoC.
	  This also provides an interface to the GPIO pins not used by other
	  peripherals supporting inputs, outputs, configuring pull-up/pull-down
	  and interrupts on input changes.

config PINCTRL_STARFIVE_JHB100_PER1
	tristate "StarFive JHB100 SoC Peripheral-1 pinctrl and GPIO driver"
	depends on ARCH_STARFIVE || COMPILE_TEST
	select PINCTRL_STARFIVE_JHB100
	default ARCH_STARFIVE
	help
	  Say yes here to support Peripheral-1 pin control on the StarFive JHB100 SoC.
	  This also provides an interface to the GPIO pins not used by other
	  peripherals supporting inputs, outputs, configuring pull-up/pull-down
	  and interrupts on input changes.

config PINCTRL_STARFIVE_JHB100_PER2
	tristate "StarFive JHB100 SoC Peripheral-2 pinctrl and GPIO driver"
	depends on ARCH_STARFIVE || COMPILE_TEST
	select PINCTRL_STARFIVE_JHB100
	default ARCH_STARFIVE
	help
	  Say yes here to support Peripheral-2 pin control on the StarFive JHB100 SoC.
	  This also provides an interface to the GPIO pins not used by other
	  peripherals supporting inputs, outputs, configuring pull-up/pull-down
	  and interrupts on input changes.

config PINCTRL_STARFIVE_JHB100_PER2POK
	tristate "StarFive JHB100 SoC Peripheral-2 Power OK pinctrl and GPIO driver"
	depends on ARCH_STARFIVE || COMPILE_TEST
	select PINCTRL_STARFIVE_JHB100
	default ARCH_STARFIVE
	help
	  Say yes here to support Peripheral-2 Power OK pin control on the StarFive JHB100 SoC.
	  This also provides an interface to the GPIO pins not used by other
	  peripherals supporting inputs, outputs, configuring pull-up/pull-down
	  and interrupts on input changes.

config PINCTRL_STARFIVE_JHB100_PER3
	tristate "StarFive JHB100 SoC Peripheral-3 pinctrl and GPIO driver"
	depends on ARCH_STARFIVE || COMPILE_TEST
	select PINCTRL_STARFIVE_JHB100
	default ARCH_STARFIVE
	help
	  Say yes here to support Peripheral-3 pin control on the StarFive JHB100 SoC.
	  This also provides an interface to the GPIO pins not used by other
	  peripherals supporting inputs, outputs, configuring pull-up/pull-down
	  and interrupts on input changes.

config PINCTRL_STARFIVE_JHB100_SYS0
	tristate "StarFive JHB100 SoC System-0 pinctrl and GPIO driver"
	depends on ARCH_STARFIVE || COMPILE_TEST
	select PINCTRL_STARFIVE_JHB100
	default ARCH_STARFIVE
	help
	  Say yes here to support system-0 pin control on the StarFive JHB100 SoC.
	  This also provides an interface to the GPIO pins not used by other
	  peripherals supporting inputs, outputs, configuring pull-up/pull-down
	  and interrupts on input changes.

config PINCTRL_STARFIVE_JHB100_SYS0H
	tristate "StarFive JHB100 SoC System-0 Host pinctrl and GPIO driver"
	depends on ARCH_STARFIVE || COMPILE_TEST
	select PINCTRL_STARFIVE_JHB100
	default ARCH_STARFIVE
	help
	  Say yes here to support System-0 Host pin control on the StarFive JHB100 SoC.
	  This also provides an interface to the GPIO pins not used by other
	  peripherals supporting inputs, outputs, configuring pull-up/pull-down
	  and interrupts on input changes.

config PINCTRL_STARFIVE_JHB100_SYS1
	tristate "StarFive JHB100 SoC System-1 pinctrl and GPIO driver"
	depends on ARCH_STARFIVE || COMPILE_TEST
	select PINCTRL_STARFIVE_JHB100
	default ARCH_STARFIVE
	help
	  Say yes here to support System-1 pin control on the StarFive JHB100 SoC.
	  This also provides an interface to the GPIO pins not used by other
	  peripherals supporting inputs, outputs, configuring pull-up/pull-down
	  and interrupts on input changes.

config PINCTRL_STARFIVE_JHB100_SYS2
	tristate "StarFive JHB100 SoC System-2 pinctrl and GPIO driver"
	depends on ARCH_STARFIVE || COMPILE_TEST
	select PINCTRL_STARFIVE_JHB100
	default ARCH_STARFIVE
	help
	  Say yes here to support System-2 pin control on the StarFive JHB100 SoC.
	  This also provides an interface to the GPIO pins not used by other
	  peripherals supporting inputs, outputs, configuring pull-up/pull-down
	  and interrupts on input changes.
```

## drivers/pinctrl/sunplus/Kconfig
```kconfig
# SPDX-License-Identifier: GPL-2.0
#
# Sunplus Pin control driver configuration
#

config PINCTRL_SPPCTL
	bool "Sunplus SP7021 PinMux and GPIO driver"
	depends on SOC_SP7021 || COMPILE_TEST
	depends on OF && HAS_IOMEM
	select GENERIC_PINCTRL_GROUPS
	select GENERIC_PINMUX_FUNCTIONS
	select GENERIC_PINCONF
	select PINCONF
	select PINMUX
	select GPIOLIB
	help
	  Say Y here to support Sunplus SP7021 pinmux controller.
	  This driver requires the pinctrl framework.
	  This driver also provides GPIO.
```

## drivers/platform/arm64/Kconfig
```kconfig
# SPDX-License-Identifier: GPL-2.0-only
#
# EC-like Drivers for aarch64 based devices.
#

menuconfig ARM64_PLATFORM_DEVICES
	bool "ARM64 Platform-Specific Device Drivers"
	depends on ARM64 || COMPILE_TEST
	default ARM64
	help
	  Say Y here to get to see options for platform-specific device drivers
	  for arm64 based devices, primarily EC-like device drivers.
	  This option alone does not add any kernel code.

	  If you say N, all options in this submenu will be skipped and disabled.

if ARM64_PLATFORM_DEVICES

config EC_ACER_ASPIRE1
	tristate "Acer Aspire 1 Embedded Controller driver"
	depends on ARCH_QCOM || COMPILE_TEST
	depends on I2C
	depends on DRM
	depends on POWER_SUPPLY
	depends on INPUT
	help
	  Say Y here to enable the EC driver for the (Snapdragon-based)
	  Acer Aspire 1 laptop. The EC handles battery and charging
	  monitoring as well as some misc functions like the lid sensor
	  and USB Type-C DP HPD events.

	  This driver provides battery and AC status support for the mentioned
	  laptop where this information is not properly exposed via the
	  standard ACPI devices.

config EC_ASUS_GLYMUR
	tristate "ASUS Zenbook A16 (Qualcomm) Embedded Controller driver"
	depends on ARCH_QCOM || COMPILE_TEST
	depends on I2C
	depends on HWMON
	depends on INPUT
	depends on PM
	depends on THERMAL || THERMAL=n
	select NEW_LEDS
	select LEDS_CLASS
	help
	  Say M or Y here to enable the EC driver for the Qualcomm Snapdragon-
	  based ASUS Zenbook A16 (UX3607OA) and similar machines. It provides
	  temperature sensors readout, fan monitoring, keyboard and EC event
	  reporting.

config EC_HUAWEI_GAOKUN
	tristate "Huawei Matebook E Go Embedded Controller driver"
	depends on ARCH_QCOM || COMPILE_TEST
	depends on I2C
	depends on INPUT
	depends on HWMON
	select AUXILIARY_BUS

	help
	  Say Y here to enable the EC driver for the Huawei Matebook E Go
	  which is a sc8280xp-based 2-in-1 tablet. The driver handles battery
	  (information, charge control) and USB Type-C DP HPD events as well
	  as some misc functions like the lid sensor and temperature sensors,
	  etc.

	  This driver provides battery and AC status support for the mentioned
	  laptop where this information is not properly exposed via the
	  standard ACPI devices.

	  Say M or Y here to include this support.

config EC_LENOVO_YOGA_C630
	tristate "Lenovo Yoga C630 Embedded Controller driver"
	depends on ARCH_QCOM || COMPILE_TEST
	depends on I2C
	select AUXILIARY_BUS
	help
	  Driver for the Embedded Controller in the Qualcomm Snapdragon-based
	  Lenovo Yoga C630, which provides battery and power adapter
	  information.

	  This driver provides battery and AC status support for the mentioned
	  laptop where this information is not properly exposed via the
	  standard ACPI devices.

	  Say M or Y here to include this support.

config EC_LENOVO_THINKPAD_T14S
	tristate "Lenovo Thinkpad T14s Embedded Controller driver"
	depends on ARCH_QCOM || COMPILE_TEST
	depends on I2C
	depends on INPUT
	select INPUT_SPARSEKMAP
	select LEDS_CLASS
	select NEW_LEDS
	select SND_CTL_LED if SND
	help
	  Driver for the Embedded Controller in the Qualcomm Snapdragon-based
	  Lenovo Thinkpad T14s, which provides access to keyboard backlight
	  and status LEDs.

	  This driver provides support for the mentioned laptop where this
	  information is not properly exposed via the standard Qualcomm
	  devices.

	  Say M or Y here to include this support.

config EC_LENOVO_YOGA_SLIM7X_GEN11
	tristate "Lenovo Yoga Slim 7x Gen 11 Embedded Controller driver"
	depends on ARCH_QCOM || COMPILE_TEST
	depends on I2C
	depends on INPUT
	depends on HWMON
	select NEW_LEDS
	select LEDS_CLASS
	help
	  Say Y here to enable the EC driver for the (Snapdragon X2 Elite,
	  glymur-based) Lenovo Yoga Slim 7x Gen 11 laptop. The EC provides
	  thermistors and CPU fan speed as hwmon channels, the keyboard
	  backlight as an LED, Fn-lock as a sysfs attribute, and the mic-mute
	  and airplane-mode keys.

	  This is the Gen 11 (glymur) machine specifically. Its EC is a Compal
	  design at i2c address 0x70 and speaks a different protocol from the
	  Qualcomm reference EC that the reference designs place at 0x76, so
	  EC_QCOM_HAMOA does not drive it - and conversely this driver does not
	  cover the X1E-based Yoga Slim 7x Gen 9.

	  To compile this driver as a module, choose M here: the module will
	  be called lenovo-yoga-slim7x-gen11-ec.

config EC_QCOM_HAMOA
	tristate "Embedded Controller driver for Qualcomm Hamoa/Glymur reference devices"
	depends on ARCH_QCOM || COMPILE_TEST
	depends on I2C
	depends on THERMAL || THERMAL=n
	help
	  Say M or Y here to enable the Embedded Controller driver for Qualcomm
	  Snapdragon-based Hamoa/Glymur reference devices. The driver handles fan
	  control, temperature sensors, access to EC state changes and supports
	  reporting suspend entry/exit to the EC.

	  This driver currently supports Hamoa/Purwa/Glymur reference devices.

endif # ARM64_PLATFORM_DEVICES
```
