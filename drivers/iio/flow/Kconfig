## drivers/net/phy/mediatek/Kconfig
```kconfig
# SPDX-License-Identifier: GPL-2.0-only
config MEDIATEK_2P5GE_PHY
	tristate "MediaTek 2.5Gb Ethernet PHYs"
	depends on (ARM64 && ARCH_MEDIATEK) || COMPILE_TEST
	select MTK_NET_PHYLIB
	help
	  Supports MediaTek SoC built-in 2.5Gb Ethernet PHYs.

	  This will load necessary firmware and add appropriate time delay.
	  Accelerate this procedure through internal pbus instead of MDIO
	  bus. Certain link-up issues will also be fixed here.

config MEDIATEK_GE_PHY
	tristate "MediaTek Gigabit Ethernet PHYs"
	select MTK_NET_PHYLIB
	help
	  Supports the MediaTek non-built-in Gigabit Ethernet PHYs.

	  Non-built-in Gigabit Ethernet PHYs include mt7530/mt7531.
	  You may find mt7530 inside mt7621. This driver shares some
	  common operations with MediaTek SoC built-in Gigabit
	  Ethernet PHYs.

config MEDIATEK_FE_SOC_PHY
	tristate "MediaTek SoC Fast Ethernet PHYs"
	depends on SOC_MT7620 || COMPILE_TEST
	help
	  Support for MediaTek MT7628 built-in Fast Ethernet PHYs.
	  This driver only sets an initialization bit required for the PHY
	  to establish 100 Mbps links. All other PHY operations are handled
	  by the kernel's generic PHY code.

config MEDIATEK_GE_SOC_PHY
	tristate "MediaTek SoC Gigabit Ethernet PHYs"
	depends on ARM64 || ECONET || COMPILE_TEST
	depends on ARCH_AIROHA || (ARCH_MEDIATEK && NVMEM_MTK_EFUSE) || \
		   ECONET || COMPILE_TEST
	select MTK_NET_PHYLIB
	select PHY_PACKAGE
	help
	  Supports MediaTek SoC built-in Gigabit Ethernet PHYs.

	  Include support for built-in Ethernet PHYs which are present in
	  the MT7981 and MT7988 SoCs. These PHYs need calibration data
	  present in the SoCs efuse and will dynamically calibrate VCM
	  (common-mode voltage) during startup.

	  Also include support for the built-in Gigabit Ethernet PHYs of
	  the Airoha AN7581 and AN7583 SoCs and of the EcoNet EN7528 SoC,
	  which need no efuse calibration data.

config MTK_NET_PHYLIB
	tristate
```

## drivers/net/pse-pd/Kconfig
```kconfig
# SPDX-License-Identifier: GPL-2.0-only
#
# Ethernet Power Sourcing Equipment drivers
#

menuconfig PSE_CONTROLLER
	bool "Ethernet Power Sourcing Equipment Support"
	depends on REGULATOR
	help
	  Generic Power Sourcing Equipment Controller support.

	  If unsure, say no.

if PSE_CONTROLLER

config PSE_REALTEK_MCU
	tristate
	help
	  Shared core for the Realtek PSE MCU driver. This is selected
	  automatically by the transport options below.

config PSE_REALTEK_MCU_I2C
	tristate "Realtek PSE MCU driver (I2C transport)"
	depends on I2C
	select PSE_REALTEK_MCU
	help
	  Driver for the microcontroller (MCU) that fronts the PSE
	  hardware on various Realtek-based managed switches, attached
	  via I2C/SMBus. The MCU exposes a message-based protocol; the actual
	  PSE silicon is not accessed directly. To compile this driver as a
	  module, choose M here: the module will be called realtek-pse-mcu-i2c.

config PSE_REGULATOR
	tristate "Regulator based PSE controller"
	help
	  This module provides support for simple regulator based Ethernet Power
	  Sourcing Equipment without automatic classification support. For
	  example for basic implementation of PoDL (802.3bu) specification.

config PSE_PD692X0
	tristate "PD692X0 PSE controller"
	depends on I2C
	select FW_LOADER
	select FW_UPLOAD
	help
	  This module provides support for PD692x0 regulator based Ethernet
	  Power Sourcing Equipment.

	  To compile this driver as a module, choose M here: the
	  module will be called pd692x0.

config PSE_SI3474
	tristate "Si3474 PSE controller"
	depends on I2C
	help
	  This module provides support for Si3474 regulator based Ethernet
	  Power Sourcing Equipment.
	  Only 4-pair PSE configurations are supported.

	  To compile this driver as a module, choose M here: the
	  module will be called si3474.

config PSE_TPS23881
	tristate "TPS23881 PSE controller"
	depends on I2C
	help
	  This module provides support for TPS23881 regulator based Ethernet
	  Power Sourcing Equipment.

	  To compile this driver as a module, choose M here: the
	  module will be called tps23881.
endif
```

## drivers/net/wireless/morsemicro/mm81x/Kconfig
```kconfig
# SPDX-License-Identifier: GPL-2.0

config MM81X
	tristate "Morse Micro MM81x wireless devices" if COMPILE_TEST
	depends on MAC80211
	select FW_LOADER
	select CRC7
	help
	  This module adds support for wireless devices based
	  on Morse Micro MM81xx chipsets.

config MM81X_USB
	tristate "Morse Micro MM81x USB support"
	depends on MAC80211 && USB
	select MM81X
	help
	  This module adds support for the USB interface of
	  devices using the Morse Micro MM81x chipset.

config MM81X_SDIO
	tristate "Morse Micro MM81x SDIO support"
	depends on MAC80211 && MMC
	select MM81X
	help
	  This module adds support for the SDIO interface of
	  devices using the Morse Micro MM81x chipset.
```

## drivers/pci/controller/cadence/Kconfig
```kconfig
# SPDX-License-Identifier: GPL-2.0

menu "Cadence-based PCIe controllers"
	depends on PCI

config PCIE_CADENCE
	tristate

config PCIE_CADENCE_DEBUGFS
	bool "Cadence PCIe debugfs entries"
	depends on DEBUG_FS
	depends on PCIE_CADENCE_HOST || PCIE_CADENCE_EP
	help
	  Say Y here to enable debugfs entries for the PCIe controller. These
	  entries provide various debug features related to the controller and
	  the LTSSM status of link can be displayed.

config PCIE_CADENCE_HOST
	tristate
	depends on OF
	select IRQ_DOMAIN
	select PCIE_CADENCE

config PCIE_CADENCE_EP
	tristate
	depends on OF
	depends on PCI_ENDPOINT
	select PCIE_CADENCE

config PCIE_CADENCE_PLAT
	tristate
	select PCIE_CADENCE_HOST if PCIE_CADENCE_PLAT_HOST != n
	select PCIE_CADENCE_EP if PCIE_CADENCE_PLAT_EP != n

config PCIE_CADENCE_PLAT_HOST
	tristate "Cadence platform PCIe controller (host mode)"
	depends on OF
	select PCIE_CADENCE_PLAT
	help
	  Say Y here if you want to support the Cadence PCIe platform controller in
	  host mode. This PCIe controller may be embedded into many different
	  vendors SoCs.

config PCIE_CADENCE_PLAT_EP
	tristate "Cadence platform PCIe controller (endpoint mode)"
	depends on OF
	depends on PCI_ENDPOINT
	select PCIE_CADENCE_PLAT
	help
	  Say Y here if you want to support the Cadence PCIe platform controller in
	  endpoint mode. This PCIe controller may be embedded into many
	  different vendors SoCs.

config PCI_SKY1_HOST
	tristate "CIX SKY1 PCIe controller (host mode)"
	depends on OF && (ARCH_CIX || COMPILE_TEST)
	select PCIE_CADENCE_HOST
	select PCI_ECAM
	help
	  Say Y here if you want to support the CIX SKY1 PCIe platform
	  controller in host mode. CIX SKY1 PCIe controller uses Cadence
	  HPA (High Performance Architecture IP [Second generation of
	  Cadence PCIe IP])

	  This driver requires Cadence PCIe core infrastructure
	  (PCIE_CADENCE_HOST) and hardware platform adaptation layer
	  to function.

config PCIE_SG2042_HOST
	tristate "Sophgo SG2042 PCIe controller (host mode)"
	depends on OF && (ARCH_SOPHGO || COMPILE_TEST)
	select PCIE_CADENCE_HOST
	help
	  Say Y here if you want to support the Sophgo SG2042 PCIe platform
	  controller in host mode. Sophgo SG2042 PCIe controller uses Cadence
	  PCIe core.

config PCI_J721E
	tristate
	select PCIE_CADENCE_HOST if PCI_J721E_HOST != n
	select PCIE_CADENCE_EP if PCI_J721E_EP != n

config PCI_J721E_HOST
	tristate "TI J721E PCIe controller (host mode)"
	depends on ARCH_K3 || COMPILE_TEST
	depends on OF
	select PCI_J721E
	help
	  Say Y here if you want to support the TI J721E PCIe platform
	  controller in host mode. TI J721E PCIe controller uses Cadence PCIe
	  core.

config PCI_J721E_EP
	tristate "TI J721E PCIe controller (endpoint mode)"
	depends on ARCH_K3 || COMPILE_TEST
	depends on OF
	depends on PCI_ENDPOINT
	select PCI_J721E
	help
	  Say Y here if you want to support the TI J721E PCIe platform
	  controller in endpoint mode. TI J721E PCIe controller uses Cadence PCIe
	  core.

endmenu
```

## drivers/phy/aspeed/Kconfig
```kconfig
# SPDX-License-Identifier: GPL-2.0-only

#
# PHY drivers for ASPEED
#

config PHY_ASPEED_USB3
	tristate "ASPEED USB3 PHY driver"
	select GENERIC_PHY
	depends on (ARCH_ASPEED || COMPILE_TEST)
	help
	  Enable this to support the USB 3.2 PHY on the Aspeed AST2700 SoC.
	  It supports SuperSpeedPlus Gen2x1 (10 Gbps), SuperSpeed (5 Gbps),
	  High Speed (480 Mbps), Full Speed (12 Mbps) and Low Speed
	  (1.5 Mbps), and is paired with the DWC3 USB controller.
```

## drivers/phy/tegra/Kconfig
```kconfig
# SPDX-License-Identifier: GPL-2.0-only
config PHY_TEGRA_XUSB
	tristate "NVIDIA Tegra XUSB pad controller driver"
	depends on ARCH_TEGRA && USB_SUPPORT
	select USB_COMMON
	select USB_CONN_GPIO if GPIOLIB
	select USB_PHY
	help
	  Choose this option if you have an NVIDIA Tegra SoC.

	  To compile this driver as a module, choose M here: the module will
	  be called phy-tegra-xusb.

config PHY_TEGRA194_P2U
	tristate "NVIDIA Tegra194 PIPE2UPHY PHY driver"
	depends on ARCH_TEGRA || COMPILE_TEST
	select GENERIC_PHY
	help
	  Enable this to support the P2U (PIPE to UPHY) that is part of Tegra 19x
	  and 234 SOCs.

config PHY_TEGRA_MPHY
	tristate "NVIDIA Tegra264 MPHY driver"
	depends on ARCH_TEGRA_264_SOC || COMPILE_TEST
	select GENERIC_PHY
	help
	  Enable this to support the MIPI M-PHY on NVIDIA Tegra264 SoCs.
	  The M-PHY provides the physical layer for the on-die UFS host
	  controller. The driver manages the shared clock-control block
	  and per-lane resets, exposing four sub-phys (L0-TX, L0-RX,
	  L1-TX, L1-RX) consumed by the UFS host driver.
```

## drivers/pinctrl/airoha/Kconfig
```kconfig
# SPDX-License-Identifier: GPL-2.0-only
menu "Airoha pinctrl drivers"
	depends on ARCH_AIROHA || COMPILE_TEST

config PINCTRL_AIROHA
	tristate "Airoha pin control"
	depends on OF
	depends on ARCH_AIROHA || COMPILE_TEST
	select PINMUX
	select GENERIC_PINCONF
	select GENERIC_PINCTRL_GROUPS
	select GENERIC_PINMUX_FUNCTIONS
	select GPIOLIB
	select GPIOLIB_IRQCHIP
	select REGMAP_MMIO
	imply PINCTRL_AIROHA_AN7563
	imply PINCTRL_AIROHA_AN7581
	imply PINCTRL_AIROHA_AN7583
	imply PINCTRL_AIROHA_EN7523
	help
	  Shared pin controller and gpio driver code for different
	  Airoha SoCs.

config PINCTRL_AIROHA_AN7563
	tristate "AN7563 pinctrl"
	depends on ARM64 || COMPILE_TEST
	depends on PINCTRL_AIROHA
	help
	  Say yes here to support pin controller and gpio driver
	  on Airoha AN7563 and other compatible SoCs.

config PINCTRL_AIROHA_AN7581
	tristate "AN7581 pinctrl"
	depends on ARM64 || COMPILE_TEST
	depends on PINCTRL_AIROHA
	help
	  Say yes here to support pin controller and gpio driver
	  on Airoha AN7581, AN7566, AN7551 and other compatible SoCs.

config PINCTRL_AIROHA_AN7583
	tristate "AN7583 pinctrl"
	depends on ARM64 || COMPILE_TEST
	depends on PINCTRL_AIROHA
	help
	  Say yes here to support pin controller and gpio driver
	  on Airoha AN7583, AN7553, AN7567 and other compatible SoCs.

config PINCTRL_AIROHA_EN7523
	tristate "EN7523 pinctrl"
	depends on ARM || COMPILE_TEST
	depends on PINCTRL_AIROHA
	help
	  Say yes here to support pin controller and gpio driver
	  on Airoha EN7523, EN7529, EN7562 and other compatible SoCs.

endmenu
```
