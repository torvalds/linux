## drivers/iio/imu/inv_icm42607/Kconfig
```kconfig
# SPDX-License-Identifier: GPL-2.0-or-later

config INV_ICM42607
	tristate
	select IIO_BUFFER
	select IIO_INV_SENSORS_TIMESTAMP

config INV_ICM42607_I2C
	tristate "InvenSense ICM-42607 I2C driver"
	depends on I2C
	select INV_ICM42607
	select REGMAP_I2C
	help
	  This driver supports the InvenSense ICM-42607 motion tracking
	  device over I2C.

	  This driver can be built as a module. The module will be called
	  inv-icm42607-i2c.
```

## drivers/iommu/hyperv/Kconfig
```kconfig
# SPDX-License-Identifier: GPL-2.0-only
# Hyper-V para-virtualized IOMMU driver for Linux guests
config HYPERV_PVIOMMU
	bool "Microsoft Hyper-V para-virtualized IOMMU driver for Linux guests"
	depends on X86_64 && HYPERV && PCI
	select IOMMU_DMA
	select GENERIC_PT
	select IOMMU_PT
	select IOMMU_PT_X86_64
	default HYPERV
	help
	  Para-virtualized IOMMU driver for Linux guests running on
	  Microsoft Hyper-V. Provides DMA remapping and IOTLB
	  flush support to enable DMA isolation for PCI devices
	  assigned to the guest.
```

## drivers/media/i2c/maxim-serdes/Kconfig
```kconfig
# SPDX-License-Identifier: GPL-2.0

config VIDEO_MAXIM_SERDES
	tristate "Maxim GMSL2/3 Serializer and Deserializer support"
	depends on VIDEO_DEV
	depends on I2C
	select I2C_ATR
	select I2C_MUX
	select MEDIA_CONTROLLER
	select V4L2_FWNODE
	select VIDEO_V4L2_SUBDEV_API
	help
	  This driver supports the Maxim GMSL2/3 common Serializer and
	  Deserializer framework.

	  To compile this driver as a module, choose M here: the module
	  will be called max_serdes.

config VIDEO_MAX96717
	tristate "Maxim MAX96717 Serializer support"
	depends on COMMON_CLK
	depends on I2C
	depends on PINCTRL
	depends on VIDEO_DEV
	select VIDEO_MAXIM_SERDES
	select GENERIC_PINCONF
	select GENERIC_PINCTRL_GROUPS
	select GENERIC_PINMUX_FUNCTIONS
	select GPIOLIB
	help
	  This driver supports the Maxim MAX9295A, MAX96717, MAX96717F,
	  MAX96793 Serializers, which receive video on a MIPI CSI-2
	  interface and output it on a GMSL2/3 link.

	  To compile this driver as a module, choose M here: the module
	  will be called max96717.

config VIDEO_MAX96724
	tristate "Maxim MAX96724 Quad Deserializer support"
	depends on I2C
	depends on VIDEO_DEV
	select VIDEO_MAXIM_SERDES
	help
	  This driver supports the Maxim MAX96712, MAX96724, MAX96724F,
	  MAX96724R Quad Deserializers, which convert from four GMSL2
	  links to up to four MIPI D-PHY or C-PHY outputs.

	  To compile this driver as a module, choose M here: the module
	  will be called max96724.

config VIDEO_MAX9296A
	tristate "Maxim MAX9296A Dual Deserializer support"
	depends on I2C
	depends on VIDEO_DEV
	select VIDEO_MAXIM_SERDES
	help
	  This driver supports the Maxim MAX9296A, MAX96716A, MAX96792A
	  Dual Deserializers, and the MAX96714, MAX96714F, MAX96714R
	  Single Deserializers, which  convert from up to two GMSL2/3
	  links to up to two MIPI D-PHY outputs.

	  To compile this driver as a module, choose M here: the module
	  will be called max9296a.
```

## drivers/media/pci/intel/ipu6/Kconfig
```kconfig
config VIDEO_INTEL_IPU6
	tristate "Intel IPU 6/7/8 driver"
	depends on ACPI || COMPILE_TEST
	depends on VIDEO_DEV
	depends on X86 && HAS_DMA
	depends on IPU_BRIDGE || !IPU_BRIDGE
	select AUXILIARY_BUS
	select IOMMU_IOVA
	select VIDEO_V4L2_SUBDEV_API
	select MEDIA_CONTROLLER
	select VIDEOBUF2_DMA_SG
	select V4L2_FWNODE
	help
	  This is the driver for 6th, 7th and 8th Gen Intel Image
	  Processing Units, found in Intel SoCs since Tiger lake and used
	  for capturing images and video from camera sensors.

	  To compile this driver, say Y here! The two modules will be
	  called intel_ipu6 and intel_ipu6_isys.

config VIDEO_INTEL_IPU6_IPU7
	bool "Support IPU 7 and IPU 7.5 in ipu6 driver by default"
	depends on VIDEO_INTEL_IPU6
	default y
	help
	  Support Intel IPU 7 and IPU 7.5 in ipu6 driver by default, instead of
	  the ipu7 staging driver. This behaviour can be changed at runtime with
	  module parameters in the respective drivers.
```

## drivers/media/platform/dreamchip/Kconfig
```kconfig
# SPDX-License-Identifier: GPL-2.0-only

source "drivers/media/platform/dreamchip/rppx1/Kconfig"
```

## drivers/media/platform/dreamchip/rppx1/Kconfig
```kconfig
# SPDX-License-Identifier: GPL-2.0
config VIDEO_DCT_RPPX1
	tristate
	depends on V4L_PLATFORM_DRIVERS
	select V4L2_ISP
	help
	  Support library for Dreamchip HDR RPP X1 High Dynamic Range Real-time
	  Pixel Processor (RPP). The library can be used by other drivers who
	  utilises the RPP as part of an ISP implementation.

	  To compile this driver as a module, choose M here: the
	  module will be called rppx1.
```

## drivers/net/dsa/motorcomm/Kconfig
```kconfig
# SPDX-License-Identifier: GPL-2.0-only
config NET_DSA_YT921X
	tristate "Motorcomm YT9215 ethernet switch chip support"
	select NET_DSA_TAG_YT921X
	select NET_IEEE8021Q_HELPERS if DCB
	help
	  This enables support for the Motorcomm YT9215 ethernet switch
	  chip.

config NET_DSA_YT921X_LEDS
	bool "LED support for Motorcomm YT9215"
	default y
	depends on NET_DSA_YT921X
	depends on LEDS_CLASS=y || LEDS_CLASS=NET_DSA_YT921X
	help
	  This enables support for controlling the LEDs attached to the
	  Motorcomm YT9215 switch chips.
```

## drivers/net/ethernet/intel/ixd/Kconfig
```kconfig
# SPDX-License-Identifier: GPL-2.0-only
# Copyright (C) 2025 Intel Corporation

config IXD
	tristate "Intel(R) Control Plane Function Support"
	depends on PCI_MSI
	select LIBIE_CP
	select LIBIE_PCI
	select NET_DEVLINK
	help
	  This driver supports Intel(R) Control Plane PCI Function
	  of Intel E2100 and later IPUs and FNICs.
	  It facilitates a centralized control over multiple IDPF PFs/VFs/SFs
	  exposed by the same card.
```

## drivers/net/ethernet/microsoft/Kconfig
```kconfig
#
# Microsoft Azure network device configuration
#

config NET_VENDOR_MICROSOFT
	bool "Microsoft Network Devices"
	default y
	help
	  If you have a network (Ethernet) device belonging to this class, say Y.

	  Note that the answer to this question doesn't directly affect the
	  kernel: saying N will just cause the configurator to skip the
	  question about Microsoft network devices. If you say Y, you will be
	  asked for your specific device in the following question.

if NET_VENDOR_MICROSOFT

config MICROSOFT_GDMA_CORE
	tristate
	select AUXILIARY_BUS
	select DIMLIB
	select PAGE_POOL
	select NET_SHAPER

config MICROSOFT_MANA
	tristate "Microsoft Azure Network Adapter (MANA) support"
	depends on PCI_MSI
	depends on X86_64 || ARM64
	depends on PCI_HYPERV
	select MICROSOFT_GDMA_CORE
	help
	  This driver supports Microsoft Azure Network Adapter (MANA).
	  So far, the driver is only supported on X86_64.

	  To compile this driver as a module, choose M here.
	  The module will be called mana.

config MICROSOFT_MANA_CDX
	tristate "Microsoft Azure Network Adapter (MANA) support for the CDX bus"
	depends on CDX_BUS
	depends on GENERIC_MSI_IRQ
	depends on 64BIT && !CPU_BIG_ENDIAN
	select MICROSOFT_GDMA_CORE
	help
	  This driver supports the Microsoft Azure Network Adapter (MANA) on
	  systems where it is integrated into the SoC and presented on the CDX
	  bus rather than discovered over PCI.

	  To compile this driver as a module, choose M here.
	  The module will be called mana_cdx.

endif #NET_VENDOR_MICROSOFT
```

## drivers/net/ethernet/nebula-matrix/Kconfig
```kconfig
# SPDX-License-Identifier: GPL-2.0
#
# Nebula-matrix network device configuration
#

config NET_VENDOR_NEBULA_MATRIX
	bool "Nebula-matrix devices"
	default y
	help
	  If you have a network (Ethernet) card belonging to this class, say Y.
	  Note that the answer to this question doesn't directly affect the
	  kernel: saying N will just cause the configurator to skip all
	  the questions about Nebula-matrix cards. If you say Y, you will be asked
	  for your specific card in the following questions.

if NET_VENDOR_NEBULA_MATRIX

config NBL
	tristate "Nebula-matrix Ethernet Controller m18110/m18000 support"
	depends on PCI && (64BIT || COMPILE_TEST) && !CPU_BIG_ENDIAN
	help
	  This driver provides the core infrastructure for Nebula-matrix
	  Ethernet Controller m18110/m18000 Family of devices, including
	  PCI enumeration, firmware mailbox and channel communication.

	  More specific information on configuring the driver is in
	  <file:Documentation/networking/device_drivers/ethernet/nebula-matrix/nbl.rst>.

	  To compile this driver as a module, choose M here. The module
	  will be called nbl.

endif # NET_VENDOR_NEBULA_MATRIX
```

## drivers/net/ethernet/smsc/Kconfig
```kconfig
# SPDX-License-Identifier: GPL-2.0-only
#
# Western Digital/SMC network device configuration
#

config NET_VENDOR_SMSC
	bool "SMC (SMSC)/Western Digital devices"
	default y
	depends on ARM || ARM64 || ATARI_ETHERNAT || COLDFIRE || \
		   ISA || MAC || MIPS || NIOS2 || PCI || \
		   PCMCIA || SUPERH || XTENSA || COMPILE_TEST
	help
	  If you have a network (Ethernet) card belonging to this class, say Y.

	  Note that the answer to this question doesn't directly affect the
	  kernel: saying N will just cause the configurator to skip all
	  the questions about SMC/Western Digital cards. If you say Y, you will
	  be asked for your specific card in the following questions.

if NET_VENDOR_SMSC

config SMC91X
	tristate "SMC 91C9x/91C1xxx support"
	select CRC32
	select MII
	depends on !OF || GPIOLIB
	depends on ARM || ARM64 || ATARI_ETHERNAT || COLDFIRE || \
		   MIPS || NIOS2 || SUPERH || XTENSA || COMPILE_TEST
	help
	  This is a driver for SMC's 91x series of Ethernet chipsets,
	  including the SMC91C94 and the SMC91C111. Say Y if you want it
	  compiled into the kernel.

	  This driver is also available as a module ( = code which can be
	  inserted in and removed from the running kernel whenever you want).
	  The module will be called smc91x.  If you want to compile it as a
	  module, say M here and read <file:Documentation/kbuild/modules.rst>.

config EPIC100
	tristate "SMC EtherPower II"
	depends on PCI
	select CRC32
	select MII
	help
	  This driver is for the SMC EtherPower II 9432 PCI Ethernet NIC,
	  which is based on the SMC83c17x (EPIC/100).
	  More specific information and updates are available from
	  <http://www.scyld.com/network/epic100.html>.

config SMSC911X
	tristate "SMSC LAN911x/LAN921x families embedded ethernet support"
	depends on HAS_IOMEM
	select CRC32
	select MII
	select PHYLIB
	help
	  Say Y here if you want support for SMSC LAN911x and LAN921x families
	  of ethernet controllers.

	  To compile this driver as a module, choose M here. The module
	  will be called smsc911x.

config SMSC911X_ARCH_HOOKS
	def_bool n
	depends on SMSC911X
	help
	  If the arch enables this, it allows the arch to implement various
	  hooks for more comprehensive interrupt control and also to override
	  the source of the MAC address.

config SMSC9420
	tristate "SMSC LAN9420 PCI ethernet adapter support"
	depends on PCI
	select CRC32
	select PHYLIB
	select SMSC_PHY
	help
	  This is a driver for SMSC's LAN9420 PCI ethernet adapter.
	  Say Y here if you want it compiled into the kernel.

	  This driver is also available as a module. The module will be
	  called smsc9420.  If you want to compile it as a module, say M
	  here and read <file:Documentation/kbuild/modules.rst>

endif # NET_VENDOR_SMSC
```

## drivers/net/ethernet/zte/Kconfig
```kconfig
# SPDX-License-Identifier: GPL-2.0-only
#
# ZTE driver configuration
#

config NET_VENDOR_ZTE
    bool "ZTE devices"
    default y
    help
      If you have a network (Ethernet) card belonging to this class, say Y.
      Note that the answer to this question doesn't directly affect the
      kernel: saying N will just cause the configurator to skip all
      the questions about Zte cards. If you say Y, you will be asked
      for your specific card in the following questions.

if NET_VENDOR_ZTE

source "drivers/net/ethernet/zte/dinghai/Kconfig"

endif # NET_VENDOR_ZTE
```

## drivers/net/ethernet/zte/dinghai/Kconfig
```kconfig
# SPDX-License-Identifier: GPL-2.0-only
#
# ZTE DingHai Ethernet driver configuration
#

config DINGHAI
    bool "ZTE DingHai Ethernet driver"
    depends on PCI
    select NET_DEVLINK
    help
      This driver supports ZTE DingHai Ethernet devices.

      DingHai is a high-performance Ethernet controller that supports
      multiple features including hardware offloading, SR-IOV, and
      advanced virtualization capabilities.

      If you say Y here, you can select specific driver variants below.

      If unsure, say N.

if DINGHAI

config DINGHAI_PF
    tristate "ZTE DingHai PF (Physical Function) driver"
    help
      This driver supports ZTE DingHai PCI Express Ethernet
      adapters (PF).

      To compile this driver as a module, choose M here. The module
      will be named dinghai10e.

      If unsure, say N.

endif # DINGHAI
```

## drivers/net/pcs/Kconfig
```kconfig
# SPDX-License-Identifier: GPL-2.0-only
#
# PCS Layer Configuration
#

menu "PCS device drivers"

config PCS_XPCS
	tristate "Synopsys DesignWare Ethernet XPCS"
	select PHYLINK
	help
	  This module provides a driver and helper functions for Synopsys
	  DesignWare XPCS controllers.

if PCS_XPCS

config PCS_XPCS_PLATFORM
	tristate "Generic XPCS controller support"
	help
	  Generic DWXPCS driver for platforms that don't require any
	  platform specific code to function or is using platform
	  data for setup.

	  If you have a controller with this interface, say Y or M here.

config PCS_XPCS_ROCKCHIP
	tristate "Rockchip XPCS controller support"
	depends on OF && (ARCH_ROCKCHIP || COMPILE_TEST)
	select GENERIC_PHY
	select PM_GENERIC_DOMAINS if PM
	help
	  Support for XPCS controller on Rockchip RK356x SoC.

	  If you have a Rockchip SoC with this interface, say Y or M here.

endif # PCS_XPCS

config PCS_LYNX
	tristate
	help
	  This module provides helpers to phylink for managing the Lynx PCS
	  which is part of the Layerscape and QorIQ Ethernet SERDES.

config PCS_MTK_LYNXI
	tristate
	select PHY_COMMON_PROPS
	select REGMAP
	help
	  This module provides helpers to phylink for managing the LynxI PCS
	  which is part of MediaTek's SoC and Ethernet switch ICs.

config PCS_RZN1_MIIC
	tristate "Renesas RZ/N1, RZ/N2H, RZ/T2H MII converter"
	depends on OF
	depends on ARCH_RENESAS || COMPILE_TEST
	help
	  This module provides a driver for the MII converter available on
	  Renesas RZ/N1, RZ/N2H, and RZ/T2H SoCs. This PCS converts MII to
	  RMII/RGMII, or can be set in pass-through mode for MII.

endmenu
```
