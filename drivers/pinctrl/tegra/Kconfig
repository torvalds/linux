## drivers/pinctrl/tegra/Kconfig
```kconfig
# SPDX-License-Identifier: GPL-2.0-only
config PINCTRL_TEGRA
	bool "NVIDIA Tegra pin controllers common" if COMPILE_TEST && !ARCH_TEGRA
	select PINMUX
	select PINCONF

config PINCTRL_TEGRA20
	bool "NVIDIA Tegra20 pin controller" if COMPILE_TEST && !ARCH_TEGRA
	select PINCTRL_TEGRA
	depends on COMMON_CLK

config PINCTRL_TEGRA30
	bool "NVIDIA Tegra30 pin controller" if COMPILE_TEST && !ARCH_TEGRA
	select PINCTRL_TEGRA

config PINCTRL_TEGRA114
	bool "NVIDIA Tegra114 pin controller" if COMPILE_TEST && !ARCH_TEGRA
	select PINCTRL_TEGRA

config PINCTRL_TEGRA124
	bool "NVIDIA Tegra124 pin controller" if COMPILE_TEST && !ARCH_TEGRA
	select PINCTRL_TEGRA

config PINCTRL_TEGRA210
	bool "NVIDIA Tegra210 pin controller" if COMPILE_TEST && !ARCH_TEGRA
	select PINCTRL_TEGRA

config PINCTRL_TEGRA186
	bool "NVIDIA Tegra186 pin controller" if COMPILE_TEST && !ARCH_TEGRA
	select PINCTRL_TEGRA

config PINCTRL_TEGRA194
	bool "NVIDIA Tegra194 pin controller" if COMPILE_TEST && !ARCH_TEGRA
	select PINCTRL_TEGRA

config PINCTRL_TEGRA234
	bool "NVIDIA Tegra234 pin controller" if COMPILE_TEST && !ARCH_TEGRA
	select PINCTRL_TEGRA

config PINCTRL_TEGRA238
	tristate "NVIDIA Tegra238 pinctrl driver"
	depends on ARCH_TEGRA || COMPILE_TEST
	default m if ARCH_TEGRA_238_SOC
	select PINCTRL_TEGRA
	help
	  Say Y or M here to enable support for the pinctrl driver for
	  NVIDIA Tegra238 SoC. This driver controls the pin multiplexing
	  and configuration for the MAIN and AON pin controllers found
	  on Tegra238.

config PINCTRL_TEGRA264
	tristate "NVIDIA Tegra264 pinctrl driver"
	depends on ARCH_TEGRA || COMPILE_TEST
	default m if ARCH_TEGRA_264_SOC
	select PINCTRL_TEGRA
	help
	  Say Y or M here to enable support for the pinctrl driver for
	  NVIDIA Tegra264 SoC. This driver controls the pin multiplexing
	  and configuration for the MAIN, AON and UPHY pin controllers found
	  on Tegra264.

config PINCTRL_TEGRA_XUSB
	bool "NVIDIA Tegra XUSB pin controller" if COMPILE_TEST && !ARCH_TEGRA
	default y if ARCH_TEGRA
	select GENERIC_PHY
	select PINCONF
	select PINMUX
```

## drivers/pinctrl/ti/Kconfig
```kconfig
config PINCTRL_TI_IODELAY
	tristate "TI IODelay Module pinconf driver"
	depends on OF
	select GENERIC_PINCTRL_GROUPS
	select GENERIC_PINMUX_FUNCTIONS
	select GENERIC_PINCONF
	select REGMAP_MMIO
	help
	  Say Y here to support Texas Instruments' IO delay pinconf driver.
	  IO delay module is used for the DRA7 SoC family.
```

## drivers/pinctrl/ultrarisc/Kconfig
```kconfig
# SPDX-License-Identifier: GPL-2.0-only

config PINCTRL_ULTRARISC
	tristate
	depends on OF
	depends on ARCH_ULTRARISC || COMPILE_TEST
	select GENERIC_PINCTRL
	select PINMUX

config PINCTRL_ULTRARISC_DP1000
	tristate "UltraRISC DP1000 SoC Pinctrl driver"
	select PINCTRL_ULTRARISC
	depends on OF && HAS_IOMEM
	depends on ARCH_ULTRARISC || COMPILE_TEST
	default ARCH_ULTRARISC
	help
	  Say Y to select the pinctrl driver for UltraRISC DP1000 SoC.
	  This pin controller allows selecting the mux function for
	  each pin. This driver can also be built as a module called
	  pinctrl-dp1000.
```

## drivers/pinctrl/uniphier/Kconfig
```kconfig
# SPDX-License-Identifier: GPL-2.0-only
menuconfig PINCTRL_UNIPHIER
	bool "UniPhier SoC pinctrl drivers"
	depends on ARCH_UNIPHIER || COMPILE_TEST
	depends on OF && MFD_SYSCON
	default ARCH_UNIPHIER
	select PINMUX
	select GENERIC_PINCONF

if PINCTRL_UNIPHIER

config PINCTRL_UNIPHIER_LD4
	bool "UniPhier LD4 SoC pinctrl driver"
	default ARM

config PINCTRL_UNIPHIER_PRO4
	bool "UniPhier Pro4 SoC pinctrl driver"
	default ARM

config PINCTRL_UNIPHIER_SLD8
	bool "UniPhier sLD8 SoC pinctrl driver"
	default ARM

config PINCTRL_UNIPHIER_PRO5
	bool "UniPhier Pro5 SoC pinctrl driver"
	default ARM

config PINCTRL_UNIPHIER_PXS2
	bool "UniPhier PXs2 SoC pinctrl driver"
	default ARM

config PINCTRL_UNIPHIER_LD6B
	bool "UniPhier LD6b SoC pinctrl driver"
	default ARM

config PINCTRL_UNIPHIER_LD11
	bool "UniPhier LD11 SoC pinctrl driver"
	default ARM64

config PINCTRL_UNIPHIER_LD20
	bool "UniPhier LD20 SoC pinctrl driver"
	default ARM64

config PINCTRL_UNIPHIER_PXS3
	bool "UniPhier PXs3 SoC pinctrl driver"
	default ARM64

config PINCTRL_UNIPHIER_NX1
	bool "UniPhier NX1 SoC pinctrl driver"
	default ARM64

endif
```

## drivers/pinctrl/visconti/Kconfig
```kconfig
# SPDX-License-Identifier: GPL-2.0-only
config PINCTRL_VISCONTI
	bool
	select PINMUX
	select GENERIC_PINCONF
	select GENERIC_PINCTRL_GROUPS
	select GENERIC_PINMUX_FUNCTIONS

config PINCTRL_TMPV7700
	bool "Toshiba Visconti TMPV7700 series pinctrl driver"
	depends on OF
	depends on ARCH_VISCONTI || COMPILE_TEST
	select PINCTRL_VISCONTI
	default ARCH_VISCONTI
```

## drivers/pinctrl/vt8500/Kconfig
```kconfig
# SPDX-License-Identifier: GPL-2.0-only
#
# VIA/Wondermedia PINCTRL drivers
#

if ARCH_VT8500 || COMPILE_TEST

config PINCTRL_WMT
	bool
	select PINMUX
	select GENERIC_PINCONF
	select GPIOLIB

config PINCTRL_VT8500
	bool "VIA VT8500 pin controller driver"
	depends on ARCH_WM8505 || COMPILE_TEST
	select PINCTRL_WMT
	help
	  Say yes here to support the gpio/pin control module on
	  VIA VT8500 SoCs.

config PINCTRL_WM8505
	bool "Wondermedia WM8505 pin controller driver"
	depends on ARCH_WM8505 || COMPILE_TEST
	select PINCTRL_WMT
	help
	  Say yes here to support the gpio/pin control module on
	  Wondermedia WM8505 SoCs.

config PINCTRL_WM8650
	bool "Wondermedia WM8650 pin controller driver"
	depends on ARCH_WM8505 || COMPILE_TEST
	select PINCTRL_WMT
	help
	  Say yes here to support the gpio/pin control module on
	  Wondermedia WM8650 SoCs.

config PINCTRL_WM8750
	bool "Wondermedia WM8750 pin controller driver"
	depends on ARCH_WM8750 || COMPILE_TEST
	select PINCTRL_WMT
	help
	  Say yes here to support the gpio/pin control module on
	  Wondermedia WM8750 SoCs.

config PINCTRL_WM8850
	bool "Wondermedia WM8850 pin controller driver"
	depends on ARCH_WM8850 || COMPILE_TEST
	select PINCTRL_WMT
	help
	  Say yes here to support the gpio/pin control module on
	  Wondermedia WM8850 SoCs.

endif
```

## drivers/pinctrl/zte/Kconfig
```kconfig
# SPDX-License-Identifier: GPL-2.0-only
config PINCTRL_ZX
	bool
	select PINMUX
	select GENERIC_PINCONF
	select GENERIC_PINCTRL_GROUPS
	select GENERIC_PINMUX_FUNCTIONS

config PINCTRL_ZX296718
	bool "ZTE ZX296718 pinctrl driver"
	depends on OF && ARCH_ZX
	select PINCTRL_ZX
	help
	  Say Y here to enable the ZX296718 pinctrl driver
```

## drivers/platform/Kconfig
```kconfig
# SPDX-License-Identifier: GPL-2.0-only
source "drivers/platform/mips/Kconfig"

source "drivers/platform/loongarch/Kconfig"

source "drivers/platform/goldfish/Kconfig"

source "drivers/platform/chrome/Kconfig"

source "drivers/platform/mellanox/Kconfig"

source "drivers/platform/olpc/Kconfig"

source "drivers/platform/surface/Kconfig"

source "drivers/platform/x86/Kconfig"

source "drivers/platform/arm64/Kconfig"
```
