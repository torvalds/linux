## drivers/platform/goldfish/Kconfig
```kconfig
menuconfig GOLDFISH
	bool "Platform support for Goldfish virtual devices"
	depends on X86_32 || X86_64 || ARM || ARM64
	---help---
	  Say Y here to get to see options for the Goldfish virtual platform.
	  This option alone does not add any kernel code.

	  Unless you are building for the Android Goldfish emulator say N here.

if GOLDFISH

config GOLDFISH_BUS
	bool "Goldfish platform bus"
	---help---
	  This is a virtual bus to host Goldfish Android Virtual Devices.

config GOLDFISH_PIPE
	tristate "Goldfish virtual device for QEMU pipes"
	---help---
	  This is a virtual device to drive the QEMU pipe interface used by
	  the Goldfish Android Virtual Device.

endif # GOLDFISH
```

## drivers/platform/hisi/Kconfig
```kconfig
config HISI_FIQ_DEBUGGER
	bool "Enable the FIQ serial debugger on Hisi"
	default n
	select FIQ_DEBUGGER
	help
	  Enables the FIQ serial debugger on Hisi
```

## drivers/platform/loongarch/Kconfig
```kconfig
#
# LoongArch Platform Specific Drivers
#

menuconfig LOONGARCH_PLATFORM_DEVICES
	bool "LoongArch Platform Specific Device Drivers"
	default y
	depends on LOONGARCH
	help
	  Say Y here to get to see options for device drivers of various
	  LoongArch platforms, including vendor-specific laptop/desktop
	  extension and hardware monitor drivers. This option itself does
	  not add any kernel code.

	  If you say N, all options in this submenu will be skipped and disabled.

if LOONGARCH_PLATFORM_DEVICES

config LOONGSON_LAPTOP
	tristate "Generic Loongson-3 Laptop Driver"
	depends on ACPI_EC
	depends on BACKLIGHT_CLASS_DEVICE
	depends on INPUT
	depends on MACH_LOONGSON64
	select ACPI_VIDEO
	select INPUT_SPARSEKMAP
	default y
	help
	  ACPI-based Loongson-3 family laptops generic driver.

endif # LOONGARCH_PLATFORM_DEVICES
```

## drivers/platform/mellanox/Kconfig
```kconfig
# SPDX-License-Identifier: GPL-2.0
#
# Platform support for Mellanox hardware
#

menuconfig MELLANOX_PLATFORM
	bool "Platform support for Mellanox hardware"
	depends on X86 || ARM || ARM64 || COMPILE_TEST
	help
	  Say Y here to get to see options for platform support for
	  Mellanox systems. This option alone does not add any kernel code.

	  If you say N, all options in this submenu will be skipped and disabled.

if MELLANOX_PLATFORM

config MLXREG_HOTPLUG
	tristate "Mellanox platform hotplug driver support"
	depends on HWMON
	depends on I2C
	select REGMAP
	help
	  This driver handles hot-plug events for the power suppliers, power
	  cables and fans on the wide range Mellanox IB and Ethernet systems.

config MLXREG_IO
	tristate "Mellanox platform register access driver support"
	depends on HWMON
	select REGMAP
	help
	  This driver allows access to Mellanox programmable device register
	  space through sysfs interface. The sets of registers for sysfs access
	  are defined per system type bases and include the registers related
	  to system resets operation, system reset causes monitoring and some
	  kinds of mux selection.

config MLXREG_LC
	tristate "Mellanox line card platform driver support"
	depends on HWMON
	depends on I2C
	select REGMAP
	help
	  This driver provides support for the Mellanox MSN4800-XX line cards,
	  which are the part of MSN4800 Ethernet modular switch systems
	  providing a high performance switching solution for Enterprise Data
	  Centers (EDC) for building Ethernet based clusters, High-Performance
	  Computing (HPC) and embedded environments.

config MLXBF_TMFIFO
	tristate "Mellanox BlueField SoC TmFifo platform driver"
	depends on ARM64
	depends on ACPI
	depends on VIRTIO_CONSOLE && VIRTIO_NET
	help
	  Say y here to enable TmFifo support. The TmFifo driver provides
	  platform driver support for the TmFifo which supports console
	  and networking based on the virtio framework.

config MLXBF_BOOTCTL
	tristate "Mellanox BlueField Firmware Boot Control driver"
	depends on ARM64
	depends on ACPI
	help
	  The Mellanox BlueField firmware implements functionality to
	  request swapping the primary and alternate eMMC boot partition,
	  and to set up a watchdog that can undo that swap if the system
	  does not boot up correctly. This driver provides sysfs access
	  to the userspace tools, to be used in conjunction with the eMMC
	  device driver to do necessary initial swap of the boot partition.

config MLXBF_PMC
	tristate "Mellanox BlueField Performance Monitoring Counters driver"
	depends on ARM64
	depends on HWMON
	depends on ACPI
	help
	  Say y here to enable PMC support. The PMC driver provides access
	  to performance monitoring counters within various blocks in the
	  Mellanox BlueField SoC via a sysfs interface.

config NVSW_SN2201
	tristate "Nvidia SN2201 platform driver support"
	depends on HWMON && I2C
	depends on ACPI || COMPILE_TEST
	select REGMAP_I2C
	help
	  This driver provides support for the Nvidia SN2201 platform.
	  The SN2201 is a highly integrated for one rack unit system with
	  L3 management switches. It has 48 x 1Gbps RJ45 + 4 x 100G QSFP28
	  ports in a compact 1RU form factor. The system also including a
	  serial port (RS-232 interface), an OOB port (1G/100M MDI interface)
	  and USB ports for management functions.
	  The processor used on SN2201 is Intel Atom®Processor C Series,
	  C3338R which is one of the Denverton product families.
	  System equipped with Nvidia®Spectrum-1 32x100GbE Ethernet switch.

endif # MELLANOX_PLATFORM
```

## drivers/platform/mips/Kconfig
```kconfig
# SPDX-License-Identifier: GPL-2.0-only
#
# MIPS Platform Specific Drivers
#

menuconfig MIPS_PLATFORM_DEVICES
	bool "MIPS Platform Specific Device Drivers"
	default y
	help
	  Say Y here to get to see options for device drivers of various
	  MIPS platforms, including vendor-specific netbook/laptop/desktop
	  extension and hardware monitor drivers. This option itself does
	  not add any kernel code.

	  If you say N, all options in this submenu will be skipped and disabled.

if MIPS_PLATFORM_DEVICES

config CPU_HWMON
	bool "Loongson-3 CPU HWMon Driver"
	depends on MACH_LOONGSON64
	select HWMON
	default y
	help
	  Loongson-3A/3B CPU Hwmon (temperature sensor) driver.

config RS780E_ACPI
	bool "Loongson RS780E ACPI Controller"
	depends on MACH_LOONGSON64 || COMPILE_TEST
	help
	  Loongson RS780E PCH ACPI Controller driver.

config LS2K_RESET
	bool "Loongson-2K1000 Reset Controller"
	depends on MACH_LOONGSON64 || COMPILE_TEST
	help
	  Loongson-2K1000 Reset Controller driver.

endif # MIPS_PLATFORM_DEVICES
```

## drivers/platform/msm/Kconfig
```kconfig
# SPDX-License-Identifier: GPL-2.0-only

menu "Qualcomm technologies inc. MSM specific device drivers"
	depends on ARCH_QCOM

config EP_PCIE
	tristate "PCIe Endpoint mode support"
	select GENERIC_ALLOCATOR
	help
	  PCIe controller is in endpoint mode.
	  It supports the APIs to clients as a service layer, and allows
	  clients to enable/disable PCIe link, configure the address
	  mapping for the access to host memory, trigger wake interrupt
	  on host side to wake up host, and trigger MSI to host side.

config MSM_MHI_DEV
	tristate "Modem Device Interface Driver"
	depends on EP_PCIE
	help
	  This kernel module is used to interact with PCIe Root complex
	  supporting MHI protocol. MHI is a data transmission protocol
	  involving communication between a host and a device over shared
	  memory. MHI interacts with the IPA for supporting transfers
	  on the HW accelerated channels between Host and device.

config MSM_MHI_NET_DEV
	tristate "Modem Device Interface Net Driver"
	depends on MSM_MHI_DEV
	help
	  This kernel module enables communication over a MHI channel for
	  clients by creating a network device. This module interacts
	  with the MHI device driver to send and receive data to/from a
	  host.

endmenu
```

## drivers/platform/msm/ep_pcie/Kconfig
```kconfig
# SPDX-License-Identifier: GPL-2.0-only

config CONFIG_L1SS_RESOURCES_HANDLING
	bool "L1SS sleep resource handling"
	help
		Enables set of APIs which updates system resource
		voting and unvoting while exiting and entering into
		L1SS sleep after MHI state machine moved to
		M2 autonomous.
```

## drivers/platform/olpc/Kconfig
```kconfig
config OLPC_EC
	select REGULATOR
	bool

menuconfig OLPC_XO175
	bool "Platform support for OLPC XO 1.75 hardware"
	depends on ARCH_MMP || COMPILE_TEST
	help
	  Say Y here to get to see options for the ARM-based OLPC platform.
	  This option alone does not add any kernel code.

	  Unless you have an OLPC XO laptop, you will want to say N.

if OLPC_XO175

config OLPC_XO175_EC
	tristate "OLPC XO 1.75 Embedded Controller"
	depends on SPI_SLAVE
	depends on INPUT
	depends on POWER_SUPPLY
	select OLPC_EC
	help
	  Include support for the OLPC XO Embedded Controller (EC). The EC
	  provides various platform services, including support for the power,
	  button, restart, shutdown and battery charging status.

	  Unless you have an OLPC XO laptop, you will want to say N.

endif # OLPC_XO175
```
