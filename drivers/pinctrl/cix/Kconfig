## drivers/pinctrl/sh-pfc/Kconfig
```kconfig
# SPDX-License-Identifier: GPL-2.0
#
# Renesas SH and SH Mobile PINCTRL drivers
#

config PINCTRL_SH_PFC
	bool "Renesas SoC pin control support" if COMPILE_TEST && !(ARCH_RENESAS || SUPERH)
	default y if ARCH_RENESAS || SUPERH
	select PINMUX
	select PINCONF
	select GENERIC_PINCONF
	select PINCTRL_PFC_EMEV2 if ARCH_EMEV2
	select PINCTRL_PFC_R8A73A4 if ARCH_R8A73A4
	select PINCTRL_PFC_R8A7740 if ARCH_R8A7740
	select PINCTRL_PFC_R8A7743 if ARCH_R8A7743
	select PINCTRL_PFC_R8A7744 if ARCH_R8A7744
	select PINCTRL_PFC_R8A7745 if ARCH_R8A7745
	select PINCTRL_PFC_R8A77470 if ARCH_R8A77470
	select PINCTRL_PFC_R8A774A1 if ARCH_R8A774A1
	select PINCTRL_PFC_R8A774C0 if ARCH_R8A774C0
	select PINCTRL_PFC_R8A7778 if ARCH_R8A7778
	select PINCTRL_PFC_R8A7779 if ARCH_R8A7779
	select PINCTRL_PFC_R8A7790 if ARCH_R8A7790
	select PINCTRL_PFC_R8A7791 if ARCH_R8A7791
	select PINCTRL_PFC_R8A7792 if ARCH_R8A7792
	select PINCTRL_PFC_R8A7793 if ARCH_R8A7793
	select PINCTRL_PFC_R8A7794 if ARCH_R8A7794
	select PINCTRL_PFC_R8A7795 if ARCH_R8A7795
	select PINCTRL_PFC_R8A7796 if ARCH_R8A7796
	select PINCTRL_PFC_R8A77965 if ARCH_R8A77965
	select PINCTRL_PFC_R8A77970 if ARCH_R8A77970
	select PINCTRL_PFC_R8A77980 if ARCH_R8A77980
	select PINCTRL_PFC_R8A77990 if ARCH_R8A77990
	select PINCTRL_PFC_R8A77995 if ARCH_R8A77995
	select PINCTRL_PFC_SH7203 if CPU_SUBTYPE_SH7203
	select PINCTRL_PFC_SH7264 if CPU_SUBTYPE_SH7264
	select PINCTRL_PFC_SH7269 if CPU_SUBTYPE_SH7269
	select PINCTRL_PFC_SH73A0 if ARCH_SH73A0
	select PINCTRL_PFC_SH7720 if CPU_SUBTYPE_SH7720
	select PINCTRL_PFC_SH7722 if CPU_SUBTYPE_SH7722
	select PINCTRL_PFC_SH7723 if CPU_SUBTYPE_SH7723
	select PINCTRL_PFC_SH7724 if CPU_SUBTYPE_SH7724
	select PINCTRL_PFC_SH7734 if CPU_SUBTYPE_SH7734
	select PINCTRL_PFC_SH7757 if CPU_SUBTYPE_SH7757
	select PINCTRL_PFC_SH7785 if CPU_SUBTYPE_SH7785
	select PINCTRL_PFC_SH7786 if CPU_SUBTYPE_SH7786
	select PINCTRL_PFC_SHX3 if CPU_SUBTYPE_SHX3
	help
	  This enables pin control drivers for Renesas SuperH and ARM platforms

config PINCTRL_SH_PFC_GPIO
	select GPIOLIB
	bool
	help
	  This enables pin control and GPIO drivers for SH/SH Mobile platforms

config PINCTRL_SH_FUNC_GPIO
	select PINCTRL_SH_PFC_GPIO
	bool
	help
	  This enables legacy function GPIOs for SH platforms

config PINCTRL_PFC_EMEV2
	bool "Emma Mobile AV2 pin control support" if COMPILE_TEST

config PINCTRL_PFC_R8A73A4
	bool "R-Mobile APE6 pin control support" if COMPILE_TEST
	select PINCTRL_SH_PFC_GPIO

config PINCTRL_PFC_R8A7740
	bool "R-Mobile A1 pin control support" if COMPILE_TEST
	select PINCTRL_SH_PFC_GPIO

config PINCTRL_PFC_R8A7743
	bool "RZ/G1M pin control support" if COMPILE_TEST

config PINCTRL_PFC_R8A7744
	bool "RZ/G1N pin control support" if COMPILE_TEST

config PINCTRL_PFC_R8A7745
	bool "RZ/G1E pin control support" if COMPILE_TEST

config PINCTRL_PFC_R8A77470
	bool "RZ/G1C pin control support" if COMPILE_TEST

config PINCTRL_PFC_R8A774A1
	bool "RZ/G2M pin control support" if COMPILE_TEST

config PINCTRL_PFC_R8A774C0
	bool "RZ/G2E pin control support" if COMPILE_TEST

config PINCTRL_PFC_R8A7778
	bool "R-Car M1A pin control support" if COMPILE_TEST

config PINCTRL_PFC_R8A7779
	bool "R-Car H1 pin control support" if COMPILE_TEST

config PINCTRL_PFC_R8A7790
	bool "R-Car H2 pin control support" if COMPILE_TEST

config PINCTRL_PFC_R8A7791
	bool "R-Car M2-W pin control support" if COMPILE_TEST

config PINCTRL_PFC_R8A7792
	bool "R-Car V2H pin control support" if COMPILE_TEST

config PINCTRL_PFC_R8A7793
	bool "R-Car M2-N pin control support" if COMPILE_TEST

config PINCTRL_PFC_R8A7794
	bool "R-Car E2 pin control support" if COMPILE_TEST

config PINCTRL_PFC_R8A7795
	bool "R-Car H3 pin control support" if COMPILE_TEST

config PINCTRL_PFC_R8A7796
	bool "R-Car M3-W pin control support" if COMPILE_TEST

config PINCTRL_PFC_R8A77965
	bool "R-Car M3-N pin control support" if COMPILE_TEST

config PINCTRL_PFC_R8A77970
	bool "R-Car V3M pin control support" if COMPILE_TEST

config PINCTRL_PFC_R8A77980
	bool "R-Car V3H pin control support" if COMPILE_TEST

config PINCTRL_PFC_R8A77990
	bool "R-Car E3 pin control support" if COMPILE_TEST

config PINCTRL_PFC_R8A77995
	bool "R-Car D3 pin control support" if COMPILE_TEST

config PINCTRL_PFC_SH7203
	bool "SH7203 pin control support" if COMPILE_TEST
	select PINCTRL_SH_FUNC_GPIO

config PINCTRL_PFC_SH7264
	bool "SH7264 pin control support" if COMPILE_TEST
	select PINCTRL_SH_FUNC_GPIO

config PINCTRL_PFC_SH7269
	bool "SH7269 pin control support" if COMPILE_TEST
	select PINCTRL_SH_FUNC_GPIO

config PINCTRL_PFC_SH73A0
	bool "SH-Mobile AG5 pin control support" if COMPILE_TEST
	select PINCTRL_SH_PFC_GPIO
	select REGULATOR

config PINCTRL_PFC_SH7720
	bool "SH7720 pin control support" if COMPILE_TEST
	select PINCTRL_SH_FUNC_GPIO

config PINCTRL_PFC_SH7722
	bool "SH7722 pin control support" if COMPILE_TEST
	select PINCTRL_SH_FUNC_GPIO

config PINCTRL_PFC_SH7723
	bool "SH-Mobile R2 pin control support" if COMPILE_TEST
	select PINCTRL_SH_FUNC_GPIO

config PINCTRL_PFC_SH7724
	bool "SH-Mobile R2R pin control support" if COMPILE_TEST
	select PINCTRL_SH_FUNC_GPIO

config PINCTRL_PFC_SH7734
	bool "SH7734 pin control support" if COMPILE_TEST
	select PINCTRL_SH_FUNC_GPIO

config PINCTRL_PFC_SH7757
	bool "SH7757 pin control support" if COMPILE_TEST
	select PINCTRL_SH_FUNC_GPIO

config PINCTRL_PFC_SH7785
	bool "SH7785 pin control support" if COMPILE_TEST
	select PINCTRL_SH_FUNC_GPIO

config PINCTRL_PFC_SH7786
	bool "SH7786 pin control support" if COMPILE_TEST
	select PINCTRL_SH_FUNC_GPIO

config PINCTRL_PFC_SHX3
	bool "SH-X3 pin control support" if COMPILE_TEST
	select PINCTRL_SH_FUNC_GPIO
```

## drivers/pinctrl/sophgo/Kconfig
```kconfig
# SPDX-License-Identifier: GPL-2.0-only
#
# Sophgo SoC PINCTRL drivers
#

config PINCTRL_SOPHGO_COMMON
	tristate
	select GENERIC_PINCTRL_GROUPS
	select GENERIC_PINMUX_FUNCTIONS
	select GENERIC_PINCONF

config PINCTRL_SOPHGO_CV18XX_OPS
	bool

config PINCTRL_SOPHGO_CV1800B
	tristate "Sophgo CV1800B SoC Pinctrl driver"
	depends on ARCH_SOPHGO || COMPILE_TEST
	depends on OF
	select PINCTRL_SOPHGO_COMMON
	select PINCTRL_SOPHGO_CV18XX_OPS
	help
	  Say Y to select the pinctrl driver for CV1800B SoC.
	  This pin controller allows selecting the mux function for
	  each pin. This driver can also be built as a module called
	  pinctrl-cv1800b.

config PINCTRL_SOPHGO_CV1812H
	tristate "Sophgo CV1812H SoC Pinctrl driver"
	depends on ARCH_SOPHGO || COMPILE_TEST
	depends on OF
	select PINCTRL_SOPHGO_COMMON
	select PINCTRL_SOPHGO_CV18XX_OPS
	help
	  Say Y to select the pinctrl driver for CV1812H SoC.
	  This pin controller allows selecting the mux function for
	  each pin. This driver can also be built as a module called
	  pinctrl-cv1812h.

config PINCTRL_SOPHGO_SG2000
	tristate "Sophgo SG2000 SoC Pinctrl driver"
	depends on ARCH_SOPHGO || COMPILE_TEST
	depends on OF
	select PINCTRL_SOPHGO_COMMON
	select PINCTRL_SOPHGO_CV18XX_OPS
	help
	  Say Y to select the pinctrl driver for SG2000 SoC.
	  This pin controller allows selecting the mux function for
	  each pin. This driver can also be built as a module called
	  pinctrl-sg2000.

config PINCTRL_SOPHGO_SG2002
	tristate "Sophgo SG2002 SoC Pinctrl driver"
	depends on ARCH_SOPHGO || COMPILE_TEST
	depends on OF
	select PINCTRL_SOPHGO_COMMON
	select PINCTRL_SOPHGO_CV18XX_OPS
	help
	  Say Y to select the pinctrl driver for SG2002 SoC.
	  This pin controller allows selecting the mux function for
	  each pin. This driver can also be built as a module called
	  pinctrl-sg2002.

config PINCTRL_SOPHGO_SG2042_OPS
	bool

config PINCTRL_SOPHGO_SG2042
	tristate "Sophgo SG2042 SoC Pinctrl driver"
	depends on ARCH_SOPHGO || COMPILE_TEST
	depends on OF
	select PINCTRL_SOPHGO_COMMON
	select PINCTRL_SOPHGO_SG2042_OPS
	help
	  Say Y to select the pinctrl driver for SG2042 SoC.
	  This pin controller allows selecting the mux function for
	  each pin. This driver can also be built as a module called
	  pinctrl-sg2042.

config PINCTRL_SOPHGO_SG2044
	tristate "Sophgo SG2044 SoC Pinctrl driver"
	depends on ARCH_SOPHGO || COMPILE_TEST
	depends on OF
	select PINCTRL_SOPHGO_COMMON
	select PINCTRL_SOPHGO_SG2042_OPS
	help
	  Say Y to select the pinctrl driver for SG2044 SoC.
	  This pin controller allows selecting the mux function for
	  each pin. This driver can also be built as a module called
	  pinctrl-sg2044.
```

## drivers/pinctrl/spacemit/Kconfig
```kconfig
# SPDX-License-Identifier: GPL-2.0-only
#
# Sophgo SoC PINCTRL drivers
#

config PINCTRL_SPACEMIT_K1
	bool "SpacemiT K1 SoC Pinctrl driver"
	depends on ARCH_SPACEMIT || COMPILE_TEST
	depends on OF
	default ARCH_SPACEMIT
	select GENERIC_PINCTRL_GROUPS
	select GENERIC_PINMUX_FUNCTIONS
	select GENERIC_PINCONF
	help
	  Say Y to select the pinctrl driver for K1 SoC.
	  This pin controller allows selecting the mux function for
	  each pin. This driver can also be built as a module called
	  pinctrl-k1.
```

## drivers/pinctrl/spear/Kconfig
```kconfig
# SPDX-License-Identifier: GPL-2.0-only
#
# ST Microelectronics SPEAr PINCTRL drivers
#

if PLAT_SPEAR

config PINCTRL_SPEAR
	bool
	depends on OF
	select PINMUX
	help
	  This enables pin control drivers for SPEAr Platform

config PINCTRL_SPEAR3XX
	bool
	depends on ARCH_SPEAR3XX
	select PINCTRL_SPEAR

config PINCTRL_SPEAR300
	bool "ST Microelectronics SPEAr300 SoC pin controller driver"
	depends on MACH_SPEAR300
	select PINCTRL_SPEAR3XX

config PINCTRL_SPEAR310
	bool "ST Microelectronics SPEAr310 SoC pin controller driver"
	depends on MACH_SPEAR310
	select PINCTRL_SPEAR3XX
	select PINCTRL_SPEAR_PLGPIO

config PINCTRL_SPEAR320
	bool "ST Microelectronics SPEAr320 SoC pin controller driver"
	depends on MACH_SPEAR320
	select PINCTRL_SPEAR3XX
	select PINCTRL_SPEAR_PLGPIO

config PINCTRL_SPEAR1310
	bool "ST Microelectronics SPEAr1310 SoC pin controller driver"
	depends on MACH_SPEAR1310
	select PINCTRL_SPEAR
	select PINCTRL_SPEAR_PLGPIO

config PINCTRL_SPEAR1340
	bool "ST Microelectronics SPEAr1340 SoC pin controller driver"
	depends on MACH_SPEAR1340
	select PINCTRL_SPEAR
	select PINCTRL_SPEAR_PLGPIO

config PINCTRL_SPEAR_PLGPIO
	bool "SPEAr SoC PLGPIO Controller"
	depends on GPIOLIB && PINCTRL_SPEAR
	select GPIOLIB_IRQCHIP
	help
	  Say yes here to support PLGPIO controller on ST Microelectronics SPEAr
	  SoCs.

endif
```

## drivers/pinctrl/sprd/Kconfig
```kconfig
# SPDX-License-Identifier: GPL-2.0-only
#
# Spreadtrum pin control drivers
#

config PINCTRL_SPRD
	tristate
	select PINMUX
	select PINCONF
	select GENERIC_PINCONF
	select GENERIC_PINMUX_FUNCTIONS
	help
	  Say Y here to enable Spreadtrum pinctrl driver

config PINCTRL_SPRD_SC9860
	tristate "Spreadtrum SC9860 pinctrl driver"
	depends on OF
	depends on ARCH_SPRD || COMPILE_TEST
	select PINCTRL_SPRD
	help
	  Say Y here to enable Spreadtrum SC9860 pinctrl driver
```

## drivers/pinctrl/stm32/Kconfig
```kconfig
# SPDX-License-Identifier: GPL-2.0-only
if ARCH_STM32 || COMPILE_TEST

config PINCTRL_STM32
	tristate
	depends on OF
	select PINMUX
	select GENERIC_PINCONF
	select GPIOLIB
	select IRQ_DOMAIN_HIERARCHY
	select MFD_SYSCON

config PINCTRL_STM32F429
	bool "STMicroelectronics STM32F429 pin control" if COMPILE_TEST && !MACH_STM32F429
	depends on OF && HAS_IOMEM
	default MACH_STM32F429
	select PINCTRL_STM32

config PINCTRL_STM32F469
	bool "STMicroelectronics STM32F469 pin control" if COMPILE_TEST && !MACH_STM32F469
	depends on OF && HAS_IOMEM
	default MACH_STM32F469
	select PINCTRL_STM32

config PINCTRL_STM32F746
	bool "STMicroelectronics STM32F746 pin control" if COMPILE_TEST && !MACH_STM32F746
	depends on OF && HAS_IOMEM
	default MACH_STM32F746
	select PINCTRL_STM32

config PINCTRL_STM32F769
	bool "STMicroelectronics STM32F769 pin control" if COMPILE_TEST && !MACH_STM32F769
	depends on OF && HAS_IOMEM
	default MACH_STM32F769
	select PINCTRL_STM32

config PINCTRL_STM32H743
	bool "STMicroelectronics STM32H743 pin control" if COMPILE_TEST && !MACH_STM32H743
	depends on OF && HAS_IOMEM
	default MACH_STM32H743
	select PINCTRL_STM32

config PINCTRL_STM32MP135
	bool "STMicroelectronics STM32MP135 pin control" if COMPILE_TEST && !MACH_STM32MP13
	depends on OF && HAS_IOMEM
	default MACH_STM32MP13
	select PINCTRL_STM32

config PINCTRL_STM32MP157
	bool "STMicroelectronics STM32MP157 pin control" if COMPILE_TEST && !MACH_STM32MP157
	depends on OF && HAS_IOMEM
	default MACH_STM32MP157
	select PINCTRL_STM32

config PINCTRL_STM32MP257
	tristate "STMicroelectronics STM32MP257 pin control"
	depends on OF && HAS_IOMEM
	default MACH_STM32MP25 || (ARCH_STM32 && ARM64)
	select PINCTRL_STM32

config PINCTRL_STM32_HDP
	tristate "STMicroelectronics STM32 Hardware Debug Port (HDP) pin control"
	depends on OF && HAS_IOMEM
	default ARCH_STM32 && !ARM_SINGLE_ARMV7M
	select PINMUX
	select GENERIC_PINCONF
	select GPIOLIB
	help
	  The Hardware Debug Port allows the observation of internal signals.
	  It uses configurable multiplexer to route signals in a dedicated observation register.
	  This driver also permits the observation of signals on external SoC pins.
	  It permits the observation of up to 16 signals per HDP line.

endif
```

## drivers/pinctrl/sunxi/Kconfig
```kconfig
if ARCH_SUNXI

config PINCTRL_SUNXI
	bool
	select PINMUX
	select GENERIC_PINCONF
	select GPIOLIB

config PINCTRL_SUNIV_F1C100S
	def_bool MACH_SUNIV
	select PINCTRL_SUNXI

config PINCTRL_SUN4I_A10
	bool "Support for the Allwinner A10, A20 and R40 PIO"
	default MACH_SUN4I || MACH_SUN7I || MACH_SUN8I
	select PINCTRL_SUNXI

config PINCTRL_SUN5I
	bool "Support for the Allwinner A10s, A13, R8 and NextThing GR8 PIO"
	default MACH_SUN5I
	select PINCTRL_SUNXI

config PINCTRL_SUN6I_A31
	bool "Support for the Allwinner A31 PIO"
	default MACH_SUN6I
	select PINCTRL_SUNXI

config PINCTRL_SUN6I_A31_R
	bool "Support for the Allwinner A31 R-PIO"
	default MACH_SUN6I
	depends on RESET_CONTROLLER
	select PINCTRL_SUNXI

config PINCTRL_SUN8I_A23
	bool "Support for the Allwinner A23 PIO"
	default MACH_SUN8I
	select PINCTRL_SUNXI

config PINCTRL_SUN8I_A33
	bool "Support for the Allwinner A33 PIO"
	default MACH_SUN8I
	select PINCTRL_SUNXI

config PINCTRL_SUN8I_A83T
	bool "Support for the Allwinner A83T PIO"
	default MACH_SUN8I
	select PINCTRL_SUNXI

config PINCTRL_SUN8I_A83T_R
	bool "Support for the Allwinner A83T R-PIO"
	default MACH_SUN8I
	select PINCTRL_SUNXI

config PINCTRL_SUN8I_A23_R
	bool "Support for the Allwinner A23 and A33 R-PIO"
	default MACH_SUN8I
	depends on RESET_CONTROLLER
	select PINCTRL_SUNXI

config PINCTRL_SUN8I_H3
	bool "Support for the Allwinner H3 PIO"
	default MACH_SUN8I
	select PINCTRL_SUNXI

config PINCTRL_SUN8I_H3_R
	bool "Support for the Allwinner H3 and H5 R-PIO"
	default MACH_SUN8I || (ARM64 && ARCH_SUNXI)
	select PINCTRL_SUNXI

config PINCTRL_SUN8I_V3S
	bool "Support for the Allwinner V3s PIO"
	default MACH_SUN8I
	select PINCTRL_SUNXI

config PINCTRL_SUN9I_A80
	bool "Support for the Allwinner A80 PIO"
	default MACH_SUN9I
	select PINCTRL_SUNXI

config PINCTRL_SUN9I_A80_R
	bool "Support for the Allwinner A80 R-PIO"
	default MACH_SUN9I
	depends on RESET_CONTROLLER
	select PINCTRL_SUNXI

config PINCTRL_SUN50I_A64
	bool "Support for the Allwinner A64 PIO"
	default ARM64 && ARCH_SUNXI
	select PINCTRL_SUNXI

config PINCTRL_SUN50I_A64_R
	bool "Support for the Allwinner A64 R-PIO"
	default ARM64 && ARCH_SUNXI
	select PINCTRL_SUNXI

config PINCTRL_SUN50I_H5
	bool "Support for the Allwinner H5 PIO"
	default ARM64 && ARCH_SUNXI
	select PINCTRL_SUNXI

config PINCTRL_SUN50I_H6
	bool "Support for the Allwinner H6 PIO"
	default ARM64 && ARCH_SUNXI
	select PINCTRL_SUNXI

config PINCTRL_SUN50I_H6_R
	bool "Support for the Allwinner H6 R-PIO"
	default ARM64 && ARCH_SUNXI
	select PINCTRL_SUNXI

endif
```
