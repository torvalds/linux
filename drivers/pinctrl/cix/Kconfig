## drivers/pinctrl/mediatek/Kconfig
```kconfig
# SPDX-License-Identifier: GPL-2.0-only
menu "MediaTek pinctrl drivers"
	depends on ARCH_MEDIATEK || ARCH_AIROHA || RALINK || COMPILE_TEST

config EINT_MTK
	tristate "MediaTek External Interrupt Support"
	depends on PINCTRL_MTK || PINCTRL_MTK_MOORE || PINCTRL_MTK_PARIS || COMPILE_TEST
	select GPIOLIB
	select IRQ_DOMAIN
	default y if PINCTRL_MTK || PINCTRL_MTK_MOORE
	default PINCTRL_MTK_PARIS

config PINCTRL_MTK
	bool
	depends on OF
	select PINMUX
	select GENERIC_PINCONF
	select GPIOLIB
	select EINT_MTK

config PINCTRL_MTK_V2
	tristate

config PINCTRL_MTK_MTMIPS
	bool
	depends on RALINK
	select PINMUX
	select GENERIC_PINCONF

config PINCTRL_MTK_MOORE
	bool
	depends on OF
	select GENERIC_PINCONF
	select GENERIC_PINCTRL_GROUPS
	select GENERIC_PINMUX_FUNCTIONS
	select GPIOLIB
	select EINT_MTK
	select PINCTRL_MTK_V2

config PINCTRL_MTK_PARIS
	tristate
	depends on OF
	select PINMUX
	select GENERIC_PINCONF
	select GPIOLIB
	select EINT_MTK
	select PINCTRL_MTK_V2

# For MIPS SoCs
config PINCTRL_MT7620
	bool "MediaTek MT7620 pin control"
	depends on SOC_MT7620 || COMPILE_TEST
	depends on RALINK
	default SOC_MT7620
	select PINCTRL_MTK_MTMIPS

config PINCTRL_MT7621
	bool "MediaTek MT7621 pin control"
	depends on SOC_MT7621 || COMPILE_TEST
	depends on RALINK
	default SOC_MT7621
	select PINCTRL_MTK_MTMIPS

config PINCTRL_MT76X8
	bool "MediaTek MT76X8 pin control"
	depends on SOC_MT7620 || COMPILE_TEST
	depends on RALINK
	default SOC_MT7620
	select PINCTRL_MTK_MTMIPS

config PINCTRL_RT2880
	bool "Ralink RT2880 pin control"
	depends on SOC_RT288X || COMPILE_TEST
	depends on RALINK
	default SOC_RT288X
	select PINCTRL_MTK_MTMIPS

config PINCTRL_RT305X
	bool "Ralink RT305X pin control"
	depends on SOC_RT305X || COMPILE_TEST
	depends on RALINK
	default SOC_RT305X
	select PINCTRL_MTK_MTMIPS

config PINCTRL_RT3883
	bool "Ralink RT3883 pin control"
	depends on SOC_RT3883 || COMPILE_TEST
	depends on RALINK
	default SOC_RT3883
	select PINCTRL_MTK_MTMIPS

# For ARMv7 SoCs
config PINCTRL_MT2701
	bool "MediaTek MT2701 pin control"
	depends on MACH_MT7623 || MACH_MT2701 || COMPILE_TEST
	depends on OF
	default MACH_MT2701
	select PINCTRL_MTK

config PINCTRL_MT7623
	bool "MediaTek MT7623 pin control with generic binding"
	depends on MACH_MT7623 || COMPILE_TEST
	depends on OF
	default MACH_MT7623
	select PINCTRL_MTK_MOORE

config PINCTRL_MT7629
	bool "MediaTek MT7629 pin control"
	depends on MACH_MT7629 || COMPILE_TEST
	depends on OF
	default MACH_MT7629
	select PINCTRL_MTK_MOORE

config PINCTRL_MT8135
	bool "MediaTek MT8135 pin control"
	depends on MACH_MT8135 || COMPILE_TEST
	depends on OF
	default MACH_MT8135
	select PINCTRL_MTK

config PINCTRL_MT8127
	bool "MediaTek MT8127 pin control"
	depends on MACH_MT8127 || COMPILE_TEST
	depends on OF
	default MACH_MT8127
	select PINCTRL_MTK

# For ARMv8 SoCs
config PINCTRL_AIROHA
	tristate "Airoha EN7581 pin control"
	depends on OF
	depends on ARM64 || COMPILE_TEST
	select PINMUX
	select GENERIC_PINCONF
	select GENERIC_PINCTRL_GROUPS
	select GENERIC_PINMUX_FUNCTIONS
	select GPIOLIB
	select GPIOLIB_IRQCHIP
	select REGMAP_MMIO
	help
	  Say yes here to support pin controller and gpio driver
	  on Airoha EN7581 SoC.

config PINCTRL_MT2712
	bool "MediaTek MT2712 pin control"
	depends on OF
	depends on ARM64 || COMPILE_TEST
	default ARM64 && ARCH_MEDIATEK
	select PINCTRL_MTK

config PINCTRL_MT6765
	tristate "MediaTek MT6765 pin control"
	depends on OF
	depends on ARM64 || COMPILE_TEST
	default ARM64 && ARCH_MEDIATEK
	select PINCTRL_MTK_PARIS

config PINCTRL_MT6779
	tristate "MediaTek MT6779 pin control"
	depends on OF
	depends on ARM64 || COMPILE_TEST
	default ARM64 && ARCH_MEDIATEK
	select PINCTRL_MTK_PARIS
	help
	  Say yes here to support pin controller and gpio driver
	  on MediaTek MT6779 SoC.
	  In MTK platform, we support virtual gpio and use it to
	  map specific eint which doesn't have real gpio pin.

config PINCTRL_MT6795
	bool "MediaTek MT6795 pin control"
	depends on OF
	depends on ARM64 || COMPILE_TEST
	default ARM64 && ARCH_MEDIATEK
	select PINCTRL_MTK_PARIS

config PINCTRL_MT6797
	bool "MediaTek MT6797 pin control"
	depends on OF
	depends on ARM64 || COMPILE_TEST
	default ARM64 && ARCH_MEDIATEK
	select PINCTRL_MTK_PARIS

config PINCTRL_MT6893
	bool "MediaTek Dimensity MT6893 pin control"
	depends on OF
	depends on ARM64 || COMPILE_TEST
	default ARM64 && ARCH_MEDIATEK
	select PINCTRL_MTK_PARIS
	help
	  Say yes here to support pin controller and gpio driver
	  on the MediaTek Dimensity 1200 MT6893 Smartphone SoC.

config PINCTRL_MT7622
	bool "MediaTek MT7622 pin control"
	depends on OF
	depends on ARM64 || COMPILE_TEST
	default ARM64 && ARCH_MEDIATEK
	select PINCTRL_MTK_MOORE

config PINCTRL_MT7981
	bool "MediaTek MT7981 pin control"
	depends on OF
	depends on ARM64 || COMPILE_TEST
	default ARM64 && ARCH_MEDIATEK
	select PINCTRL_MTK_MOORE

config PINCTRL_MT7986
	bool "MediaTek MT7986 pin control"
	depends on OF
	depends on ARM64 || COMPILE_TEST
	default ARM64 && ARCH_MEDIATEK
	select PINCTRL_MTK_MOORE

config PINCTRL_MT7988
	bool "Mediatek MT7988 pin control"
	depends on OF
	depends on ARM64 || COMPILE_TEST
	default ARM64 && ARCH_MEDIATEK
	select PINCTRL_MTK_MOORE

config PINCTRL_MT8167
	bool "MediaTek MT8167 pin control"
	depends on OF
	depends on ARM64 || COMPILE_TEST
	default ARM64 && ARCH_MEDIATEK
	select PINCTRL_MTK

config PINCTRL_MT8173
	bool "MediaTek MT8173 pin control"
	depends on OF
	depends on ARM64 || COMPILE_TEST
	default ARM64 && ARCH_MEDIATEK
	select PINCTRL_MTK

config PINCTRL_MT8183
	bool "MediaTek MT8183 pin control"
	depends on OF
	depends on ARM64 || COMPILE_TEST
	default ARM64 && ARCH_MEDIATEK
	select PINCTRL_MTK_PARIS

config PINCTRL_MT8186
	bool "MediaTek MT8186 pin control"
	depends on OF
	depends on ARM64 || COMPILE_TEST
	default ARM64 && ARCH_MEDIATEK
	select PINCTRL_MTK_PARIS

config PINCTRL_MT8188
	bool "MediaTek MT8188 pin control"
	depends on OF
	depends on ARM64 || COMPILE_TEST
	default ARM64 && ARCH_MEDIATEK
	select PINCTRL_MTK_PARIS
	help
	  Say yes here to support pin controller and gpio driver
	  on MediaTek MT8188 SoC.
	  In MTK platform, we support virtual gpio and use it to
	  map specific eint which doesn't have real gpio pin.

config PINCTRL_MT8189
        bool "MediaTek MT8189 pin control"
        depends on OF
        depends on ARM64 || COMPILE_TEST
        default ARM64 && ARCH_MEDIATEK
        select PINCTRL_MTK_PARIS
        help
          Say yes here to support pin controller and gpio driver
          on MediaTek MT8189 SoC.
          In MTK platform, we support virtual gpio and use it to
          map specific eint which doesn't have real gpio pin.

config PINCTRL_MT8192
	bool "MediaTek MT8192 pin control"
	depends on OF
	depends on ARM64 || COMPILE_TEST
	default ARM64 && ARCH_MEDIATEK
	select PINCTRL_MTK_PARIS

config PINCTRL_MT8195
	bool "MediaTek MT8195 pin control"
	depends on OF
	depends on ARM64 || COMPILE_TEST
	default ARM64 && ARCH_MEDIATEK
	select PINCTRL_MTK_PARIS

config PINCTRL_MT8196
	bool "MediaTek MT8196 pin control"
	depends on OF
	depends on ARM64 || COMPILE_TEST
	default ARM64 && ARCH_MEDIATEK
	select PINCTRL_MTK_PARIS
	help
	  Say yes here to support pin controller and gpio driver
	  on MediaTek MT8196 SoC.
	  In MTK platform, we support virtual gpio and use it to
	  map specific eint which doesn't have real gpio pin.

config PINCTRL_MT8365
	bool "MediaTek MT8365 pin control"
	depends on OF
	depends on ARM64 || COMPILE_TEST
	default ARM64 && ARCH_MEDIATEK
	select PINCTRL_MTK

config PINCTRL_MT8516
	bool "MediaTek MT8516 pin control"
	depends on OF
	depends on ARM64 || COMPILE_TEST
	default ARM64 && ARCH_MEDIATEK
	select PINCTRL_MTK

# For PMIC
config PINCTRL_MT6397
	bool "MediaTek MT6397 pin control"
	depends on MFD_MT6397 || COMPILE_TEST
	depends on OF
	default MFD_MT6397
	select PINCTRL_MTK

endmenu
```

## drivers/pinctrl/meson/Kconfig
```kconfig
# SPDX-License-Identifier: GPL-2.0-only
menuconfig PINCTRL_MESON
	tristate "Amlogic SoC pinctrl drivers"
	depends on ARCH_MESON || COMPILE_TEST
	depends on OF
	default ARCH_MESON
	select PINMUX
	select PINCONF
	select GENERIC_PINCONF
	select GPIOLIB
	select OF_GPIO
	select REGMAP_MMIO

if PINCTRL_MESON

config PINCTRL_MESON8
	bool "Meson 8 SoC pinctrl driver"
	depends on ARM
	select PINCTRL_MESON8_PMX
	default ARCH_MESON

config PINCTRL_MESON8B
	bool "Meson 8b SoC pinctrl driver"
	depends on ARM
	select PINCTRL_MESON8_PMX
	default ARCH_MESON

config PINCTRL_MESON_GXBB
	tristate "Meson gxbb SoC pinctrl driver"
	depends on ARM64
	select PINCTRL_MESON8_PMX
	default ARCH_MESON

config PINCTRL_MESON_GXL
	tristate "Meson gxl SoC pinctrl driver"
	depends on ARM64
	select PINCTRL_MESON8_PMX
	default ARCH_MESON

config PINCTRL_MESON8_PMX
	tristate

config PINCTRL_MESON_AXG
	tristate "Meson axg Soc pinctrl driver"
	depends on ARM64
	select PINCTRL_MESON_AXG_PMX
	default ARCH_MESON

config PINCTRL_MESON_AXG_PMX
	tristate

config PINCTRL_MESON_G12A
	tristate "Meson g12a Soc pinctrl driver"
	depends on ARM64
	select PINCTRL_MESON_AXG_PMX
	default ARCH_MESON

config PINCTRL_MESON_A1
	tristate "Meson a1 Soc pinctrl driver"
	depends on ARM64
	select PINCTRL_MESON_AXG_PMX
	default ARCH_MESON

config PINCTRL_MESON_S4
	tristate "Meson s4 Soc pinctrl driver"
	depends on ARM64
	select PINCTRL_MESON_AXG_PMX
	default ARCH_MESON

config PINCTRL_AMLOGIC_A4
	bool "AMLOGIC pincontrol"
	depends on ARM64
	default ARCH_MESON
	help
	  This is the driver for the pin controller found on Amlogic SoCs.

	  This driver is simplify subsequent support for new amlogic SoCs,
	  to support new Amlogic SoCs, only need to add the corresponding dts file,
	  no additional binding header files or C file are added.

config PINCTRL_AMLOGIC_C3
	tristate "Amlogic C3 SoC pinctrl driver"
	depends on ARM64
	select PINCTRL_MESON_AXG_PMX
	default ARCH_MESON

config PINCTRL_AMLOGIC_T7
	tristate "Amlogic T7 SoC pinctrl driver"
	depends on ARM64
	select PINCTRL_MESON_AXG_PMX
	default ARCH_MESON

endif
```

## drivers/pinctrl/microchip/Kconfig
```kconfig
# SPDX-License-Identifier: GPL-2.0-only

config PINCTRL_PIC64GX
	bool "pic64gx gpio2 pinctrl driver"
	depends on ARCH_MICROCHIP || COMPILE_TEST
	depends on OF
	select GENERIC_PINCONF
	select REGMAP_MMIO
	help
	  This selects the pinctrl driver for gpio2 on pic64gx.

config PINCTRL_POLARFIRE_SOC
	bool "Polarfire SoC pinctrl drivers"
	depends on ARCH_MICROCHIP || COMPILE_TEST
	depends on OF
	select GENERIC_PINCTRL
	help
	  This selects the pinctrl drivers for Microchip Polarfire SoC.
```

## drivers/pinctrl/mvebu/Kconfig
```kconfig
# SPDX-License-Identifier: GPL-2.0-only
config PINCTRL_MVEBU
	bool
	select PINMUX
	select PINCONF

config PINCTRL_DOVE
	bool
	select PINCTRL_MVEBU
	select MFD_SYSCON

config PINCTRL_KIRKWOOD
	bool
	select PINCTRL_MVEBU

config PINCTRL_ARMADA_370
	bool
	select PINCTRL_MVEBU

config PINCTRL_ARMADA_375
	bool
	select PINCTRL_MVEBU

config PINCTRL_ARMADA_38X
	bool
	select PINCTRL_MVEBU

config PINCTRL_ARMADA_39X
	bool
	select PINCTRL_MVEBU

config PINCTRL_ARMADA_AP806
	bool
	select PINCTRL_MVEBU

config PINCTRL_ARMADA_CP110
	bool
	select PINCTRL_MVEBU

config PINCTRL_ARMADA_XP
	bool
	select PINCTRL_MVEBU

config PINCTRL_ORION
	bool
	select PINCTRL_MVEBU

config PINCTRL_AC5
	bool
	select PINCTRL_MVEBU

config PINCTRL_ARMADA_37XX
	bool
	select GENERIC_PINCONF
	select MFD_SYSCON
	select PINCONF
	select PINMUX
```

## drivers/pinctrl/nomadik/Kconfig
```kconfig
# SPDX-License-Identifier: GPL-2.0-only
if ARCH_U8500

config PINCTRL_ABX500
	bool "ST-Ericsson ABx500 family Mixed Signal Circuit gpio functions"
	depends on AB8500_CORE
	select GENERIC_PINCONF
	help
	  Select this to enable the ABx500 family IC GPIO driver

config PINCTRL_AB8500
	bool "AB8500 pin controller driver"
	depends on PINCTRL_ABX500 && ARCH_U8500

config PINCTRL_AB8505
	bool "AB8505 pin controller driver"
	depends on PINCTRL_ABX500 && ARCH_U8500

endif

if (ARCH_U8500 || ARCH_ANALMADIK)

config PINCTRL_ANALMADIK
	bool "Analmadik pin controller driver"
	depends on OF && GPIOLIB
	select PINMUX
	select PINCONF
	select OF_GPIO
	select GPIOLIB_IRQCHIP

config PINCTRL_STN8815
	bool "STN8815 pin controller driver"
	depends on PINCTRL_ANALMADIK && ARCH_ANALMADIK

config PINCTRL_DB8500
	bool "DB8500 pin controller driver"
	depends on PINCTRL_ANALMADIK && ARCH_U8500

endif
```

## drivers/pinctrl/nuvoton/Kconfig
```kconfig
# SPDX-License-Identifier: GPL-2.0-only

config PINCTRL_WPCM450
	tristate "Pinctrl and GPIO driver for Nuvoton WPCM450"
	depends on (ARCH_WPCM450 || COMPILE_TEST) && OF
	select PINMUX
	select PINCONF
	select GENERIC_PINCONF
	select GENERIC_PINCTRL_GROUPS
	select GPIOLIB
	select GPIO_GENERIC
	select GPIOLIB_IRQCHIP
	select MFD_SYSCON
	help
	  Say Y or M here to enable pin controller and GPIO support for
	  the Nuvoton WPCM450 SoC. This is strongly recommended when
	  building a kernel that will run on this chip.

	  If this driver is compiled as a module, it will be named
	  pinctrl-wpcm450.

config PINCTRL_NPCM7XX
	bool "Pinctrl and GPIO driver for Nuvoton NPCM7XX"
	depends on (ARCH_NPCM7XX || COMPILE_TEST) && OF
	select PINMUX
	select PINCONF
	select GENERIC_PINCONF
	select GPIOLIB
	select GPIO_GENERIC
	select GPIOLIB_IRQCHIP
	help
	  Say Y here to enable pin controller and GPIO support
	  for Nuvoton NPCM750/730/715/705 SoCs.

config PINCTRL_NPCM8XX
	tristate "Pinctrl and GPIO driver for Nuvoton NPCM8XX"
	depends on (ARCH_NPCM || COMPILE_TEST) && OF
	select PINMUX
	select PINCONF
	select GENERIC_PINCONF
	select GPIOLIB
	select GPIO_GENERIC
	select GPIOLIB_IRQCHIP
	help
	  Say Y or M here to enable pin controller and GPIO support for
	  the Nuvoton NPCM8XX SoC. This is strongly recommended when
	  building a kernel that will run on this chip.

config PINCTRL_MA35
	bool
	depends on (ARCH_MA35 || COMPILE_TEST) && OF
	select GENERIC_PINCTRL_GROUPS
	select GENERIC_PINMUX_FUNCTIONS
	select GENERIC_PINCONF
	select GPIOLIB
	select GPIO_GENERIC
	select GPIOLIB_IRQCHIP
	select MFD_SYSCON

config PINCTRL_MA35D1
	bool "Pinctrl and GPIO driver for Nuvoton MA35D1"
	depends on (ARCH_MA35 || COMPILE_TEST) && OF
	select PINCTRL_MA35
	help
	  Say Y here to enable pin controller and GPIO support
	  for Nuvoton MA35D1 SoC.
```

## drivers/pinctrl/nxp/Kconfig
```kconfig
# SPDX-License-Identifier: GPL-2.0-only
config PINCTRL_S32CC
	bool
	depends on ARCH_S32 && OF
	select GENERIC_PINCTRL_GROUPS
	select GENERIC_PINMUX_FUNCTIONS
	select GENERIC_PINCONF
	select REGMAP_MMIO

config PINCTRL_S32G2
	depends on ARCH_S32 && OF
	bool "NXP S32G2 pinctrl driver"
	select PINCTRL_S32CC
	help
	  Say Y here to enable the pinctrl driver for NXP S32G2 family SoCs
```

## drivers/pinctrl/pxa/Kconfig
```kconfig
if (ARCH_PXA || COMPILE_TEST)

config PINCTRL_PXA
	bool
	select PINMUX
	select PINCONF
	select GENERIC_PINCONF

config PINCTRL_PXA25X
	tristate "Marvell PXA25x pin controller driver"
	select PINCTRL_PXA
	default y if PXA25x
	help
	  This is the pinctrl, pinmux, pinconf driver for the Marvell
	  PXA2xx block found in the pxa25x platforms.

config PINCTRL_PXA27X
	tristate "Marvell PXA27x pin controller driver"
	select PINCTRL_PXA
	default y if PXA27x
	help
	  This is the pinctrl, pinmux, pinconf driver for the Marvell
	  PXA2xx block found in the pxa27x platforms.

endif
```
