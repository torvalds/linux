## drivers/mfd/display-serdes/Kconfig
```kconfig
# SPDX-License-Identifier: GPL-2.0-only
#
# Multifunction miscellaneous devices
#
comment "driver for different display serdes"

menuconfig MFD_SERDES_DISPLAY
	tristate "rockchip display serdes drivers support"
	select DRM_PANEL_BRIDGE
	select DRM_KMS_HELPER
	select DRM_MIPI_DSI
	select SERDES_DISPLAY_CHIP_ROHM
	select SERDES_DISPLAY_CHIP_MAXIM
	select SERDES_DISPLAY_CHIP_ROCKCHIP
	select SERDES_DISPLAY_CHIP_NOVO
	select MFD_CORE
	select REGMAP_I2C
	select GENERIC_PINCTRL_GROUPS
	select GENERIC_PINMUX_FUNCTIONS
	default n
	help
	  This driver supports different serdes devices from different vendor such as
	  maxim, rohm, rockchip etc.

if MFD_SERDES_DISPLAY
source "drivers/mfd/display-serdes/maxim/Kconfig"
source "drivers/mfd/display-serdes/rohm/Kconfig"
source "drivers/mfd/display-serdes/rockchip/Kconfig"
source "drivers/mfd/display-serdes/novo/Kconfig"
endif
```

## drivers/mfd/display-serdes/maxim/Kconfig
```kconfig
# SPDX-License-Identifier: GPL-2.0
#
# maxim display serdes drivers configuration
#

menuconfig SERDES_DISPLAY_CHIP_MAXIM
	tristate "maxim serdes device support"
	default y
	help
	  Enable this to be able to choose the drivers for controlling the
	  maxim serdes.

if SERDES_DISPLAY_CHIP_MAXIM
config SERDES_DISPLAY_CHIP_MAXIM_MAX96745
	tristate "maxim max96745 serdes"
	default y
	help
	  To support maxim max96745 display serdes.

config SERDES_DISPLAY_CHIP_MAXIM_MAX96752
	tristate "maxim max96752 serdes"
	default y
	help
	  To support maxim max96752 display serdes.

config SERDES_DISPLAY_CHIP_MAXIM_MAX96755
	tristate "maxim max96755 serdes"
	default y
	help
	  To support maxim max96755 display serdes.

config SERDES_DISPLAY_CHIP_MAXIM_MAX96772
	tristate "maxim max96772 serdes"
	default y
	help
	  To support maxim max96772 display serdes.

config SERDES_DISPLAY_CHIP_MAXIM_MAX96789
	tristate "maxim max96789 serdes"
	default y
	help
	  To support maxim max96789 display serdes.

endif
```

## drivers/mfd/display-serdes/novo/Kconfig
```kconfig
# SPDX-License-Identifier: GPL-2.0
#
# rohm serdes drivers configuration
#

menuconfig SERDES_DISPLAY_CHIP_NOVO
	tristate "novo expander device support"
	default y
	help
	  Enable this to be able to choose the drivers for controlling the
	  rohm serdes.

if SERDES_DISPLAY_CHIP_NOVO
config SERDES_DISPLAY_CHIP_NOVO_NCA9539
	tristate "novo nca9539 expander"
	default y
	help
	  To support novo nca9539 expander.

endif
```

## drivers/mfd/display-serdes/rockchip/Kconfig
```kconfig
# SPDX-License-Identifier: GPL-2.0
#
# rockchip display serdes drivers configuration
#

menuconfig SERDES_DISPLAY_CHIP_ROCKCHIP
	tristate "rockchip serdes device support"
	default y
	help
	  Enable this to be able to choose the drivers for controlling the
	  rockchip serdes.

if SERDES_DISPLAY_CHIP_ROCKCHIP
config SERDES_DISPLAY_CHIP_ROCKCHIP_RKX111
	tristate "rockchip rkx111 serdes"
	default y
	help
	  To support rockchip rkx111 display serdes.

config SERDES_DISPLAY_CHIP_ROCKCHIP_RKX121
	tristate "rockchip rkx121 serdes"
	default y
	help
	  To support rockchip rkx121 display serdes.
endif
```

## drivers/mfd/display-serdes/rohm/Kconfig
```kconfig
# SPDX-License-Identifier: GPL-2.0
#
# rohm serdes drivers configuration
#

menuconfig SERDES_DISPLAY_CHIP_ROHM
	tristate "rohm serdes device support"
	default y
	help
	  Enable this to be able to choose the drivers for controlling the
	  rohm serdes.

if SERDES_DISPLAY_CHIP_ROHM
config SERDES_DISPLAY_CHIP_ROHM_BU18TL82
	tristate "rohm bu18tl82 serdes"
	default y
	help
	  To support rohm bu18tl82 display serdes.

config SERDES_DISPLAY_CHIP_ROHM_BU18RL82
	tristate "rohm bu18rl82 serdes"
	default y
	help
	  To support rohm bu18rl82 display serdes.
endif
```

## drivers/mfd/rkx110_x120/Kconfig
```kconfig
# SPDX-License-Identifier: (GPL-2.0+ OR MIT)

config MFD_RKX110_X120
	tristate "Rockchip RKx110 RKx120 SerDes MFD Driver"
	depends on I2C
	depends on OF
	select MFD_CORE
	help
	  if you say yes here you get support for the RKx110 RKx120 from Rockchip.

config ROCKCHIP_SERDES_DRM_PANEL
	tristate "Generic RK Serdes panel driver"
	depends on OF
	depends on BACKLIGHT_CLASS_DEVICE
	select VIDEOMODE_HELPERS
	help
	  This driver supports rk serdes panels.
```

## drivers/misc/3g_module/Kconfig
```kconfig
# SPDX-License-Identifier: GPL-2.0
#
# 3G device configuration
#

menuconfig 3G_MODULE
	tristate "3G module for mid"
	---help---
	  Say Y here if you have a support modem

choice
	depends on 3G_MODULE
	prompt  "Select 3G Module"

    config MU509
  	bool "MU509"

    config MT6229
    	bool "MT6229"

    config MW100
    	bool "MW100"

    config SEW868
	bool "SEW868"	

  


endchoice
```
