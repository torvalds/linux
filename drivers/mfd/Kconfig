## drivers/misc/altera-stapl/Kconfig
```kconfig
# SPDX-License-Identifier: GPL-2.0-only
comment "Altera FPGA firmware download module (requires I2C)"
	depends on !I2C

config ALTERA_STAPL
	tristate "Altera FPGA firmware download module"
	depends on I2C
	help
	  An Altera FPGA module. Say Y when you want to support this tool.
```

## drivers/misc/amd-sbi/Kconfig
```kconfig
# SPDX-License-Identifier: GPL-2.0-only
config AMD_SBRMI_I2C
	tristate "AMD side band RMI support"
	depends on I2C
	depends on ARM || ARM64 || COMPILE_TEST
	select REGMAP_I2C
	help
	  Side band RMI over I2C support for AMD out of band management.
	  This driver is intended to run on the BMC, not the managed node.

	  This driver can also be built as a module. If so, the module will
	  be called sbrmi-i2c.

config AMD_SBRMI_HWMON
	bool "SBRMI hardware monitoring"
	depends on AMD_SBRMI_I2C && HWMON
	depends on !(AMD_SBRMI_I2C=y && HWMON=m)
	help
	  This provides support for RMI device hardware monitoring. If enabled,
	  a hardware monitoring device will be created for each socket in
	  the system.
```

## drivers/misc/bcm-vk/Kconfig
```kconfig
# SPDX-License-Identifier: GPL-2.0-only
#
# Broadcom VK device
#
config BCM_VK
	tristate "Support for Broadcom VK Accelerators"
	depends on PCI_MSI
	help
	  Select this option to enable support for Broadcom
	  VK Accelerators.  VK is used for performing
	  multiple specific offload processing tasks in parallel.
	  Such offload tasks assist in such operations as video
	  transcoding, compression, and crypto tasks.
	  This driver enables userspace programs to access these
	  accelerators via /dev/bcm-vk.N devices.

	  If unsure, say N.

config BCM_VK_TTY
	bool "Enable tty ports on a Broadcom VK Accelerator device"
	depends on TTY
	depends on BCM_VK
	help
	  Select this option to enable tty support to allow console
	  access to Broadcom VK Accelerator cards from host.

	  Device node will in the form /dev/bcm-vk.x_ttyVKy where:
	  x is the instance of the VK card
	  y is the tty device number on the VK card.
```

## drivers/misc/bp/Kconfig
```kconfig
# SPDX-License-Identifier: GPL-2.0
#
# all auto modem control drivers configuration
#

config BP_AUTO
	bool "voice modem support"
	default n	
```

## drivers/misc/bp/chips/Kconfig
```kconfig
# SPDX-License-Identifier: GPL-2.0
config BP_AUTO_MT6229
bool "modem mt6229"
	default n
 
config BP_AUTO_MU509
bool "modem mu509"
	default n

config BP_AUTO_MW100
bool "modem mw100"
	default n
config BP_AUTO_MI700
bool "modem mi700"
	default n
config BP_AUTO_C66A
bool "modem c66a"
        default n

config BP_AUTO_SEW290
bool "modem sew290"
        default n
config BP_AUTO_U7501
bool "modem u7501"
        default n
	
config BP_AUTO_U5501
bool "modem u5501"

config BP_AUTO_AW706
bool "modem aw706"
        default n
```

## drivers/misc/c2c/Kconfig
```kconfig
#
# C2C XXX
#

menuconfig SAMSUNG_C2C
	tristate "C2C Support"
	depends on CPU_EXYNOS4212 || CPU_EXYNOS5250
	default n
	help
	  It is for supporting C2C driver.

if SAMSUNG_C2C
config C2C_DEBUG
	bool "C2C Debugging - Print C2C debug messages"
	default y
	help
	  Print C2C debug messages.

config C2C_IPC_ENABLE
	bool "Enable C2C IPC via the Shared Memory"
	default n
	help
	  Enable C2C IPC via the Shared Memory.
endif # SAMSUNG_C2C
```

## drivers/misc/c2port/Kconfig
```kconfig
#
# C2 port devices
#

menuconfig C2PORT
	tristate "Silicon Labs C2 port support (EXPERIMENTAL)"
	depends on EXPERIMENTAL
	default n
	help
	  This option enables support for Silicon Labs C2 port used to
	  program Silicon micro controller chips (and other 8051 compatible).

	  If your board have no such micro controllers you don't need this
	  interface at all.

	  To compile this driver as a module, choose M here: the module will
	  be called c2port_core. Note that you also need a client module
	  usually called c2port-*.

	  If you are not sure, say N here.

if C2PORT

config C2PORT_DURAMAR_2150
	tristate "C2 port support for Eurotech's Duramar 2150 (EXPERIMENTAL)"
	depends on X86
	default n
	help
	  This option enables C2 support for the Eurotech's Duramar 2150
	  on board micro controller.

	  To compile this driver as a module, choose M here: the module will
	  be called c2port-duramar2150.

endif # C2PORT
```

## drivers/misc/cardreader/Kconfig
```kconfig
# SPDX-License-Identifier: GPL-2.0-only
config MISC_ALCOR_PCI
	tristate "Alcor Micro/Alcor Link PCI-E card reader"
	depends on PCI
	select MFD_CORE
	help
	  This supports for Alcor Micro PCI-Express card reader including au6601,
	  au6621.
	  Alcor Micro card readers support access to many types of memory cards,
	  such as Memory Stick, Memory Stick Pro, Secure Digital and
	  MultiMediaCard.

config MISC_RTSX_PCI
	tristate "Realtek PCI-E card reader"
	depends on PCI
	select MFD_CORE
	help
	  This supports for Realtek PCI-Express card reader including rts5209,
	  rts5227, rts5228, rts522A, rts5229, rts5249, rts524A, rts525A, rtl8411,
	  rts5260, rts5261, rts5264.
	  Realtek card readers support access to many types of memory cards,
	  such as Memory Stick, Memory Stick Pro, Secure Digital and
	  MultiMediaCard.

config MISC_RTSX_USB
	tristate "Realtek USB card reader"
	depends on USB
	select MFD_CORE
	help
	  Select this option to get support for Realtek USB 2.0 card readers
	  including RTS5129, RTS5139, RTS5179 and RTS5170.
	  Realtek card reader supports access to many types of memory cards,
	  such as Memory Stick Pro, Secure Digital and MultiMediaCard.
```

## drivers/misc/carma/Kconfig
```kconfig
config CARMA_FPGA
	tristate "CARMA DATA-FPGA Access Driver"
	depends on FSL_SOC && PPC_83xx && HAS_DMA && FSL_DMA
	default n
	help
	  Say Y here to include support for communicating with the data
	  processing FPGAs on the OVRO CARMA board.

config CARMA_FPGA_PROGRAM
	tristate "CARMA DATA-FPGA Programmer"
	depends on FSL_SOC && PPC_83xx && HAS_DMA && FSL_DMA
	default n
	help
	  Say Y here to include support for programming the data processing
	  FPGAs on the OVRO CARMA board.
```

## drivers/misc/cb710/Kconfig
```kconfig
# SPDX-License-Identifier: GPL-2.0-only
config CB710_CORE
	tristate "ENE CB710/720 Flash memory card reader support"
	depends on PCI
	help
	  This option enables support for PCI ENE CB710/720 Flash memory card
	  reader found in some laptops (ie. some versions of HP Compaq nx9500).

	  You will also have to select some flash card format drivers (MMC/SD,
	  MemoryStick).

	  This driver can also be built as a module. If so, the module
	  will be called cb710.

config CB710_DEBUG
	bool "Enable driver debugging"
	depends on CB710_CORE != n
	default n
	help
	  This is an option for use by developers; most people should
	  say N here.  This adds a lot of debugging output to dmesg.

config CB710_DEBUG_ASSUMPTIONS
	bool
	depends on CB710_CORE != n
	default y
```

## drivers/misc/cxl/Kconfig
```kconfig
#
# IBM Coherent Accelerator (CXL) compatible devices
#

config CXL_BASE
	bool
	default n
	select PPC_COPRO_BASE

config CXL_AFU_DRIVER_OPS
	bool
	default n

config CXL
	tristate "Support for IBM Coherent Accelerators (CXL)"
	depends on PPC_POWERNV && PCI_MSI && EEH
	select CXL_BASE
	select CXL_AFU_DRIVER_OPS
	default m
	help
	  Select this option to enable driver support for IBM Coherent
	  Accelerators (CXL).  CXL is otherwise known as Coherent Accelerator
	  Processor Interface (CAPI).  CAPI allows accelerators in FPGAs to be
	  coherently attached to a CPU via an MMU.  This driver enables
	  userspace programs to access these accelerators via /dev/cxl/afuM.N
	  devices.

	  CAPI adapters are found in POWER8 based systems.

	  If unsure, say N.

config CXL_BIMODAL
	bool "Support for bi-modal CAPI cards"
	depends on HOTPLUG_PCI_POWERNV = y && CXL || HOTPLUG_PCI_POWERNV = m && CXL = m
	default y
	help
	  Select this option to enable support for bi-modal CAPI cards, such as
	  the Mellanox CX-4.
```

## drivers/misc/echo/Kconfig
```kconfig
# SPDX-License-Identifier: GPL-2.0-only
config ECHO
	tristate "Line Echo Canceller support"
	---help---
	  This driver provides line echo cancelling support for mISDN and
	  Zaptel drivers.

	  To compile this driver as a module, choose M here. The module
	  will be called echo.
```

## drivers/misc/eeprom/Kconfig
```kconfig
# SPDX-License-Identifier: GPL-2.0-only
menu "EEPROM support"

config EEPROM_MAX6875
	tristate "Maxim MAX6874/5 power supply supervisor"
	depends on I2C
	help
	  If you say yes here you get read-only support for the user EEPROM of
	  the Maxim MAX6874/5 EEPROM-programmable, quad power-supply
	  sequencer/supervisor.

	  All other features of this chip should be accessed via i2c-dev.

	  This driver can also be built as a module.  If so, the module
	  will be called max6875.


config EEPROM_93CX6
	tristate "EEPROM 93CX6 support"
	help
	  This is a driver for the EEPROM chipsets 93c46 and 93c66.
	  The driver supports both read as well as write commands.

	  If unsure, say N.

config EEPROM_DIGSY_MTC_CFG
	bool "DigsyMTC display configuration EEPROMs device"
	depends on GPIO_MPC5200 && SPI_GPIO
	help
	  This option enables access to display configuration EEPROMs
	  on digsy_mtc board. You have to additionally select Microwire
	  EEPROM 93XX46 driver. sysfs entries will be created for that
	  EEPROM allowing to read/write the configuration data or to
	  erase the whole EEPROM.

	  If unsure, say N.

config EEPROM_IDT_89HPESX
	tristate "IDT 89HPESx PCIe-switches EEPROM / CSR support"
	depends on I2C && SYSFS
	help
	  Enable this driver to get read/write access to EEPROM / CSRs
	  over IDT PCIe-switch i2c-slave interface.

	  This driver can also be built as a module. If so, the module
	  will be called idt_89hpesx.

endmenu
```

## drivers/misc/ethosn/Kconfig
```kconfig
config ETHOSN
    tristate "Ethos-N driver support"
    default m
    help
      This enables support for the Ethos-N driver.
      Select 'm' to build as a loadable module, or 'y' to compile it statically into the kernel.
```

## drivers/misc/fpga-bridge/Kconfig
```kconfig
#
# FPGA bridge manager configuration
#

menu "FPGA Bridges"

config FPGA_BRIDGE
       tristate "FPGA Bridge Drivers"
       depends on OF
       help
         Say Y here if you want to support bridges connected between host
	 processors and FPGAs or between FPGAs.

config ALTERA_SOCFPGA_BRIDGE
       tristate "Altera SoCFPGA Bridges"
       depends on FPGA_BRIDGE
       help
         Say Y to enable drivers for FPGA bridges for Altera socfpga
	 devices.
endmenu
```

## drivers/misc/genwqe/Kconfig
```kconfig
# SPDX-License-Identifier: GPL-2.0-only
#
# IBM Accelerator Family 'GenWQE'
#

menuconfig GENWQE
	tristate "GenWQE PCIe Accelerator"
	depends on PCI && 64BIT
	select CRC_ITU_T
	default n
	help
	  Enables PCIe card driver for IBM GenWQE accelerators.
	  The user-space interface is described in
	  include/linux/genwqe/genwqe_card.h.

config GENWQE_PLATFORM_ERROR_RECOVERY
	int "Use platform recovery procedures (0=off, 1=on)"
	depends on GENWQE
	default 1 if PPC64
	default 0
```
