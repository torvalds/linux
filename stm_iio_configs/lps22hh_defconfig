## stm_iio_configs/lsm6ds3_defconfig
```kconfig
CONFIG_ST_LSM6DS3_IIO=m
CONFIG_ST_LSM6DS3_I2C_IIO=m
CONFIG_ST_LSM6DS3_SPI_IIO=m
CONFIG_ST_LSM6DS3_IIO_LIMIT_FIFO=0
CONFIG_ST_LSM6DS3_STEP_COUNTER_ON_DURING_SUSPEND=n
CONFIG_ST_LSM6DS3_IIO_MASTER_SUPPORT=y
CONFIG_ST_LSM6DS3_ENABLE_INTERNAL_PULLUP=y
CONFIG_ST_LSM6DS3_IIO_EXT0_LIS2MDL=y
CONFIG_ST_LSM6DS3_XL_DATA_INJECTION=y
```

## stm_iio_configs/lsm6ds3h_defconfig
```kconfig
CONFIG_ST_LSM6DS3H_IIO=m
CONFIG_ST_LSM6DS3H_I2C_IIO=m
CONFIG_ST_LSM6DS3H_SPI_IIO=m
CONFIG_ST_LSM6DS3H_IIO_LIMIT_FIFO=0
CONFIG_ST_LSM6DS3H_STEP_COUNTER_ON_DURING_SUSPEND=n
CONFIG_ST_LSM6DS3H_IIO_MASTER_SUPPORT=y
CONFIG_ST_LSM6DS3H_ENABLE_INTERNAL_PULLUP=y
CONFIG_ST_LSM6DS3H_IIO_EXT0_LIS2MDL=y
CONFIG_ST_LSM6DS3H_XL_DATA_INJECTION=y
```

## stm_iio_configs/lsm6dsm_defconfig
```kconfig
CONFIG_ST_LSM6DSM_IIO=m
CONFIG_ST_LSM6DSM_I2C_IIO=m
CONFIG_ST_LSM6DSM_SPI_IIO=m
CONFIG_ST_LSM6DSM_IIO_LIMIT_FIFO=0
CONFIG_ST_LSM6DSM_STEP_COUNTER_ON_DURING_SUSPEND=n
CONFIG_ST_LSM6DSM_IIO_MASTER_SUPPORT=y
CONFIG_ST_LSM6DSM_ENABLE_INTERNAL_PULLUP=y
CONFIG_ST_LSM6DSM_IIO_EXT0_LIS2MDL=y
CONFIG_ST_LSM6DSM_XL_DATA_INJECTION=y
```

## stm_iio_configs/lsm6dso16is_defconfig
```kconfig
CONFIG_IIO_ST_LSM6DSO16IS=m
CONFIG_IIO_ST_LSM6DSO16IS_I2C=m
CONFIG_IIO_ST_LSM6DSO16IS_SPI=m
```

## stm_iio_configs/lsm6dso32_defconfig
```kconfig
CONFIG_IIO_ST_LSM6DSO32=m
CONFIG_IIO_ST_LSM6DSO32_I2C=m
CONFIG_IIO_ST_LSM6DSO32_SPI=m
CONFIG_IIO_ST_LSM6DSO32_MAY_WAKEUP=y
```

## stm_iio_configs/lsm6dso32x_defconfig
```kconfig
CONFIG_IIO_ST_LSM6DSO32X=m
CONFIG_IIO_ST_LSM6DSO32X_I2C=m
CONFIG_IIO_ST_LSM6DSO32X_SPI=m
CONFIG_IIO_ST_LSM6DSO32X_I3C=m
CONFIG_IIO_ST_LSM6DSO32X_MLC=y
CONFIG_IIO_ST_LSM6DSO32X_MLC_PRELOAD=y
CONFIG_IIO_ST_LSM6DSO32X_MAY_WAKEUP=y
CONFIG_IIO_ST_LSM6DSO32X_EN_REGULATOR=y
```

## stm_iio_configs/lsm6dso_defconfig
```kconfig
CONFIG_IIO_ST_LSM6DSO=m
CONFIG_IIO_ST_LSM6DSO_I2C=m
CONFIG_IIO_ST_LSM6DSO_SPI=m
CONFIG_IIO_ST_LSM6DSO_MAY_WAKEUP=y
```

## stm_iio_configs/lsm6dsox_defconfig
```kconfig
CONFIG_IIO_ST_LSM6DSOX=m
CONFIG_IIO_ST_LSM6DSOX_I2C=m
CONFIG_IIO_ST_LSM6DSOX_SPI=m
CONFIG_IIO_ST_LSM6DSOX_I3C=m
```

## stm_iio_configs/lsm6dsr_defconfig
```kconfig
CONFIG_IIO_ST_LSM6DSR=m
CONFIG_IIO_ST_LSM6DSR_I2C=m
CONFIG_IIO_ST_LSM6DSR_SPI=m
CONFIG_IIO_ST_LSM6DSR_MAY_WAKEUP=y
```

## stm_iio_configs/lsm6dsrx_defconfig
```kconfig
CONFIG_IIO_ST_LSM6DSRX=m
CONFIG_IIO_ST_LSM6DSRX_I2C=m
CONFIG_IIO_ST_LSM6DSRX_SPI=m
CONFIG_IIO_ST_LSM6DSRX_I3C=m
CONFIG_IIO_ST_LSM6DSRX_MLC_PRELOAD=y
```

## stm_iio_configs/lsm6dsv16bx_defconfig
```kconfig
CONFIG_IIO_ST_LSM6DSV16BX=m
CONFIG_IIO_ST_LSM6DSV16BX_I2C=m
CONFIG_IIO_ST_LSM6DSV16BX_I3C=m
CONFIG_IIO_ST_LSM6DSV16BX_SPI=m
CONFIG_IIO_ST_LSM6DSV16BX_MLC_PRELOAD=y
CONFIG_IIO_ST_LSM6DSV16BX_ASYNC_HW_TIMESTAMP=y
```

## stm_iio_configs/lsm6dsvx_defconfig
```kconfig
CONFIG_IIO_ST_LSM6DSVX=m
CONFIG_IIO_ST_LSM6DSVX_I2C=m
CONFIG_IIO_ST_LSM6DSVX_SPI=m
CONFIG_IIO_ST_LSM6DSVX_QVAR_IN_FIFO=y
CONFIG_IIO_ST_LSM6DSVX_MLC_PRELOAD=y
```

## stm_iio_configs/sths34pf80_defconfig
```kconfig
CONFIG_IIO_ST_STHS34PF80=m
CONFIG_IIO_ST_STHS34PF80_SPI=m
CONFIG_IIO_ST_STHS34PF80_I2C=m
```

## tools/verification/dot2/dot2k_templates/Kconfig
```kconfig
# SPDX-License-Identifier: GPL-2.0-only
#
config RV_MON_%%MODEL_NAME_UP%%
	depends on RV
%%MONITOR_DEPS%%
	select %%MONITOR_CLASS_TYPE%%
	bool "%%MODEL_NAME%% monitor"
	help
	  %%DESCRIPTION%%
```

## ubuntu/Kconfig
```kconfig
menu "Ubuntu Supplied Third-Party Device Drivers"

#
# NOTE: to allow drivers to be added and removed without causing merge
# collisions you should add new entries in the middle of the six lines
# of ## at the bottom of the list.  Always add three lines of ## above
# your new entry and maintain the six lines below.
#

##
##
##
##
##
##

endmenu
```

## ubuntu/hio/Kconfig
```kconfig
config HIO
	tristate "ES3000 V2 High-Performance PCIe SSD"
	---help---
	Driver for ES3000 V2 High-Performance PCIe SSD.
```
