## lib/int_to_fp_str/Kconfig
```kconfig
menu "H Lib"

config INT_TO_FP_STR 
        bool "int_to_fp_str"
		default y

config INT_TO_FP_STR_TEST
        bool "Test for lib int_to_fp_str"
        depends on KUNIT=y
        default KUNIT_ALL_TESTS

endmenu
```

## lib/kfuzztest/Kconfig
```kconfig
# SPDX-License-Identifier: GPL-2.0-only

config KFUZZTEST
	bool "KFuzzTest - enable support for internal fuzz targets"
	depends on DEBUG_FS && DEBUG_KERNEL
	help
	  Enables support for the kernel fuzz testing framework (KFuzzTest), an
	  interface for exposing internal kernel functions to a userspace fuzzing
	  engine. KFuzzTest targets are exposed via a debugfs interface that
	  accepts serialized userspace inputs, and is designed to make it easier
	  to fuzz deeply nested kernel code that is hard to reach from the system
	  call boundary. Using a simple macro-based API, developers can add a new
	  fuzz target with minimal boilerplate code.

	  It is strongly recommended to also enable CONFIG_KASAN for byte-accurate
	  out-of-bounds detection, as KFuzzTest was designed with this in mind. It
	  is also recommended to enable CONFIG_KCOV for coverage guided fuzzing.

	  WARNING: This exposes internal kernel functions directly to userspace
	  and must NEVER be enabled in production builds.
```

## lib/kunit/Kconfig
```kconfig
#
# KUnit base configuration
#

menuconfig KUNIT
	tristate "KUnit - Enable support for unit tests"
	select GLOB
	help
	  Enables support for kernel unit tests (KUnit), a lightweight unit
	  testing and mocking framework for the Linux kernel. These tests are
	  able to be run locally on a developer's workstation without a VM or
	  special hardware when using UML. Can also be used on most other
	  architectures. For more information, please see
	  Documentation/dev-tools/kunit/.

if KUNIT

config KUNIT_DEBUGFS
	bool "KUnit - Enable /sys/kernel/debug/kunit debugfs representation" if !KUNIT_ALL_TESTS
	default KUNIT_ALL_TESTS
	help
	  Enable debugfs representation for kunit.  Currently this consists
	  of /sys/kernel/debug/kunit/<test_suite>/results files for each
	  test suite, which allow users to see results of the last test suite
	  run that occurred.

config KUNIT_FAULT_TEST
	bool "Enable KUnit tests which print BUG stacktraces"
	depends on KUNIT_TEST
	depends on !UML
	default y
	help
	  Enables fault handling tests for the KUnit framework. These tests may
	  trigger a kernel BUG(), and the associated stack trace, even when they
	  pass. If this conflicts with your test infrastrcture (or is confusing
	  or annoying), they can be disabled by setting this to N.

config KUNIT_TEST
	tristate "KUnit test for KUnit" if !KUNIT_ALL_TESTS
	default KUNIT_ALL_TESTS
	help
	  Enables the unit tests for the KUnit test framework. These tests test
	  the KUnit test framework itself; the tests are both written using
	  KUnit and test KUnit. This option should only be enabled for testing
	  purposes by developers interested in testing that KUnit works as
	  expected.

config KUNIT_EXAMPLE_TEST
	tristate "Example test for KUnit" if !KUNIT_ALL_TESTS
	default KUNIT_ALL_TESTS
	help
	  Enables an example unit test that illustrates some of the basic
	  features of KUnit. This test only exists to help new users understand
	  what KUnit is and how it is used. Please refer to the example test
	  itself, lib/kunit/example-test.c, for more information. This option
	  is intended for curious hackers who would like to understand how to
	  use KUnit for kernel development.

config KUNIT_ALL_TESTS
	tristate "All KUnit tests with satisfied dependencies"
	help
	  Enables all KUnit tests, if they can be enabled.
	  KUnit tests run during boot and output the results to the debug log
	  in TAP format (http://testanything.org/). Only useful for kernel devs
	  running the KUnit test harness, and not intended for inclusion into a
	  production build.

	  For more information on KUnit and unit tests in general please refer
	  to the KUnit documentation in Documentation/dev-tools/kunit/.

	  If unsure, say N.

config KUNIT_DEFAULT_ENABLED
	bool "Default value of kunit.enable"
	default y
	help
	  Sets the default value of kunit.enable. If set to N then KUnit
	  tests will not execute unless kunit.enable=1 is passed to the
	  kernel command line.

	  In most cases this should be left as Y. Only if additional opt-in
	  behavior is needed should this be set to N.

config KUNIT_AUTORUN_ENABLED
	bool "Default value of kunit.autorun"
	default y
	help
	  Sets the default value of kunit.autorun. If set to N then KUnit
	  tests will not run after initialization unless kunit.autorun=1 is
	  passed to the kernel command line. The test can still be run manually
	  via debugfs interface.

	  In most cases this should be left as Y. Only if additional opt-in
	  behavior is needed should this be set to N.

config KUNIT_DEFAULT_TIMEOUT
	int "Default value of the timeout module parameter"
	default 300
	help
	  Sets the default timeout, in seconds, for Kunit test cases. This value
	  is further multiplied by a factor determined by the assigned speed
	  setting: 1x for `DEFAULT`, 3x for `KUNIT_SPEED_SLOW`, and 12x for
	  `KUNIT_SPEED_VERY_SLOW`. This allows slower tests on slower machines
	  sufficient time to complete.

	  If unsure, the default timeout of 300 seconds is suitable for most
	  cases.

config KUNIT_UML_PCI
	bool "KUnit UML PCI Support"
	depends on UML
	select UML_PCI
	help
	  Enables the PCI subsystem on UML for use by KUnit tests.
	  Some KUnit tests require the PCI core which is not enabled by
	  default on UML.

	  If unsure, say N.

endif # KUNIT
```

## lib/math/Kconfig
```kconfig
# SPDX-License-Identifier: GPL-2.0-only
config CORDIC
	tristate "CORDIC algorithm"
	help
	  This option provides an implementation of the CORDIC algorithm;
	  calculations are in fixed point. Module will be called cordic.

config PRIME_NUMBERS
	tristate "Simple prime number generator for testing"
	help
	  This option provides a simple prime number generator for test
	  modules.

	  If unsure, say N.

config RATIONAL
	tristate
```

## lib/raid/Kconfig
```kconfig
# SPDX-License-Identifier: GPL-2.0

config XOR_BLOCKS
	tristate

# selected by architectures that provide an optimized XOR implementation
config XOR_BLOCKS_ARCH
	depends on XOR_BLOCKS
	default y if ALPHA
	default y if ARM
	default y if ARM64
	default y if CPU_HAS_LSX		# loongarch
	default y if ALTIVEC			# powerpc
	default y if RISCV_ISA_V
	default y if SPARC
	default y if S390
	default y if X86_32
	default y if X86_64
	bool

config XOR_KUNIT_TEST
	tristate "KUnit tests for xor_gen" if !KUNIT_ALL_TESTS
	depends on KUNIT
	depends on XOR_BLOCKS
	default KUNIT_ALL_TESTS
	help
	  Unit tests for the XOR library functions.

	  This is intended to help people writing architecture-specific
	  optimized versions.  If unsure, say N.

config RAID6_PQ
	tristate

# selected by architectures that provide an optimized PQ implementation
config RAID6_PQ_ARCH
	depends on RAID6_PQ
	default y if KERNEL_MODE_NEON		# arm32/arm64
	default y if LOONGARCH
	default y if ALTIVEC			# powerpc
	default y if RISCV_ISA_V
	default y if S390
	default y if X86
	bool

config RAID6_PQ_KUNIT_TEST
	tristate "KUnit tests for RAID6 PQ functions" if !KUNIT_ALL_TESTS
	depends on KUNIT
	depends on RAID6_PQ
	default KUNIT_ALL_TESTS
	help
	  Unit tests for the RAID6 PQ library functions.

	  This is intended to help people writing architecture-specific
	  optimized versions.  If unsure, say N.

config RAID6_PQ_BENCHMARK
	bool "Automatically choose fastest RAID6 PQ functions"
	depends on RAID6_PQ
	default y
	help
	  Benchmark all available RAID6 PQ functions on init and choose the
	  fastest one.
```

## lib/vdso/Kconfig
```kconfig
# SPDX-License-Identifier: GPL-2.0

config VDSO_DATASTORE
	bool

config GENERIC_GETTIMEOFDAY
	bool
	select VDSO_DATASTORE
	help
	  This is a generic implementation of gettimeofday vdso.
	  Each architecture that enables this feature has to
	  provide the fallback implementation.

config GENERIC_VDSO_OVERFLOW_PROTECT
	bool
	help
	  Select to add multiplication overflow protection to the VDSO
	  time getter functions for the price of an extra conditional
	  in the hotpath.

config VDSO_GETRANDOM
	bool
	select VDSO_DATASTORE
	help
	  Selected by architectures that support vDSO getrandom().
```

## lib/xz/Kconfig
```kconfig
# SPDX-License-Identifier: GPL-2.0-only
config XZ_DEC
	tristate "XZ decompression support"
	select CRC32
	help
	  LZMA2 compression algorithm and BCJ filters are supported using
	  the .xz file format as the container. For integrity checking,
	  CRC32 is supported. See Documentation/xz.txt for more information.

if XZ_DEC

config XZ_DEC_X86
	bool "x86 BCJ filter decoder" if EXPERT
	default y
	select XZ_DEC_BCJ

config XZ_DEC_POWERPC
	bool "PowerPC BCJ filter decoder" if EXPERT
	default y
	select XZ_DEC_BCJ

config XZ_DEC_IA64
	bool "IA-64 BCJ filter decoder" if EXPERT
	default y
	select XZ_DEC_BCJ

config XZ_DEC_ARM
	bool "ARM BCJ filter decoder" if EXPERT
	default y
	select XZ_DEC_BCJ

config XZ_DEC_ARMTHUMB
	bool "ARM-Thumb BCJ filter decoder" if EXPERT
	default y
	select XZ_DEC_BCJ

config XZ_DEC_SPARC
	bool "SPARC BCJ filter decoder" if EXPERT
	default y
	select XZ_DEC_BCJ

endif

config XZ_DEC_BCJ
	bool
	default n

config XZ_DEC_TEST
	tristate "XZ decompressor tester"
	default n
	depends on XZ_DEC
	help
	  This allows passing .xz files to the in-kernel XZ decoder via
	  a character special file. It calculates CRC32 of the decompressed
	  data and writes diagnostics to the system log.

	  Unless you are developing the XZ decoder, you don't need this
	  and should say N.
```
