## net/6lowpan/Kconfig
```kconfig
menuconfig 6LOWPAN
	tristate "6LoWPAN Support"
	depends on IPV6
	---help---
	  This enables IPv6 over Low power Wireless Personal Area Network -
	  "6LoWPAN" which is supported by IEEE 802.15.4 or Bluetooth stacks.

config 6LOWPAN_DEBUGFS
	bool "6LoWPAN debugfs support"
	depends on 6LOWPAN
	depends on DEBUG_FS
	---help---
	  This enables 6LoWPAN debugfs support. For example to manipulate
	  IPHC context information at runtime.

menuconfig 6LOWPAN_NHC
	tristate "Next Header and Generic Header Compression Support"
	depends on 6LOWPAN
	default y
	---help---
	  Support for next header and generic header compression defined in
	  RFC6282 and RFC7400.

if 6LOWPAN_NHC

config 6LOWPAN_NHC_DEST
	tristate "Destination Options Header Support"
	default y
	---help---
	  6LoWPAN IPv6 Destination Options Header compression according to
	  RFC6282.

config 6LOWPAN_NHC_FRAGMENT
	tristate "Fragment Header Support"
	default y
	---help---
	  6LoWPAN IPv6 Fragment Header compression according to RFC6282.

config 6LOWPAN_NHC_HOP
	tristate "Hop-by-Hop Options Header Support"
	default y
	---help---
	  6LoWPAN IPv6 Hop-by-Hop Options Header compression according to
	  RFC6282.

config 6LOWPAN_NHC_IPV6
	tristate "IPv6 Header Support"
	default y
	---help---
	  6LoWPAN IPv6 Header compression according to RFC6282.

config 6LOWPAN_NHC_MOBILITY
	tristate "Mobility Header Support"
	default y
	---help---
	  6LoWPAN IPv6 Mobility Header compression according to RFC6282.

config 6LOWPAN_NHC_ROUTING
	tristate "Routing Header Support"
	default y
	---help---
	  6LoWPAN IPv6 Routing Header compression according to RFC6282.

config 6LOWPAN_NHC_UDP
	tristate "UDP Header Support"
	default y
	---help---
	  6LoWPAN IPv6 UDP Header compression according to RFC6282.

config 6LOWPAN_GHC_EXT_HDR_HOP
	tristate "GHC Hop-by-Hop Options Header Support"
	---help---
	  6LoWPAN IPv6 Hop-by-Hop option generic header compression according
	  to RFC7400.

config 6LOWPAN_GHC_UDP
	tristate "GHC UDP Support"
	---help---
	  6LoWPAN IPv6 UDP generic header compression according to RFC7400.

config 6LOWPAN_GHC_ICMPV6
	tristate "GHC ICMPv6 Support"
	---help---
	  6LoWPAN IPv6 ICMPv6 generic header compression according to RFC7400.

config 6LOWPAN_GHC_EXT_HDR_DEST
	tristate "GHC Destination Options Header Support"
	---help---
	  6LoWPAN IPv6 destination option generic header compression according
	  to RFC7400.

config 6LOWPAN_GHC_EXT_HDR_FRAG
	tristate "GHC Fragmentation Options Header Support"
	---help---
	  6LoWPAN IPv6 fragmentation option generic header compression
	  according to RFC7400.

config 6LOWPAN_GHC_EXT_HDR_ROUTE
	tristate "GHC Routing Options Header Support"
	---help---
	  6LoWPAN IPv6 routing option generic header compression according
	  to RFC7400.

endif
```

## net/802/Kconfig
```kconfig
# SPDX-License-Identifier: GPL-2.0-only
config STP
	tristate
	select LLC

config GARP
	tristate
	select STP

config MRP
	tristate
```

## net/8021q/Kconfig
```kconfig
#
# Configuration for 802.1Q VLAN support
#

config VLAN_8021Q
	tristate "802.1Q/802.1ad VLAN Support"
	---help---
	  Select this and you will be able to create 802.1Q VLAN interfaces
	  on your ethernet interfaces.  802.1Q VLAN supports almost
	  everything a regular ethernet interface does, including
	  firewalling, bridging, and of course IP traffic.  You will need
	  the 'vconfig' tool from the VLAN project in order to effectively
	  use VLANs.  See the VLAN web page for more information:
	  <http://www.candelatech.com/~greear/vlan.html>

	  To compile this code as a module, choose M here: the module
	  will be called 8021q.

	  If unsure, say N.

config VLAN_8021Q_GVRP
	bool "GVRP (GARP VLAN Registration Protocol) support"
	depends on VLAN_8021Q
	select GARP
	help
	  Select this to enable GVRP end-system support. GVRP is used for
	  automatic propagation of registered VLANs to switches.

	  If unsure, say N.

config VLAN_8021Q_MVRP
	bool "MVRP (Multiple VLAN Registration Protocol) support"
	depends on VLAN_8021Q
	select MRP
	help
	  Select this to enable MVRP end-system support. MVRP is used for
	  automatic propagation of registered VLANs to switches; it
	  supersedes GVRP and is not backwards-compatible.

	  If unsure, say N.
```

## net/9p/Kconfig
```kconfig
# SPDX-License-Identifier: GPL-2.0-only
#
# 9P protocol configuration
#

menuconfig NET_9P
	tristate "Plan 9 Resource Sharing Support (9P2000)"
	select NETFS_SUPPORT
	help
	  If you say Y here, you will get experimental support for
	  Plan 9 resource sharing via the 9P2000 protocol.

	  See <http://v9fs.sf.net> for more information.

	  If unsure, say N.

if NET_9P

config NET_9P_FD
	default NET_9P
	imply INET
	imply UNIX
	tristate "9P FD Transport"
	help
	  This builds support for transports over TCP, Unix sockets and
	  filedescriptors.

config NET_9P_VIRTIO
	depends on VIRTIO
	tristate "9P Virtio Transport"
	help
	  This builds support for a transports between
	  guest partitions and a host partition.

config NET_9P_XEN
	depends on XEN
	select XEN_XENBUS_FRONTEND
	tristate "9P Xen Transport"
	help
	  This builds support for a transport for 9pfs between
	  two Xen domains.

config NET_9P_USBG
	tristate "9P USB Gadget Transport"
	depends on USB_GADGET
	select CONFIGFS_FS
	select USB_LIBCOMPOSITE
	help
	  This builds support for a transport for 9pfs over
	  usb gadget.

config NET_9P_RDMA
	depends on INET && INFINIBAND && INFINIBAND_ADDR_TRANS
	tristate "9P RDMA Transport (Experimental)"
	help
	  This builds support for an RDMA transport.

config NET_9P_DEBUG
	bool "Debug information"
	help
	  Say Y if you want the 9P subsystem to log debug information.

endif
```
