## sound/hda/codecs/realtek/Kconfig
```kconfig
# SPDX-License-Identifier: GPL-2.0-only

menuconfig SND_HDA_CODEC_REALTEK
	tristate "Realtek HD-audio codec support"
	help
	  Say Y or M here to include Realtek HD-audio codec support.

	  This will enable all Realtek HD-audio codec drivers as default,
	  but you can enable/disable each codec driver individually, too
	  (only when CONFIG_EXPERT is set).

if SND_HDA_CODEC_REALTEK

config SND_HDA_CODEC_REALTEK_LIB
	tristate
	select SND_HDA_GENERIC
	select SND_HDA_GENERIC_LEDS
	select SND_HDA_SCODEC_COMPONENT

config SND_HDA_CODEC_ALC260
	tristate "Build Realtek ALC260 HD-audio codec support" if EXPERT
	depends on INPUT
	select SND_HDA_CODEC_REALTEK_LIB
	default y
	help
	  Say Y or M here to include Realtek ALC260 HD-audio codec support

config SND_HDA_CODEC_ALC262
	tristate "Build Realtek ALC262 HD-audio codec support" if EXPERT
	depends on INPUT
	select SND_HDA_CODEC_REALTEK_LIB
	default y
	help
	  Say Y or M here to include Realtek ALC262 HD-audio codec support

config SND_HDA_CODEC_ALC268
	tristate "Build Realtek ALC268 HD-audio codec support" if EXPERT
	depends on INPUT
	select SND_HDA_CODEC_REALTEK_LIB
	default y
	help
	  Say Y or M here to include Realtek ALC268 and compatible HD-audio
	  codec support

config SND_HDA_CODEC_ALC269
	tristate "Build Realtek ALC269 HD-audio codecs support" if EXPERT
	depends on INPUT
	select SND_HDA_CODEC_REALTEK_LIB
	default y
	help
	  Say Y or M here to include Realtek ALC269 and compatible HD-audio
	  codec support

config SND_HDA_CODEC_ALC662
	tristate "Build Realtek ALC662 HD-audio codecs support" if EXPERT
	depends on INPUT
	select SND_HDA_CODEC_REALTEK_LIB
	default y
	help
	  Say Y or M here to include Realtek ALC662 and compatible HD-audio
	  codec support

config SND_HDA_CODEC_ALC680
	tristate "Build Realtek ALC680 HD-audio codecs support" if EXPERT
	depends on INPUT
	select SND_HDA_CODEC_REALTEK_LIB
	default y
	help
	  Say Y or M here to include Realtek ALC680 HD-audio codec support

config SND_HDA_CODEC_ALC861
	tristate "Build Realtek ALC861 HD-audio codecs support" if EXPERT
	depends on INPUT
	select SND_HDA_CODEC_REALTEK_LIB
	default y
	help
	  Say Y or M here to include Realtek ALC861 HD-audio codec support

config SND_HDA_CODEC_ALC861VD
	tristate "Build Realtek ALC861-VD HD-audio codecs support" if EXPERT
	depends on INPUT
	select SND_HDA_CODEC_REALTEK_LIB
	default y
	help
	  Say Y or M here to include Realtek ALC861-VD HD-audio codec support

config SND_HDA_CODEC_ALC880
	tristate "Build Realtek ALC880 HD-audio codecs support" if EXPERT
	depends on INPUT
	select SND_HDA_CODEC_REALTEK_LIB
	default y
	help
	  Say Y or M here to include Realtek ALC880 HD-audio codec support

config SND_HDA_CODEC_ALC882
	tristate "Build Realtek ALC882 HD-audio codecs support" if EXPERT
	depends on INPUT
	select SND_HDA_CODEC_REALTEK_LIB
	default y
	help
	  Say Y or M here to include Realtek ALC882 and compatible HD-audio
	  codec support

endif
```

## sound/hda/codecs/side-codecs/Kconfig
```kconfig
config SND_HDA_CIRRUS_SCODEC
	tristate

config SND_HDA_CIRRUS_SCODEC_KUNIT_TEST
	tristate "KUnit test for Cirrus side-codec library" if !KUNIT_ALL_TESTS
	depends on SND_HDA_CIRRUS_SCODEC && GPIOLIB && KUNIT
	default KUNIT_ALL_TESTS
	help
	  This builds KUnit tests for the cirrus side-codec library.
	  For more information on KUnit and unit tests in general,
	  please refer to the KUnit documentation in
	  Documentation/dev-tools/kunit/.
	  If in doubt, say "N".

config SND_HDA_SCODEC_CS35L41
	tristate
	select SND_HDA_GENERIC
	select REGMAP_IRQ
	select FW_CS_DSP

config SND_HDA_SCODEC_COMPONENT
	tristate

config SND_HDA_SCODEC_CS35L41_I2C
	tristate "Build CS35L41 HD-audio side codec support for I2C Bus"
	depends on I2C
	depends on ACPI
	depends on EFI
	depends on SND_SOC
	select SND_SOC_CS35L41_LIB
	select SND_HDA_SCODEC_CS35L41
	select SND_SOC_CS_AMP_LIB
	help
	  Say Y or M here to include CS35L41 I2C HD-audio side codec support
	  in snd-hda-intel driver, such as ALC287.

comment "Set to Y if you want auto-loading the side codec driver"
	depends on SND_HDA=y && SND_HDA_SCODEC_CS35L41_I2C=m

config SND_HDA_SCODEC_CS35L41_SPI
	tristate "Build CS35L41 HD-audio codec support for SPI Bus"
	depends on SPI_MASTER
	depends on ACPI
	depends on EFI
	depends on SND_SOC
	select SND_SOC_CS35L41_LIB
	select SND_HDA_SCODEC_CS35L41
	select SND_SOC_CS_AMP_LIB
	help
	  Say Y or M here to include CS35L41 SPI HD-audio side codec support
	  in snd-hda-intel driver, such as ALC287.

comment "Set to Y if you want auto-loading the side codec driver"
	depends on SND_HDA=y && SND_HDA_SCODEC_CS35L41_SPI=m

config SND_HDA_SCODEC_CS35L56
	tristate

config SND_HDA_SCODEC_CS35L56_I2C
	tristate "Build CS35L56 HD-audio side codec support for I2C Bus"
	depends on I2C
	depends on ACPI
	depends on SND_SOC
	select FW_CS_DSP
	imply SERIAL_MULTI_INSTANTIATE
	select SND_HDA_GENERIC
	select SND_SOC_CS35L56_SHARED
	select SND_HDA_SCODEC_CS35L56
	select SND_HDA_CIRRUS_SCODEC
	select SND_SOC_CS_AMP_LIB
	help
	  Say Y or M here to include CS35L56 amplifier support with
	  I2C control.

config SND_HDA_SCODEC_CS35L56_SPI
	tristate "Build CS35L56 HD-audio side codec support for SPI Bus"
	depends on SPI_MASTER
	depends on ACPI
	depends on SND_SOC
	select FW_CS_DSP
	imply SERIAL_MULTI_INSTANTIATE
	select SND_HDA_GENERIC
	select SND_SOC_CS35L56_SHARED
	select SND_HDA_SCODEC_CS35L56
	select SND_HDA_CIRRUS_SCODEC
	select SND_SOC_CS_AMP_LIB
	help
	  Say Y or M here to include CS35L56 amplifier support with
	  SPI control.

config SND_HDA_SCODEC_TAS2781
	tristate
	select SND_HDA_GENERIC

config SND_HDA_SCODEC_TAS2781_I2C
	tristate "Build TAS2781 HD-audio side codec support for I2C Bus"
	depends on I2C
	depends on ACPI
	depends on EFI
	depends on SND_SOC
	select SND_HDA_SCODEC_TAS2781
	select SND_SOC_TAS2781_COMLIB_I2C
	select SND_SOC_TAS2781_FMWLIB
	select CRC32
	help
	  Say Y or M here to include TAS2781 I2C HD-audio side codec support
	  in snd-hda-intel driver, such as ALC287.

comment "Set to Y if you want auto-loading the side codec driver"
	depends on SND_HDA=y && SND_HDA_SCODEC_TAS2781_I2C=m

config SND_HDA_SCODEC_TAS2781_SPI
	tristate "Build TAS2781 HD-audio side codec support for SPI Bus"
	depends on SPI_MASTER
	depends on ACPI
	depends on EFI
	depends on SND_SOC
	select SND_HDA_SCODEC_TAS2781
	select SND_SOC_TAS2781_COMLIB
	select SND_SOC_TAS2781_FMWLIB
	select CRC8
	select CRC32
	help
	  Say Y or M here to include TAS2781 SPI HD-audio side codec support
	  in snd-hda-intel driver, such as ALC287.

comment "Set to Y if you want auto-loading the side codec driver"
	depends on SND_HDA=y && SND_HDA_SCODEC_TAS2781_SPI=m
```

## sound/hda/common/Kconfig
```kconfig
# SPDX-License-Identifier: GPL-2.0-only

config SND_HDA
	tristate
	select SND_PCM
	select SND_VMASTER
	select SND_JACK
	select SND_HDA_CORE

if SND_HDA

config SND_HDA_HWDEP
	bool "Build hwdep interface for HD-audio driver"
	select SND_HWDEP
	help
	  Say Y here to build a hwdep interface for HD-audio driver.
	  This interface can be used for out-of-band communication
	  with codecs for debugging purposes.

config SND_HDA_RECONFIG
	bool "Allow dynamic codec reconfiguration"
	help
	  Say Y here to enable the HD-audio codec re-configuration feature.
	  It allows user to clear the whole codec configuration, change the
	  codec setup, add extra verbs, and re-configure the codec dynamically.

	  Note that this item alone doesn't provide the sysfs interface, but
	  enables the feature just for the patch loader below.
	  If you need the traditional sysfs entries for the manual interaction,
	  turn on CONFIG_SND_HDA_HWDEP as well.

config SND_HDA_INPUT_BEEP
	bool "Support digital beep via input layer"
	depends on INPUT=y || INPUT=SND_HDA
	help
	  Say Y here to build a digital beep interface for HD-audio
	  driver. This interface is used to generate digital beeps.

config SND_HDA_INPUT_BEEP_MODE
	int "Digital beep registration mode (0=off, 1=on)"
	depends on SND_HDA_INPUT_BEEP=y
	default "1"
	range 0 1
	help
	  Set 0 to disable the digital beep interface for HD-audio by default.
	  Set 1 to always enable the digital beep interface for HD-audio by
	  default.

config SND_HDA_PATCH_LOADER
	bool "Support initialization patch loading for HD-audio"
	select FW_LOADER
	select SND_HDA_RECONFIG
	help
	  Say Y here to allow the HD-audio driver to load a pseudo
	  firmware file ("patch") for overriding the BIOS setup at
	  start up.  The "patch" file can be specified via patch module
	  option, such as patch=hda-init.

config SND_HDA_POWER_SAVE_DEFAULT
	int "Default time-out for HD-audio power-save mode"
	depends on PM
	default 0
	help
	  The default time-out value in seconds for HD-audio automatic
	  power-save mode.  0 means to disable the power-save mode.

config SND_HDA_CTL_DEV_ID
	bool "Use the device identifier field for controls"
	depends on SND_HDA_INTEL
	help
	  Say Y to use the device identifier field for (mixer)
	  controls (old behaviour until this option is available).

	  When enabled, the multiple HDA codecs may set the device
	  field in control (mixer) element identifiers. The use
	  of this field is not recommended and defined for mixer controls.

	  The old behaviour (Y) is obsolete and will be removed. Consider
	  to not enable this option.

config SND_HDA_PREALLOC_SIZE
	int "Pre-allocated buffer size for HD-audio driver"
	range 0 32768
	default 0 if SND_DMA_SGBUF
	default 64 if !SND_DMA_SGBUF
	help
	  Specifies the default pre-allocated buffer-size in kB for the
	  HD-audio driver.  A larger buffer (e.g. 2048) is preferred
	  for systems using PulseAudio.  The default 64 is chosen just
	  for compatibility reasons.
	  On x86 systems, the default is zero as S/G allocation works
	  and no preallocation is needed in most cases.

	  Note that the pre-allocation size can be changed dynamically
	  via a proc file (/proc/asound/card*/pcm*/sub*/prealloc), too.

endif
```

## sound/hda/controllers/Kconfig
```kconfig
# SPDX-License-Identifier: GPL-2.0-only
config SND_HDA_INTEL
	tristate "HD Audio PCI"
	depends on SND_PCI
	select SND_HDA
	select SND_INTEL_DSP_CONFIG
	help
	  Say Y here to include support for Intel "High Definition
	  Audio" (Azalia) and its compatible devices.

	  This option enables the HD-audio controller.  Don't forget
	  to choose the appropriate HD-audio codec options.

	  To compile this driver as a module, choose M here: the module
	  will be called snd-hda-intel.

config SND_HDA_TEGRA
	tristate "NVIDIA Tegra HD Audio"
	depends on ARCH_TEGRA
	select SND_HDA
	select SND_HDA_ALIGNED_MMIO
	help
	  Say Y here to support the HDA controller present in NVIDIA
	  Tegra SoCs

	  This options enables support for the HD Audio controller
	  present in some NVIDIA Tegra SoCs, used to communicate audio
	  to the HDMI output.

	  To compile this driver as a module, choose M here: the module
	  will be called snd-hda-tegra.

config SND_HDA_ACPI
	tristate "HD Audio ACPI"
	depends on ACPI
	select SND_HDA
	help
	  Say Y here to include support for Azalia-compatible HDA controllers
	  which are advertised via ACPI objects.

	  To compile this driver as a module, choose M here: the module
	  will be called snd-hda-acpi.
```
