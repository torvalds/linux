## sound/firewire/Kconfig
```kconfig
# SPDX-License-Identifier: GPL-2.0-only
menuconfig SND_FIREWIRE
	bool "FireWire sound devices"
	depends on FIREWIRE
	default y
	help
	  Support for IEEE-1394/FireWire/iLink sound devices.

if SND_FIREWIRE && FIREWIRE

config SND_FIREWIRE_LIB
	tristate
	select SND_PCM
	select SND_RAWMIDI

config SND_DICE
	tristate "DICE-based DACs support"
	select SND_HWDEP
	select SND_FIREWIRE_LIB
	help
	  Say Y here to include support for many DACs based on the DICE
	  chip family (DICE-II/Jr/Mini) which TC Applied Technologies produces.

	  To compile this driver as a module, choose M here: the module
	  will be called snd-dice.

config SND_OXFW
	tristate "Oxford Semiconductor FW970/971 chipset support"
	select SND_FIREWIRE_LIB
	select SND_HWDEP
	help
	  Say Y here to include support for FireWire devices based on
	  Oxford Semiconductor FW970/971 chipset.
	   * Griffin Firewave
	   * LaCie Firewire Speakers
	   * Behringer F-Control Audio 202
	   * Mackie(Loud) Onyx-i series (former models)
	   * Mackie(Loud) Onyx 1640i (former model)
	   * Mackie(Loud) Onyx Satellite
	   * Mackie(Loud) Tapco Link.Firewire
	   * Mackie(Loud) d.4 pro
	   * Mackie(Loud) U.420/U.420d
	   * TASCAM FireOne
	   * Stanton Controllers & Systems 1 Deck/Mixer
	   * APOGEE duet FireWire

	  To compile this driver as a module, choose M here: the module
	  will be called snd-oxfw.

config SND_ISIGHT
	tristate "Apple iSight microphone"
	select SND_FIREWIRE_LIB
	help
	  Say Y here to include support for the front and rear microphones
	  of the Apple iSight web camera.

	  To compile this driver as a module, choose M here: the module
	  will be called snd-isight.

config SND_FIREWORKS
	tristate "Echo Fireworks board module support"
	select SND_FIREWIRE_LIB
	select SND_HWDEP
	help
	  Say Y here to include support for FireWire devices based
	  on Echo Digital Audio Fireworks board:
	   * Mackie Onyx 400F/1200F
	   * Echo AudioFire12/8(until 2009 July)
	   * Echo AudioFire2/4/Pre8/8(since 2009 July)
	   * Echo Fireworks 8/HDMI
	   * Gibson Robot Interface Pack/GoldTop

	  To compile this driver as a module, choose M here: the module
	  will be called snd-fireworks.

config SND_BEBOB
	tristate "BridgeCo DM1000/DM1100/DM1500 with BeBoB firmware"
	select SND_FIREWIRE_LIB
	select SND_HWDEP
	help
	 Say Y here to include support for FireWire devices based
	 on BridgeCo DM1000/DM1100/DM1500 with BeBoB firmware:
	  * Edirol FA-66/FA-101
	  * PreSonus FIREBOX/FIREPOD/FP10/Inspire1394
	  * BridgeCo RDAudio1/Audio5
	  * Mackie Onyx 1220/1620/1640 (FireWire I/O Card)
	  * Mackie d.2 (FireWire Option) and d.2 Pro
	  * Stanton FinalScratch 2 (ScratchAmp)
	  * Tascam IF-FW/DM
	  * Behringer XENIX UFX 1204/1604
	  * Behringer Digital Mixer X32 series (X-UF Card)
	  * Behringer FCA610/1616
	  * Apogee Rosetta 200/400 (X-FireWire card)
	  * Apogee DA/AD/DD-16X (X-FireWire card)
	  * Apogee Ensemble
	  * ESI QuataFire 610
	  * AcousticReality eARMasterOne
	  * CME MatrixKFW
	  * Phonic Helix Board 12 MkII/18 MkII/24 MkII
	  * Phonic Helix Board 12 Universal/18 Universal/24 Universal
	  * Lynx Aurora 8/16 (LT-FW)
	  * ICON FireXon
	  * PrismSound Orpheus/ADA-8XR
	  * TerraTec PHASE 24 FW/PHASE X24 FW/PHASE 88 Rack FW
	  * TerraTec EWS MIC2/EWS MIC8
	  * TerraTec Aureon 7.1 FireWire
	  * Yamaha GO44/GO46
	  * Focusrite Saffire/Saffire LE/SaffirePro10 IO/SaffirePro26 IO
	  * M-Audio FireWire410/AudioPhile/Solo
	  * M-Audio Ozonic/NRV10/ProfireLightBridge
	  * M-Audio FireWire 1814/ProjectMix IO
	  * Digidesign Mbox 2 Pro

	  To compile this driver as a module, choose M here: the module
	  will be called snd-bebob.

config SND_FIREWIRE_DIGI00X
	tristate "Digidesign Digi 002/003 family support"
	select SND_FIREWIRE_LIB
	select SND_HWDEP
	help
	 Say Y here to include support for Digidesign Digi 002/003 family.
	  * Digi 002 Console
	  * Digi 002 Rack
	  * Digi 003 Console
	  * Digi 003 Rack
	  * Digi 003 Rack+

	 To compile this driver as a module, choose M here: the module
	 will be called snd-firewire-digi00x.

config SND_FIREWIRE_TASCAM
	tristate "TASCAM FireWire series support"
	select SND_FIREWIRE_LIB
	select SND_HWDEP
	help
	 Say Y here to include support for TASCAM.
	  * FW-1884
	  * FW-1082
	  * FW-1804

	 To compile this driver as a module, choose M here: the module
	 will be called snd-firewire-tascam.

config SND_FIREWIRE_MOTU
	tristate "Mark of the unicorn FireWire series support"
	select SND_FIREWIRE_LIB
	select SND_HWDEP
	help
	 Say Y here to enable support for FireWire devices which MOTU produced:
	  * 828mk2
	  * Traveler
	  * Ultralite
	  * 8pre
	  * 828mk3 (FireWire only)
	  * 828mk3 (Hybrid)
	  * Audio Express
	  * 4pre

	 To compile this driver as a module, choose M here: the module
	 will be called snd-firewire-motu.

config SND_FIREFACE
	tristate "RME Fireface series support"
	select SND_FIREWIRE_LIB
	select SND_HWDEP
	help
	 Say Y here to include support for RME fireface series.
	  * Fireface 400
	  * Fireface 800
	  * Fireface UFX
	  * Fireface UCX
	  * Fireface 802

endif # SND_FIREWIRE
```

## sound/hda/Kconfig
```kconfig
# SPDX-License-Identifier: GPL-2.0-only
menu "HD-Audio"

source "sound/hda/common/Kconfig"
source "sound/hda/controllers/Kconfig"
source "sound/hda/codecs/Kconfig"
source "sound/hda/core/Kconfig"

endmenu
```

## sound/hda/codecs/Kconfig
```kconfig
# SPDX-License-Identifier: GPL-2.0-only
if SND_HDA

config SND_HDA_GENERIC_LEDS
       bool

config SND_HDA_CODEC_ANALOG
	tristate "Build Analog Devices HD-audio codec support"
	select SND_HDA_GENERIC
	help
	  Say Y or M here to include Analog Devices HD-audio codec support in
	  snd-hda-intel driver, such as AD1986A.

comment "Set to Y if you want auto-loading the codec driver"
	depends on SND_HDA=y && SND_HDA_CODEC_ANALOG=m

config SND_HDA_CODEC_SIGMATEL
	tristate "Build IDT/Sigmatel HD-audio codec support"
	select SND_HDA_GENERIC
	select SND_HDA_GENERIC_LEDS
	help
	  Say Y or M here to include IDT (Sigmatel) HD-audio codec support in
	  snd-hda-intel driver, such as STAC9200.

comment "Set to Y if you want auto-loading the codec driver"
	depends on SND_HDA=y && SND_HDA_CODEC_SIGMATEL=m

config SND_HDA_CODEC_VIA
	tristate "Build VIA HD-audio codec support"
	select SND_HDA_GENERIC
	help
	  Say Y or M here to include VIA HD-audio codec support in
	  snd-hda-intel driver, such as VT1708.

comment "Set to Y if you want auto-loading the codec driver"
	depends on SND_HDA=y && SND_HDA_CODEC_VIA=m

config SND_HDA_CODEC_CONEXANT
	tristate "Build Conexant HD-audio codec support"
	select SND_HDA_GENERIC
	select SND_HDA_GENERIC_LEDS
	help
	  Say Y or M here to include Conexant HD-audio codec support in
	  snd-hda-intel driver, such as CX20549.

comment "Set to Y if you want auto-loading the codec driver"
	depends on SND_HDA=y && SND_HDA_CODEC_CONEXANT=m

config SND_HDA_CODEC_SENARYTECH
	tristate "Build Senarytech HD-audio codec support"
	select SND_HDA_GENERIC
	select SND_HDA_GENERIC_LEDS
	help
	  Say Y or M here to include Senarytech HD-audio codec support in
	  snd-hda-intel driver, such as SN6186.

comment "Set to Y if you want auto-loading the codec driver"
	depends on SND_HDA=y && SND_HDA_CODEC_SENARYTECH=m

config SND_HDA_CODEC_CA0110
	tristate "Build Creative CA0110-IBG codec support"
	select SND_HDA_GENERIC
	help
	  Say Y or M here to include Creative CA0110-IBG codec support in
	  snd-hda-intel driver, found on some Creative X-Fi cards.

comment "Set to Y if you want auto-loading the codec driver"
	depends on SND_HDA=y && SND_HDA_CODEC_CA0110=m

config SND_HDA_CODEC_CA0132
	tristate "Build Creative CA0132 codec support"
	help
	  Say Y or M here to include Creative CA0132 codec support in
	  snd-hda-intel driver.

comment "Set to Y if you want auto-loading the codec driver"
	depends on SND_HDA=y && SND_HDA_CODEC_CA0132=m

config SND_HDA_CODEC_CA0132_DSP
	bool "Support new DSP code for CA0132 codec"
	depends on SND_HDA_CODEC_CA0132
	default y
	select SND_HDA_DSP_LOADER
	select FW_LOADER
	help
	  Say Y here to enable the DSP for Creative CA0132 for extended
	  features like equalizer or echo cancellation.

	  Note that this option requires the external firmware file
	  (ctefx.bin).

config SND_HDA_CODEC_CMEDIA
	tristate "Build C-Media HD-audio codec support"
	select SND_HDA_GENERIC
	help
	  Say Y or M here to include C-Media HD-audio codec support in
	  snd-hda-intel driver, such as CMI9880.

comment "Set to Y if you want auto-loading the codec driver"
	depends on SND_HDA=y && SND_HDA_CODEC_CMEDIA=m

config SND_HDA_CODEC_CM9825
	tristate "Build C-Media CM9825 HD-audio codec support"
	select SND_HDA_GENERIC
	help
	  Say Y or M here to include C-Media CM9825 HD-audio codec support in
	  snd-hda-intel driver

comment "Set to Y if you want auto-loading the codec driver"
	depends on SND_HDA=y && SND_HDA_CODEC_CM9825=m

config SND_HDA_CODEC_SI3054
	tristate "Build Silicon Labs 3054 HD-modem codec support"
	help
	  Say Y or M here to include Silicon Labs 3054 HD-modem codec
	  (and compatibles) support in snd-hda-intel driver.

comment "Set to Y if you want auto-loading the codec driver"
	depends on SND_HDA=y && SND_HDA_CODEC_SI3054=m

config SND_HDA_GENERIC
	tristate "Enable generic HD-audio codec parser"
	select SND_CTL_LED if SND_HDA_GENERIC_LEDS
	select LEDS_CLASS if SND_HDA_GENERIC_LEDS
	help
	  Say Y or M here to enable the generic HD-audio codec parser
	  in snd-hda-intel driver.

comment "Set to Y if you want auto-loading the codec driver"
	depends on SND_HDA=y && SND_HDA_GENERIC=m

source "sound/hda/codecs/realtek/Kconfig"
source "sound/hda/codecs/cirrus/Kconfig"
source "sound/hda/codecs/hdmi/Kconfig"
source "sound/hda/codecs/side-codecs/Kconfig"

endif # SND_HDA
```

## sound/hda/codecs/cirrus/Kconfig
```kconfig
# SPDX-License-Identifier: GPL-2.0-only

menuconfig SND_HDA_CODEC_CIRRUS
	tristate "Cirrus Logic HD-audio codec support"
	help
	  Say Y or M here to include Cirrus Logic HD-audio codec support.

	  This will enable both CS420x and CS421x HD-audio codec drivers
	  as default, but you can enable/disable each codec driver
	  individually, too (only when CONFIG_EXPERT is set).

if SND_HDA_CODEC_CIRRUS

config SND_HDA_CODEC_CS420X
	tristate "Build Cirrus Logic CS420x codec support" if EXPERT
	select SND_HDA_GENERIC
	default y
	help
	  Say Y or M here to include Cirrus Logic CS420x codec support

comment "Set to Y if you want auto-loading the codec driver"
	depends on SND_HDA=y && SND_HDA_CODEC_CS420X=m

config SND_HDA_CODEC_CS421X
	tristate "Build Cirrus Logic CS421x codec support" if EXPERT
	select SND_HDA_GENERIC
	default y
	help
	  Say Y or M here to include Cirrus Logic CS421x codec support

comment "Set to Y if you want auto-loading the codec driver"
	depends on SND_HDA=y && SND_HDA_CODEC_CS421X=m

config SND_HDA_CODEC_CS8409
	tristate "Build Cirrus Logic HDA bridge support"
	select SND_HDA_GENERIC
	help
	  Say Y or M here to include Cirrus Logic HDA bridge support
	  such as CS8409.

comment "Set to Y if you want auto-loading the codec driver"
	depends on SND_HDA=y && SND_HDA_CODEC_CS8409=m

endif
```

## sound/hda/codecs/hdmi/Kconfig
```kconfig
# SPDX-License-Identifier: GPL-2.0-only

menuconfig SND_HDA_CODEC_HDMI
	tristate "HD-audio HDMI codec support"
	help
	  Say Y or M here to include HD-audio HDMI/DislayPort codec support.

	  This will enable all HDMI/DP codec drivers as default, but you can
	  enable/disable each codec driver individually, too (only when
	  CONFIG_EXPERT is set).

if SND_HDA_CODEC_HDMI

config SND_HDA_CODEC_HDMI_GENERIC
	tristate "Generic HDMI/DisplayPort HD-audio codec support" if EXPERT
	select SND_DYNAMIC_MINORS
	select SND_PCM_ELD
	default y
	help
	  Say Y or M here to include Generic HDMI and DisplayPort HD-audio
	  codec support.

	  Note that this option mandatorily enables CONFIG_SND_DYNAMIC_MINORS
	  to assure the multiple streams for DP-MST support.

config SND_HDA_CODEC_HDMI_SIMPLE
	tristate "Simple HDMI/DisplayPort HD-audio codec support" if EXPERT
	default y
	help
	  Say Y or M here to include Simple HDMI and DisplayPort HD-audio
	  codec support for VIA and other codecs.

config SND_HDA_CODEC_HDMI_INTEL
	tristate "Intel HDMI/DisplayPort HD-audio codec support" if EXPERT
	select SND_HDA_CODEC_HDMI_GENERIC
	default y
	help
	  Say Y or M here to include Intel graphics HDMI and DisplayPort
	  HD-audio codec support.

config SND_HDA_INTEL_HDMI_SILENT_STREAM
	bool "Enable Silent Stream always for HDMI"
	depends on SND_HDA_CODEC_HDMI_INTEL
	help
	  Say Y to enable HD-Audio Keep Alive (KAE) aka Silent Stream
	  for HDMI on hardware that supports the feature.

	  When enabled, the HDMI/DisplayPort codec will continue to provide
	  a continuous clock and a valid but silent data stream to
	  any connected external receiver. This allows to avoid gaps
	  at start of playback. Many receivers require multiple seconds
	  to start playing audio after the clock has been stopped.
	  This feature can impact power consumption as resources
	  are kept reserved both at transmitter and receiver.

config SND_HDA_CODEC_HDMI_ATI
	tristate "AMD/ATI HDMI/DisplayPort HD-audio codec support" if EXPERT
	select SND_HDA_CODEC_HDMI_GENERIC
	default y
	help
	  Say Y or M here to include AMD/ATI graphics HDMI and DisplayPort
	  HD-audio codec support.

config SND_HDA_CODEC_HDMI_NVIDIA
	tristate "Nvidia HDMI/DisplayPort HD-audio codec support" if EXPERT
	select SND_HDA_CODEC_HDMI_GENERIC
	default y
	help
	  Say Y or M here to include HDMI and DisplayPort HD-audio codec
	  support for the recent Nvidia graphics cards.

config SND_HDA_CODEC_HDMI_NVIDIA_MCP
	tristate "Legacy Nvidia HDMI/DisplayPort HD-audio codec support" if EXPERT
	select SND_HDA_CODEC_HDMI_SIMPLE
	default y
	help
	  Say Y or M here to include HDMI and DisplayPort HD-audio codec
	  support for the legacy Nvidia graphics like MCP73, MCP67, MCP77/78.

config SND_HDA_CODEC_HDMI_TEGRA
	tristate "Nvidia Tegra HDMI/DisplayPort HD-audio codec support" if EXPERT
	select SND_HDA_CODEC_HDMI_GENERIC
	default y
	help
	  Say Y or M here to include HDMI and DisplayPort HD-audio codec
	  support for Nvidia Tegra.

endif
```
