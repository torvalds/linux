## security/timgad/Kconfig
```kconfig
config SECURITY_TIMGAD
	bool "TIMGAD support"
	depends on SECURITY
	default n
	help
	  This selects TIMGAD, which applies restrictions on module auto-loading
          feature. Further information can be found in
          Documentation/security/timgad.txt.

	  If you are unsure how to answer this question, answer N.
```

## security/tlk_driver/Kconfig
```kconfig
config TRUSTED_LITTLE_KERNEL
	bool "Enable Open Trusted Execution driver"
	depends on ARM_TRUSTZONE
	default y
	help
	  This option adds kernel support for communication with the
	  Trusted LK secure OS monitor/runtime support.
	  If you are unsure how to answer this question, answer N.

config TRUST_OS_LOGGER
	bool "Enable TLK logs in linux kmsg"
	depends on TRUSTED_LITTLE_KERNEL
	default y
	help
	 This option adds support in the kernel driver to read the logs
	 from the secure world and make them available as a part of kmsg.
```

## security/tomoyo/Kconfig
```kconfig
# SPDX-License-Identifier: GPL-2.0-only
config SECURITY_TOMOYO
	bool "TOMOYO Linux Support"
	depends on SECURITY
	depends on NET
	select SECURITYFS
	select SECURITY_PATH
	select SECURITY_NETWORK
	default n
	help
	  This selects TOMOYO Linux, pathname-based access control.
	  Required userspace tools and further information may be
	  found at <https://tomoyo.sourceforge.net/>.
	  If you are unsure how to answer this question, answer N.

config SECURITY_TOMOYO_MAX_ACCEPT_ENTRY
	int "Default maximal count for learning mode"
	default 2048
	range 0 2147483647
	depends on SECURITY_TOMOYO
	help
	  This is the default value for maximal ACL entries
	  that are automatically appended into policy at "learning mode".
	  Some programs access thousands of objects, so running
	  such programs in "learning mode" dulls the system response
	  and consumes much memory.
	  This is the safeguard for such programs.

config SECURITY_TOMOYO_MAX_AUDIT_LOG
	int "Default maximal count for audit log"
	default 1024
	range 0 2147483647
	depends on SECURITY_TOMOYO
	help
	  This is the default value for maximal entries for
	  audit logs that the kernel can hold on memory.
	  You can read the log via /sys/kernel/security/tomoyo/audit.
	  If you don't need audit logs, you may set this value to 0.

config SECURITY_TOMOYO_OMIT_USERSPACE_LOADER
	bool "Activate without calling userspace policy loader."
	default n
	depends on SECURITY_TOMOYO
	help
	  Say Y here if you want to activate access control as soon as built-in
	  policy was loaded. This option will be useful for systems where
	  operations which can lead to the hijacking of the boot sequence are
	  needed before loading the policy. For example, you can activate
	  immediately after loading the fixed part of policy which will allow
	  only operations needed for mounting a partition which contains the
	  variant part of policy and verifying (e.g. running GPG check) and
	  loading the variant part of policy. Since you can start using
	  enforcing mode from the beginning, you can reduce the possibility of
	  hijacking the boot sequence.

config SECURITY_TOMOYO_POLICY_LOADER
	string "Location of userspace policy loader"
	default "/sbin/tomoyo-init"
	depends on SECURITY_TOMOYO
	depends on !SECURITY_TOMOYO_OMIT_USERSPACE_LOADER
	help
	  This is the default pathname of policy loader which is called before
	  activation. You can override this setting via TOMOYO_loader= kernel
	  command line option.

config SECURITY_TOMOYO_ACTIVATION_TRIGGER
	string "Trigger for calling userspace policy loader"
	default "/sbin/init"
	depends on SECURITY_TOMOYO
	depends on !SECURITY_TOMOYO_OMIT_USERSPACE_LOADER
	help
	  This is the default pathname of activation trigger.
	  You can override this setting via TOMOYO_trigger= kernel command line
	  option. For example, if you pass init=/bin/systemd option, you may
	  want to also pass TOMOYO_trigger=/bin/systemd option.

config SECURITY_TOMOYO_INSECURE_BUILTIN_SETTING
	bool "Use insecure built-in settings for fuzzing tests."
	default n
	depends on SECURITY_TOMOYO
	select SECURITY_TOMOYO_OMIT_USERSPACE_LOADER
	help
	  Enabling this option forces minimal built-in policy and disables
	  domain/program checks for run-time policy modifications. Please enable
	  this option only if this kernel is built for doing fuzzing tests.
```

## security/whitelist/Kconfig
```kconfig
config SECURITY_WHITELIST
	bool "Whitelist Security Module"
	depends on SECURITY
	depends on NET
	select SECURITYFS
	select SECURITY_PATH
	select SECURITY_NETWORK
	select SRCU
	select BUILD_BIN2C
	default n
	help
	  This selects an attr-based access control.
          Binaries with a particular xattr setting will be
          permitted to be executed by non-root users.
```

## security/yama/Kconfig
```kconfig
# SPDX-License-Identifier: GPL-2.0-only
config SECURITY_YAMA
	bool "Yama support"
	depends on SECURITY
	default n
	help
	  This selects Yama, which extends DAC support with additional
	  system-wide security settings beyond regular Linux discretionary
	  access controls. Currently available is ptrace scope restriction.
	  Like capabilities, this security module stacks with other LSMs.
	  Further information can be found in
	  Documentation/admin-guide/LSM/Yama.rst.

	  If you are unsure how to answer this question, answer N.
```

## sound/Kconfig
```kconfig
menuconfig SOUND
	tristate "Sound card support"
	depends on HAS_IOMEM
	help
	  If you have a sound card in your computer, i.e. if it can say more
	  than an occasional beep, say Y.

if SOUND

config SOUND_OSS_CORE
	bool
	default n

config SOUND_OSS_CORE_PRECLAIM
	bool "Preclaim OSS device numbers"
	depends on SOUND_OSS_CORE
	default y
	help
	  With this option enabled, the kernel will claim all OSS device
	  numbers if any OSS support (native or emulation) is enabled
	  whether the respective module is loaded or not and try to load the
	  appropriate module using sound-slot/service-* and char-major-*
	  module aliases when one of the device numbers is opened.  With
	  this option disabled, kernel will only claim actually in-use
	  device numbers and opening a missing device will generate only the
	  standard char-major-* aliases.

	  The only visible difference is use of additional module aliases
	  and whether OSS sound devices appear multiple times in
	  /proc/devices.  sound-slot/service-* module aliases are scheduled
	  to be removed (ie. PRECLAIM won't be available) and this option is
	  to make the transition easier.  This option can be overridden
	  during boot using the kernel parameter soundcore.preclaim_oss.

	  Disabling this allows alternative OSS implementations.

	  If unsure, say Y.

source "sound/oss/dmasound/Kconfig"

if !UML

menuconfig SND
	tristate "Advanced Linux Sound Architecture"
	help
	  Say 'Y' or 'M' to enable ALSA (Advanced Linux Sound Architecture),
	  the new base sound system.

	  For more information, see <http://www.alsa-project.org/>

if SND

source "sound/core/Kconfig"

source "sound/drivers/Kconfig"

source "sound/isa/Kconfig"

source "sound/pci/Kconfig"

source "sound/hda/Kconfig"

source "sound/ppc/Kconfig"

source "sound/ac97/Kconfig"

source "sound/aoa/Kconfig"

source "sound/arm/Kconfig"

source "sound/atmel/Kconfig"

source "sound/spi/Kconfig"

source "sound/mips/Kconfig"

source "sound/sh/Kconfig"

# the following will depend on the order of config.
# here assuming USB is defined before ALSA
source "sound/usb/Kconfig"

source "sound/firewire/Kconfig"

# the following will depend on the order of config.
# here assuming PCMCIA is defined before ALSA
source "sound/pcmcia/Kconfig"

source "sound/sparc/Kconfig"

source "sound/parisc/Kconfig"

source "sound/soc/Kconfig"

source "sound/x86/Kconfig"

source "sound/synth/Kconfig"

source "sound/xen/Kconfig"

endif # SND

endif # !UML

endif # SOUND

# AC97_BUS is used from both sound and ucb1400
config AC97_BUS
	tristate
	help
	  This is used to avoid config and link hard dependencies between the
	  sound subsystem and other function drivers completely unrelated to
	  sound although they're sharing the AC97 bus. Concerned drivers
	  should "select" this.
```

## sound/ac97/Kconfig
```kconfig
#
# AC97 configuration
#


config AC97_BUS_NEW
	tristate
	select AC97
	help
	  This is the new AC97 bus type, successor of AC97_BUS. The ported
	  drivers which benefit from the AC97 automatic probing should "select"
	  this instead of the AC97_BUS.
	  Say Y here if you want to have AC97 devices, which are sound oriented
	  devices around an AC-Link.

config AC97_BUS_COMPAT
	bool
	depends on AC97_BUS_NEW
	depends on !AC97_BUS
```

## sound/aoa/Kconfig
```kconfig
menuconfig SND_AOA
	tristate "Apple Onboard Audio driver"
	depends on PPC_PMAC
	select SND_PCM
	---help---
	This option enables the new driver for the various
	Apple Onboard Audio components.

if SND_AOA

source "sound/aoa/fabrics/Kconfig"

source "sound/aoa/codecs/Kconfig"

source "sound/aoa/soundbus/Kconfig"

endif	# SND_AOA
```

## sound/aoa/codecs/Kconfig
```kconfig
# SPDX-License-Identifier: GPL-2.0-only
config SND_AOA_ONYX
	tristate "support Onyx chip"
	select I2C
	select I2C_POWERMAC
	help
	This option enables support for the Onyx (pcm3052)
	codec chip found in the latest Apple machines
	(most of those with digital audio output).

config SND_AOA_TAS
	tristate "support TAS chips"
	select I2C
	select I2C_POWERMAC
	help
	This option enables support for the tas chips
	found in a lot of Apple Machines, especially
	iBooks and PowerBooks without digital.

config SND_AOA_TOONIE
	tristate "support Toonie chip"
	help
	This option enables support for the toonie codec
	found in the Mac Mini. If you have a Mac Mini and
	want to hear sound, select this option.
```

## sound/aoa/fabrics/Kconfig
```kconfig
# SPDX-License-Identifier: GPL-2.0-only
config SND_AOA_FABRIC_LAYOUT
	tristate "layout-id fabric"
	select SND_AOA_SOUNDBUS
	select SND_AOA_SOUNDBUS_I2S
	---help---
	This enables the layout-id fabric for the Apple Onboard
	Audio driver, the module holding it all together
	based on the device-tree's layout-id property.
	
	If you are unsure and have a later Apple machine,
	compile it as a module.
```

## sound/aoa/soundbus/Kconfig
```kconfig
config SND_AOA_SOUNDBUS
	tristate "Apple Soundbus support"
	depends on SOUND
	select SND_PCM
	---help---
	This option enables the generic driver for the soundbus
	support on Apple machines.
	
	It is required for the sound bus implementations.

config SND_AOA_SOUNDBUS_I2S
	tristate "I2S bus support"
	depends on SND_AOA_SOUNDBUS && PCI
	---help---
	This option enables support for Apple I2S busses.
```

## sound/arm/Kconfig
```kconfig
# SPDX-License-Identifier: GPL-2.0-only
# ALSA ARM drivers

menuconfig SND_ARM
	bool "ARM sound devices"
	depends on ARM
	default y
	help
	  Support for sound devices specific to ARM architectures.
	  Drivers that are implemented on ASoC can be found in
	  "ALSA for SoC audio support" section.

if SND_ARM

config SND_ARMAACI
	tristate "ARM PrimeCell PL041 AC Link support"
	depends on ARM_AMBA
	select SND_PCM
	select SND_AC97_CODEC

endif	# SND_ARM

config SND_PXA2XX_LIB
	tristate
	select SND_DMAENGINE_PCM

config SND_PXA2XX_LIB_AC97
	bool
```

## sound/atmel/Kconfig
```kconfig
# SPDX-License-Identifier: GPL-2.0-only
menu "Atmel devices (AT91)"
	depends on ARCH_AT91

config SND_ATMEL_AC97C
	tristate "Atmel AC97 Controller (AC97C) driver"
	select SND_PCM
	select SND_AC97_CODEC
	depends on ARCH_AT91
	help
	  ALSA sound driver for the Atmel AC97 controller.

endmenu
```
