/* $FreeBSD$ */

&pci {
	#address-cells = <3>;
	#size-cells = <2>;
	ranges = <
		0x02000000 0 0x00000000 0x20000000 0 0x10000000
		0x01000000 0 0x00000000 0x10160000 0 0x00010000
	>;

	interrupt-parent = <&cpuintc>;
	interrupts = <4>;

	resets = <&rstctrl 23>;
	clocks = <&clkctrl 21>;
};
