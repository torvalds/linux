/*
 * usb_a9g20.dts - Device Tree file for Caloa USB A9G20 board
 *
 *  Copyright (C) 2011 Jean-Christophe PLAGNIOL-VILLARD <plagnioj@jcrosoft.com>
 *
 * Licensed under GPLv2 or later.
 */
/dts-v1/;
#include "usb_a9g20_common.dtsi"

/ {
	model = "Calao USB A9G20";
	compatible = "calao,usb-a9g20", "atmel,at91sam9g20", "atmel,at91sam9";
};
