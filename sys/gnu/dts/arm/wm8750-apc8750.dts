/*
 * wm8750-apc8750.dts
 *  - Device tree file for VIA APC8750
 *
 * Copyright (C) 2012 Tony Prisk <linux@prisktech.co.nz>
 *
 * Licensed under GPLv2 or later
 */

/dts-v1/;
/include/ "wm8750.dtsi"

/ {
	model = "VIA APC8750";
};

&pinctrl {
	pinctrl-names = "default";
	pinctrl-0 = <&i2c>;

	i2c: i2c {
		wm,pins = <168 169 170 171>;
		wm,function = <2>;	/* alt */
		wm,pull = <2>;	/* pull-up */
	};
};

&uart0 {
	status = "okay";
};
