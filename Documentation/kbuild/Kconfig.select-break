## Documentation/kbuild/Kconfig.select-break
```kconfig
# Select broken dependency issue
# ~~~~~~~~~~~~~~~~~~~~~~~~~~~~~~
#
# Test with:
#
# make KBUILD_KCONFIG=Documentation/kbuild/Kconfig.select-break menuconfig
#
# kconfig will not complain and enable this layout for configuration. This is
# currently a feature of kconfig, given select was designed to be heavy handed.
# Kconfig currently does not check the list of symbols listed on a symbol's
# "select" list, this is done on purpose to help load a set of known required
# symbols. Because of this use of select should be used with caution. An
# example of this issue is below.
#
# The option B and C are clearly contradicting with respect to A.
# However, when A is set, C can be set as well because Kconfig does not
# visit the dependencies of the select target (in this case B).  And since
# Kconfig does not visit the dependencies, it breaks the dependencies of B
# (!A).

mainmenu "Simple example to demo kconfig select broken dependency issue"

config A
	bool "CONFIG A"

config B
	bool "CONFIG B"
	depends on !A

config C
	bool "CONFIG C"
	depends on A
	select B
```

## Documentation/kbuild/kconfig.txt
```kconfig
This file contains some assistance for using "make *config".

Use "make help" to list all of the possible configuration targets.

The xconfig ('qconf') and menuconfig ('mconf') programs also
have embedded help text.  Be sure to check it for navigation,
search, and other general help text.

======================================================================
General
--------------------------------------------------

New kernel releases often introduce new config symbols.  Often more
important, new kernel releases may rename config symbols.  When
this happens, using a previously working .config file and running
"make oldconfig" won't necessarily produce a working new kernel
for you, so you may find that you need to see what NEW kernel
symbols have been introduced.

To see a list of new config symbols when using "make oldconfig", use

	cp user/some/old.config .config
	yes "" | make oldconfig >conf.new

and the config program will list as (NEW) any new symbols that have
unknown values.  Of course, the .config file is also updated with
new (default) values, so you can use:

	grep "(NEW)" conf.new

to see the new config symbols or you can 'diff' the previous and
new .config files to see the differences:

	diff .config.old .config | less

(Yes, we need something better here.)

______________________________________________________________________
Environment variables for '*config'

KCONFIG_CONFIG
--------------------------------------------------
This environment variable can be used to specify a default kernel config
file name to override the default name of ".config".

KCONFIG_OVERWRITECONFIG
--------------------------------------------------
If you set KCONFIG_OVERWRITECONFIG in the environment, Kconfig will not
break symlinks when .config is a symlink to somewhere else.

KCONFIG_NOTIMESTAMP
--------------------------------------------------
If this environment variable exists and is non-null, the timestamp line
in generated .config files is omitted.

______________________________________________________________________
Environment variables for '{allyes/allmod/allno/rand}config'

KCONFIG_ALLCONFIG
--------------------------------------------------
(partially based on lkml email from/by Rob Landley, re: miniconfig)
--------------------------------------------------
The allyesconfig/allmodconfig/allnoconfig/randconfig variants can
also use the environment variable KCONFIG_ALLCONFIG as a flag or a
filename that contains config symbols that the user requires to be
set to a specific value.  If KCONFIG_ALLCONFIG is used without a
filename, "make *config" checks for a file named
"all{yes/mod/no/def/random}.config" (corresponding to the *config command
that was used) for symbol values that are to be forced.  If this file
is not found, it checks for a file named "all.config" to contain forced
values.

This enables you to create "miniature" config (miniconfig) or custom
config files containing just the config symbols that you are interested
in.  Then the kernel config system generates the full .config file,
including symbols of your miniconfig file.

This 'KCONFIG_ALLCONFIG' file is a config file which contains
(usually a subset of all) preset config symbols.  These variable
settings are still subject to normal dependency checks.

Examples:
	KCONFIG_ALLCONFIG=custom-notebook.config make allnoconfig
or
	KCONFIG_ALLCONFIG=mini.config make allnoconfig
or
	make KCONFIG_ALLCONFIG=mini.config allnoconfig

These examples will disable most options (allnoconfig) but enable or
disable the options that are explicitly listed in the specified
mini-config files.

______________________________________________________________________
Environment variables for 'silentoldconfig'

KCONFIG_NOSILENTUPDATE
--------------------------------------------------
If this variable has a non-blank value, it prevents silent kernel
config updates (requires explicit updates).

KCONFIG_AUTOCONFIG
--------------------------------------------------
This environment variable can be set to specify the path & name of the
"auto.conf" file.  Its default value is "include/config/auto.conf".

KCONFIG_TRISTATE
--------------------------------------------------
This environment variable can be set to specify the path & name of the
"tristate.conf" file.  Its default value is "include/config/tristate.conf".

KCONFIG_AUTOHEADER
--------------------------------------------------
This environment variable can be set to specify the path & name of the
"autoconf.h" (header) file.
Its default value is "include/generated/autoconf.h".


======================================================================
menuconfig
--------------------------------------------------

SEARCHING for CONFIG symbols

Searching in menuconfig:

	The Search function searches for kernel configuration symbol
	names, so you have to know something close to what you are
	looking for.

	Example:
		/hotplug
		This lists all config symbols that contain "hotplug",
		e.g., HOTPLUG, HOTPLUG_CPU, MEMORY_HOTPLUG.

	For search help, enter / followed TAB-TAB-TAB (to highlight
	<Help>) and Enter.  This will tell you that you can also use
	regular expressions (regexes) in the search string, so if you
	are not interested in MEMORY_HOTPLUG, you could try

		/^hotplug

______________________________________________________________________
User interface options for 'menuconfig'

MENUCONFIG_COLOR
--------------------------------------------------
It is possible to select different color themes using the variable
MENUCONFIG_COLOR.  To select a theme use:

	make MENUCONFIG_COLOR=<theme> menuconfig

Available themes are:
  mono       => selects colors suitable for monochrome displays
  blackbg    => selects a color scheme with black background
  classic    => theme with blue background. The classic look
  bluetitle  => a LCD friendly version of classic. (default)

MENUCONFIG_MODE
--------------------------------------------------
This mode shows all sub-menus in one large tree.

Example:
	make MENUCONFIG_MODE=single_menu menuconfig


======================================================================
xconfig
--------------------------------------------------

Searching in xconfig:

	The Search function searches for kernel configuration symbol
	names, so you have to know something close to what you are
	looking for.

	Example:
		Ctrl-F hotplug
	or
		Menu: File, Search, hotplug

	lists all config symbol entries that contain "hotplug" in
	the symbol name.  In this Search dialog, you may change the
	config setting for any of the entries that are not grayed out.
	You can also enter a different search string without having
	to return to the main menu.


======================================================================
gconfig
--------------------------------------------------

Searching in gconfig:

	None (gconfig isn't maintained as well as xconfig or menuconfig);
	however, gconfig does have a few more viewing choices than
	xconfig does.

###
```

## FSM/Kconfig
```kconfig
#
# FSM Server and Client
#


menu "FSM Client and Server"

#############################################################################
# Server
#############################################################################

config FSM_DeviceProcess
	tristate "FSM Server Module"
	help
	  FSM Device Control Module.

config FSM_GPIO
	tristate "FSM GPIO Module"
	depends on FSM_DeviceProcess
	
	help
	  FSM GPIO Module.

config FSM_Crypt
	tristate "FSM Crypt Module"
	depends on FSM_DeviceProcess
	
	help
	`FSM Crypt Module.

config FSM_CRC
	tristate "FSM CRC Module"
	depends on FSM_DeviceProcess
	
	help
	  FSM CRC Module.	  

config FSM_Flash
	tristate "FSM Flash Module"
	depends on FSM_DeviceProcess
	depends on FSM_CRC

	help
	  FSM Flash Module.

config FSM_TreeSetting
	tristate "FSM Tree Setting Module"
	depends on FSM_DeviceProcess
	
	help
	  FSM Tree Setting Module.

config FSM_Beep
	tristate "FSM Beep Module"
	depends on FSM_DeviceProcess
	
	help
	  FSM Beep Module.

config FSM_ClientProtocol
	tristate "FSM Ethernet Module"
	depends on FSM_DeviceProcess
	depends on FSM_GPIO
	depends on FSM_Flash
        depends on FSM_Beep
	depends on FSM_TreeSetting

	help
	  FSM Ethernet Module.

config FSM_CCKControl
	tristate "FSM CCK Control Module"
	depends on FSM_DeviceProcess
	
	help
	  FSM CCK Control Module.

config FSM_AudioStream
	tristate "FSM Audio Stream Module"
	depends on FSM_DeviceProcess
	depends on FSM_ClientProtocol

	help
	  FSM Audio Stream Module.

config FSM_FIFOAudioStream
tristate "FSM FIFO Audio Stream Module"
	depends on FSM_DeviceProcess
	depends on FSM_AudioStream

	help
	  FSM FIFO Audio Stream Module.

config FSM_E1Device
	tristate "FSM E1 Module"
	depends on FSM_DeviceProcess
	depends on FSM_AudioStream
	depends on FSM_ClientProtocol
	depends on FSM_FIFOAudioStream

	help
	  FSM E1 Module.

config FSM_Commutator
tristate "FSM Commutator Module"
	depends on FSM_DeviceProcess
	depends on FSM_AudioStream

	help
	  FSM Commutator Module.

config FSM_E1CAS1
	tristate "FSM E1CAS1 Module"
	depends on FSM_DeviceProcess
	depends on FSM_AudioStream
	depends on FSM_ClientProtocol

	help
	  FSM E1CAS1 Module.

config FSM_MN111Device
	tristate "FSM MN111 Module"
	depends on FSM_DeviceProcess
	depends on FSM_AudioStream
	depends on FSM_ClientProtocol

	help
	  FSM MN111 Module.

config FSM_MN825Device
	tristate "FSM MN825 Module"
         
	depends on FSM_DeviceProcess 
        depends on FSM_Commutator
        depends on FSM_AudioStream 
        depends on FSM_ClientProtocol
	depends on FSM_CCKControl

	help
	  FSM MN825 Module.

config FSM_MN921Device
	tristate "FSM MN921 Module"
	depends on FSM_DeviceProcess 
        depends on FSM_Commutator
        depends on FSM_AudioStream 
        depends on FSM_ClientProtocol
	depends on FSM_CCKControl
	depends on FSM_TreeSetting

	help
	  FSM MN921 Module.

config FSM_PO06Device
	tristate "FSM PO06 Module"
	depends on FSM_DeviceProcess 
        depends on FSM_Commutator
        depends on FSM_AudioStream 
        depends on FSM_ClientProtocol
	depends on FSM_CCKControl

	help
	  FSM PO06 Module.

config FSM_PO07Device
	tristate "FSM PO07 Module"
	depends on FSM_DeviceProcess 
        depends on FSM_Commutator
        depends on FSM_AudioStream 
        depends on FSM_ClientProtocol
	depends on FSM_CCKControl
	
	help
	  FSM PO07 Module.

config FSM_PO08Device
	tristate "FSM PO08 Module"
	depends on FSM_DeviceProcess 
        depends on FSM_Commutator
        depends on FSM_AudioStream 
        depends on FSM_ClientProtocol
	depends on FSM_CCKControl
	
	help
	  FSM PO08 Module.

config FSM_SkyNet
tristate "FSM SkyNet Module"
	depends on FSM_DeviceProcess
	depends on FSM_ClientProtocol

	help
	  FSM SkyNet Module.

config FSM_SocialAnalytic
	tristate "FSM SocialAnalytic Module"
	depends on FSM_DeviceProcess
	depends on FSM_ClientProtocol

	help
	  FSM SocialAnalytic Module.

config FSM_StatisticServer
	tristate "FSM StatisticServer Module"
	depends on FSM_DeviceProcess
	help
	  FSM StatisticServer Module.

config FSM_SettingServer
	tristate "FSM SettingServer Module"
	depends on FSM_DeviceProcess
	
	help
	  FSM SettingServer Module.


config FSM_ServerIODev
	tristate "FSM Server IO Dev Module"
	depends on FSM_DeviceProcess
	
	help
	  FSM Server IO Dev Module.

config FSM_ControlDeviceClass
	tristate "FSM Control Device Class Module"
	depends on FSM_DeviceProcess
	
	help
	  FSM Control Device Class Module.

#############################################################################
# Client
#############################################################################

config FSM_Client
	tristate "FSM Client Module"
	help
	  FSM Client Module.

config FSM_ControlDevice
	tristate "FSM Control Device Module"
	depends on FSM_Client
	
	help
	  FSM Control Device Module.

config FSM_StatisticClient
	tristate "FSM Statistic Client Module"
	depends on FSM_Client
	
	help
	  FSM Statistic Client Module.

config FSM_SettingClient
	tristate "FSM Setting Client Module"
	depends on FSM_Client
	
	help
	  FSM Setting Client Module.

config FSM_SendSignalToPipe
	tristate "FSM Send Signal To Pipe Module"
	depends on FSM_Client
	
	help
	  FSM Send Signal To Pipe Module.

config FSM_ClientIOCtl
	tristate "FSM Client IO Ctl Module"
	depends on FSM_Client
	
	help
	  FSM Client IO Ctl Module.

endmenu
```

## Kconfig
```kconfig
# SPDX-License-Identifier: GPL-2.0
#
# Kernel Configuration Main Menu
# For syntax details, see Documentation/kbuild/kconfig-language.rst.
#

mainmenu "Linux/$(ARCH) $(KERNELVERSION) Kernel Configuration"

# Common includes for setup and initialization
source "scripts/Kconfig.include"
source "init/Kconfig"

# Core kernel modules and features
source "kernel/Kconfig.freezer"
source "mm/Kconfig"            # Memory Management

# Filesystems configurations
source "fs/Kconfig.binfmt"      # Binary Format Support
source "fs/Kconfig"             # General Filesystem Options

# Network configurations
source "net/Kconfig"

# Drivers, Security, and Cryptography options
source "drivers/Kconfig"        # Device Drivers
source "security/Kconfig"       # Security Features
source "crypto/Kconfig"         # Cryptography Support

# Libraries and Debugging tools
source "lib/Kconfig"            # Core Libraries
source "lib/Kconfig.debug"      # Debugging Options

# Documentation-specific options
source "Documentation/Kconfig"
```

## arch/alpha/Kconfig.debug
```kconfig
# SPDX-License-Identifier: GPL-2.0
menu "Kernel hacking"

source "lib/Kconfig.debug"

config EARLY_PRINTK
	bool
	depends on ALPHA_GENERIC || ALPHA_SRM
	default y

config ALPHA_LEGACY_START_ADDRESS
	bool "Legacy kernel start address"
	depends on ALPHA_GENERIC
	default n
	---help---
	  The 2.4 kernel changed the kernel start address from 0x310000
	  to 0x810000 to make room for the Wildfire's larger SRM console.
	  Recent consoles on Titan and Marvel machines also require the
	  extra room.

	  If you're using aboot 0.7 or later, the bootloader will examine the
	  ELF headers to determine where to transfer control. Unfortunately,
	  most older bootloaders -- APB or MILO -- hardcoded the kernel start
	  address rather than examining the ELF headers, and the result is a
	  hard lockup.

	  Say Y if you have a broken bootloader.  Say N if you do not, or if
	  you wish to run on Wildfire, Titan, or Marvel.

config ALPHA_LEGACY_START_ADDRESS
	bool
	depends on !ALPHA_GENERIC && !ALPHA_TITAN && !ALPHA_MARVEL && !ALPHA_WILDFIRE
	default y

config MATHEMU
	tristate "Kernel FP software completion" if DEBUG_KERNEL && !SMP
	default y if !DEBUG_KERNEL || SMP
	help
	  This option is required for IEEE compliant floating point arithmetic
	  on the Alpha. The only time you would ever not say Y is to say M in
	  order to debug the code. Say Y unless you know what you are doing.

endmenu
```
