## Documentation/devicetree/bindings/net/dsa/vitesse,vsc73xx.yaml
```yaml
# SPDX-License-Identifier: (GPL-2.0-only OR BSD-2-Clause)
%YAML 1.2
---
$id: http://devicetree.org/schemas/net/dsa/vitesse,vsc73xx.yaml#
$schema: http://devicetree.org/meta-schemas/core.yaml#

title: Vitesse VSC73xx DSA Switches

maintainers:
  - Linus Walleij <linus.walleij@linaro.org>

description:
  The Vitesse DSA Switches were produced in the early-to-mid 2000s.

  The Vitesse company has been acquired by Microsemi and Microsemi has
  been acquired Microchip but the new owner retains this vendor branding.

  The currently supported switch chips are
  Vitesse VSC7385 SparX-G5 5+1-port Integrated Gigabit Ethernet Switch
  Vitesse VSC7388 SparX-G8 8-port Integrated Gigabit Ethernet Switch
  Vitesse VSC7395 SparX-G5e 5+1-port Integrated Gigabit Ethernet Switch
  Vitesse VSC7398 SparX-G8e 8-port Integrated Gigabit Ethernet Switch

  This switch can use one of two different management interfaces.

  If SPI interface is used, the device tree node is an SPI device so it must
  reside inside a SPI bus device tree node, see spi/spi-bus.txt

  When the chip is connected to a parallel memory bus and work in memory-mapped
  I/O mode, a platform device is used to represent the vsc73xx. In this case it
  must reside inside a platform bus device tree node.

properties:
  compatible:
    enum:
      - vitesse,vsc7385
      - vitesse,vsc7388
      - vitesse,vsc7395
      - vitesse,vsc7398

  reg:
    maxItems: 1

  gpio-controller: true
  "#gpio-cells":
    const: 2

  reset-gpios:
    description: GPIO to be used to reset the whole device
    maxItems: 1

allOf:
  - $ref: dsa.yaml#/$defs/ethernet-ports

patternProperties:
  "^(ethernet-)?ports$":
    additionalProperties: true
    patternProperties:
      "^(ethernet-)?port@6$":
        allOf:
          - if:
              properties:
                phy-mode:
                  contains:
                    enum:
                      - rgmii
            then:
              properties:
                rx-internal-delay-ps:
                  $ref: "#/$defs/internal-delay-ps"
                tx-internal-delay-ps:
                  $ref: "#/$defs/internal-delay-ps"

# This checks if reg is a chipselect so the device is on an SPI
# bus, the if-clause will fail if reg is a tuple such as for a
# platform device.
if:
  properties:
    reg:
      minimum: 0
      maximum: 256
then:
  $ref: /schemas/spi/spi-peripheral-props.yaml#

required:
  - compatible
  - reg

$defs:
  internal-delay-ps:
    description:
      Disable tunable delay lines using 0 ps, or enable them and select
      the phase between 1400 ps and 2000 ps in increments of 300 ps.
    default: 2000
    enum:
      [0, 1400, 1700, 2000]

unevaluatedProperties: false

examples:
  - |
    #include <dt-bindings/gpio/gpio.h>

    spi {
      #address-cells = <1>;
      #size-cells = <0>;

      ethernet-switch@0 {
        compatible = "vitesse,vsc7395";
        reg = <0>;
        spi-max-frequency = <2500000>;
        gpio-controller;
        #gpio-cells = <2>;

        ethernet-ports {
          #address-cells = <1>;
          #size-cells = <0>;

          ethernet-port@0 {
            reg = <0>;
            label = "lan1";
          };
          ethernet-port@1 {
            reg = <1>;
            label = "lan2";
          };
          ethernet-port@2 {
            reg = <2>;
            label = "lan3";
          };
          ethernet-port@3 {
            reg = <3>;
            label = "lan4";
          };
          ethernet-port@6 {
            reg = <6>;
            ethernet = <&gmac1>;
            phy-mode = "rgmii";
            rx-internal-delay-ps = <0>;
            tx-internal-delay-ps = <0>;
            fixed-link {
              speed = <1000>;
              full-duplex;
              pause;
            };
          };
        };
      };
    };

    bus {
      #address-cells = <1>;
      #size-cells = <1>;

      ethernet-switch@10000000 {
        compatible = "vitesse,vsc7385";
        reg = <0x10000000 0x20000>;
        reset-gpios = <&gpio0 12 GPIO_ACTIVE_LOW>;

        ethernet-ports {
          #address-cells = <1>;
          #size-cells = <0>;

          ethernet-port@0 {
            reg = <0>;
            label = "lan1";
          };
          ethernet-port@1 {
            reg = <1>;
            label = "lan2";
          };
          ethernet-port@2 {
            reg = <2>;
            label = "lan3";
          };
          ethernet-port@3 {
            reg = <3>;
            label = "lan4";
          };
          ethernet-port@6 {
            reg = <6>;
            ethernet = <&enet0>;
            rx-internal-delay-ps = <0>;
            tx-internal-delay-ps = <0>;
            phy-mode = "rgmii";
            fixed-link {
              speed = <1000>;
              full-duplex;
              pause;
            };
          };
        };
      };
    };
```

## Documentation/devicetree/bindings/net/dwmac-sun8i.txt
```
* Allwinner sun8i GMAC ethernet controller

This device is a platform glue layer for stmmac.
Please see stmmac.txt for the other unchanged properties.

Required properties:
- compatible: must be one of the following string:
		"allwinner,sun8i-a83t-emac"
		"allwinner,sun8i-h3-emac"
		"allwinner,sun8i-v3s-emac"
		"allwinner,sun50i-a64-emac"
- reg: address and length of the register for the device.
- interrupts: interrupt for the device
- interrupt-names: must be "macirq"
- clocks: A phandle to the reference clock for this device
- clock-names: must be "stmmaceth"
- resets: A phandle to the reset control for this device
- reset-names: must be "stmmaceth"
- phy-mode: See ethernet.txt
- phy-handle: See ethernet.txt
- #address-cells: shall be 1
- #size-cells: shall be 0
- syscon: A phandle to the syscon of the SoC with one of the following
 compatible string:
  - allwinner,sun8i-h3-system-controller
  - allwinner,sun8i-v3s-system-controller
  - allwinner,sun50i-a64-system-controller
  - allwinner,sun8i-a83t-system-controller

Optional properties:
- allwinner,tx-delay-ps: TX clock delay chain value in ps. Range value is 0-700. Default is 0)
- allwinner,rx-delay-ps: RX clock delay chain value in ps. Range value is 0-3100. Default is 0)
Both delay properties need to be a multiple of 100. They control the delay for
external PHY.

Optional properties for the following compatibles:
  - "allwinner,sun8i-h3-emac",
  - "allwinner,sun8i-v3s-emac":
- allwinner,leds-active-low: EPHY LEDs are active low

Required child node of emac:
- mdio bus node: should be named mdio with compatible "snps,dwmac-mdio"

Required properties of the mdio node:
- #address-cells: shall be 1
- #size-cells: shall be 0

The device node referenced by "phy" or "phy-handle" must be a child node
of the mdio node. See phy.txt for the generic PHY bindings.

The following compatibles require that the emac node have a mdio-mux child
node called "mdio-mux":
  - "allwinner,sun8i-h3-emac"
  - "allwinner,sun8i-v3s-emac":
Required properties for the mdio-mux node:
  - compatible = "allwinner,sun8i-h3-mdio-mux"
  - mdio-parent-bus: a phandle to EMAC mdio
  - one child mdio for the integrated mdio with the compatible
    "allwinner,sun8i-h3-mdio-internal"
  - one child mdio for the external mdio if present (V3s have none)
Required properties for the mdio-mux children node:
  - reg: 1 for internal MDIO bus, 2 for external MDIO bus

The following compatibles require a PHY node representing the integrated
PHY, under the integrated MDIO bus node if an mdio-mux node is used:
  - "allwinner,sun8i-h3-emac",
  - "allwinner,sun8i-v3s-emac":

Additional information regarding generic multiplexer properties can be found
at Documentation/devicetree/bindings/net/mdio-mux.txt

Required properties of the integrated phy node:
- clocks: a phandle to the reference clock for the EPHY
- resets: a phandle to the reset control for the EPHY
- Must be a child of the integrated mdio

Example with integrated PHY:
emac: ethernet@1c0b000 {
	compatible = "allwinner,sun8i-h3-emac";
	syscon = <&syscon>;
	reg = <0x01c0b000 0x104>;
	interrupts = <GIC_SPI 82 IRQ_TYPE_LEVEL_HIGH>;
	interrupt-names = "macirq";
	resets = <&ccu RST_BUS_EMAC>;
	reset-names = "stmmaceth";
	clocks = <&ccu CLK_BUS_EMAC>;
	clock-names = "stmmaceth";
	#address-cells = <1>;
	#size-cells = <0>;

	phy-handle = <&int_mii_phy>;
	phy-mode = "mii";
	allwinner,leds-active-low;

	mdio: mdio {
		#address-cells = <1>;
		#size-cells = <0>;
		compatible = "snps,dwmac-mdio";
	};

	mdio-mux {
		compatible = "mdio-mux", "allwinner,sun8i-h3-mdio-mux";
		#address-cells = <1>;
		#size-cells = <0>;

		mdio-parent-bus = <&mdio>;

		int_mdio: mdio@1 {
			compatible = "allwinner,sun8i-h3-mdio-internal";
			reg = <1>;
			#address-cells = <1>;
			#size-cells = <0>;
			int_mii_phy: ethernet-phy@1 {
				reg = <1>;
				clocks = <&ccu CLK_BUS_EPHY>;
				resets = <&ccu RST_BUS_EPHY>;
				phy-is-integrated;
			};
		};
		ext_mdio: mdio@2 {
			reg = <2>;
			#address-cells = <1>;
			#size-cells = <0>;
		};
	};
};

Example with external PHY:
emac: ethernet@1c0b000 {
	compatible = "allwinner,sun8i-h3-emac";
	syscon = <&syscon>;
	reg = <0x01c0b000 0x104>;
	interrupts = <GIC_SPI 82 IRQ_TYPE_LEVEL_HIGH>;
	interrupt-names = "macirq";
	resets = <&ccu RST_BUS_EMAC>;
	reset-names = "stmmaceth";
	clocks = <&ccu CLK_BUS_EMAC>;
	clock-names = "stmmaceth";
	#address-cells = <1>;
	#size-cells = <0>;

	phy-handle = <&ext_rgmii_phy>;
	phy-mode = "rgmii";
	allwinner,leds-active-low;

	mdio: mdio {
		#address-cells = <1>;
		#size-cells = <0>;
		compatible = "snps,dwmac-mdio";
	};

	mdio-mux {
		compatible = "allwinner,sun8i-h3-mdio-mux";
		#address-cells = <1>;
		#size-cells = <0>;

		mdio-parent-bus = <&mdio>;

		int_mdio: mdio@1 {
			compatible = "allwinner,sun8i-h3-mdio-internal";
			reg = <1>;
			#address-cells = <1>;
			#size-cells = <0>;
			int_mii_phy: ethernet-phy@1 {
				reg = <1>;
				clocks = <&ccu CLK_BUS_EPHY>;
				resets = <&ccu RST_BUS_EPHY>;
			};
		};
		ext_mdio: mdio@2 {
			reg = <2>;
			#address-cells = <1>;
			#size-cells = <0>;
			ext_rgmii_phy: ethernet-phy@1 {
				reg = <1>;
			};
		}:
	};
};

Example with SoC without integrated PHY

emac: ethernet@1c0b000 {
	compatible = "allwinner,sun8i-a83t-emac";
	syscon = <&syscon>;
	reg = <0x01c0b000 0x104>;
	interrupts = <GIC_SPI 82 IRQ_TYPE_LEVEL_HIGH>;
	interrupt-names = "macirq";
	resets = <&ccu RST_BUS_EMAC>;
	reset-names = "stmmaceth";
	clocks = <&ccu CLK_BUS_EMAC>;
	clock-names = "stmmaceth";
	#address-cells = <1>;
	#size-cells = <0>;

	phy-handle = <&ext_rgmii_phy>;
	phy-mode = "rgmii";

	mdio: mdio {
		compatible = "snps,dwmac-mdio";
		#address-cells = <1>;
		#size-cells = <0>;
		ext_rgmii_phy: ethernet-phy@1 {
			reg = <1>;
		};
	};
};
```

## Documentation/devicetree/bindings/net/emac_rockchip.txt
```
* ARC EMAC 10/100 Ethernet platform driver for Rockchip RK3036/RK3066/RK3188 SoCs

Required properties:
- compatible: should be "rockchip,<name>-emac"
   "rockchip,rk3036-emac": found on RK3036 SoCs
   "rockchip,rk3066-emac": found on RK3066 SoCs
   "rockchip,rk3188-emac": found on RK3188 SoCs
- reg: Address and length of the register set for the device
- interrupts: Should contain the EMAC interrupts
- rockchip,grf: phandle to the syscon grf used to control speed and mode
  for emac.
- phy: see ethernet.txt file in the same directory.
- phy-mode: see ethernet.txt file in the same directory.

Optional properties:
- phy-supply: phandle to a regulator if the PHY needs one

Clock handling:
- clocks: Must contain an entry for each entry in clock-names.
- clock-names: Shall be "hclk" for the host clock needed to calculate and set
  polling period of EMAC and "macref" for the reference clock needed to transfer
  data to and from the phy.

Child nodes of the driver are the individual PHY devices connected to the
MDIO bus. They must have a "reg" property given the PHY address on the MDIO bus.

Examples:

ethernet@10204000 {
	compatible = "rockchip,rk3188-emac";
	reg = <0xc0fc2000 0x3c>;
	interrupts = <6>;
	mac-address = [ 00 11 22 33 44 55 ];

	clocks = <&cru HCLK_EMAC>, <&cru SCLK_MAC>;
	clock-names = "hclk", "macref";

	pinctrl-names = "default";
	pinctrl-0 = <&emac_xfer>, <&emac_mdio>, <&phy_int>;

	rockchip,grf = <&grf>;

	phy = <&phy0>;
	phy-mode = "rmii";
	phy-supply = <&vcc_rmii>;

	#address-cells = <1>;
	#size-cells = <0>;
	phy0: ethernet-phy@0 {
	      reg = <1>;
	};
};
```

## Documentation/devicetree/bindings/net/engleder,tsnep.yaml
```yaml
# SPDX-License-Identifier: (GPL-2.0-only OR BSD-2-Clause)
%YAML 1.2
---
$id: http://devicetree.org/schemas/net/engleder,tsnep.yaml#
$schema: http://devicetree.org/meta-schemas/core.yaml#

title: TSN endpoint Ethernet MAC binding

maintainers:
  - Gerhard Engleder <gerhard@engleder-embedded.com>

allOf:
  - $ref: ethernet-controller.yaml#

properties:
  compatible:
    const: engleder,tsnep

  reg:
    maxItems: 1

  interrupts:
    minItems: 1
    maxItems: 8

  interrupt-names:
    minItems: 1
    items:
      - const: mac
      - const: txrx-1
      - const: txrx-2
      - const: txrx-3
      - const: txrx-4
      - const: txrx-5
      - const: txrx-6
      - const: txrx-7
    description:
      The main interrupt for basic MAC features and the first TX/RX queue pair
      is named "mac". "txrx-[1-7]" are the interrupts for additional TX/RX
      queue pairs.

  dma-coherent: true

  local-mac-address: true

  mac-address: true

  nvmem-cells: true

  nvmem-cell-names: true

  phy-connection-type:
    enum:
      - mii
      - gmii
      - rgmii
      - rgmii-id

  phy-mode: true

  phy-handle: true

  mdio:
    type: object
    $ref: "mdio.yaml#"
    description: optional node for embedded MDIO controller

required:
  - compatible
  - reg
  - interrupts

additionalProperties: false

examples:
  - |
    axi {
        #address-cells = <2>;
        #size-cells = <2>;
        tsnep0: ethernet@a0000000 {
            compatible = "engleder,tsnep";
            reg = <0x0 0xa0000000 0x0 0x10000>;
            interrupts = <0 89 1>;
            interrupt-parent = <&gic>;
            local-mac-address = [00 00 00 00 00 00];
            phy-mode = "rgmii";
            phy-handle = <&phy0>;
            mdio {
                #address-cells = <1>;
                #size-cells = <0>;
                suppress-preamble;
                phy0: ethernet-phy@1 {
                    reg = <1>;
                    rxc-skew-ps = <1080>;
                };
            };
        };

        tsnep1: ethernet@a0010000 {
            compatible = "engleder,tsnep";
            reg = <0x0 0xa0010000 0x0 0x10000>;
            interrupts = <0 93 1>, <0 94 1>, <0 95 1>, <0 96 1>;
            interrupt-names = "mac", "txrx-1", "txrx-2", "txrx-3";
            interrupt-parent = <&gic>;
            local-mac-address = [00 00 00 00 00 00];
            phy-mode = "rgmii";
            phy-handle = <&phy1>;
            mdio {
                #address-cells = <1>;
                #size-cells = <0>;
                suppress-preamble;
                phy1: ethernet-phy@1 {
                    reg = <1>;
                    rxc-skew-ps = <1080>;
                };
            };
        };
    };
```
