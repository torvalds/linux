## Documentation/devicetree/bindings/net/dsa/renesas,rzn1-a5psw.yaml
```yaml
# SPDX-License-Identifier: (GPL-2.0-only OR BSD-2-Clause)
%YAML 1.2
---
$id: http://devicetree.org/schemas/net/dsa/renesas,rzn1-a5psw.yaml#
$schema: http://devicetree.org/meta-schemas/core.yaml#

title: Renesas RZ/N1 Advanced 5 ports ethernet switch

maintainers:
  - Clément Léger <clement.leger@bootlin.com>

description: |
  The advanced 5 ports switch is present on the Renesas RZ/N1 SoC family and
  handles 4 ports + 1 CPU management port.

allOf:
  - $ref: dsa.yaml#

properties:
  compatible:
    items:
      - enum:
          - renesas,r9a06g032-a5psw
      - const: renesas,rzn1-a5psw

  reg:
    maxItems: 1

  interrupts:
    items:
      - description: Device Level Ring (DLR) interrupt
      - description: Switch interrupt
      - description: Parallel Redundancy Protocol (PRP) interrupt
      - description: Integrated HUB module interrupt
      - description: Receive Pattern Match interrupt

  interrupt-names:
    items:
      - const: dlr
      - const: switch
      - const: prp
      - const: hub
      - const: ptrn

  power-domains:
    maxItems: 1

  mdio:
    $ref: /schemas/net/mdio.yaml#
    unevaluatedProperties: false

  clocks:
    items:
      - description: AHB clock used for the switch register interface
      - description: Switch system clock

  clock-names:
    items:
      - const: hclk
      - const: clk

  ethernet-ports:
    type: object
    properties:
      '#address-cells':
        const: 1
      '#size-cells':
        const: 0

    patternProperties:
      "^(ethernet-)?port@[0-4]$":
        type: object
        description: Ethernet switch ports

        properties:
          pcs-handle:
            description:
              phandle pointing to a PCS sub-node compatible with
              renesas,rzn1-miic.yaml#
            $ref: /schemas/types.yaml#/definitions/phandle

unevaluatedProperties: false

required:
  - compatible
  - reg
  - clocks
  - clock-names
  - power-domains

examples:
  - |
    #include <dt-bindings/gpio/gpio.h>
    #include <dt-bindings/clock/r9a06g032-sysctrl.h>
    #include <dt-bindings/interrupt-controller/arm-gic.h>

    switch@44050000 {
        compatible = "renesas,r9a06g032-a5psw", "renesas,rzn1-a5psw";
        reg = <0x44050000 0x10000>;
        clocks = <&sysctrl R9A06G032_HCLK_SWITCH>, <&sysctrl R9A06G032_CLK_SWITCH>;
        clock-names = "hclk", "clk";
        power-domains = <&sysctrl>;
        interrupts = <GIC_SPI 40 IRQ_TYPE_LEVEL_HIGH>,
                     <GIC_SPI 42 IRQ_TYPE_LEVEL_HIGH>,
                     <GIC_SPI 43 IRQ_TYPE_LEVEL_HIGH>,
                     <GIC_SPI 44 IRQ_TYPE_LEVEL_HIGH>,
                     <GIC_SPI 45 IRQ_TYPE_LEVEL_HIGH>;
        interrupt-names = "dlr", "switch", "prp", "hub", "ptrn";

        dsa,member = <0 0>;

        ethernet-ports {
            #address-cells = <1>;
            #size-cells = <0>;

            port@0 {
                reg = <0>;
                label = "lan0";
                phy-handle = <&switch0phy3>;
                pcs-handle = <&mii_conv4>;
            };

            port@1 {
                reg = <1>;
                label = "lan1";
                phy-handle = <&switch0phy1>;
                pcs-handle = <&mii_conv3>;
            };

            port@4 {
                reg = <4>;
                ethernet = <&gmac2>;
                label = "cpu";
                fixed-link {
                  speed = <1000>;
                  full-duplex;
                };
            };
        };

        mdio {
            #address-cells = <1>;
            #size-cells = <0>;

            reset-gpios = <&gpio0a 2 GPIO_ACTIVE_HIGH>;
            reset-delay-us = <15>;
            clock-frequency = <2500000>;

            switch0phy1: ethernet-phy@1{
                reg = <1>;
            };

            switch0phy3: ethernet-phy@3{
                reg = <3>;
            };
        };
    };
```

## Documentation/devicetree/bindings/net/dsa/sja1105.txt
```
NXP SJA1105 switch driver
=========================

Required properties:

- compatible:
	Must be one of:
	- "nxp,sja1105e"
	- "nxp,sja1105t"
	- "nxp,sja1105p"
	- "nxp,sja1105q"
	- "nxp,sja1105r"
	- "nxp,sja1105s"

	Although the device ID could be detected at runtime, explicit bindings
	are required in order to be able to statically check their validity.
	For example, SGMII can only be specified on port 4 of R and S devices,
	and the non-SGMII devices, while pin-compatible, are not equal in terms
	of support for RGMII internal delays (supported on P/Q/R/S, but not on
	E/T).

See Documentation/devicetree/bindings/net/dsa/dsa.txt for the list of standard
DSA required and optional properties.

Other observations
------------------

The SJA1105 SPI interface requires a CS-to-CLK time (t2 in UM10944) of at least
one half of t_CLK. At an SPI frequency of 1MHz, this means a minimum
cs_sck_delay of 500ns. Ensuring that this SPI timing requirement is observed
depends on the SPI bus master driver.

Example
-------

Ethernet switch connected via SPI to the host, CPU port wired to enet2:

arch/arm/boot/dts/ls1021a-tsn.dts:

/* SPI controller of the LS1021 */
&dspi0 {
	sja1105@1 {
		reg = <0x1>;
		#address-cells = <1>;
		#size-cells = <0>;
		compatible = "nxp,sja1105t";
		spi-max-frequency = <4000000>;
		fsl,spi-cs-sck-delay = <1000>;
		fsl,spi-sck-cs-delay = <1000>;
		ports {
			#address-cells = <1>;
			#size-cells = <0>;
			port@0 {
				/* ETH5 written on chassis */
				label = "swp5";
				phy-handle = <&rgmii_phy6>;
				phy-mode = "rgmii-id";
				reg = <0>;
			};
			port@1 {
				/* ETH2 written on chassis */
				label = "swp2";
				phy-handle = <&rgmii_phy3>;
				phy-mode = "rgmii-id";
				reg = <1>;
			};
			port@2 {
				/* ETH3 written on chassis */
				label = "swp3";
				phy-handle = <&rgmii_phy4>;
				phy-mode = "rgmii-id";
				reg = <2>;
			};
			port@3 {
				/* ETH4 written on chassis */
				phy-handle = <&rgmii_phy5>;
				label = "swp4";
				phy-mode = "rgmii-id";
				reg = <3>;
			};
			port@4 {
				/* Internal port connected to eth2 */
				ethernet = <&enet2>;
				phy-mode = "rgmii";
				reg = <4>;

				fixed-link {
					speed = <1000>;
					full-duplex;
				};
			};
		};
	};
};

/* MDIO controller of the LS1021 */
&mdio0 {
	/* BCM5464 */
	rgmii_phy3: ethernet-phy@3 {
		reg = <0x3>;
	};
	rgmii_phy4: ethernet-phy@4 {
		reg = <0x4>;
	};
	rgmii_phy5: ethernet-phy@5 {
		reg = <0x5>;
	};
	rgmii_phy6: ethernet-phy@6 {
		reg = <0x6>;
	};
};

/* Ethernet master port of the LS1021 */
&enet2 {
	phy-connection-type = "rgmii";
	status = "ok";
	fixed-link {
		speed = <1000>;
		full-duplex;
	};
};
```

## Documentation/devicetree/bindings/net/dsa/smsc,lan9303.yaml
```yaml
# SPDX-License-Identifier: (GPL-2.0-only OR BSD-2-Clause)
%YAML 1.2
---
$id: http://devicetree.org/schemas/net/dsa/smsc,lan9303.yaml#
$schema: http://devicetree.org/meta-schemas/core.yaml#

title: SMSC/MicroChip LAN9303 three port ethernet switch

maintainers:
  - Frank Li <Frank.Li@nxp.com>

description:
  The LAN9303 is a three port ethernet switch with integrated PHYs for the
  two external ports. The third port is an RMII/MII interface to a host
  processor. The device can be managed via I2C or MDIO.

  Note - always use 'reg = <0/1/2>;' for the three DSA ports, even if the
  device is configured to use 1/2/3 instead. This hardware configuration
  will be auto-detected and mapped accordingly.

properties:
  compatible:
    enum:
      - smsc,lan9303-i2c
      - smsc,lan9303-mdio

  reg:
    maxItems: 1

  reset-gpios:
    description:
      GPIO to be used to reset the whole device
    maxItems: 1

  reset-duration:
    description:
      Reset duration in milliseconds
    default: 200
    $ref: /schemas/types.yaml#/definitions/uint32

required:
  - compatible
  - reg

unevaluatedProperties: false

allOf:
  - $ref: dsa.yaml#

examples:
  - |
    #include <dt-bindings/gpio/gpio.h>

    /* I2C managed mode */
    i2c {
        #address-cells = <1>;
        #size-cells = <0>;

        switch@a {
            compatible = "smsc,lan9303-i2c";
            reg = <0xa>;
            reset-gpios = <&gpio7 6 GPIO_ACTIVE_LOW>;
            reset-duration = <200>;

            ports {
                #address-cells = <1>;
                #size-cells = <0>;

                port@0 {
                    reg = <0>;
                    label = "cpu";
                    ethernet = <&master>;
                };

                port@1 {
                    reg = <1>;
                    label = "lan1";
                };

                port@2 {
                    reg = <2>;
                    label = "lan2";
                };
            };
        };
    };

  - |
    #include <dt-bindings/gpio/gpio.h>

    /* MDIO managed mode */
    mdio {
        #address-cells = <1>;
        #size-cells = <0>;

        switch@0 {
            compatible = "smsc,lan9303-mdio";
            reg = <0>;
            reset-gpios = <&gpio7 6 GPIO_ACTIVE_LOW>;
            reset-duration = <100>;

            ports {
                #address-cells = <1>;
                #size-cells = <0>;

                port@0 {
                    reg = <0>;
                    label = "cpu";
                    ethernet = <&master>;
                };

                port@1 {
                    reg = <1>;
                    label = "lan1";
                };

                port@2 {
                    reg = <2>;
                    label = "lan2";
                };
            };
        };
    };
```

## Documentation/devicetree/bindings/net/dsa/vitesse,vsc73xx.txt
```
Vitesse VSC73xx Switches
========================

This defines device tree bindings for the Vitesse VSC73xx switch chips.
The Vitesse company has been acquired by Microsemi and Microsemi has
been acquired Microchip but retains this vendor branding.

The currently supported switch chips are:
Vitesse VSC7385 SparX-G5 5+1-port Integrated Gigabit Ethernet Switch
Vitesse VSC7388 SparX-G8 8-port Integrated Gigabit Ethernet Switch
Vitesse VSC7395 SparX-G5e 5+1-port Integrated Gigabit Ethernet Switch
Vitesse VSC7398 SparX-G8e 8-port Integrated Gigabit Ethernet Switch

This switch could have two different management interface.

If SPI interface is used, the device tree node is an SPI device so it must
reside inside a SPI bus device tree node, see spi/spi-bus.txt

When the chip is connected to a parallel memory bus and work in memory-mapped
I/O mode, a platform device is used to represent the vsc73xx. In this case it
must reside inside a platform bus device tree node.

Required properties:

- compatible: must be exactly one of:
	"vitesse,vsc7385"
	"vitesse,vsc7388"
	"vitesse,vsc7395"
	"vitesse,vsc7398"
- gpio-controller: indicates that this switch is also a GPIO controller,
  see gpio/gpio.txt
- #gpio-cells: this must be set to <2> and indicates that we are a twocell
  GPIO controller, see gpio/gpio.txt

Optional properties:

- reset-gpios: a handle to a GPIO line that can issue reset of the chip.
  It should be tagged as active low.

Required subnodes:

See net/dsa/dsa.txt for a list of additional required and optional properties
and subnodes of DSA switches.

Examples:

SPI:
switch@0 {
	compatible = "vitesse,vsc7395";
	reg = <0>;
	/* Specified for 2.5 MHz or below */
	spi-max-frequency = <2500000>;
	gpio-controller;
	#gpio-cells = <2>;

	ports {
		#address-cells = <1>;
		#size-cells = <0>;

		port@0 {
			reg = <0>;
			label = "lan1";
		};
		port@1 {
			reg = <1>;
			label = "lan2";
		};
		port@2 {
			reg = <2>;
			label = "lan3";
		};
		port@3 {
			reg = <3>;
			label = "lan4";
		};
		vsc: port@6 {
			reg = <6>;
			label = "cpu";
			ethernet = <&gmac1>;
			phy-mode = "rgmii";
			fixed-link {
				speed = <1000>;
				full-duplex;
				pause;
			};
		};
	};
};

Platform:
switch@2,0 {
	#address-cells = <1>;
	#size-cells = <1>;
	compatible = "vitesse,vsc7385";
	reg = <0x2 0x0 0x20000>;
	reset-gpios = <&gpio0 12 GPIO_ACTIVE_LOW>;

	ports {
		#address-cells = <1>;
		#size-cells = <0>;

		port@0 {
			reg = <0>;
			label = "lan1";
		};
		port@1 {
			reg = <1>;
			label = "lan2";
		};
		port@2 {
			reg = <2>;
			label = "lan3";
		};
		port@3 {
			reg = <3>;
			label = "lan4";
		};
		vsc: port@6 {
			reg = <6>;
			label = "cpu";
			ethernet = <&enet0>;
			phy-mode = "rgmii";
			fixed-link {
				speed = <1000>;
				full-duplex;
				pause;
			};
		};
	};

};
```
