## Documentation/devicetree/bindings/net/dsa/qca8k.yaml
```yaml
# SPDX-License-Identifier: (GPL-2.0-only OR BSD-2-Clause)
%YAML 1.2
---
$id: http://devicetree.org/schemas/net/dsa/qca8k.yaml#
$schema: http://devicetree.org/meta-schemas/core.yaml#

title: Qualcomm Atheros QCA83xx switch family

maintainers:
  - John Crispin <john@phrozen.org>

description:
  If the QCA8K switch is connect to an SoC's external mdio-bus, each subnode
  describing a port needs to have a valid phandle referencing the internal PHY
  it is connected to. This is because there is no N:N mapping of port and PHY
  ID. To declare the internal mdio-bus configuration, declare an MDIO node in
  the switch node and declare the phandle for the port, referencing the internal
  PHY it is connected to. In this config, an internal mdio-bus is registered and
  the MDIO master is used for communication. Mixed external and internal
  mdio-bus configurations are not supported by the hardware.

properties:
  compatible:
    oneOf:
      - enum:
          - qca,qca8327
          - qca,qca8328
          - qca,qca8334
          - qca,qca8337
    description: |
      qca,qca8328: referenced as AR8328(N)-AK1(A/B) QFN 176 pin package
      qca,qca8327: referenced as AR8327(N)-AL1A DR-QFN 148 pin package
      qca,qca8334: referenced as QCA8334-AL3C QFN 88 pin package
      qca,qca8337: referenced as QCA8337N-AL3(B/C) DR-QFN 148 pin package

  reg:
    maxItems: 1

  reset-gpios:
    description:
      GPIO to be used to reset the whole device
    maxItems: 1

  qca,ignore-power-on-sel:
    $ref: /schemas/types.yaml#/definitions/flag
    description:
      Ignore power-on pin strapping to configure LED open-drain or EEPROM
      presence. This is needed for devices with incorrect configuration or when
      the OEM has decided not to use pin strapping and falls back to SW regs.

  qca,led-open-drain:
    $ref: /schemas/types.yaml#/definitions/flag
    description:
      Set LEDs to open-drain mode. This requires the qca,ignore-power-on-sel to
      be set, otherwise the driver will fail at probe. This is required if the
      OEM does not use pin strapping to set this mode and prefers to set it
      using SW regs. The pin strappings related to LED open-drain mode are
      B68 on the QCA832x and B49 on the QCA833x.

  mdio:
    $ref: /schemas/net/mdio.yaml#
    unevaluatedProperties: false
    description: Qca8k switch have an internal mdio to access switch port.
                 If this is not present, the legacy mapping is used and the
                 internal mdio access is used.
                 With the legacy mapping the reg corresponding to the internal
                 mdio is the switch reg with an offset of -1.

$ref: "dsa.yaml#"

patternProperties:
  "^(ethernet-)?ports$":
    type: object
    patternProperties:
      "^(ethernet-)?port@[0-6]$":
        type: object
        description: Ethernet switch ports

        $ref: dsa-port.yaml#

        properties:
          qca,sgmii-rxclk-falling-edge:
            $ref: /schemas/types.yaml#/definitions/flag
            description:
              Set the receive clock phase to falling edge. Mostly commonly used on
              the QCA8327 with CPU port 0 set to SGMII.

          qca,sgmii-txclk-falling-edge:
            $ref: /schemas/types.yaml#/definitions/flag
            description:
              Set the transmit clock phase to falling edge.

          qca,sgmii-enable-pll:
            $ref: /schemas/types.yaml#/definitions/flag
            description:
              For SGMII CPU port, explicitly enable PLL, TX and RX chain along with
              Signal Detection. On the QCA8327 this should not be enabled, otherwise
              the SGMII port will not initialize. When used on the QCA8337, revision 3
              or greater, a warning will be displayed. When the CPU port is set to
              SGMII on the QCA8337, it is advised to set this unless a communication
              issue is observed.

        unevaluatedProperties: false

oneOf:
  - required:
      - ports
  - required:
      - ethernet-ports

required:
  - compatible
  - reg

unevaluatedProperties: false

examples:
  - |
    #include <dt-bindings/gpio/gpio.h>

    mdio {
        #address-cells = <1>;
        #size-cells = <0>;

        external_phy_port1: ethernet-phy@0 {
            reg = <0>;
        };

        external_phy_port2: ethernet-phy@1 {
            reg = <1>;
        };

        external_phy_port3: ethernet-phy@2 {
            reg = <2>;
        };

        external_phy_port4: ethernet-phy@3 {
            reg = <3>;
        };

        external_phy_port5: ethernet-phy@4 {
            reg = <4>;
        };

        switch@10 {
            compatible = "qca,qca8337";
            reset-gpios = <&gpio 42 GPIO_ACTIVE_LOW>;
            reg = <0x10>;

            ports {
                #address-cells = <1>;
                #size-cells = <0>;

                port@0 {
                    reg = <0>;
                    ethernet = <&gmac1>;
                    phy-mode = "rgmii";

                    fixed-link {
                        speed = <1000>;
                        full-duplex;
                    };
                };

                port@1 {
                    reg = <1>;
                    label = "lan1";
                    phy-handle = <&external_phy_port1>;
                };

                port@2 {
                    reg = <2>;
                    label = "lan2";
                    phy-handle = <&external_phy_port2>;
                };

                port@3 {
                    reg = <3>;
                    label = "lan3";
                    phy-handle = <&external_phy_port3>;
                };

                port@4 {
                    reg = <4>;
                    label = "lan4";
                    phy-handle = <&external_phy_port4>;
                };

                port@5 {
                    reg = <5>;
                    label = "wan";
                    phy-handle = <&external_phy_port5>;
                };
            };
        };
    };
  - |
    #include <dt-bindings/gpio/gpio.h>

    mdio {
        #address-cells = <1>;
        #size-cells = <0>;

        switch@10 {
            compatible = "qca,qca8337";
            reset-gpios = <&gpio 42 GPIO_ACTIVE_LOW>;
            reg = <0x10>;

            ports {
                #address-cells = <1>;
                #size-cells = <0>;

                port@0 {
                    reg = <0>;
                    ethernet = <&gmac1>;
                    phy-mode = "rgmii";

                    fixed-link {
                        speed = <1000>;
                        full-duplex;
                    };
                };

                port@1 {
                    reg = <1>;
                    label = "lan1";
                    phy-mode = "internal";
                    phy-handle = <&internal_phy_port1>;
                };

                port@2 {
                    reg = <2>;
                    label = "lan2";
                    phy-mode = "internal";
                    phy-handle = <&internal_phy_port2>;
                };

                port@3 {
                    reg = <3>;
                    label = "lan3";
                    phy-mode = "internal";
                    phy-handle = <&internal_phy_port3>;
                };

                port@4 {
                    reg = <4>;
                    label = "lan4";
                    phy-mode = "internal";
                    phy-handle = <&internal_phy_port4>;
                };

                port@5 {
                    reg = <5>;
                    label = "wan";
                    phy-mode = "internal";
                    phy-handle = <&internal_phy_port5>;
                };

                port@6 {
                    reg = <0>;
                    ethernet = <&gmac1>;
                    phy-mode = "sgmii";

                    qca,sgmii-rxclk-falling-edge;

                    fixed-link {
                        speed = <1000>;
                        full-duplex;
                    };
                };
            };

            mdio {
                #address-cells = <1>;
                #size-cells = <0>;

                internal_phy_port1: ethernet-phy@0 {
                    reg = <0>;
                };

                internal_phy_port2: ethernet-phy@1 {
                    reg = <1>;
                };

                internal_phy_port3: ethernet-phy@2 {
                    reg = <2>;
                };

                internal_phy_port4: ethernet-phy@3 {
                    reg = <3>;
                };

                internal_phy_port5: ethernet-phy@4 {
                    reg = <4>;
                };
            };
        };
    };
```

## Documentation/devicetree/bindings/net/dsa/realtek-smi.txt
```
Realtek SMI-based Switches
==========================

The SMI "Simple Management Interface" is a two-wire protocol using
bit-banged GPIO that while it reuses the MDIO lines MCK and MDIO does
not use the MDIO protocol. This binding defines how to specify the
SMI-based Realtek devices.

Required properties:

- compatible: must be exactly one of:
      "realtek,rtl8365mb" (4+1 ports)
      "realtek,rtl8366"
      "realtek,rtl8366rb" (4+1 ports)
      "realtek,rtl8366s"  (4+1 ports)
      "realtek,rtl8367"
      "realtek,rtl8367b"
      "realtek,rtl8368s"  (8 port)
      "realtek,rtl8369"
      "realtek,rtl8370"   (8 port)

Required properties:
- mdc-gpios: GPIO line for the MDC clock line.
- mdio-gpios: GPIO line for the MDIO data line.
- reset-gpios: GPIO line for the reset signal.

Optional properties:
- realtek,disable-leds: if the LED drivers are not used in the
  hardware design this will disable them so they are not turned on
  and wasting power.

Required subnodes:

- interrupt-controller

  This defines an interrupt controller with an IRQ line (typically
  a GPIO) that will demultiplex and handle the interrupt from the single
  interrupt line coming out of one of the SMI-based chips. It most
  importantly provides link up/down interrupts to the PHY blocks inside
  the ASIC.

Required properties of interrupt-controller:

- interrupt: parent interrupt, see interrupt-controller/interrupts.txt
- interrupt-controller: see interrupt-controller/interrupts.txt
- #address-cells: should be <0>
- #interrupt-cells: should be <1>

- mdio

  This defines the internal MDIO bus of the SMI device, mostly for the
  purpose of being able to hook the interrupts to the right PHY and
  the right PHY to the corresponding port.

Required properties of mdio:

- compatible: should be set to "realtek,smi-mdio" for all SMI devices

See net/mdio.txt for additional MDIO bus properties.

See net/dsa/dsa.txt for a list of additional required and optional properties
and subnodes of DSA switches.

Examples:

An example for the RTL8366RB:

switch {
	compatible = "realtek,rtl8366rb";
	/* 22 = MDIO (has input reads), 21 = MDC (clock, output only) */
	mdc-gpios = <&gpio0 21 GPIO_ACTIVE_HIGH>;
	mdio-gpios = <&gpio0 22 GPIO_ACTIVE_HIGH>;
	reset-gpios = <&gpio0 14 GPIO_ACTIVE_LOW>;

	switch_intc: interrupt-controller {
		/* GPIO 15 provides the interrupt */
		interrupt-parent = <&gpio0>;
		interrupts = <15 IRQ_TYPE_LEVEL_LOW>;
		interrupt-controller;
		#address-cells = <0>;
		#interrupt-cells = <1>;
	};

	ports {
		#address-cells = <1>;
		#size-cells = <0>;
		reg = <0>;
		port@0 {
			reg = <0>;
			label = "lan0";
			phy-handle = <&phy0>;
		};
		port@1 {
			reg = <1>;
			label = "lan1";
			phy-handle = <&phy1>;
		};
		port@2 {
			reg = <2>;
			label = "lan2";
			phy-handle = <&phy2>;
		};
		port@3 {
			reg = <3>;
			label = "lan3";
			phy-handle = <&phy3>;
		};
		port@4 {
			reg = <4>;
			label = "wan";
			phy-handle = <&phy4>;
		};
		port@5 {
			reg = <5>;
			label = "cpu";
			ethernet = <&gmac0>;
			phy-mode = "rgmii";
			fixed-link {
				speed = <1000>;
				full-duplex;
			};
		};
	};

	mdio {
		compatible = "realtek,smi-mdio", "dsa-mdio";
		#address-cells = <1>;
		#size-cells = <0>;

		phy0: phy@0 {
			reg = <0>;
			interrupt-parent = <&switch_intc>;
			interrupts = <0>;
		};
		phy1: phy@1 {
			reg = <1>;
			interrupt-parent = <&switch_intc>;
			interrupts = <1>;
		};
		phy2: phy@2 {
			reg = <2>;
			interrupt-parent = <&switch_intc>;
			interrupts = <2>;
		};
		phy3: phy@3 {
			reg = <3>;
			interrupt-parent = <&switch_intc>;
			interrupts = <3>;
		};
		phy4: phy@4 {
			reg = <4>;
			interrupt-parent = <&switch_intc>;
			interrupts = <12>;
		};
	};
};

An example for the RTL8365MB-VC:

switch {
	compatible = "realtek,rtl8365mb";
	mdc-gpios = <&gpio1 16 GPIO_ACTIVE_HIGH>;
	mdio-gpios = <&gpio1 17 GPIO_ACTIVE_HIGH>;
	reset-gpios = <&gpio5 0 GPIO_ACTIVE_LOW>;

	switch_intc: interrupt-controller {
		interrupt-parent = <&gpio5>;
		interrupts = <1 IRQ_TYPE_LEVEL_LOW>;
		interrupt-controller;
		#address-cells = <0>;
		#interrupt-cells = <1>;
	};

	ports {
		#address-cells = <1>;
		#size-cells = <0>;
		reg = <0>;
		port@0 {
			reg = <0>;
			label = "swp0";
			phy-handle = <&ethphy0>;
		};
		port@1 {
			reg = <1>;
			label = "swp1";
			phy-handle = <&ethphy1>;
		};
		port@2 {
			reg = <2>;
			label = "swp2";
			phy-handle = <&ethphy2>;
		};
		port@3 {
			reg = <3>;
			label = "swp3";
			phy-handle = <&ethphy3>;
		};
		port@6 {
			reg = <6>;
			label = "cpu";
			ethernet = <&fec1>;
			phy-mode = "rgmii";
			tx-internal-delay-ps = <2000>;
			rx-internal-delay-ps = <2000>;

			fixed-link {
				speed = <1000>;
				full-duplex;
				pause;
			};
		};
	};

	mdio {
		compatible = "realtek,smi-mdio";
		#address-cells = <1>;
		#size-cells = <0>;

		ethphy0: phy@0 {
			reg = <0>;
			interrupt-parent = <&switch_intc>;
			interrupts = <0>;
		};
		ethphy1: phy@1 {
			reg = <1>;
			interrupt-parent = <&switch_intc>;
			interrupts = <1>;
		};
		ethphy2: phy@2 {
			reg = <2>;
			interrupt-parent = <&switch_intc>;
			interrupts = <2>;
		};
		ethphy3: phy@3 {
			reg = <3>;
			interrupt-parent = <&switch_intc>;
			interrupts = <3>;
		};
	};
};
```
