## Documentation/devicetree/bindings/net/dsa/nxp,netc-switch.yaml
```yaml
# SPDX-License-Identifier: (GPL-2.0-only OR BSD-2-Clause)
%YAML 1.2
---
$id: http://devicetree.org/schemas/net/dsa/nxp,netc-switch.yaml#
$schema: http://devicetree.org/meta-schemas/core.yaml#

title: NETC Switch family

description: >
  The NETC presents itself as a multi-function PCIe Root Complex Integrated
  Endpoint (RCiEP) and provides full 802.1Q Ethernet switch functionality,
  advanced QoS with 8 traffic classes and 4 drop resilience levels, and a
  full range of TSN standards capabilities.

  The CPU port of the switch connects to an internal ENETC. The switch and
  the internal ENETC are fully integrated into the NETC IP, a back-to-back
  MAC is not required. Instead, a light-weight "pseudo MAC" provides the
  delineation between the switch and ENETC. This translates to lower power
  (less logic and memory) and lower delay (as there is no serialization
  delay across this link).

maintainers:
  - Wei Fang <wei.fang@nxp.com>

properties:
  compatible:
    enum:
      - pci1131,eef2

  reg:
    maxItems: 1

  dsa,member:
    description: >
      The property indicates DSA cluster and switch index. For NETC switch,
      the valid range of the switch index is 1 ~ 7, the index is reflected
      in the switch tag as an indication of the switch ID where the frame
      originated. The value 0 is reserved for ENETC VEPA switch, whose ID
      is hardwired to zero.
    items:
      - true
      - minimum: 1
        maximum: 7

  ethernet-ports:
    type: object
    patternProperties:
      "^ethernet-port@[0-9a-f]$":
        type: object
        $ref: dsa-port.yaml#

        properties:
          clocks:
            items:
              - description: MAC transmit/receive reference clock.

          clock-names:
            items:
              - const: ref

          mdio:
            $ref: /schemas/net/mdio.yaml#
            unevaluatedProperties: false
            description:
              Optional child node for switch port, otherwise use NETC EMDIO.

        unevaluatedProperties: false

required:
  - compatible
  - reg
  - dsa,member
  - ethernet-ports

allOf:
  - $ref: /schemas/pci/pci-device.yaml
  - $ref: dsa.yaml#

unevaluatedProperties: false

examples:
  - |
    pcie {
        #address-cells = <3>;
        #size-cells = <2>;

        ethernet-switch@0,2 {
            compatible = "pci1131,eef2";
            reg = <0x200 0 0 0 0>;
            dsa,member = <0 1>;
            pinctrl-names = "default";
            pinctrl-0 = <&pinctrl_switch>;

            ethernet-ports {
                #address-cells = <1>;
                #size-cells = <0>;

                ethernet-port@0 {
                    reg = <0>;
                    phy-handle = <&ethphy0>;
                    phy-mode = "mii";
                };

                ethernet-port@1 {
                    reg = <1>;
                    phy-handle = <&ethphy1>;
                    phy-mode = "mii";
                };

                ethernet-port@2 {
                    reg = <2>;
                    clocks = <&scmi_clk 103>;
                    clock-names = "ref";
                    phy-handle = <&ethphy2>;
                    phy-mode = "rgmii-id";
                };

                ethernet-port@3 {
                    reg = <3>;
                    ethernet = <&enetc3>;
                    phy-mode = "internal";

                    fixed-link {
                        speed = <2500>;
                        full-duplex;
                        pause;
                    };
                };
            };
        };
    };
```

## Documentation/devicetree/bindings/net/dsa/nxp,sja1105.yaml
```yaml
# SPDX-License-Identifier: (GPL-2.0-only OR BSD-2-Clause)
%YAML 1.2
---
$id: http://devicetree.org/schemas/net/dsa/nxp,sja1105.yaml#
$schema: http://devicetree.org/meta-schemas/core.yaml#

title: NXP SJA1105 Automotive Ethernet Switch Family

description:
  The SJA1105 SPI interface requires a CS-to-CLK time (t2 in UM10944.pdf) of at
  least one half of t_CLK. At an SPI frequency of 1MHz, this means a minimum
  cs_sck_delay of 500ns. Ensuring that this SPI timing requirement is observed
  depends on the SPI bus master driver.

allOf:
  - $ref: "dsa.yaml#"
  - $ref: /schemas/spi/spi-peripheral-props.yaml#

maintainers:
  - Vladimir Oltean <vladimir.oltean@nxp.com>

properties:
  compatible:
    enum:
      - nxp,sja1105e
      - nxp,sja1105t
      - nxp,sja1105p
      - nxp,sja1105q
      - nxp,sja1105r
      - nxp,sja1105s
      - nxp,sja1110a
      - nxp,sja1110b
      - nxp,sja1110c
      - nxp,sja1110d

  reg:
    maxItems: 1

  # Optional container node for the 2 internal MDIO buses of the SJA1110
  # (one for the internal 100base-T1 PHYs and the other for the single
  # 100base-TX PHY). The "reg" property does not have physical significance.
  # The PHY addresses to port correspondence is as follows: for 100base-T1,
  # port 5 has PHY 1, port 6 has PHY 2 etc, while for 100base-TX, port 1 has
  # PHY 1.
  mdios:
    type: object

    properties:
      '#address-cells':
        const: 1
      '#size-cells':
        const: 0

    patternProperties:
      "^mdio@[0-1]$":
        $ref: /schemas/net/mdio.yaml#
        unevaluatedProperties: false

        properties:
          compatible:
            oneOf:
              - enum:
                  - nxp,sja1110-base-t1-mdio
                  - nxp,sja1110-base-tx-mdio

          reg:
            oneOf:
              - enum:
                  - 0
                  - 1

        required:
          - compatible
          - reg

patternProperties:
  "^(ethernet-)?ports$":
    patternProperties:
      "^(ethernet-)?port@[0-9]+$":
        allOf:
          - if:
              properties:
                phy-mode:
                  contains:
                    enum:
                      - rgmii
                      - rgmii-rxid
                      - rgmii-txid
                      - rgmii-id
            then:
              properties:
                rx-internal-delay-ps:
                  $ref: "#/$defs/internal-delay-ps"
                tx-internal-delay-ps:
                  $ref: "#/$defs/internal-delay-ps"

required:
  - compatible
  - reg

$defs:
  internal-delay-ps:
    description:
      Disable tunable delay lines using 0 ps, or enable them and select
      the phase between 1640 ps (73.8 degree shift at 1Gbps) and 2260 ps
      (101.7 degree shift) in increments of 0.9 degrees (20 ps).
    enum:
      [0, 1640, 1660, 1680, 1700, 1720, 1740, 1760, 1780, 1800, 1820, 1840,
       1860, 1880, 1900, 1920, 1940, 1960, 1980, 2000, 2020, 2040, 2060, 2080,
       2100, 2120, 2140, 2160, 2180, 2200, 2220, 2240, 2260]

unevaluatedProperties: false

examples:
  - |
    spi {
            #address-cells = <1>;
            #size-cells = <0>;

            ethernet-switch@1 {
                    reg = <0x1>;
                    compatible = "nxp,sja1105t";

                    ethernet-ports {
                            #address-cells = <1>;
                            #size-cells = <0>;

                            port@0 {
                                    phy-handle = <&rgmii_phy6>;
                                    phy-mode = "rgmii-id";
                                    rx-internal-delay-ps = <0>;
                                    tx-internal-delay-ps = <0>;
                                    reg = <0>;
                            };

                            port@1 {
                                    phy-handle = <&rgmii_phy3>;
                                    phy-mode = "rgmii-id";
                                    rx-internal-delay-ps = <0>;
                                    tx-internal-delay-ps = <0>;
                                    reg = <1>;
                            };

                            port@2 {
                                    phy-handle = <&rgmii_phy4>;
                                    phy-mode = "rgmii-id";
                                    rx-internal-delay-ps = <0>;
                                    tx-internal-delay-ps = <0>;
                                    reg = <2>;
                            };

                            port@3 {
                                    phy-handle = <&rgmii_phy4>;
                                    phy-mode = "rgmii-id";
                                    rx-internal-delay-ps = <0>;
                                    tx-internal-delay-ps = <0>;
                                    reg = <3>;
                            };

                            port@4 {
                                    ethernet = <&enet2>;
                                    phy-mode = "rgmii";
                                    rx-internal-delay-ps = <0>;
                                    tx-internal-delay-ps = <0>;
                                    reg = <4>;

                                    fixed-link {
                                            speed = <1000>;
                                            full-duplex;
                                    };
                            };
                    };
            };
    };
```

## Documentation/devicetree/bindings/net/dsa/ocelot.txt
```
Microchip Ocelot switch driver family
=====================================

Felix
-----

The VSC9959 core is currently the only switch supported by the driver, and is
found in the NXP LS1028A. It is a PCI device, part of the larger ENETC root
complex. As a result, the ethernet-switch node is a sub-node of the PCIe root
complex node and its "reg" property conforms to the parent node bindings:

* reg: Specifies PCIe Device Number and Function Number of the endpoint device,
  in this case for the Ethernet L2Switch it is PF5 (of device 0, bus 0).

It does not require a "compatible" string.

The interrupt line is used to signal availability of PTP TX timestamps and for
TSN frame preemption.

For the external switch ports, depending on board configuration, "phy-mode" and
"phy-handle" are populated by board specific device tree instances. Ports 4 and
5 are fixed as internal ports in the NXP LS1028A instantiation.

The CPU port property ("ethernet") configures the feature called "NPI port" in
the Ocelot hardware core. The CPU port in Ocelot is a set of queues, which are
connected, in the Node Processor Interface (NPI) mode, to an Ethernet port.
By default, in fsl-ls1028a.dtsi, the NPI port is assigned to the internal
2.5Gbps port@4, but can be moved to the 1Gbps port@5, depending on the specific
use case.  Moving the NPI port to an external switch port is hardware possible,
but there is no platform support for the Linux system on the LS1028A chip to
operate as an entire slave DSA chip.  NPI functionality (and therefore DSA
tagging) is supported on a single port at a time.

Any port can be disabled (and in fsl-ls1028a.dtsi, they are indeed all disabled
by default, and should be enabled on a per-board basis). But if any external
switch port is enabled at all, the ENETC PF2 (enetc_port2) should be enabled as
well, regardless of whether it is configured as the DSA master or not. This is
because the Felix PHYLINK implementation accesses the MAC PCS registers, which
in hardware truly belong to the ENETC port #2 and not to Felix.

Supported PHY interface types (appropriate SerDes protocol setting changes are
needed in the RCW binary):

* phy_mode = "internal": on ports 4 and 5
* phy_mode = "sgmii": on ports 0, 1, 2, 3
* phy_mode = "qsgmii": on ports 0, 1, 2, 3
* phy_mode = "usxgmii": on ports 0, 1, 2, 3
* phy_mode = "2500base-x": on ports 0, 1, 2, 3

For the rest of the device tree binding definitions, which are standard DSA and
PCI, refer to the following documents:

Documentation/devicetree/bindings/net/dsa/dsa.txt
Documentation/devicetree/bindings/pci/pci.txt

Example:

&soc {
	pcie@1f0000000 { /* Integrated Endpoint Root Complex */
		ethernet-switch@0,5 {
			reg = <0x000500 0 0 0 0>;
			/* IEP INT_B */
			interrupts = <GIC_SPI 95 IRQ_TYPE_LEVEL_HIGH>;

			ports {
				#address-cells = <1>;
				#size-cells = <0>;

				/* External ports */
				port@0 {
					reg = <0>;
					label = "swp0";
				};

				port@1 {
					reg = <1>;
					label = "swp1";
				};

				port@2 {
					reg = <2>;
					label = "swp2";
				};

				port@3 {
					reg = <3>;
					label = "swp3";
				};

				/* Tagging CPU port */
				port@4 {
					reg = <4>;
					ethernet = <&enetc_port2>;
					phy-mode = "internal";

					fixed-link {
						speed = <2500>;
						full-duplex;
					};
				};

				/* Non-tagging CPU port */
				port@5 {
					reg = <5>;
					phy-mode = "internal";
					status = "disabled";

					fixed-link {
						speed = <1000>;
						full-duplex;
					};
				};
			};
		};
	};
};
```
