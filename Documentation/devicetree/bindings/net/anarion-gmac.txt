## Documentation/devicetree/bindings/net/bluetooth/qcom,qca9377-bt.yaml
```yaml
# SPDX-License-Identifier: (GPL-2.0 OR BSD-2-Clause)
%YAML 1.2
---
$id: http://devicetree.org/schemas/net/bluetooth/qcom,qca9377-bt.yaml#
$schema: http://devicetree.org/meta-schemas/core.yaml#

title: Qualcomm QCA9377 Bluetooth

maintainers:
  - Balakrishna Godavarthi <quic_bgodavar@quicinc.com>
  - Rocky Liao <quic_rjliao@quicinc.com>

properties:
  compatible:
    enum:
      - qcom,qca9377-bt

  clocks:
    items:
      - description: External low-power 32.768 kHz clock input

  enable-gpios:
    maxItems: 1

  vddio-supply:
    description: VDD_IO supply regulator handle

  vddxo-supply:
    description: VDD_XO supply regulator handle

required:
  - compatible
  - clocks
  - enable-gpios

allOf:
  - $ref: bluetooth-controller.yaml#
  - $ref: qcom,bluetooth-common.yaml
  - $ref: /schemas/serial/serial-peripheral-props.yaml#

unevaluatedProperties: false

examples:
  - |
    #include <dt-bindings/gpio/gpio.h>

    serial {
        bluetooth {
            compatible = "qcom,qca9377-bt";
            clocks = <&rk809 1>;
            enable-gpios = <&gpio3 5 GPIO_ACTIVE_HIGH>;
            max-speed = <2000000>;
            pinctrl-names = "default";
            pinctrl-0 = <&bt_enable>;
            vddio-supply = <&vcc_1v8>;
            vddxo-supply = <&vcc3v3_sys>;
        };
    };
```

## Documentation/devicetree/bindings/net/bluetooth/qcom,wcn3950-bt.yaml
```yaml
# SPDX-License-Identifier: (GPL-2.0 OR BSD-2-Clause)
%YAML 1.2
---
$id: http://devicetree.org/schemas/net/bluetooth/qcom,wcn3950-bt.yaml#
$schema: http://devicetree.org/meta-schemas/core.yaml#

title: Qualcomm WCN3950/WCN3988 Bluetooth

maintainers:
  - Balakrishna Godavarthi <quic_bgodavar@quicinc.com>
  - Rocky Liao <quic_rjliao@quicinc.com>

properties:
  compatible:
    enum:
      - qcom,wcn3950-bt
      - qcom,wcn3988-bt

  enable-gpios:
    maxItems: 1

  swctrl-gpios:
    maxItems: 1
    description: gpio specifier is used to find status
                 of clock supply to SoC

  vddch0-supply:
    description: VDD_CH0 supply regulator handle

  vddio-supply:
    description: VDD_IO supply regulator handle

  vddrf-supply:
    description: VDD_RF supply regulator handle

  vddxo-supply:
    description: VDD_XO supply regulator handle

required:
  - compatible
  - vddch0-supply
  - vddio-supply
  - vddrf-supply
  - vddxo-supply

allOf:
  - $ref: bluetooth-controller.yaml#
  - $ref: qcom,bluetooth-common.yaml
  - $ref: /schemas/serial/serial-peripheral-props.yaml#

unevaluatedProperties: false

examples:
  - |
    #include <dt-bindings/gpio/gpio.h>

    serial {
        bluetooth {
            compatible = "qcom,wcn3950-bt";
            enable-gpios = <&tlmm 87 GPIO_ACTIVE_HIGH>;
            max-speed = <3200000>;
            vddch0-supply = <&pm4125_l22>;
            vddio-supply = <&pm4125_l15>;
            vddrf-supply = <&pm4125_l10>;
            vddxo-supply = <&pm4125_l13>;
        };
    };
```

## Documentation/devicetree/bindings/net/bluetooth/qcom,wcn3990-bt.yaml
```yaml
# SPDX-License-Identifier: (GPL-2.0 OR BSD-2-Clause)
%YAML 1.2
---
$id: http://devicetree.org/schemas/net/bluetooth/qcom,wcn3990-bt.yaml#
$schema: http://devicetree.org/meta-schemas/core.yaml#

title: Qualcomm WCN3990/WCN3991/WCN3998 Bluetooth

maintainers:
  - Balakrishna Godavarthi <quic_bgodavar@quicinc.com>
  - Rocky Liao <quic_rjliao@quicinc.com>

properties:
  compatible:
    enum:
      - qcom,wcn3990-bt
      - qcom,wcn3991-bt
      - qcom,wcn3998-bt

  clocks:
    items:
      - description: External low-power 32.768 kHz clock input

  vddch0-supply:
    description: VDD_CH0 supply regulator handle

  vddch1-supply:
    description: VDD_CH1 supply regulator handle

  vddio-supply:
    description: VDD_IO supply regulator handle

  vddrf-supply:
    description: VDD_RF supply regulator handle

  vddxo-supply:
    description: VDD_XO supply regulator handle

required:
  - compatible
  - vddch0-supply
  - vddio-supply
  - vddrf-supply
  - vddxo-supply

allOf:
  - $ref: bluetooth-controller.yaml#
  - $ref: qcom,bluetooth-common.yaml
  - $ref: /schemas/serial/serial-peripheral-props.yaml#

unevaluatedProperties: false

examples:
  - |
    serial {
        bluetooth {
            compatible = "qcom,wcn3990-bt";
            firmware-name = "crnv21.bin";
            max-speed = <3200000>;
            vddio-supply = <&vreg_s4a_1p8>;
            vddch0-supply = <&vreg_l25a_3p3>;
            vddch1-supply = <&vreg_l23a_3p3>;
            vddrf-supply = <&vreg_l17a_1p3>;
            vddxo-supply = <&vreg_l7a_1p8>;
        };
    };
```

## Documentation/devicetree/bindings/net/bluetooth/qcom,wcn6855-bt.yaml
```yaml
# SPDX-License-Identifier: (GPL-2.0 OR BSD-2-Clause)
%YAML 1.2
---
$id: http://devicetree.org/schemas/net/bluetooth/qcom,wcn6855-bt.yaml#
$schema: http://devicetree.org/meta-schemas/core.yaml#

title: Qualcomm WCN6855 Bluetooth

maintainers:
  - Bartosz Golaszewski <brgl@bgdev.pl>
  - Balakrishna Godavarthi <quic_bgodavar@quicinc.com>
  - Rocky Liao <quic_rjliao@quicinc.com>

properties:
  compatible:
    enum:
      - qcom,wcn6855-bt

  enable-gpios:
    maxItems: 1
    deprecated: true

  swctrl-gpios:
    maxItems: 1
    description: gpio specifier is used to find status
                 of clock supply to SoC
    deprecated: true

  vddaon-supply:
    description: VDD_AON supply regulator handle

  vddbtcmx-supply:
    description: VDD_BT_CMX supply regulator handle

  vddbtcxmx-supply:
    description: VDD_BT_CXMX supply regulator handle
    deprecated: true

  vddio-supply:
    description: VDD_IO supply regulator handle
    deprecated: true

  vddrfa0p8-supply:
    description: VDD_RFA_0P8 supply regulator handle

  vddrfa1p2-supply:
    description: VDD_RFA_1P2 supply regulator handle

  vddrfa1p7-supply:
    description: VDD_RFA_1P7 supply regulator handle
    deprecated: true

  vddrfa1p8-supply:
    description: VDD_RFA_1P8 supply regulator handle

  vddrfacmn-supply:
    description: VDD_RFA_CMN supply regulator handle

  vddwlcx-supply:
    description: VDD_WLCX supply regulator handle

  vddwlmx-supply:
    description: VDD_WLMX supply regulator handle

required:
  - compatible
  - vddaon-supply
  - vddbtcmx-supply
  - vddrfa0p8-supply
  - vddrfa1p2-supply
  - vddrfa1p8-supply
  - vddrfacmn-supply
  - vddwlcx-supply
  - vddwlmx-supply

allOf:
  - $ref: bluetooth-controller.yaml#
  - $ref: qcom,bluetooth-common.yaml
  - $ref: /schemas/serial/serial-peripheral-props.yaml#

unevaluatedProperties: false

examples:
  - |
    serial {
        bluetooth {
            compatible = "qcom,wcn6855-bt";

            max-speed = <3000000>;
            vddaon-supply = <&vreg_pmu_aon_0p8>;
            vddbtcmx-supply = <&vreg_pmu_btcmx_0p8>;
            vddrfa0p8-supply = <&vreg_pmu_rfa_0p8>;
            vddrfa1p2-supply = <&vreg_pmu_rfa_1p2>;
            vddrfa1p8-supply = <&vreg_pmu_rfa_1p7>;
            vddrfacmn-supply = <&vreg_pmu_rfa_cmn_0p8>;
            vddwlcx-supply = <&vreg_pmu_wlcx_0p8>;
            vddwlmx-supply = <&vreg_pmu_wlmx_0p8>;
        };
    };
```
