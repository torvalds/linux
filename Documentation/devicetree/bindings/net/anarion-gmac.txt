## Documentation/devicetree/bindings/net/anarion-gmac.txt
```
*  Adaptrum Anarion ethernet controller

This device is a platform glue layer for stmmac.
Please see stmmac.txt for the other unchanged properties.

Required properties:
 - compatible:  Should be "adaptrum,anarion-gmac", "snps,dwmac"
 - phy-mode:    Should be "rgmii". Other modes are not currently supported.


Examples:

	gmac1: ethernet@f2014000 {
		compatible = "adaptrum,anarion-gmac", "snps,dwmac";
		reg = <0xf2014000 0x4000>, <0xf2018100 8>;

		interrupt-parent = <&core_intc>;
		interrupts = <21>;
		interrupt-names = "macirq";

		clocks = <&core_clk>;
		clock-names = "stmmaceth";

		phy-mode = "rgmii";
	};
```

## Documentation/devicetree/bindings/net/apm,xgene-enet.yaml
```yaml
# SPDX-License-Identifier: (GPL-2.0-only OR BSD-2-Clause)
%YAML 1.2
---
$id: http://devicetree.org/schemas/net/apm,xgene-enet.yaml#
$schema: http://devicetree.org/meta-schemas/core.yaml#

title: APM X-Gene SoC Ethernet

maintainers:
  - Iyappan Subramanian <iyappan@os.amperecomputing.com>
  - Keyur Chudgar <keyur@os.amperecomputing.com>
  - Quan Nguyen <quan@os.amperecomputing.com>

allOf:
  - $ref: ethernet-controller.yaml#

properties:
  compatible:
    enum:
      - apm,xgene-enet
      - apm,xgene1-sgenet
      - apm,xgene1-xgenet
      - apm,xgene2-sgenet
      - apm,xgene2-xgenet

  reg:
    maxItems: 3

  reg-names:
    items:
      - const: enet_csr
      - const: ring_csr
      - const: ring_cmd

  clocks:
    maxItems: 1

  dma-coherent: true

  interrupts:
    description: An rx and tx completion interrupt pair per queue
    minItems: 1
    maxItems: 16

  channel:
    description: Ethernet to CPU start channel number
    $ref: /schemas/types.yaml#/definitions/uint32

  port-id:
    description: Port number
    $ref: /schemas/types.yaml#/definitions/uint32
    maximum: 1

  tx-delay:
    description: Delay value for RGMII bridge TX clock
    $ref: /schemas/types.yaml#/definitions/uint32
    maximum: 7
    default: 4

  rx-delay:
    description: Delay value for RGMII bridge RX clock
    $ref: /schemas/types.yaml#/definitions/uint32
    maximum: 7
    default: 2

  rxlos-gpios:
    description: Input GPIO from SFP+ module indicating incoming signal
    maxItems: 1

  mdio:
    description: MDIO bus subnode
    $ref: mdio.yaml#
    unevaluatedProperties: false

    properties:
      compatible:
        const: apm,xgene-mdio

    required:
      - compatible

required:
  - compatible
  - reg
  - interrupts

unevaluatedProperties: false

examples:
  - |
    ethernet@17020000 {
        compatible = "apm,xgene-enet";
        reg = <0x17020000 0xd100>,
              <0x17030000 0x400>,
              <0x10000000 0x200>;
        reg-names = "enet_csr", "ring_csr", "ring_cmd";
        interrupts = <0x0 0x3c 0x4>;
        channel = <0>;
        port-id = <0>;
        clocks = <&menetclk 0>;
        local-mac-address = [00 01 73 00 00 01];
        phy-connection-type = "rgmii";
        phy-handle = <&menetphy>;

        mdio {
            compatible = "apm,xgene-mdio";
            #address-cells = <1>;
            #size-cells = <0>;

            menetphy: ethernet-phy@3 {
                compatible = "ethernet-phy-id001c.c915";
                reg = <3>;
            };
        };
    };
```

## Documentation/devicetree/bindings/net/apm,xgene-mdio-rgmii.yaml
```yaml
# SPDX-License-Identifier: (GPL-2.0-only OR BSD-2-Clause)
%YAML 1.2
---
$id: http://devicetree.org/schemas/net/apm,xgene-mdio-rgmii.yaml#
$schema: http://devicetree.org/meta-schemas/core.yaml#

title: APM X-Gene SoC MDIO

maintainers:
  - Iyappan Subramanian <iyappan@os.amperecomputing.com>
  - Keyur Chudgar <keyur@os.amperecomputing.com>
  - Quan Nguyen <quan@os.amperecomputing.com>

allOf:
  - $ref: mdio.yaml#

properties:
  compatible:
    enum:
      - apm,xgene-mdio-rgmii
      - apm,xgene-mdio-xfi

  reg:
    maxItems: 1

  clocks:
    maxItems: 1

unevaluatedProperties: false

required:
  - compatible
  - reg
  - clocks

examples:
  - |
    mdio@17020000 {
        compatible = "apm,xgene-mdio-rgmii";
        #address-cells = <1>;
        #size-cells = <0>;
        reg = <0x17020000 0xd100>;
        clocks = <&menetclk 0>;

        phy@3 {
            reg = <0x3>;
        };
        phy@4 {
            reg = <0x4>;
        };
        phy@5 {
            reg = <0x5>;
        };
    };
```

## Documentation/devicetree/bindings/net/apm-xgene-enet.txt
```
APM X-Gene SoC Ethernet nodes

Ethernet nodes are defined to describe on-chip ethernet interfaces in
APM X-Gene SoC.

Required properties for all the ethernet interfaces:
- compatible: Should state binding information from the following list,
  - "apm,xgene-enet":    RGMII based 1G interface
  - "apm,xgene1-sgenet": SGMII based 1G interface
  - "apm,xgene1-xgenet": XFI based 10G interface
- reg: Address and length of the register set for the device. It contains the
  information of registers in the same order as described by reg-names
- reg-names: Should contain the register set names
  - "enet_csr": Ethernet control and status register address space
  - "ring_csr": Descriptor ring control and status register address space
  - "ring_cmd": Descriptor ring command register address space
- interrupts: Two interrupt specifiers can be specified.
  - First is the Rx interrupt.  This irq is mandatory.
  - Second is the Tx completion interrupt.
    This is supported only on SGMII based 1GbE and 10GbE interfaces.
- port-id: Port number (0 or 1)
- clocks: Reference to the clock entry.
- local-mac-address: MAC address assigned to this device
- phy-connection-type: Interface type between ethernet device and PHY device

Required properties for ethernet interfaces that have external PHY:
- phy-handle: Reference to a PHY node connected to this device

- mdio: Device tree subnode with the following required properties:
  - compatible: Must be "apm,xgene-mdio".
  - #address-cells: Must be <1>.
  - #size-cells: Must be <0>.

  For the phy on the mdio bus, there must be a node with the following fields:
  - compatible: PHY identifier.  Please refer ./phy.txt for the format.
  - reg: The ID number for the phy.

Optional properties:
- status: Should be "ok" or "disabled" for enabled/disabled. Default is "ok".
- tx-delay: Delay value for RGMII bridge TX clock.
	    Valid values are between 0 to 7, that maps to
	    417, 717, 1020, 1321, 1611, 1913, 2215, 2514 ps
	    Default value is 4, which corresponds to 1611 ps
- rx-delay: Delay value for RGMII bridge RX clock.
	    Valid values are between 0 to 7, that maps to
	    273, 589, 899, 1222, 1480, 1806, 2147, 2464 ps
	    Default value is 2, which corresponds to 899 ps

Example:
	menetclk: menetclk {
		compatible = "apm,xgene-device-clock";
		clock-output-names = "menetclk";
		status = "ok";
	};

	menet: ethernet@17020000 {
		compatible = "apm,xgene-enet";
		status = "disabled";
		reg = <0x0 0x17020000 0x0 0xd100>,
		      <0x0 0X17030000 0x0 0X400>,
		      <0x0 0X10000000 0x0 0X200>;
		reg-names = "enet_csr", "ring_csr", "ring_cmd";
		interrupts = <0x0 0x3c 0x4>;
		port-id = <0>;
		clocks = <&menetclk 0>;
		local-mac-address = [00 01 73 00 00 01];
		phy-connection-type = "rgmii";
		phy-handle = <&menetphy>;
		mdio {
			compatible = "apm,xgene-mdio";
			#address-cells = <1>;
			#size-cells = <0>;
			menetphy: menetphy@3 {
				compatible = "ethernet-phy-id001c.c915";
				reg = <0x3>;
			};

		};
	};

/* Board-specific peripheral configurations */
&menet {
	tx-delay = <4>;
	rx-delay = <2>;
        status = "ok";
};
```

## Documentation/devicetree/bindings/net/apm-xgene-mdio.txt
```
APM X-Gene SoC MDIO node

MDIO node is defined to describe on-chip MDIO controller.

Required properties:
	- compatible: Must be "apm,xgene-mdio-rgmii" or "apm,xgene-mdio-xfi"
	- #address-cells: Must be <1>.
	- #size-cells: Must be <0>.
	- reg: Address and length of the register set
	- clocks: Reference to the clock entry

For the phys on the mdio bus, there must be a node with the following fields:
	- compatible: PHY identifier.  Please refer ./phy.txt for the format.
	- reg: The ID number for the phy.

Example:

	mdio: mdio@17020000 {
		compatible = "apm,xgene-mdio-rgmii";
		#address-cells = <1>;
		#size-cells = <0>;
		reg = <0x0 0x17020000 0x0 0xd100>;
		clocks = <&menetclk 0>;
	};

	/* Board-specific peripheral configurations */
	&mdio {
		menetphy: phy@3 {
			reg = <0x3>;
		};
		sgenet0phy: phy@4 {
			reg = <0x4>;
		};
		sgenet1phy: phy@5 {
			reg = <0x5>;
		};
	};
```

## Documentation/devicetree/bindings/net/arc_emac.txt
```
* Synopsys ARC EMAC 10/100 Ethernet driver (EMAC)

Required properties:
- compatible: Should be "snps,arc-emac"
- reg: Address and length of the register set for the device
- interrupts: Should contain the EMAC interrupts
- max-speed: see ethernet.txt file in the same directory.
- phy: see ethernet.txt file in the same directory.

Clock handling:
The clock frequency is needed to calculate and set polling period of EMAC.
It must be provided by one of:
- clock-frequency: CPU frequency.
- clocks: reference to the clock supplying the EMAC.

Child nodes of the driver are the individual PHY devices connected to the
MDIO bus. They must have a "reg" property given the PHY address on the MDIO bus.

Examples:

	ethernet@c0fc2000 {
		compatible = "snps,arc-emac";
		reg = <0xc0fc2000 0x3c>;
		interrupts = <6>;
		mac-address = [ 00 11 22 33 44 55 ];

		clock-frequency = <80000000>;
		/* or */
		clocks = <&emac_clock>;

		max-speed = <100>;
		phy = <&phy0>;

		#address-cells = <1>;
		#size-cells = <0>;
		phy0: ethernet-phy@0 {
			reg = <1>;
		};
	};
```

## Documentation/devicetree/bindings/net/asix,ax88178.yaml
```yaml
# SPDX-License-Identifier: (GPL-2.0-only OR BSD-2-Clause)
%YAML 1.2
---
$id: http://devicetree.org/schemas/net/asix,ax88178.yaml#
$schema: http://devicetree.org/meta-schemas/core.yaml#

title: ASIX AX88172/AX88772 USB Ethernet Controllers

maintainers:
  - Oleksij Rempel <o.rempel@pengutronix.de>

description: |
  Device tree properties for hard wired USB Ethernet devices.

allOf:
  - $ref: ethernet-controller.yaml#

properties:
  compatible:
    items:
      - enum:
          - usbb95,1720   # ASIX AX88172
          - usbb95,172a   # ASIX AX88172A
          - usbb95,1780   # ASIX AX88178
          - usbb95,7720   # ASIX AX88772
          - usbb95,772a   # ASIX AX88772A
          - usbb95,772b   # ASIX AX88772B
          - usbb95,7e2b   # ASIX AX88772B

  reg:
    maxItems: 1

  local-mac-address: true
  mac-address: true

required:
  - compatible
  - reg

additionalProperties: false

examples:
  - |
    usb {
        #address-cells = <1>;
        #size-cells = <0>;

        ethernet@1 {
            compatible = "usbb95,7e2b";
            reg = <1>;
            local-mac-address = [00 00 00 00 00 00];
        };
    };
  - |
    usb {
        #address-cells = <1>;
        #size-cells = <0>;

        usb1@1 {
            compatible = "usb1234,5678";
            reg = <1>;
            #address-cells = <1>;
            #size-cells = <0>;

            ethernet@1 {
               compatible = "usbb95,772b";
               reg = <1>;
            };
        };
    };
```

## Documentation/devicetree/bindings/net/asix,ax88796c.yaml
```yaml
# SPDX-License-Identifier: GPL-2.0-only OR BSD-2-Clause
%YAML 1.2
---
$id: http://devicetree.org/schemas/net/asix,ax88796c.yaml#
$schema: http://devicetree.org/meta-schemas/core.yaml#

title: ASIX AX88796C SPI Ethernet Adapter

maintainers:
  - Łukasz Stelmach <l.stelmach@samsung.com>

description: |
  ASIX AX88796C is an Ethernet controller with a built in PHY. This
  describes SPI mode of the chip.

  The node for this driver must be a child node of an SPI controller,
  hence all mandatory properties described in
  ../spi/spi-controller.yaml must be specified.

allOf:
  - $ref: ethernet-controller.yaml#
  - $ref: /schemas/spi/spi-peripheral-props.yaml

properties:
  compatible:
    const: asix,ax88796c

  reg:
    maxItems: 1

  spi-max-frequency:
    maximum: 40000000

  interrupts:
    maxItems: 1

  reset-gpios:
    description:
      A GPIO line handling reset of the chip. As the line is active low,
      it should be marked GPIO_ACTIVE_LOW.
    maxItems: 1

  controller-data: true
  local-mac-address: true
  mac-address: true

required:
  - compatible
  - reg
  - spi-max-frequency
  - interrupts
  - reset-gpios

additionalProperties: false

examples:
  # Artik5 eval board
  - |
    #include <dt-bindings/interrupt-controller/irq.h>
    #include <dt-bindings/gpio/gpio.h>
    spi {
        #address-cells = <1>;
        #size-cells = <0>;

        ethernet@0 {
            compatible = "asix,ax88796c";
            reg = <0x0>;
            local-mac-address = [00 00 00 00 00 00]; /* Filled in by a bootloader */
            interrupt-parent = <&gpx2>;
            interrupts = <0 IRQ_TYPE_LEVEL_LOW>;
            spi-max-frequency = <40000000>;
            reset-gpios = <&gpe0 2 GPIO_ACTIVE_LOW>;
        };
    };
```

## Documentation/devicetree/bindings/net/aspeed,ast2600-mdio.yaml
```yaml
# SPDX-License-Identifier: GPL-2.0-or-later
%YAML 1.2
---
$id: http://devicetree.org/schemas/net/aspeed,ast2600-mdio.yaml#
$schema: http://devicetree.org/meta-schemas/core.yaml#

title: ASPEED AST2600 MDIO Controller

maintainers:
  - Andrew Jeffery <andrew@aj.id.au>

description: |+
  The ASPEED AST2600 MDIO controller is the third iteration of ASPEED's MDIO
  bus register interface, this time also separating out the controller from the
  MAC.

allOf:
  - $ref: "mdio.yaml#"

properties:
  compatible:
    const: aspeed,ast2600-mdio
  reg:
    maxItems: 1
    description: The register range of the MDIO controller instance

required:
  - compatible
  - reg
  - "#address-cells"
  - "#size-cells"

examples:
  - |
    mdio0: mdio@1e650000 {
            compatible = "aspeed,ast2600-mdio";
            reg = <0x1e650000 0x8>;
            #address-cells = <1>;
            #size-cells = <0>;

            ethphy0: ethernet-phy@0 {
                    compatible = "ethernet-phy-ieee802.3-c22";
                    reg = <0>;
            };
    };
```

## Documentation/devicetree/bindings/net/bluetooth.txt
```
The following properties are common to the Bluetooth controllers:

- local-bd-address: array of 6 bytes, specifies the BD address that was
  uniquely assigned to the Bluetooth device, formatted with least significant
  byte first (little-endian).
```

## Documentation/devicetree/bindings/net/bluetooth/amlogic,w155s2-bt.yaml
```yaml
# SPDX-License-Identifier: (GPL-2.0-only OR BSD-2-Clause)
# Copyright (C) 2024 Amlogic, Inc. All rights reserved
%YAML 1.2
---
$id: http://devicetree.org/schemas/net/bluetooth/amlogic,w155s2-bt.yaml#
$schema: http://devicetree.org/meta-schemas/core.yaml#

title: Amlogic Bluetooth chips

description:
  The W155S2 is an Amlogic Bluetooth and Wi-Fi combo chip. It works on
  the standard H4 protocol via a 4-wire UART interface, with baud rates
  up to 4 Mbps.

maintainers:
  - Yang Li <yang.li@amlogic.com>

properties:
  compatible:
    oneOf:
      - items:
          - enum:
              - amlogic,w265s1-bt
              - amlogic,w265p1-bt
          - const: amlogic,w155s2-bt
      - enum:
          - amlogic,w155s2-bt
          - amlogic,w265s2-bt

  clocks:
    maxItems: 1
    description: clock provided to the controller (32.768KHz)

  enable-gpios:
    maxItems: 1

  vddio-supply:
    description: VDD_IO supply regulator handle

  firmware-name:
    maxItems: 1
    description: specify the path of firmware bin to load

required:
  - compatible
  - clocks
  - enable-gpios
  - vddio-supply
  - firmware-name

additionalProperties: false

examples:
  - |
    #include <dt-bindings/gpio/gpio.h>
    bluetooth {
        compatible = "amlogic,w155s2-bt";
        clocks = <&extclk>;
        enable-gpios = <&gpio 17 GPIO_ACTIVE_HIGH>;
        vddio-supply = <&wcn_3v3>;
        firmware-name = "amlogic/aml_w155s2_bt_uart.bin";
    };
```
