## Documentation/devicetree/bindings/net/bluetooth/bluetooth-controller.yaml
```yaml
# SPDX-License-Identifier: (GPL-2.0 OR BSD-2-Clause)
%YAML 1.2
---
$id: http://devicetree.org/schemas/net/bluetooth/bluetooth-controller.yaml#
$schema: http://devicetree.org/meta-schemas/core.yaml#

title: Bluetooth Controller Generic Binding

maintainers:
  - Marcel Holtmann <marcel@holtmann.org>
  - Johan Hedberg <johan.hedberg@gmail.com>
  - Luiz Augusto von Dentz <luiz.dentz@gmail.com>

properties:
  $nodename:
    pattern: "^bluetooth(@.*)?$"

  local-bd-address:
    $ref: /schemas/types.yaml#/definitions/uint8-array
    maxItems: 6
    description:
      Specifies the BD address that was uniquely assigned to the Bluetooth
      device. Formatted with least significant byte first (little-endian), e.g.
      in order to assign the address 00:11:22:33:44:55 this property must have
      the value [55 44 33 22 11 00].

additionalProperties: true

...
```

## Documentation/devicetree/bindings/net/bluetooth/brcm,bcm4377-bluetooth.yaml
```yaml
# SPDX-License-Identifier: (GPL-2.0 OR BSD-2-Clause)
%YAML 1.2
---
$id: http://devicetree.org/schemas/net/bluetooth/brcm,bcm4377-bluetooth.yaml#
$schema: http://devicetree.org/meta-schemas/core.yaml#

title: Broadcom BCM4377 family PCIe Bluetooth Chips

maintainers:
  - Sven Peter <sven@svenpeter.dev>

description:
  This binding describes Broadcom BCM4377 family PCIe-attached bluetooth chips
  usually found in Apple machines. The Wi-Fi part of the chip is described in
  bindings/net/wireless/brcm,bcm4329-fmac.yaml.

allOf:
  - $ref: bluetooth-controller.yaml#

properties:
  compatible:
    enum:
      - pci14e4,5fa0 # BCM4377
      - pci14e4,5f69 # BCM4378
      - pci14e4,5f71 # BCM4387
      - pci14e4,5f72 # BCM4388

  reg:
    maxItems: 1

  brcm,board-type:
    $ref: /schemas/types.yaml#/definitions/string
    description: Board type of the Bluetooth chip. This is used to decouple
      the overall system board from the Bluetooth module and used to construct
      firmware and calibration data filenames.
      On Apple platforms, this should be the Apple module-instance codename
      prefixed by "apple,", e.g. "apple,atlantisb".
    pattern: '^apple,.*'

  brcm,taurus-cal-blob:
    $ref: /schemas/types.yaml#/definitions/uint8-array
    description: A per-device calibration blob for the Bluetooth radio. This
      should be filled in by the bootloader from platform configuration
      data, if necessary, and will be uploaded to the device.
      This blob is used if the chip stepping of the Bluetooth module does not
      support beamforming.

  brcm,taurus-bf-cal-blob:
    $ref: /schemas/types.yaml#/definitions/uint8-array
    description: A per-device calibration blob for the Bluetooth radio. This
      should be filled in by the bootloader from platform configuration
      data, if necessary, and will be uploaded to the device.
      This blob is used if the chip stepping of the Bluetooth module supports
      beamforming.

  local-bd-address: true

required:
  - compatible
  - reg
  - local-bd-address
  - brcm,board-type

additionalProperties: false

examples:
  - |
    pcie@a0000000 {
      #address-cells = <3>;
      #size-cells = <2>;
      reg = <0xa0000000 0x1000000>;
      device_type = "pci";
      ranges = <0x43000000 0x6 0xa0000000 0xa0000000 0x0 0x20000000>;

      bluetooth@0,1 {
        compatible = "pci14e4,5f69";
        reg = <0x100 0x0 0x0 0x0 0x0>;
        brcm,board-type = "apple,honshu";
        /* To be filled by the bootloader */
        local-bd-address = [00 00 00 00 00 00];
      };
    };
```

## Documentation/devicetree/bindings/net/bluetooth/marvell,88w8897.yaml
```yaml
# SPDX-License-Identifier: (GPL-2.0 OR BSD-2-Clause)
%YAML 1.2
---
$id: http://devicetree.org/schemas/net/bluetooth/marvell,88w8897.yaml#
$schema: http://devicetree.org/meta-schemas/core.yaml#

title: Marvell Bluetooth chips

description: |
  This documents the binding structure and common properties for serial
  attached Marvell Bluetooth devices.

maintainers:
  - Rob Herring <robh@kernel.org>

properties:
  compatible:
    enum:
      - mrvl,88w8897
      - mrvl,88w8997

  max-speed: true

required:
  - compatible

allOf:
  - $ref: /schemas/serial/serial-peripheral-props.yaml#
  - if:
      properties:
        compatible:
          contains:
            const: mrvl,88w8997
    then:
      properties:
        max-speed: true
    else:
      properties:
        max-speed: false

additionalProperties: false

examples:
  - |
    serial {
      bluetooth {
        compatible = "mrvl,88w8897";
      };
    };
```

## Documentation/devicetree/bindings/net/bluetooth/marvell,sd8897-bt.yaml
```yaml
# SPDX-License-Identifier: (GPL-2.0 OR BSD-2-Clause)
%YAML 1.2
---
$id: http://devicetree.org/schemas/net/bluetooth/marvell,sd8897-bt.yaml#
$schema: http://devicetree.org/meta-schemas/core.yaml#

title: Marvell 8897/8997 (sd8897/sd8997) bluetooth devices (SDIO)

maintainers:
  - Ariel D'Alessandro <ariel.dalessandro@collabora.com>

allOf:
  - $ref: /schemas/net/bluetooth/bluetooth-controller.yaml#

properties:
  compatible:
    enum:
      - marvell,sd8897-bt
      - marvell,sd8997-bt

  reg:
    maxItems: 1

  interrupts:
    maxItems: 1

  marvell,cal-data:
    $ref: /schemas/types.yaml#/definitions/uint8-array
    description:
      Calibration data downloaded to the device during initialization.
    maxItems: 28

  marvell,wakeup-pin:
    $ref: /schemas/types.yaml#/definitions/uint16
    description:
      Wakeup pin number of the bluetooth chip. Used by firmware to wakeup host
      system.

  marvell,wakeup-gap-ms:
    $ref: /schemas/types.yaml#/definitions/uint16
    description:
      Wakeup latency of the host platform. Required by the chip sleep feature.

required:
  - compatible
  - reg
  - interrupts

additionalProperties: false

examples:
  - |
    #include <dt-bindings/interrupt-controller/irq.h>

    mmc {
        vmmc-supply = <&wlan_en_reg>;
        bus-width = <4>;
        cap-power-off-card;
        keep-power-in-suspend;

        #address-cells = <1>;
        #size-cells = <0>;

        bluetooth@2 {
            compatible = "marvell,sd8897-bt";
            reg = <2>;
            interrupt-parent = <&pio>;
            interrupts = <119 IRQ_TYPE_LEVEL_LOW>;

            marvell,cal-data = /bits/ 8 <
                0x37 0x01 0x1c 0x00 0xff 0xff 0xff 0xff 0x01 0x7f 0x04 0x02
                0x00 0x00 0xba 0xce 0xc0 0xc6 0x2d 0x00 0x00 0x00 0x00 0x00
                0x00 0x00 0xf0 0x00>;
            marvell,wakeup-pin = /bits/ 16 <0x0d>;
            marvell,wakeup-gap-ms = /bits/ 16 <0x64>;
        };
    };

...
```

## Documentation/devicetree/bindings/net/bluetooth/mediatek,mt7622-bluetooth.yaml
```yaml
# SPDX-License-Identifier: GPL-2.0-only OR BSD-2-Clause
%YAML 1.2
---
$id: http://devicetree.org/schemas/net/bluetooth/mediatek,mt7622-bluetooth.yaml#
$schema: http://devicetree.org/meta-schemas/core.yaml#

title: MediaTek SoC built-in Bluetooth

description:
  This device is a serial attached device to BTIF device and thus it must be a
  child node of the serial node with BTIF. The dt-bindings details for BTIF
  device can be known via Documentation/devicetree/bindings/serial/8250.yaml.

maintainers:
  - Sean Wang <sean.wang@mediatek.com>

allOf:
  - $ref: bluetooth-controller.yaml#

properties:
  compatible:
    const: mediatek,mt7622-bluetooth

  clocks:
    maxItems: 1

  clock-names:
    const: ref

  power-domains:
    maxItems: 1

required:
  - clocks
  - clock-names
  - power-domains

unevaluatedProperties: false

examples:
  - |
    #include <dt-bindings/power/mt7622-power.h>

    serial {
        bluetooth {
            compatible = "mediatek,mt7622-bluetooth";
            power-domains = <&scpsys MT7622_POWER_DOMAIN_WB>;
            clocks = <&clk25m>;
            clock-names = "ref";
        };
    };
```

## Documentation/devicetree/bindings/net/bluetooth/mediatek,mt7921s-bluetooth.yaml
```yaml
# SPDX-License-Identifier: (GPL-2.0 OR BSD-2-Clause)
%YAML 1.2
---
$id: http://devicetree.org/schemas/net/bluetooth/mediatek,mt7921s-bluetooth.yaml#
$schema: http://devicetree.org/meta-schemas/core.yaml#

title: MediaTek MT7921S Bluetooth

maintainers:
  - Sean Wang <sean.wang@mediatek.com>

description:
  MT7921S is an SDIO-attached dual-radio WiFi+Bluetooth Combo chip; each
  function is its own SDIO function on a shared SDIO interface. The chip
  has two dedicated reset lines, one for each function core.
  This binding only covers the Bluetooth SDIO function, with one device
  node describing only this SDIO function.

allOf:
  - $ref: bluetooth-controller.yaml#

properties:
  compatible:
    enum:
      - mediatek,mt7921s-bluetooth

  reg:
    const: 2

  reset-gpios:
    maxItems: 1
    description:
      An active-low reset line for the Bluetooth core; on typical M.2
      key E modules this is the W_DISABLE2# pin.

required:
  - compatible
  - reg

unevaluatedProperties: false

examples:
  - |
    #include <dt-bindings/gpio/gpio.h>

    mmc {
        #address-cells = <1>;
        #size-cells = <0>;

        bluetooth@2 {
            compatible = "mediatek,mt7921s-bluetooth";
            reg = <2>;
            reset-gpios = <&pio 8 GPIO_ACTIVE_LOW>;
        };
    };
```

## Documentation/devicetree/bindings/net/bluetooth/nxp,88w8987-bt.yaml
```yaml
# SPDX-License-Identifier: (GPL-2.0 OR BSD-2-Clause)
%YAML 1.2
---
$id: http://devicetree.org/schemas/net/bluetooth/nxp,88w8987-bt.yaml#
$schema: http://devicetree.org/meta-schemas/core.yaml#

title: NXP Bluetooth chips

description:
  This binding describes UART-attached NXP bluetooth chips. These chips
  are dual-radio chips supporting WiFi and Bluetooth. The bluetooth
  works on standard H4 protocol over 4-wire UART. The RTS and CTS lines
  are used during FW download. To enable power save mode, the host
  asserts break signal over UART-TX line to put the chip into power save
  state. De-asserting break wakes up the BT chip.

maintainers:
  - Neeraj Sanjay Kale <neeraj.sanjaykale@nxp.com>

allOf:
  - $ref: bluetooth-controller.yaml#

properties:
  compatible:
    enum:
      - nxp,88w8987-bt
      - nxp,88w8997-bt

  fw-init-baudrate:
    $ref: /schemas/types.yaml#/definitions/uint32
    default: 115200
    description:
      Chip baudrate after FW is downloaded and initialized.
      This property depends on the module vendor's
      configuration.

  max-speed:
    $ref: /schemas/types.yaml#/definitions/uint32
    enum:
      - 3000000
      - 4000000
    default: 3000000

  firmware-name:
    maxItems: 1

  device-wakeup-gpios:
    maxItems: 1
    description:
      Host-To-Chip power save mechanism is driven by this GPIO
      connected to BT_WAKE_IN pin of the NXP chipset.

  nxp,wakein-pin:
    $ref: /schemas/types.yaml#/definitions/uint8
    description:
      The GPIO number of the NXP chipset used for BT_WAKE_IN.

  interrupts:
    maxItems: 1
    description:
      Host wakeup by falling edge interrupt on this pin which is
      connected to BT_WAKE_OUT pin of the NXP chipset.

  interrupt-names:
    items:
      - const: wakeup

  wakeup-source: true

  nxp,wakeout-pin:
    $ref: /schemas/types.yaml#/definitions/uint8
    description:
      The GPIO number of the NXP chipset used for BT_WAKE_OUT.

  vcc-supply:
    description:
      phandle of the regulator that provides the supply voltage.

  reset-gpios:
    description:
      Chip powerdown/reset signal (PDn).

required:
  - compatible

unevaluatedProperties: false

examples:
  - |
    #include <dt-bindings/gpio/gpio.h>
    #include <dt-bindings/interrupt-controller/irq.h>
    serial {
        bluetooth {
            compatible = "nxp,88w8987-bt";
            fw-init-baudrate = <3000000>;
            max-speed = <4000000>;
            firmware-name = "uartuart8987_bt_v0.bin";
            device-wakeup-gpios = <&gpio 11 GPIO_ACTIVE_HIGH>;
            nxp,wakein-pin = /bits/ 8 <18>;
            nxp,wakeout-pin = /bits/ 8 <19>;
            vcc-supply = <&nxp_iw612_supply>;
            reset-gpios = <&gpioctrl 2 GPIO_ACTIVE_LOW>;
            local-bd-address = [66 55 44 33 22 11];
            interrupt-parent = <&gpio>;
            interrupts = <8 IRQ_TYPE_EDGE_FALLING>;
            interrupt-names = "wakeup";
            wakeup-source;
        };
    };
```

## Documentation/devicetree/bindings/net/bluetooth/qcom,bluetooth-common.yaml
```yaml
# SPDX-License-Identifier: (GPL-2.0 OR BSD-2-Clause)
%YAML 1.2
---
$id: http://devicetree.org/schemas/net/bluetooth/qcom,bluetooth-common.yaml#
$schema: http://devicetree.org/meta-schemas/core.yaml#

title: Qualcomm Bluetooth Common Properties

maintainers:
  - Balakrishna Godavarthi <quic_bgodavar@quicinc.com>
  - Rocky Liao <quic_rjliao@quicinc.com>

properties:
  firmware-name:
    minItems: 1
    items:
      - description: specify the name of nvm firmware to load
      - description: specify the name of rampatch firmware to load

  qcom,local-bd-address-broken:
    type: boolean
    description:
      boot firmware is incorrectly passing the address in big-endian order

additionalProperties: true
```

## Documentation/devicetree/bindings/net/bluetooth/qcom,qca2066-bt.yaml
```yaml
# SPDX-License-Identifier: (GPL-2.0 OR BSD-2-Clause)
%YAML 1.2
---
$id: http://devicetree.org/schemas/net/bluetooth/qcom,qca2066-bt.yaml#
$schema: http://devicetree.org/meta-schemas/core.yaml#

title: Qualcomm QCA2006 Bluetooth

maintainers:
  - Balakrishna Godavarthi <quic_bgodavar@quicinc.com>
  - Rocky Liao <quic_rjliao@quicinc.com>

properties:
  compatible:
    enum:
      - qcom,qca2066-bt
      - qcom,qca6174-bt

  clocks:
    items:
      - description: External low-power 32.768 kHz clock input

  enable-gpios:
    maxItems: 1

required:
  - compatible
  - clocks
  - enable-gpios

allOf:
  - $ref: bluetooth-controller.yaml#
  - $ref: qcom,bluetooth-common.yaml
  - $ref: /schemas/serial/serial-peripheral-props.yaml#

unevaluatedProperties: false

examples:
  - |
    #include <dt-bindings/gpio/gpio.h>

    serial {
        bluetooth {
            compatible = "qcom,qca6174-bt";
            clocks = <&divclk4>;
            enable-gpios = <&pm8994_gpios 19 GPIO_ACTIVE_HIGH>;
            firmware-name = "nvm_00440302.bin";
        };
    };
```

## Documentation/devicetree/bindings/net/bluetooth/qcom,qca6390-bt.yaml
```yaml
# SPDX-License-Identifier: (GPL-2.0 OR BSD-2-Clause)
%YAML 1.2
---
$id: http://devicetree.org/schemas/net/bluetooth/qcom,qca6390-bt.yaml#
$schema: http://devicetree.org/meta-schemas/core.yaml#

title: Qualcomm QCA6390 Bluetooth

maintainers:
  - Balakrishna Godavarthi <quic_bgodavar@quicinc.com>
  - Rocky Liao <quic_rjliao@quicinc.com>

properties:
  compatible:
    enum:
      - qcom,qca6390-bt

  vddaon-supply:
    description: VDD_AON supply regulator handle

  vddbtcmx-supply:
    description: VDD_BT_CMX supply regulator handle

  vddrfa0p8-supply:
    description: VDD_RFA_0P8 supply regulator handle

  vddrfa1p2-supply:
    description: VDD_RFA_1P2 supply regulator handle

  vddrfa1p7-supply:
    description: VDD_RFA_1P7 supply regulator handle

  vddrfacmn-supply:
    description: VDD_RFA_CMN supply regulator handle

required:
  - compatible
  - vddaon-supply
  - vddbtcmx-supply
  - vddrfa0p8-supply
  - vddrfa1p2-supply
  - vddrfa1p7-supply
  - vddrfacmn-supply

allOf:
  - $ref: bluetooth-controller.yaml#
  - $ref: qcom,bluetooth-common.yaml
  - $ref: /schemas/serial/serial-peripheral-props.yaml#

unevaluatedProperties: false

examples:
  - |
    serial {
        bluetooth {
            compatible = "qcom,qca6390-bt";
            vddaon-supply = <&vreg_pmu_aon_0p59>;
            vddbtcmx-supply = <&vreg_pmu_btcmx_0p85>;
            vddrfa0p8-supply = <&vreg_pmu_rfa_0p8>;
            vddrfa1p2-supply = <&vreg_pmu_rfa_1p2>;
            vddrfa1p7-supply = <&vreg_pmu_rfa_1p7>;
            vddrfacmn-supply = <&vreg_pmu_rfa_cmn>;
        };
    };
```
