## Documentation/devicetree/bindings/net/can/microchip,mcp2510.yaml
```yaml
# SPDX-License-Identifier: (GPL-2.0-only OR BSD-2-Clause)
%YAML 1.2
---
$id: http://devicetree.org/schemas/can/microchip,mcp2510.yaml#
$schema: http://devicetree.org/meta-schemas/core.yaml#

title: Microchip MCP251X stand-alone CAN controller

maintainers:
  - Marc Kleine-Budde <mkl@pengutronix.de>

properties:
  compatible:
    enum:
      - microchip,mcp2510
      - microchip,mcp2515
      - microchip,mcp25625

  reg:
    maxItems: 1

  clocks:
    maxItems: 1

  interrupts:
    maxItems: 1

  vdd-supply:
    description: Regulator that powers the CAN controller.

  xceiver-supply:
    description: Regulator that powers the CAN transceiver.

  gpio-controller: true

  "#gpio-cells":
    const: 2

required:
  - compatible
  - reg
  - clocks
  - interrupts

allOf:
  - $ref: /schemas/spi/spi-peripheral-props.yaml#

unevaluatedProperties: false

examples:
  - |
    #include <dt-bindings/interrupt-controller/irq.h>

    spi {
        #address-cells = <1>;
        #size-cells = <0>;

        can@1 {
            compatible = "microchip,mcp2515";
            reg = <1>;
            clocks = <&clk24m>;
            interrupt-parent = <&gpio4>;
            interrupts = <13 IRQ_TYPE_LEVEL_LOW>;
            vdd-supply = <&reg5v0>;
            xceiver-supply = <&reg5v0>;
            gpio-controller;
            #gpio-cells = <2>;
        };
    };
```

## Documentation/devicetree/bindings/net/can/microchip,mcp251x.txt
```
* Microchip MCP251X stand-alone CAN controller device tree bindings

Required properties:
 - compatible: Should be one of the following:
   - "microchip,mcp2510" for MCP2510.
   - "microchip,mcp2515" for MCP2515.
   - "microchip,mcp25625" for MCP25625.
 - reg: SPI chip select.
 - clocks: The clock feeding the CAN controller.
 - interrupts: Should contain IRQ line for the CAN controller.

Optional properties:
 - vdd-supply: Regulator that powers the CAN controller.
 - xceiver-supply: Regulator that powers the CAN transceiver.
 - gpio-controller: Indicates this device is a GPIO controller.
 - #gpio-cells: Should be two. The first cell is the pin number and
                the second cell is used to specify the gpio polarity.

Example:
	can0: can@1 {
		compatible = "microchip,mcp2515";
		reg = <1>;
		clocks = <&clk24m>;
		interrupt-parent = <&gpio4>;
		interrupts = <13 IRQ_TYPE_LEVEL_LOW>;
		vdd-supply = <&reg5v0>;
		xceiver-supply = <&reg5v0>;
		gpio-controller;
		#gpio-cells = <2>;
	};
```

## Documentation/devicetree/bindings/net/can/microchip,mcp251xfd.yaml
```yaml
# SPDX-License-Identifier: (GPL-2.0-only OR BSD-2-Clause)
%YAML 1.2
---
$id: http://devicetree.org/schemas/net/can/microchip,mcp251xfd.yaml#
$schema: http://devicetree.org/meta-schemas/core.yaml#

title:
  Microchip MCP2517FD, MCP2518FD and MCP251863 stand-alone CAN
  controller device tree bindings

maintainers:
  - Marc Kleine-Budde <mkl@pengutronix.de>

allOf:
  - $ref: can-controller.yaml#

properties:
  compatible:
    oneOf:
      - enum:
          - microchip,mcp2517fd
          - microchip,mcp2518fd
          - microchip,mcp251xfd
      - items:
          - enum:
              - microchip,mcp251863
          - const: microchip,mcp2518fd
  reg:
    maxItems: 1

  interrupts:
    maxItems: 1

  clocks:
    maxItems: 1

  vdd-supply:
    description: Regulator that powers the CAN controller.

  xceiver-supply:
    description: Regulator that powers the CAN transceiver.

  microchip,rx-int-gpios:
    description:
      GPIO phandle of GPIO connected to to INT1 pin of the MCP251XFD, which
      signals a pending RX interrupt.
    maxItems: 1

  spi-max-frequency:
    description:
      Must be half or less of "clocks" frequency.
    maximum: 20000000

required:
  - compatible
  - reg
  - interrupts
  - clocks

additionalProperties: false

examples:
  - |
    #include <dt-bindings/gpio/gpio.h>
    #include <dt-bindings/interrupt-controller/irq.h>

    spi0 {
        #address-cells = <1>;
        #size-cells = <0>;

        can@0 {
            compatible = "microchip,mcp251xfd";
            reg = <0>;
            clocks = <&can0_osc>;
            pinctrl-names = "default";
            pinctrl-0 = <&can0_pins>;
            spi-max-frequency = <20000000>;
            interrupts-extended = <&gpio 13 IRQ_TYPE_LEVEL_LOW>;
            microchip,rx-int-gpios = <&gpio 27 GPIO_ACTIVE_LOW>;
            vdd-supply = <&reg5v0>;
            xceiver-supply = <&reg5v0>;
        };
    };
```

## Documentation/devicetree/bindings/net/can/microchip,mpfs-can.yaml
```yaml
# SPDX-License-Identifier: (GPL-2.0-only OR BSD-2-Clause)
%YAML 1.2
---
$id: http://devicetree.org/schemas/net/can/microchip,mpfs-can.yaml#
$schema: http://devicetree.org/meta-schemas/core.yaml#

title:
  Microchip PolarFire SoC (MPFS) can controller

maintainers:
  - Conor Dooley <conor.dooley@microchip.com>

allOf:
  - $ref: can-controller.yaml#

properties:
  compatible:
    const: microchip,mpfs-can

  reg:
    maxItems: 1

  interrupts:
    maxItems: 1

  clocks:
    items:
      - description: AHB peripheral clock
      - description: CAN bus clock

required:
  - compatible
  - reg
  - interrupts
  - clocks

additionalProperties: false

examples:
  - |
    can@2010c000 {
        compatible = "microchip,mpfs-can";
        reg = <0x2010c000 0x1000>;
        clocks = <&clkcfg 17>, <&clkcfg 37>;
        interrupt-parent = <&plic>;
        interrupts = <56>;
    };
```

## Documentation/devicetree/bindings/net/can/mpc5xxx-mscan.txt
```
CAN Device Tree Bindings
------------------------

(c) 2006-2009 Secret Lab Techanallogies Ltd
Grant Likely <grant.likely@secretlab.ca>

fsl,mpc5200-mscan analdes
-----------------------
In addition to the required compatible-, reg- and interrupt-properties, you can
also specify which clock source shall be used for the controller:

- fsl,mscan-clock-source : a string describing the clock source. Valid values
			   are:	"ip" for ip bus clock
				 "ref" for reference clock (XTAL)
			   "ref" is default in case this property is analt
			   present.

fsl,mpc5121-mscan analdes
-----------------------
In addition to the required compatible-, reg- and interrupt-properties, you can
also specify which clock source and divider shall be used for the controller:

- fsl,mscan-clock-source : a string describing the clock source. Valid values
			   are:	"ip" for ip bus clock
				"ref" for reference clock
				"sys" for system clock
			   If this property is analt present, an optimal CAN
			   clock source and frequency based on the system
			   clock will be selected. If this is analt possible,
			   the reference clock will be used.

- fsl,mscan-clock-divider: for the reference and system clock, an additional
			   clock divider can be specified. By default, a
			   value of 1 is used.

Analte that the MPC5121 Rev. 1 processor is analt supported.

Examples:
	can@1300 {
		compatible = "fsl,mpc5121-mscan";
		interrupts = <12 0x8>;
		interrupt-parent = <&ipic>;
		reg = <0x1300 0x80>;
	};

	can@1380 {
		compatible = "fsl,mpc5121-mscan";
		interrupts = <13 0x8>;
		interrupt-parent = <&ipic>;
		reg = <0x1380 0x80>;
		fsl,mscan-clock-source = "ref";
		fsl,mscan-clock-divider = <3>;
	};
```

## Documentation/devicetree/bindings/net/can/nxp,sja1000.yaml
```yaml
# SPDX-License-Identifier: (GPL-2.0-only OR BSD-2-Clause)
%YAML 1.2
---
$id: http://devicetree.org/schemas/net/can/nxp,sja1000.yaml#
$schema: http://devicetree.org/meta-schemas/core.yaml#

title: Memory mapped SJA1000 CAN controller from NXP (formerly Philips)

maintainers:
  - Wolfgang Grandegger <wg@grandegger.com>

properties:
  compatible:
    oneOf:
      - enum:
          - nxp,sja1000
          - technologic,sja1000
      - items:
          - const: renesas,r9a06g032-sja1000 # RZ/N1D
          - const: renesas,rzn1-sja1000 # RZ/N1

  reg:
    maxItems: 1

  interrupts:
    maxItems: 1

  clocks:
    maxItems: 1

  power-domains:
    maxItems: 1

  reg-io-width:
    description: I/O register width (in bytes) implemented by this device
    default: 1
    enum: [ 1, 2, 4 ]

  nxp,external-clock-frequency:
    $ref: /schemas/types.yaml#/definitions/uint32
    default: 16000000
    description: |
      Frequency of the external oscillator clock in Hz.
      The internal clock frequency used by the SJA1000 is half of that value.

  nxp,tx-output-mode:
    $ref: /schemas/types.yaml#/definitions/uint32
    enum: [ 0, 1, 2, 3 ]
    default: 1
    description: |
      operation mode of the TX output control logic. Valid values are:
        <0> : bi-phase output mode
        <1> : normal output mode (default)
        <2> : test output mode
        <3> : clock output mode

  nxp,tx-output-config:
    $ref: /schemas/types.yaml#/definitions/uint32
    default: 0x02
    description: |
      TX output pin configuration. Valid values are any one of the below
      or combination of TX0 and TX1:
        <0x01> : TX0 invert
        <0x02> : TX0 pull-down (default)
        <0x04> : TX0 pull-up
        <0x06> : TX0 push-pull
        <0x08> : TX1 invert
        <0x10> : TX1 pull-down
        <0x20> : TX1 pull-up
        <0x30> : TX1 push-pull

  nxp,clock-out-frequency:
    $ref: /schemas/types.yaml#/definitions/uint32
    description: |
      clock frequency in Hz on the CLKOUT pin.
      If not specified or if the specified value is 0, the CLKOUT pin
      will be disabled.

  nxp,no-comparator-bypass:
    type: boolean
    description: Allows to disable the CAN input comparator.

required:
  - compatible
  - reg
  - interrupts

allOf:
  - $ref: can-controller.yaml#
  - if:
      properties:
        compatible:
          contains:
            enum:
              - technologic,sja1000
              - renesas,rzn1-sja1000
    then:
      required:
        - reg-io-width
  - if:
      properties:
        compatible:
          contains:
            const: renesas,rzn1-sja1000
    then:
      required:
        - clocks
        - power-domains

unevaluatedProperties: false

examples:
  - |
    can@1a000 {
        compatible = "technologic,sja1000";
        reg = <0x1a000 0x100>;
        interrupts = <1>;
        reg-io-width = <2>;
        nxp,tx-output-config = <0x06>;
        nxp,external-clock-frequency = <24000000>;
    };

  - |
    #include <dt-bindings/interrupt-controller/arm-gic.h>
    #include <dt-bindings/clock/r9a06g032-sysctrl.h>

    can@52104000 {
        compatible = "renesas,r9a06g032-sja1000", "renesas,rzn1-sja1000";
        reg = <0x52104000 0x800>;
        reg-io-width = <4>;
        interrupts = <GIC_SPI 95 IRQ_TYPE_LEVEL_HIGH>;
        clocks = <&sysctrl R9A06G032_HCLK_CAN0>;
        power-domains = <&sysctrl>;
    };
```

## Documentation/devicetree/bindings/net/can/rcar_can.txt
```
Renesas R-Car CAN controller Device Tree Bindings
-------------------------------------------------

Required properties:
- compatible: "renesas,can-r8a7743" if CAN controller is a part of R8A7743 SoC.
	      "renesas,can-r8a7744" if CAN controller is a part of R8A7744 SoC.
	      "renesas,can-r8a7745" if CAN controller is a part of R8A7745 SoC.
	      "renesas,can-r8a77470" if CAN controller is a part of R8A77470 SoC.
	      "renesas,can-r8a774a1" if CAN controller is a part of R8A774A1 SoC.
	      "renesas,can-r8a774b1" if CAN controller is a part of R8A774B1 SoC.
	      "renesas,can-r8a774c0" if CAN controller is a part of R8A774C0 SoC.
	      "renesas,can-r8a7778" if CAN controller is a part of R8A7778 SoC.
	      "renesas,can-r8a7779" if CAN controller is a part of R8A7779 SoC.
	      "renesas,can-r8a7790" if CAN controller is a part of R8A7790 SoC.
	      "renesas,can-r8a7791" if CAN controller is a part of R8A7791 SoC.
	      "renesas,can-r8a7792" if CAN controller is a part of R8A7792 SoC.
	      "renesas,can-r8a7793" if CAN controller is a part of R8A7793 SoC.
	      "renesas,can-r8a7794" if CAN controller is a part of R8A7794 SoC.
	      "renesas,can-r8a7795" if CAN controller is a part of R8A7795 SoC.
	      "renesas,can-r8a7796" if CAN controller is a part of R8A7796 SoC.
	      "renesas,can-r8a77965" if CAN controller is a part of R8A77965 SoC.
	      "renesas,can-r8a77990" if CAN controller is a part of R8A77990 SoC.
	      "renesas,can-r8a77995" if CAN controller is a part of R8A77995 SoC.
	      "renesas,rcar-gen1-can" for a generic R-Car Gen1 compatible device.
	      "renesas,rcar-gen2-can" for a generic R-Car Gen2 or RZ/G1
	      compatible device.
	      "renesas,rcar-gen3-can" for a generic R-Car Gen3 or RZ/G2
	      compatible device.
	      When compatible with the generic version, nodes must list the
	      SoC-specific version corresponding to the platform first
	      followed by the generic version.

- reg: physical base address and size of the R-Car CAN register map.
- interrupts: interrupt specifier for the sole interrupt.
- clocks: phandles and clock specifiers for 3 CAN clock inputs.
- clock-names: 3 clock input name strings: "clkp1", "clkp2", and "can_clk".
- pinctrl-0: pin control group to be used for this controller.
- pinctrl-names: must be "default".

Required properties for R8A774A1, R8A774B1, R8A774C0, R8A7795, R8A7796,
R8A77965, R8A77990, and R8A77995:
For the denoted SoCs, "clkp2" can be CANFD clock. This is a div6 clock and can
be used by both CAN and CAN FD controller at the same time. It needs to be
scaled to maximum frequency if any of these controllers use it. This is done
using the below properties:

- assigned-clocks: phandle of clkp2(CANFD) clock.
- assigned-clock-rates: maximum frequency of this clock.

Optional properties:
- renesas,can-clock-select: R-Car CAN Clock Source Select. Valid values are:
			    <0x0> (default) : Peripheral clock (clkp1)
			    <0x1> : Peripheral clock (clkp2)
			    <0x3> : External input clock

Example
-------

SoC common .dtsi file:

	can0: can@e6e80000 {
		compatible = "renesas,can-r8a7791", "renesas,rcar-gen2-can";
		reg = <0 0xe6e80000 0 0x1000>;
		interrupts = <0 186 IRQ_TYPE_LEVEL_HIGH>;
		clocks = <&mstp9_clks R8A7791_CLK_RCAN0>,
			 <&cpg_clocks R8A7791_CLK_RCAN>, <&can_clk>;
		clock-names = "clkp1", "clkp2", "can_clk";
		status = "disabled";
	};

Board specific .dts file:

&can0 {
	pinctrl-0 = <&can0_pins>;
	pinctrl-names = "default";
	status = "okay";
};
```
