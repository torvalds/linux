## Documentation/devicetree/bindings/net/can/ctu,ctucanfd.yaml
```yaml
# SPDX-License-Identifier: (GPL-2.0-only OR BSD-2-Clause)
%YAML 1.2
---
$id: http://devicetree.org/schemas/net/can/ctu,ctucanfd.yaml#
$schema: http://devicetree.org/meta-schemas/core.yaml#

title: CTU CAN FD Open-source IP Core

description: |
  Open-source CAN FD IP core developed at the Czech Technical University in Prague

  The core sources and documentation on project page
    [1] sources : https://gitlab.fel.cvut.cz/canbus/ctucanfd_ip_core
    [2] datasheet : https://canbus.pages.fel.cvut.cz/ctucanfd_ip_core/doc/Datasheet.pdf

  Integration in Xilinx Zynq SoC based system together with
  OpenCores SJA1000 compatible controllers
    [3] project : https://gitlab.fel.cvut.cz/canbus/zynq/zynq-can-sja1000-top
  Martin Jerabek dimploma thesis with integration and testing
  framework description
    [4] PDF : https://dspace.cvut.cz/bitstream/handle/10467/80366/F3-DP-2019-Jerabek-Martin-Jerabek-thesis-2019-canfd.pdf

maintainers:
  - Pavel Pisa <pisa@cmp.felk.cvut.cz>
  - Ondrej Ille <ondrej.ille@gmail.com>
  - Martin Jerabek <martin.jerabek01@gmail.com>

allOf:
  - $ref: can-controller.yaml#

properties:
  compatible:
    oneOf:
      - items:
          - const: ctu,ctucanfd-2
          - const: ctu,ctucanfd
      - const: ctu,ctucanfd

  reg:
    maxItems: 1

  interrupts:
    maxItems: 1

  clocks:
    description: |
      phandle of reference clock (100 MHz is appropriate
      for FPGA implementation on Zynq-7000 system).
    maxItems: 1

required:
  - compatible
  - reg
  - interrupts
  - clocks

additionalProperties: false

examples:
  - |
    ctu_can_fd_0: can@43c30000 {
      compatible = "ctu,ctucanfd";
      interrupts = <0 30 4>;
      clocks = <&clkc 15>;
      reg = <0x43c30000 0x10000>;
    };
```

## Documentation/devicetree/bindings/net/can/fsl,flexcan.yaml
```yaml
# SPDX-License-Identifier: (GPL-2.0-only OR BSD-2-Clause)
%YAML 1.2
---
$id: http://devicetree.org/schemas/net/can/fsl,flexcan.yaml#
$schema: http://devicetree.org/meta-schemas/core.yaml#

title:
  Flexcan CAN controller on Freescale's ARM and PowerPC system-on-a-chip (SOC).

maintainers:
  - Marc Kleine-Budde <mkl@pengutronix.de>

allOf:
  - $ref: can-controller.yaml#

properties:
  compatible:
    oneOf:
      - enum:
          - fsl,imx8qm-flexcan
          - fsl,imx8mp-flexcan
          - fsl,imx6q-flexcan
          - fsl,imx28-flexcan
          - fsl,imx25-flexcan
          - fsl,p1010-flexcan
          - fsl,vf610-flexcan
          - fsl,ls1021ar2-flexcan
          - fsl,lx2160ar1-flexcan
      - items:
          - enum:
              - fsl,imx53-flexcan
              - fsl,imx35-flexcan
          - const: fsl,imx25-flexcan
      - items:
          - enum:
              - fsl,imx7d-flexcan
              - fsl,imx6ul-flexcan
              - fsl,imx6sx-flexcan
          - const: fsl,imx6q-flexcan
      - items:
          - enum:
              - fsl,ls1028ar1-flexcan
          - const: fsl,lx2160ar1-flexcan

  reg:
    maxItems: 1

  interrupts:
    maxItems: 1

  clocks:
    maxItems: 2

  clock-names:
    items:
      - const: ipg
      - const: per

  clock-frequency:
    $ref: /schemas/types.yaml#/definitions/uint32
    description: |
      The oscillator frequency driving the flexcan device, filled in by the
      boot loader. This property should only be used the used operating system
      doesn't support the clocks and clock-names property.

  xceiver-supply:
    description: Regulator that powers the CAN transceiver.

  big-endian:
    $ref: /schemas/types.yaml#/definitions/flag
    description: |
      This means the registers of FlexCAN controller are big endian. This is
      optional property.i.e. if this property is not present in device tree
      node then controller is assumed to be little endian. If this property is
      present then controller is assumed to be big endian.

  fsl,stop-mode:
    description: |
      Register bits of stop mode control.

      The format should be as follows:
      <gpr req_gpr req_bit>
      gpr is the phandle to general purpose register node.
      req_gpr is the gpr register offset of CAN stop request.
      req_bit is the bit offset of CAN stop request.
    $ref: /schemas/types.yaml#/definitions/phandle-array
    items:
      items:
        - description: The 'gpr' is the phandle to general purpose register node.
        - description: The 'req_gpr' is the gpr register offset of CAN stop request.
          maximum: 0xff
        - description: The 'req_bit' is the bit offset of CAN stop request.
          maximum: 0x1f

  fsl,clk-source:
    description: |
      Select the clock source to the CAN Protocol Engine (PE). It's SoC
      implementation dependent. Refer to RM for detailed definition. If this
      property is not set in device tree node then driver selects clock source 1
      by default.
      0: clock source 0 (oscillator clock)
      1: clock source 1 (peripheral clock)
    $ref: /schemas/types.yaml#/definitions/uint8
    default: 1
    minimum: 0
    maximum: 1

  wakeup-source:
    $ref: /schemas/types.yaml#/definitions/flag
    description:
      Enable CAN remote wakeup.

  fsl,scu-index:
    description: |
      The scu index of CAN instance.
      For SoCs with SCU support, need setup stop mode via SCU firmware, so this
      property can help indicate a resource. It supports up to 3 CAN instances
      now.
    $ref: /schemas/types.yaml#/definitions/uint8
    minimum: 0
    maximum: 2

required:
  - compatible
  - reg
  - interrupts

additionalProperties: false

examples:
  - |
    can@1c000 {
        compatible = "fsl,p1010-flexcan";
        reg = <0x1c000 0x1000>;
        interrupts = <48 0x2>;
        interrupt-parent = <&mpic>;
        clock-frequency = <200000000>;
        fsl,clk-source = /bits/ 8 <0>;
    };
  - |
    #include <dt-bindings/interrupt-controller/irq.h>

    can@2090000 {
        compatible = "fsl,imx6q-flexcan";
        reg = <0x02090000 0x4000>;
        interrupts = <0 110 IRQ_TYPE_LEVEL_HIGH>;
        clocks = <&clks 1>, <&clks 2>;
        clock-names = "ipg", "per";
        fsl,stop-mode = <&gpr 0x34 28>;
        fsl,scu-index = /bits/ 8 <1>;
    };
```

## Documentation/devicetree/bindings/net/can/fsl-flexcan.txt
```
Flexcan CAN controller on Freescale's ARM and PowerPC system-on-a-chip (SOC).

Required properties:

- compatible : Should be "fsl,<processor>-flexcan"

  An implementation should also claim any of the following compatibles
  that it is fully backwards compatible with:

  - fsl,p1010-flexcan

- reg : Offset and length of the register set for this device
- interrupts : Interrupt tuple for this device

Optional properties:

- clock-frequency : The oscillator frequency driving the flexcan device

- xceiver-supply: Regulator that powers the CAN transceiver

- big-endian: This means the registers of FlexCAN controller are big endian.
              This is optional property.i.e. if this property is not present in
              device tree node then controller is assumed to be little endian.
              if this property is present then controller is assumed to be big
              endian.

- fsl,stop-mode: register bits of stop mode control, the format is
		 <&gpr req_gpr req_bit ack_gpr ack_bit>.
		 gpr is the phandle to general purpose register node.
		 req_gpr is the gpr register offset of CAN stop request.
		 req_bit is the bit offset of CAN stop request.
		 ack_gpr is the gpr register offset of CAN stop acknowledge.
		 ack_bit is the bit offset of CAN stop acknowledge.

- fsl,clk-source: Select the clock source to the CAN Protocol Engine (PE).
		  It's SoC Implementation dependent. Refer to RM for detailed
		  definition. If this property is not set in device tree node
		  then driver selects clock source 1 by default.
		  0: clock source 0 (oscillator clock)
		  1: clock source 1 (peripheral clock)

- wakeup-source: enable CAN remote wakeup

Example:

	can@1c000 {
		compatible = "fsl,p1010-flexcan";
		reg = <0x1c000 0x1000>;
		interrupts = <48 0x2>;
		interrupt-parent = <&mpic>;
		clock-frequency = <200000000>; // filled in by bootloader
		fsl,clk-source = <0>; // select clock source 0 for PE
	};
```

## Documentation/devicetree/bindings/net/can/grcan.txt
```
Aeroflex Gaisler GRCAN and GRHCAN CAN controllers.

The GRCAN and CRHCAN CAN controllers are available in the GRLIB VHDL IP core
library.

Note: These properties are built from the AMBA plug&play in a Leon SPARC system
(the ordinary environment for GRCAN and GRHCAN). There are no dts files for
sparc.

Required properties:

- name : Should be "GAISLER_GRCAN", "01_03d", "GAISLER_GRHCAN" or "01_034"

- reg : Address and length of the register set for the device

- freq : Frequency of the external oscillator clock in Hz (the frequency of
	the amba bus in the ordinary case)

- interrupts : Interrupt number for this device

Optional properties:

- systemid : If not present or if the value of the least significant 16 bits
	of this 32-bit property is smaller than GRCAN_TXBUG_SAFE_GRLIB_VERSION
	a bug workaround is activated.

For further information look in the documentation for the GLIB IP core library:
http://www.gaisler.com/products/grlib/grip.pdf
```

## Documentation/devicetree/bindings/net/can/holt_hi311x.txt
```
* Holt HI-311X stand-alone CAN controller device tree bindings

Required properties:
 - compatible: Should be one of the following:
   - "holt,hi3110" for HI-3110
 - reg: SPI chip select.
 - clocks: The clock feeding the CAN controller.
 - interrupt-parent: The parent interrupt controller.
 - interrupts: Should contain IRQ line for the CAN controller.

Optional properties:
 - vdd-supply: Regulator that powers the CAN controller.
 - xceiver-supply: Regulator that powers the CAN transceiver.

Example:
	can0: can@1 {
		compatible = "holt,hi3110";
		reg = <1>;
		clocks = <&clk32m>;
		interrupt-parent = <&gpio4>;
		interrupts = <13 IRQ_TYPE_EDGE_RISING>;
		vdd-supply = <&reg5v0>;
		xceiver-supply = <&reg5v0>;
	};
```

## Documentation/devicetree/bindings/net/can/ifi_canfd.txt
```
IFI CANFD controller
--------------------

Required properties:
  - compatible: Should be "ifi,canfd-1.0"
  - reg: Should contain CAN controller registers location and length
  - interrupts: Should contain IRQ line for the CAN controller

Example:

	canfd0: canfd@ff220000 {
		compatible = "ifi,canfd-1.0";
		reg = <0xff220000 0x00001000>;
		interrupts = <0 43 0>;
	};
```

## Documentation/devicetree/bindings/net/can/ipms-can.yaml
```yaml
# SPDX-License-Identifier: GPL-2.0
%YAML 1.2
---
#$id: http://devicetree.org/schemas/net/can/ipms-can.yaml#
#$schema: http://devicetree.org/meta-schemas/core.yaml#

title: IPMS CAN/CANFD controller Device Tree Bindings

properties:
  compatible:
    const:ipms,can

  reg:
    maxItems: 1
    items:
      - description:CAN controller registers

  interrupts:
    maxItems: 1

  clocks:
    minItems: 1
    items:
      - description:apb_clk clock
      - description:core_clk clock
      - description:timer_clk clock

  clock-names:
    minItems: 1
    items:
      - const:apb_clk
      - const:core_clk
      - const:timer_clk
  resets:
   minItems: 1
    items:
      - description:apb_clk reset
      - description:core_clk reset
      - description:timer_clk reset
  reset-names:
    minItems: 1
    items:
      - const:rst_apb
      - const:rst_core
      - const:rst_timer
  starfive,sys-syscon:
    format:
    starfive,sys-syscon = <&arg0 arg1 arg2 arg3>
    description:
      arg0:arg0 is sys_syscon.
      arg1:arg1 is syscon register offset, used to enable can2.0/canfd function, can0 is 0x10, can1 is 0x88.
      arg2:arg2 is used to enable the register shift of the can2.0/canfd function, can0 is 0x3, can1 is 0x12.
      arg3:arg3 is used to enable the register mask of the can2.0/canfd function, can0 is 0x8, can1 is 0x40000

  syscon,can_or_canfd:
    description:
    IPMS CAN-CTRL core is a serial communications controller that performs serial communication according to the CAN protocol.
    This CAN bus interface uses the basic CAN principle and meets all constraints of the CAN-specification 2.0B active.
    Furthermore this CAN core can be configured to meet the specification of CAN with flexible data rate CAN FD.
    When syscon,can_or_canfd is set to 0, use CAN2.0B.
    when syscon,can_or_canfd is set to 1, use CAN FD.
required:
  - compatible
  - reg
  - interrupts
  - clocks
  - clock-names
  - resets
  - reset-names
  - starfive,sys-syscon
  - syscon,can_or_canfd
additionalProperties:false

examples:
  - |
    can0: can@130d0000{
    compatible = "ipms,can";
    reg = <0x0 0x130d0000 0x0 0x1000>;
    interrupts = <112>;
    interrupt-parent = <&plic>;
    clocks = <&clkgen JH7110_CAN0_CTRL_CLK_APB>,
             <&clkgen JH7110_CAN0_CTRL_CLK_CAN>,
             <&clkgen JH7110_CAN0_CTRL_CLK_TIMER>;
    clock-names = "apb_clk",
                  "core_clk",
                  "timer_clk";
    resets = <&rstgen RSTN_U0_CAN_CTRL_APB>,
             <&rstgen RSTN_U0_CAN_CTRL_CORE>,
             <&rstgen RSTN_U0_CAN_CTRL_TIMER>;
    reset-names = "rst_apb",
                  "rst_core",
                  "rst_timer";
    starfive,sys-syscon = <&sys_syscon, 0x10 0x3 0x8>;
    syscon,can_or_canfd = <0>;
    };

...
```

## Documentation/devicetree/bindings/net/can/m_can.txt
```
Bosch MCAN controller Device Tree Bindings
-------------------------------------------------

Required properties:
- compatible		: Should be "bosch,m_can" for M_CAN controllers
- reg			: physical base address and size of the M_CAN
			  registers map and Message RAM
- reg-names		: Should be "m_can" and "message_ram"
- interrupts		: Should be the interrupt number of M_CAN interrupt
			  line 0 and line 1, could be same if sharing
			  the same interrupt.
- interrupt-names	: Should contain "int0" and "int1"
- clocks		: Clocks used by controller, should be host clock
			  and CAN clock.
- clock-names		: Should contain "hclk" and "cclk"
- pinctrl-<n>		: Pinctrl states as described in bindings/pinctrl/pinctrl-bindings.txt
- pinctrl-names 	: Names corresponding to the numbered pinctrl states
- bosch,mram-cfg	: Message RAM configuration data.
			  Multiple M_CAN instances can share the same Message
			  RAM and each element(e.g Rx FIFO or Tx Buffer and etc)
			  number in Message RAM is also configurable,
			  so this property is telling driver how the shared or
			  private Message RAM are used by this M_CAN controller.

			  The format should be as follows:
			  <offset sidf_elems xidf_elems rxf0_elems rxf1_elems
			   rxb_elems txe_elems txb_elems>
			  The 'offset' is an address offset of the Message RAM
			  where the following elements start from. This is
			  usually set to 0x0 if you're using a private Message
			  RAM. The remain cells are used to specify how many
			  elements are used for each FIFO/Buffer.

			  M_CAN includes the following elements according to user manual:
			  11-bit Filter	0-128 elements / 0-128 words
			  29-bit Filter	0-64 elements / 0-128 words
			  Rx FIFO 0	0-64 elements / 0-1152 words
			  Rx FIFO 1	0-64 elements / 0-1152 words
			  Rx Buffers	0-64 elements / 0-1152 words
			  Tx Event FIFO	0-32 elements / 0-64 words
			  Tx Buffers	0-32 elements / 0-576 words

			  Please refer to 2.4.1 Message RAM Configuration in
			  Bosch M_CAN user manual for details.

Example:
SoC dtsi:
m_can1: can@20e8000 {
	compatible = "bosch,m_can";
	reg = <0x020e8000 0x4000>, <0x02298000 0x4000>;
	reg-names = "m_can", "message_ram";
	interrupts = <0 114 0x04>,
		     <0 114 0x04>;
	interrupt-names = "int0", "int1";
	clocks = <&clks IMX6SX_CLK_CANFD>,
		 <&clks IMX6SX_CLK_CANFD>;
	clock-names = "hclk", "cclk";
	bosch,mram-cfg = <0x0 0 0 32 0 0 0 1>;
};

Board dts:
&m_can1 {
	pinctrl-names = "default";
	pinctrl-0 = <&pinctrl_m_can1>;
	status = "enabled";
};
```
