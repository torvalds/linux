## Documentation/devicetree/bindings/net/can/allwinner,sun4i-a10-can.yaml
```yaml
# SPDX-License-Identifier: GPL-2.0
%YAML 1.2
---
$id: http://devicetree.org/schemas/net/can/allwinner,sun4i-a10-can.yaml#
$schema: http://devicetree.org/meta-schemas/core.yaml#

title: Allwinner A10 CAN Controller Device Tree Bindings

maintainers:
  - Chen-Yu Tsai <wens@csie.org>
  - Maxime Ripard <mripard@kernel.org>

properties:
  compatible:
    oneOf:
      - items:
          - const: allwinner,sun7i-a20-can
          - const: allwinner,sun4i-a10-can
      - const: allwinner,sun4i-a10-can

  reg:
    maxItems: 1

  interrupts:
    maxItems: 1

  clocks:
    maxItems: 1

required:
  - compatible
  - reg
  - interrupts
  - clocks

additionalProperties: false

examples:
  - |
    #include <dt-bindings/interrupt-controller/arm-gic.h>
    #include <dt-bindings/clock/sun7i-a20-ccu.h>

    can0: can@1c2bc00 {
        compatible = "allwinner,sun7i-a20-can",
                     "allwinner,sun4i-a10-can";
        reg = <0x01c2bc00 0x400>;
        interrupts = <GIC_SPI 26 IRQ_TYPE_LEVEL_HIGH>;
        clocks = <&ccu CLK_APB1_CAN>;
    };

...
```

## Documentation/devicetree/bindings/net/can/atmel,at91sam9263-can.yaml
```yaml
# SPDX-License-Identifier: (GPL-2.0-only OR BSD-2-Clause)
%YAML 1.2
---
$id: http://devicetree.org/schemas/net/can/atmel,at91sam9263-can.yaml#
$schema: http://devicetree.org/meta-schemas/core.yaml#

title: Microchip AT91 CAN Controller

maintainers:
  - Nicolas Ferre <nicolas.ferre@microchip.com>

allOf:
  - $ref: can-controller.yaml#

properties:
  compatible:
    oneOf:
      - enum:
          - atmel,at91sam9263-can
          - atmel,at91sam9x5-can
      - items:
          - enum:
              - microchip,sam9x60-can
          - const: atmel,at91sam9x5-can

  reg:
    maxItems: 1

  interrupts:
    maxItems: 1

  clocks:
    maxItems: 1

  clock-names:
    items:
      - const: can_clk

required:
  - compatible
  - reg
  - interrupts
  - clocks
  - clock-names

unevaluatedProperties: false

examples:
  - |
    #include <dt-bindings/interrupt-controller/irq.h>
    #include <dt-bindings/clock/at91.h>
    can@f000c000 {
          compatible = "atmel,at91sam9263-can";
          reg = <0xf000c000 0x300>;
          interrupts = <30 IRQ_TYPE_LEVEL_HIGH 3>;
          clocks = <&pmc PMC_TYPE_PERIPHERAL 12>;
          clock-names = "can_clk";
    };
```

## Documentation/devicetree/bindings/net/can/atmel-can.txt
```
* AT91 CAN *

Required properties:
  - compatible: Should be "atmel,at91sam9263-can" or "atmel,at91sam9x5-can"
  - reg: Should contain CAN controller registers location and length
  - interrupts: Should contain IRQ line for the CAN controller

Example:

	can0: can@f000c000 {
		compatible = "atmel,at91sam9x5-can";
		reg = <0xf000c000 0x300>;
		interrupts = <40 4 5>
	};
```

## Documentation/devicetree/bindings/net/can/bosch,c_can.yaml
```yaml
# SPDX-License-Identifier: (GPL-2.0-only OR BSD-2-Clause)
%YAML 1.2
---
$id: http://devicetree.org/schemas/net/can/bosch,c_can.yaml#
$schema: http://devicetree.org/meta-schemas/core.yaml#

title: Bosch C_CAN/D_CAN controller Device Tree Bindings

description: Bosch C_CAN/D_CAN controller for CAN bus

maintainers:
  - Dario Binacchi <dariobin@libero.it>

allOf:
  - $ref: can-controller.yaml#

properties:
  compatible:
    oneOf:
      - enum:
          - bosch,c_can
          - bosch,d_can
          - ti,dra7-d_can
          - ti,am3352-d_can
      - items:
          - enum:
              - ti,am4372-d_can
          - const: ti,am3352-d_can

  reg:
    maxItems: 1

  interrupts:
    minItems: 1
    maxItems: 4

  power-domains:
    description: |
      Should contain a phandle to a PM domain provider node and an args
      specifier containing the DCAN device id value. It's mandatory for
      Keystone 2 66AK2G SoCs only.
    maxItems: 1

  clocks:
    description: |
      CAN functional clock phandle.
    maxItems: 1

  clock-names:
    maxItems: 1

  syscon-raminit:
    description: |
      Handle to system control region that contains the RAMINIT register,
      register offset to the RAMINIT register and the CAN instance number (0
      offset).
    $ref: /schemas/types.yaml#/definitions/phandle-array
    items:
      - items:
          - description: The phandle to the system control region.
          - description: The register offset.
          - description: The CAN instance number.

  resets:
    maxItems: 1

required:
  - compatible
  - reg
  - interrupts
  - clocks

if:
  properties:
    compatible:
      contains:
        enum:
          - bosch,d_can

then:
  properties:
    interrupts:
      items:
        - description: Error and status IRQ
        - description: Message object IRQ
        - description: RAM ECC correctable error IRQ
        - description: RAM ECC non-correctable error IRQ

else:
  properties:
    interrupts:
      items:
        - description: Error and status IRQ

additionalProperties: false

examples:
  - |
    #include <dt-bindings/reset/altr,rst-mgr.h>

    can@ffc00000 {
       compatible = "bosch,d_can";
       reg = <0xffc00000 0x1000>;
       interrupts = <0 131 4>, <0 132 4>, <0 133 4>, <0 134 4>;
       clocks = <&can0_clk>;
       resets = <&rst CAN0_RESET>;
    };
  - |
    can@0 {
        compatible = "ti,am3352-d_can";
        reg = <0x0 0x2000>;
        clocks = <&dcan1_fck>;
        clock-names = "fck";
        syscon-raminit = <&scm_conf 0x644 1>;
        interrupts = <55>;
    };
```

## Documentation/devicetree/bindings/net/can/bosch,m_can.yaml
```yaml
# SPDX-License-Identifier: GPL-2.0
%YAML 1.2
---
$id: http://devicetree.org/schemas/net/can/bosch,m_can.yaml#
$schema: http://devicetree.org/meta-schemas/core.yaml#

title: Bosch MCAN controller

description: Bosch MCAN controller for CAN bus

maintainers:
  - Chandrasekar Ramakrishnan <rcsekar@samsung.com>

allOf:
  - $ref: can-controller.yaml#

properties:
  compatible:
    const: bosch,m_can

  reg:
    items:
      - description: M_CAN registers map
      - description: message RAM

  reg-names:
    items:
      - const: m_can
      - const: message_ram

  interrupts:
    items:
      - description: interrupt line0
      - description: interrupt line1
    minItems: 1

  interrupt-names:
    items:
      - const: int0
      - const: int1
    minItems: 1

  clocks:
    items:
      - description: peripheral clock
      - description: bus clock

  clock-names:
    items:
      - const: hclk
      - const: cclk

  bosch,mram-cfg:
    description: |
      Message RAM configuration data.
      Multiple M_CAN instances can share the same Message RAM
      and each element(e.g Rx FIFO or Tx Buffer and etc) number
      in Message RAM is also configurable, so this property is
      telling driver how the shared or private Message RAM are
      used by this M_CAN controller.

      The format should be as follows:
      <offset sidf_elems xidf_elems rxf0_elems rxf1_elems rxb_elems txe_elems txb_elems>
      The 'offset' is an address offset of the Message RAM where
      the following elements start from. This is usually set to
      0x0 if you're using a private Message RAM. The remain cells
      are used to specify how many elements are used for each FIFO/Buffer.

      M_CAN includes the following elements according to user manual:
      11-bit Filter	0-128 elements / 0-128 words
      29-bit Filter	0-64 elements / 0-128 words
      Rx FIFO 0		0-64 elements / 0-1152 words
      Rx FIFO 1		0-64 elements / 0-1152 words
      Rx Buffers	0-64 elements / 0-1152 words
      Tx Event FIFO	0-32 elements / 0-64 words
      Tx Buffers	0-32 elements / 0-576 words

      Please refer to 2.4.1 Message RAM Configuration in Bosch
      M_CAN user manual for details.
    $ref: /schemas/types.yaml#/definitions/int32-array
    items:
      - description: The 'offset' is an address offset of the Message RAM where
          the following elements start from. This is usually set to 0x0 if
          you're using a private Message RAM.
        default: 0
      - description: 11-bit Filter 0-128 elements / 0-128 words
        minimum: 0
        maximum: 128
      - description: 29-bit Filter 0-64 elements / 0-128 words
        minimum: 0
        maximum: 64
      - description: Rx FIFO 0 0-64 elements / 0-1152 words
        minimum: 0
        maximum: 64
      - description: Rx FIFO 1 0-64 elements / 0-1152 words
        minimum: 0
        maximum: 64
      - description: Rx Buffers 0-64 elements / 0-1152 words
        minimum: 0
        maximum: 64
      - description: Tx Event FIFO 0-32 elements / 0-64 words
        minimum: 0
        maximum: 32
      - description: Tx Buffers 0-32 elements / 0-576 words
        minimum: 0
        maximum: 32
    minItems: 1

  power-domains:
    description:
      Power domain provider node and an args specifier containing
      the can device id value.
    maxItems: 1

  can-transceiver:
    $ref: can-transceiver.yaml#

  phys:
    maxItems: 1

required:
  - compatible
  - reg
  - reg-names
  - clocks
  - clock-names
  - bosch,mram-cfg

unevaluatedProperties: false

examples:
  - |
    // Example with interrupts
    #include <dt-bindings/clock/imx6sx-clock.h>
    can@20e8000 {
      compatible = "bosch,m_can";
      reg = <0x020e8000 0x4000>, <0x02298000 0x4000>;
      reg-names = "m_can", "message_ram";
      interrupts = <0 114 0x04>, <0 114 0x04>;
      interrupt-names = "int0", "int1";
      clocks = <&clks IMX6SX_CLK_CANFD>,
               <&clks IMX6SX_CLK_CANFD>;
      clock-names = "hclk", "cclk";
      bosch,mram-cfg = <0x0 0 0 32 0 0 0 1>;

      can-transceiver {
        max-bitrate = <5000000>;
      };
    };

  - |
    // Example with timer polling
    #include <dt-bindings/clock/imx6sx-clock.h>
    can@20e8000 {
      compatible = "bosch,m_can";
      reg = <0x020e8000 0x4000>, <0x02298000 0x4000>;
      reg-names = "m_can", "message_ram";
      clocks = <&clks IMX6SX_CLK_CANFD>,
               <&clks IMX6SX_CLK_CANFD>;
      clock-names = "hclk", "cclk";
      bosch,mram-cfg = <0x0 0 0 32 0 0 0 1>;

      can-transceiver {
        max-bitrate = <5000000>;
      };
    };

...
```

## Documentation/devicetree/bindings/net/can/c_can.txt
```
Bosch C_CAN/D_CAN controller Device Tree Bindings
-------------------------------------------------

Required properties:
- compatible		: Should be "bosch,c_can" for C_CAN controllers and
			  "bosch,d_can" for D_CAN controllers.
			  Can be "ti,dra7-d_can", "ti,am3352-d_can" or
			  "ti,am4372-d_can".
- reg			: physical base address and size of the C_CAN/D_CAN
			  registers map
- interrupts		: property with a value describing the interrupt
			  number

The following are mandatory properties for DRA7x, AM33xx and AM43xx SoCs only:
- ti,hwmods		: Must be "d_can<n>" or "c_can<n>", n being the
			  instance number

The following are mandatory properties for Keystone 2 66AK2G SoCs only:
- power-domains		: Should contain a phandle to a PM domain provider node
			  and an args specifier containing the DCAN device id
			  value. This property is as per the binding,
			  Documentation/devicetree/bindings/soc/ti/sci-pm-domain.yaml
- clocks		: CAN functional clock phandle. This property is as per the
			  binding,
			  Documentation/devicetree/bindings/clock/ti,sci-clk.yaml

Optional properties:
- syscon-raminit	: Handle to system control region that contains the
			  RAMINIT register, register offset to the RAMINIT
			  register and the CAN instance number (0 offset).

Note: "ti,hwmods" field is used to fetch the base address and irq
resources from TI, omap hwmod data base during device registration.
Future plan is to migrate hwmod data base contents into device tree
blob so that, all the required data will be used from device tree dts
file.

Example:

Step1: SoC common .dtsi file

	dcan1: d_can@481d0000 {
		compatible = "bosch,d_can";
		reg = <0x481d0000 0x2000>;
		interrupts = <55>;
		interrupt-parent = <&intc>;
		status = "disabled";
	};

(or)

	dcan1: d_can@481d0000 {
		compatible = "bosch,d_can";
		ti,hwmods = "d_can1";
		reg = <0x481d0000 0x2000>;
		interrupts = <55>;
		interrupt-parent = <&intc>;
		status = "disabled";
	};

Step 2: board specific .dts file

	&dcan1 {
		status = "okay";
	};
```

## Documentation/devicetree/bindings/net/can/can-controller.yaml
```yaml
# SPDX-License-Identifier: (GPL-2.0-only OR BSD-2-Clause)
%YAML 1.2
---
$id: http://devicetree.org/schemas/net/can/can-controller.yaml#
$schema: http://devicetree.org/meta-schemas/core.yaml#

title: CAN Controller Generic Binding

maintainers:
  - Marc Kleine-Budde <mkl@pengutronix.de>

properties:
  $nodename:
    pattern: "^can(@.*)?$"

  termination-gpios:
    description: GPIO pin to enable CAN bus termination.
    maxItems: 1

  termination-ohms:
    description: The resistance value of the CAN bus termination resistor.
    minimum: 1
    maximum: 65535

additionalProperties: true

...
```

## Documentation/devicetree/bindings/net/can/can-transceiver.yaml
```yaml
# SPDX-License-Identifier: GPL-2.0
%YAML 1.2
---
$id: http://devicetree.org/schemas/net/can/can-transceiver.yaml#
$schema: http://devicetree.org/meta-schemas/core.yaml#

title: CAN transceiver Bindings

description: CAN transceiver generic properties bindings

maintainers:
  - Rob Herring <robh@kernel.org>

properties:
  max-bitrate:
    $ref: /schemas/types.yaml#/definitions/uint32
    description: a positive non 0 value that determines the max speed that CAN/CAN-FD can run.
    minimum: 1

additionalProperties: true
```

## Documentation/devicetree/bindings/net/can/cc770.txt
```
Memory mapped Bosch CC770 and Intel AN82527 CAN controller

Note: The CC770 is a CAN controller from Bosch, which is 100%
compatible with the old AN82527 from Intel, but with "bugs" being fixed.

Required properties:

- compatible : should be "bosch,cc770" for the CC770 and "intc,82527"
	for the AN82527.

- reg : should specify the chip select, address offset and size required
	to map the registers of the controller. The size is usually 0x80.

- interrupts : property with a value describing the interrupt source
	(number and sensitivity) required for the controller.

Optional properties:

- bosch,external-clock-frequency : frequency of the external oscillator
	clock in Hz. Note that the internal clock frequency used by the
	controller is half of that value. If not specified, a default
	value of 16000000 (16 MHz) is used.

- bosch,clock-out-frequency : slock frequency in Hz on the CLKOUT pin.
	If not specified or if the specified value is 0, the CLKOUT pin
	will be disabled.

- bosch,slew-rate : slew rate of the CLKOUT signal. If not specified,
	a resonable value will be calculated.

- bosch,disconnect-rx0-input : see data sheet.

- bosch,disconnect-rx1-input : see data sheet.

- bosch,disconnect-tx1-output : see data sheet.

- bosch,polarity-dominant : see data sheet.

- bosch,divide-memory-clock : see data sheet.

- bosch,iso-low-speed-mux : see data sheet.

For further information, please have a look to the CC770 or AN82527.

Examples:

can@3,100 {
	compatible = "bosch,cc770";
	reg = <3 0x100 0x80>;
	interrupts = <2 0>;
	interrupt-parent = <&mpic>;
	bosch,external-clock-frequency = <16000000>;
};
```
