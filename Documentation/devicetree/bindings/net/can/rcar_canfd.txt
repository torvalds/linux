## Documentation/devicetree/bindings/net/can/rockchip,rk3568v2-canfd.yaml
```yaml
# SPDX-License-Identifier: (GPL-2.0-only OR BSD-2-Clause)
%YAML 1.2
---
$id: http://devicetree.org/schemas/net/can/rockchip,rk3568v2-canfd.yaml#
$schema: http://devicetree.org/meta-schemas/core.yaml#

title:
  Rockchip CAN-FD controller

maintainers:
  - Marc Kleine-Budde <mkl@pengutronix.de>

allOf:
  - $ref: can-controller.yaml#

properties:
  compatible:
    oneOf:
      - const: rockchip,rk3568v2-canfd
      - items:
          - const: rockchip,rk3568v3-canfd
          - const: rockchip,rk3568v2-canfd

  reg:
    maxItems: 1

  interrupts:
    maxItems: 1

  clocks:
    maxItems: 2

  clock-names:
    items:
      - const: baud
      - const: pclk

  resets:
    maxItems: 2

  reset-names:
    items:
      - const: core
      - const: apb

required:
  - compatible
  - reg
  - interrupts
  - clocks
  - resets

additionalProperties: false

examples:
  - |
    #include <dt-bindings/clock/rk3568-cru.h>
    #include <dt-bindings/interrupt-controller/arm-gic.h>
    #include <dt-bindings/interrupt-controller/irq.h>

    soc {
        #address-cells = <2>;
        #size-cells = <2>;

        can@fe570000 {
            compatible = "rockchip,rk3568v2-canfd";
            reg = <0x0 0xfe570000 0x0 0x1000>;
            interrupts = <GIC_SPI 1 IRQ_TYPE_LEVEL_HIGH>;
            clocks = <&cru CLK_CAN0>, <&cru PCLK_CAN0>;
            clock-names = "baud", "pclk";
            resets = <&cru SRST_CAN0>, <&cru SRST_P_CAN0>;
            reset-names = "core", "apb";
        };
    };
```

## Documentation/devicetree/bindings/net/can/rockchip_can.txt
```
Rockchip CAN controller Device Tree Bindings
---------------------------------------------------------

Required properties:
- compatible		: Should be:
			  - "rockchip,can-1.0" for CAN controllers 1.0
- reg			: Physical base address and size of the controller
			  registers map.
- interrupts		: Property with a value describing the interrupt
			  number.
- clock-names		: List of input clock names
			  - "can_clk", "pclk",
			  (See clock bindings for details).
- clocks		: Clock phandles (see clock bindings for details).
- resets : Must contain an entry for each entry in reset-names.
	   See ../reset/reset.txt for details.
- reset-names : List of input reset names
			  - "can", "can-apb".

Example:

For Dts file:
	can: can@ff250000 {
		compatible = "rockchip,can-1.0";
		reg = <0x0 0xff610000 0x0 0x1000>;
		interrupts = <GIC_SPI 100 IRQ_TYPE_LEVEL_HIGH>;
		clocks = <&cru CLK_CAN>, <&cru PCLK_CAN>;
		clock-names = "baudclk", "apb_pclk";
		resets = <&cru SRST_CAN>, &cru SRST_CAN_P>;
		reset-names = "can", "can-apb";
		status = "okay";
	};
```

## Documentation/devicetree/bindings/net/can/rockchip_canfd.txt
```
Rockchip CANFD controller Device Tree Bindings
---------------------------------------------------------

Required properties:
- compatible		: Should be:
			  - "rockchip,canfd-1.0" for CANFD controllers 1.0
- reg			: Physical base address and size of the controller
			  registers map.
- interrupts		: Property with a value describing the interrupt
			  number.
- clock-names		: List of input clock names
			  - "can_clk", "pclk",
			  (See clock bindings for details).
- clocks		: Clock phandles (see clock bindings for details).
- resets : Must contain an entry for each entry in reset-names.
	   See ../reset/reset.txt for details.
- reset-names : List of input reset names
			  - "can", "can-apb".

Example:

For Dts file:
	can0: can0@fe570000 {
		compatible = "rockchip,canfd-1.0";
		reg = <0x0 0xfe570000 0x0 0x1000>;
		interrupts = <GIC_SPI 1 IRQ_TYPE_LEVEL_HIGH>;
		clocks = <&cru CLK_CAN0>, <&cru PCLK_CAN0>;
		clock-names = "baudclk", "apb_pclk";
		resets = <&cru SRST_CAN0>, &cru SRST_P_CAN0>;
		reset-names = "can", "can-apb";
		status = "okay";
	};
```

## Documentation/devicetree/bindings/net/can/st,stm32-bxcan.yaml
```yaml
# SPDX-License-Identifier: (GPL-2.0-only OR BSD-2-Clause)
%YAML 1.2
---
$id: http://devicetree.org/schemas/net/can/st,stm32-bxcan.yaml#
$schema: http://devicetree.org/meta-schemas/core.yaml#

title: STMicroelectronics bxCAN controller

description: STMicroelectronics BxCAN controller for CAN bus

maintainers:
  - Dario Binacchi <dario.binacchi@amarulasolutions.com>

allOf:
  - $ref: can-controller.yaml#

properties:
  compatible:
    enum:
      - st,stm32f4-bxcan

  st,can-primary:
    description:
      Primary mode of the bxCAN peripheral is only relevant if the chip has
      two CAN peripherals in dual CAN configuration. In that case they share
      some of the required logic.
      Not to be used if the peripheral is in single CAN configuration.
      To avoid misunderstandings, it should be noted that ST documentation
      uses the terms master instead of primary.
    type: boolean

  st,can-secondary:
    description:
      Secondary mode of the bxCAN peripheral is only relevant if the chip
      has two CAN peripherals in dual CAN configuration. In that case they
      share some of the required logic.
      Not to be used if the peripheral is in single CAN configuration.
      To avoid misunderstandings, it should be noted that ST documentation
      uses the terms slave instead of secondary.
    type: boolean

  reg:
    maxItems: 1

  interrupts:
    items:
      - description: transmit interrupt
      - description: FIFO 0 receive interrupt
      - description: FIFO 1 receive interrupt
      - description: status change error interrupt

  interrupt-names:
    items:
      - const: tx
      - const: rx0
      - const: rx1
      - const: sce

  resets:
    maxItems: 1

  clocks:
    maxItems: 1

  st,gcan:
    $ref: /schemas/types.yaml#/definitions/phandle-array
    description:
      The phandle to the gcan node which allows to access the 512-bytes
      SRAM memory shared by the two bxCAN cells (CAN1 primary and CAN2
      secondary) in dual CAN peripheral configuration.

required:
  - compatible
  - reg
  - interrupts
  - resets
  - clocks
  - st,gcan

additionalProperties: false

examples:
  - |
    #include <dt-bindings/clock/stm32fx-clock.h>
    #include <dt-bindings/mfd/stm32f4-rcc.h>

    can1: can@40006400 {
        compatible = "st,stm32f4-bxcan";
        reg = <0x40006400 0x200>;
        interrupts = <19>, <20>, <21>, <22>;
        interrupt-names = "tx", "rx0", "rx1", "sce";
        resets = <&rcc STM32F4_APB1_RESET(CAN1)>;
        clocks = <&rcc 0 STM32F4_APB1_CLOCK(CAN1)>;
        st,can-primary;
        st,gcan = <&gcan>;
    };
```

## Documentation/devicetree/bindings/net/can/sun4i_can.txt
```
Allwinner A10/A20 CAN controller Device Tree Bindings
-----------------------------------------------------

Required properties:
- compatible: "allwinner,sun4i-a10-can"
- reg: physical base address and size of the Allwinner A10/A20 CAN register map.
- interrupts: interrupt specifier for the sole interrupt.
- clock: phandle and clock specifier.

Example
-------

SoC common .dtsi file:

	can0_pins_a: can0@0 {
		allwinner,pins = "PH20","PH21";
		allwinner,function = "can";
		allwinner,drive = <0>;
		allwinner,pull = <0>;
	};
...
	can0: can@01c2bc00 {
		compatible = "allwinner,sun4i-a10-can";
		reg = <0x01c2bc00 0x400>;
		interrupts = <0 26 4>;
		clocks = <&apb1_gates 4>;
		status = "disabled";
	};

Board specific .dts file:

	can0: can@01c2bc00 {
		pinctrl-names = "default";
		pinctrl-0 = <&can0_pins_a>;
		status = "okay";
	};
```

## Documentation/devicetree/bindings/net/can/tcan4x5x.txt
```
Texas Instruments TCAN4x5x CAN Controller
================================================

This file provides device node information for the TCAN4x5x interface contains.

Required properties:
	- compatible: "ti,tcan4x5x"
	- reg: 0
	- #address-cells: 1
	- #size-cells: 0
	- spi-max-frequency: Maximum frequency of the SPI bus the chip can
			     operate at should be less than or equal to 18 MHz.
	- interrupt-parent: the phandle to the interrupt controller which provides
                    the interrupt.
	- interrupts: interrupt specification for data-ready.

See Documentation/devicetree/bindings/net/can/bosch,m_can.yaml for additional
required property details.

Optional properties:
	- reset-gpios: Hardwired output GPIO. If not defined then software
		       reset.
	- device-state-gpios: Input GPIO that indicates if the device is in
			      a sleep state or if the device is active.
	- device-wake-gpios: Wake up GPIO to wake up the TCAN device.

Example:
tcan4x5x: tcan4x5x@0 {
		compatible = "ti,tcan4x5x";
		reg = <0>;
		#address-cells = <1>;
		#size-cells = <1>;
		spi-max-frequency = <10000000>;
		bosch,mram-cfg = <0x0 0 0 32 0 0 1 1>;
		interrupt-parent = <&gpio1>;
		interrupts = <14 IRQ_TYPE_LEVEL_LOW>;
		device-state-gpios = <&gpio3 21 GPIO_ACTIVE_HIGH>;
		device-wake-gpios = <&gpio1 15 GPIO_ACTIVE_HIGH>;
		reset-gpios = <&gpio1 27 GPIO_ACTIVE_HIGH>;
};
```

## Documentation/devicetree/bindings/net/can/ti,tcan4x5x.yaml
```yaml
# SPDX-License-Identifier: (GPL-2.0-only OR BSD-2-Clause)
%YAML 1.2
---
$id: http://devicetree.org/schemas/net/can/ti,tcan4x5x.yaml#
$schema: http://devicetree.org/meta-schemas/core.yaml#

title: Texas Instruments TCAN4x5x CAN Controller

maintainers:
  - Marc Kleine-Budde <mkl@pengutronix.de>

properties:
  compatible:
    oneOf:
      - items:
          - enum:
              - ti,tcan4552
              - ti,tcan4553
          - const: ti,tcan4x5x
      - const: ti,tcan4x5x

  reg:
    maxItems: 1

  interrupts:
    maxItems: 1
    description: The GPIO parent interrupt.

  clocks:
    maxItems: 1

  clock-names:
    items:
      - const: cclk

  reset-gpios:
    description: Hardwired output GPIO. If not defined then software reset.
    maxItems: 1

  device-state-gpios:
    description:
      Input GPIO that indicates if the device is in a sleep state or if the
      device is active. Not available with tcan4552/4553.
    maxItems: 1

  device-wake-gpios:
    description:
      Wake up GPIO to wake up the TCAN device.
      Not available with tcan4552/4553.
    maxItems: 1

  bosch,mram-cfg:
    description: |
      Message RAM configuration data.
      Multiple M_CAN instances can share the same Message RAM
      and each element(e.g Rx FIFO or Tx Buffer and etc) number
      in Message RAM is also configurable, so this property is
      telling driver how the shared or private Message RAM are
      used by this M_CAN controller.

      The format should be as follows:
      <offset sidf_elems xidf_elems rxf0_elems rxf1_elems rxb_elems txe_elems txb_elems>
      The 'offset' is an address offset of the Message RAM where
      the following elements start from. This is usually set to
      0x0 if you're using a private Message RAM. The remain cells
      are used to specify how many elements are used for each FIFO/Buffer.

      M_CAN includes the following elements according to user manual:
      11-bit Filter	0-128 elements / 0-128 words
      29-bit Filter	0-64 elements / 0-128 words
      Rx FIFO 0		0-64 elements / 0-1152 words
      Rx FIFO 1		0-64 elements / 0-1152 words
      Rx Buffers	0-64 elements / 0-1152 words
      Tx Event FIFO	0-32 elements / 0-64 words
      Tx Buffers	0-32 elements / 0-576 words

      Please refer to 2.4.1 Message RAM Configuration in Bosch
      M_CAN user manual for details.
    $ref: /schemas/types.yaml#/definitions/int32-array
    items:
      - description: The 'offset' is an address offset of the Message RAM where
          the following elements start from. This is usually set to 0x0 if
          you're using a private Message RAM.
        default: 0
      - description: 11-bit Filter 0-128 elements / 0-128 words
        minimum: 0
        maximum: 128
      - description: 29-bit Filter 0-64 elements / 0-128 words
        minimum: 0
        maximum: 64
      - description: Rx FIFO 0 0-64 elements / 0-1152 words
        minimum: 0
        maximum: 64
      - description: Rx FIFO 1 0-64 elements / 0-1152 words
        minimum: 0
        maximum: 64
      - description: Rx Buffers 0-64 elements / 0-1152 words
        minimum: 0
        maximum: 64
      - description: Tx Event FIFO 0-32 elements / 0-64 words
        minimum: 0
        maximum: 32
      - description: Tx Buffers 0-32 elements / 0-576 words
        minimum: 0
        maximum: 32
    minItems: 1

  spi-max-frequency:
    description:
      Must be half or less of "clocks" frequency.
    maximum: 18000000

  ti,nwkrq-voltage-vio:
    type: boolean
    description:
      nWKRQ Pin GPO buffer voltage configuration.
      Set nWKRQ to use VIO voltage rail.
      When not set nWKRQ will use internal voltage rail.

  wakeup-source:
    $ref: /schemas/types.yaml#/definitions/flag
    description:
      Enable CAN remote wakeup.

allOf:
  - $ref: can-controller.yaml#
  - $ref: /schemas/spi/spi-peripheral-props.yaml#
  - if:
      properties:
        compatible:
          contains:
            enum:
              - ti,tcan4552
              - ti,tcan4553
    then:
      properties:
        device-state-gpios: false
        device-wake-gpios: false

required:
  - compatible
  - reg
  - interrupts
  - clocks
  - clock-names
  - bosch,mram-cfg

unevaluatedProperties: false

examples:
  - |
    #include <dt-bindings/gpio/gpio.h>
    #include <dt-bindings/interrupt-controller/irq.h>

    spi {
        #address-cells = <1>;
        #size-cells = <0>;

        can@0 {
            compatible = "ti,tcan4x5x";
            reg = <0>;
            clocks = <&can0_osc>;
            clock-names = "cclk";
            pinctrl-names = "default";
            pinctrl-0 = <&can0_pins>;
            spi-max-frequency = <10000000>;
            bosch,mram-cfg = <0x0 0 0 16 0 0 1 1>;
            interrupt-parent = <&gpio1>;
            interrupts = <14 IRQ_TYPE_LEVEL_LOW>;
            device-state-gpios = <&gpio3 21 GPIO_ACTIVE_HIGH>;
            device-wake-gpios = <&gpio1 15 GPIO_ACTIVE_HIGH>;
            reset-gpios = <&gpio1 27 GPIO_ACTIVE_HIGH>;
            ti,nwkrq-voltage-vio;
            wakeup-source;
        };
    };
  - |
    #include <dt-bindings/gpio/gpio.h>
    #include <dt-bindings/interrupt-controller/irq.h>

    spi {
        #address-cells = <1>;
        #size-cells = <0>;

        can@0 {
            compatible = "ti,tcan4552", "ti,tcan4x5x";
            reg = <0>;
            clocks = <&can0_osc>;
            clock-names = "cclk";
            pinctrl-names = "default";
            pinctrl-0 = <&can0_pins>;
            spi-max-frequency = <10000000>;
            bosch,mram-cfg = <0x0 0 0 16 0 0 1 1>;
            interrupt-parent = <&gpio1>;
            interrupts = <14 IRQ_TYPE_LEVEL_LOW>;
            reset-gpios = <&gpio1 27 GPIO_ACTIVE_HIGH>;
            wakeup-source;
        };
    };
```

## Documentation/devicetree/bindings/net/can/ti_hecc.txt
```
Texas Instruments High End CAN Controller (HECC)
================================================

This file provides information, what the device node
for the hecc interface contains.

Required properties:
- compatible: "ti,am3517-hecc"
- reg: addresses and lengths of the register spaces for 'hecc', 'hecc-ram'
       and 'mbx'
- reg-names :"hecc", "hecc-ram", "mbx"
- interrupts: interrupt mapping for the hecc interrupts sources
- clocks: clock phandles (see clock bindings for details)

Optional properties:
- ti,use-hecc1int: if provided configures HECC to produce all interrupts
		   on HECC1INT interrupt line. By default HECC0INT interrupt
		   line will be used.
- xceiver-supply: regulator that powers the CAN transceiver

Example:

For am3517evm board:
	hecc: can@5c050000 {
		compatible = "ti,am3517-hecc";
		reg = <0x5c050000 0x80>,
		      <0x5c053000 0x180>,
		      <0x5c052000 0x200>;
		reg-names = "hecc", "hecc-ram", "mbx";
		interrupts = <24>;
		clocks = <&hecc_ck>;
	};
```
