## Documentation/devicetree/bindings/net/cdns,macb.yaml
```yaml
# SPDX-License-Identifier: (GPL-2.0-only OR BSD-2-Clause)
%YAML 1.2
---
$id: http://devicetree.org/schemas/net/cdns,macb.yaml#
$schema: http://devicetree.org/meta-schemas/core.yaml#

title: Cadence MACB/GEM Ethernet controller

maintainers:
  - Nicolas Ferre <nicolas.ferre@microchip.com>
  - Claudiu Beznea <claudiu.beznea@microchip.com>

properties:
  compatible:
    oneOf:
      - items:
          - enum:
              - cdns,at91rm9200-emac  # Atmel at91rm9200 SoC
          - const: cdns,emac          # Generic

      - items:
          - enum:
              - cdns,zynq-gem         # Xilinx Zynq-7xxx SoC
              - cdns,zynqmp-gem       # Xilinx Zynq Ultrascale+ MPSoC
          - const: cdns,gem           # Generic

      - items:
          - enum:
              - cdns,at91sam9260-macb # Atmel at91sam9 SoCs
              - cdns,sam9x60-macb     # Microchip sam9x60 SoC
          - const: cdns,macb          # Generic

      - items:
          - enum:
              - atmel,sama5d3-macb    # 10/100Mbit IP on Atmel sama5d3 SoCs
          - enum:
              - cdns,at91sam9260-macb # Atmel at91sam9 SoCs.
          - const: cdns,macb          # Generic

      - enum:
          - atmel,sama5d29-gem        # GEM XL IP (10/100) on Atmel sama5d29 SoCs
          - atmel,sama5d2-gem         # GEM IP (10/100) on Atmel sama5d2 SoCs
          - atmel,sama5d3-gem         # Gigabit IP on Atmel sama5d3 SoCs
          - atmel,sama5d4-gem         # GEM IP (10/100) on Atmel sama5d4 SoCs
          - cdns,at32ap7000-macb      # Other 10/100 usage or use the generic form
          - cdns,np4-macb             # NP4 SoC devices
          - microchip,sama7g5-emac    # Microchip SAMA7G5 ethernet interface
          - microchip,sama7g5-gem     # Microchip SAMA7G5 gigabit ethernet interface
          - sifive,fu540-c000-gem     # SiFive FU540-C000 SoC
          - cdns,emac                 # Generic
          - cdns,gem                  # Generic
          - cdns,macb                 # Generic

  reg:
    minItems: 1
    items:
      - description: Basic register set
      - description: GEMGXL Management block registers on SiFive FU540-C000 SoC

  interrupts:
    minItems: 1
    maxItems: 8
    description: One interrupt per available hardware queue

  clocks:
    minItems: 1
    maxItems: 5

  clock-names:
    minItems: 1
    items:
      - enum: [ ether_clk, hclk, pclk ]
      - enum: [ hclk, pclk ]
      - const: tx_clk
      - enum: [ rx_clk, tsu_clk ]
      - const: tsu_clk

  local-mac-address: true

  phy-mode: true

  phy-handle: true

  fixed-link: true

  iommus:
    maxItems: 1

  power-domains:
    maxItems: 1

  '#address-cells':
    const: 1

  '#size-cells':
    const: 0

  mdio:
    type: object
    description:
      Node containing PHY children. If this node is not present, then PHYs will
      be direct children.

patternProperties:
  "^ethernet-phy@[0-9a-f]$":
    type: object
    $ref: ethernet-phy.yaml#

    properties:
      reset-gpios: true

      magic-packet:
        description:
          Indicates that the hardware supports waking up via magic packet.

    unevaluatedProperties: false

required:
  - compatible
  - reg
  - interrupts
  - clocks
  - clock-names
  - phy-mode

allOf:
  - $ref: ethernet-controller.yaml#

  - if:
      not:
        properties:
          compatible:
            contains:
              const: sifive,fu540-c000-gem
    then:
      properties:
        reg:
          maxItems: 1

unevaluatedProperties: false

examples:
  - |
    macb0: ethernet@fffc4000 {
            compatible = "cdns,at32ap7000-macb";
            reg = <0xfffc4000 0x4000>;
            interrupts = <21>;
            phy-mode = "rmii";
            local-mac-address = [3a 0e 03 04 05 06];
            clock-names = "pclk", "hclk", "tx_clk";
            clocks = <&clkc 30>, <&clkc 30>, <&clkc 13>;
            #address-cells = <1>;
            #size-cells = <0>;

            ethernet-phy@1 {
                    reg = <0x1>;
                    reset-gpios = <&pioE 6 1>;
            };
    };
```

## Documentation/devicetree/bindings/net/cdns-emac.txt
```
* Cadence EMAC Ethernet controller

Required properties:
- compatible: Should be "cdns,[<chip>-]{emac}"
  Use "cdns,at91rm9200-emac" Atmel at91rm9200 SoC.
  or the generic form: "cdns,emac".
- reg: Address and length of the register set for the device
- interrupts: Should contain macb interrupt
- phy-mode: see ethernet.txt file in the same directory.

Examples:

	macb0: ethernet@fffc4000 {
		compatible = "cdns,at91rm9200-emac";
		reg = <0xfffc4000 0x4000>;
		interrupts = <21>;
		phy-mode = "rmii";
		local-mac-address = [3a 0e 03 04 05 06];
	};
```

## Documentation/devicetree/bindings/net/cirrus,cs89x0.txt
```
* Cirrus Logic CS8900/CS8920 Network Controller

Required properties:
- compatible	: Should be "cirrus,cs8900" or "cirrus,cs8920".
- reg		: Address and length of the IO space.
- interrupts	: Should contain the controller interrupt line.

Examples:
	eth0: eth@10000000 {
		compatible = "cirrus,cs8900";
		reg = <0x10000000 0x400>;
		interrupts = <10>;
	};
```

## Documentation/devicetree/bindings/net/cirrus,ep9301-eth.yaml
```yaml
# SPDX-License-Identifier: (GPL-2.0-only OR BSD-2-Clause)
%YAML 1.2
---
$id: http://devicetree.org/schemas/net/cirrus,ep9301-eth.yaml#
$schema: http://devicetree.org/meta-schemas/core.yaml#

title: EP93xx SoC Ethernet Controller

maintainers:
  - Alexander Sverdlin <alexander.sverdlin@gmail.com>
  - Nikita Shubin <nikita.shubin@maquefel.me>

allOf:
  - $ref: ethernet-controller.yaml#

properties:
  compatible:
    oneOf:
      - const: cirrus,ep9301-eth
      - items:
          - enum:
              - cirrus,ep9302-eth
              - cirrus,ep9307-eth
              - cirrus,ep9312-eth
              - cirrus,ep9315-eth
          - const: cirrus,ep9301-eth

  reg:
    items:
      - description: The physical base address and size of IO range

  interrupts:
    items:
      - description: Combined signal for various interrupt events

  phy-handle: true

  mdio:
    $ref: mdio.yaml#
    unevaluatedProperties: false
    description: optional node for embedded MDIO controller

required:
  - compatible
  - reg
  - interrupts
  - phy-handle

additionalProperties: false

examples:
  - |
    ethernet@80010000 {
        compatible = "cirrus,ep9301-eth";
        reg = <0x80010000 0x10000>;
        interrupt-parent = <&vic1>;
        interrupts = <7>;
        phy-handle = <&phy0>;
    };
```

## Documentation/devicetree/bindings/net/cortina,gemini-ethernet.txt
```
Cortina Systems Gemini Ethernet Controller
==========================================

This ethernet controller is found in the Gemini SoC family:
StorLink SL3512 and SL3516, also known as Cortina Systems
CS3512 and CS3516.

Required properties:
- compatible: must be "cortina,gemini-ethernet"
- reg: must contain the global registers and the V-bit and A-bit
  memory areas, in total three register sets.
- syscon: a phandle to the system controller
- #address-cells: must be specified, must be <1>
- #size-cells: must be specified, must be <1>
- ranges: should be state like this giving a 1:1 address translation
  for the subnodes

The subnodes represents the two ethernet ports in this device.
They are not independent of each other since they share resources
in the parent node, and are thus children.

Required subnodes:
- port0: contains the resources for ethernet port 0
- port1: contains the resources for ethernet port 1

Required subnode properties:
- compatible: must be "cortina,gemini-ethernet-port"
- reg: must contain two register areas: the DMA/TOE memory and
  the GMAC memory area of the port
- interrupts: should contain the interrupt line of the port.
  this is nominally a level interrupt active high.
- resets: this must provide an SoC-integrated reset line for
  the port.
- clocks: this should contain a handle to the PCLK clock for
  clocking the silicon in this port
- clock-names: must be "PCLK"

Optional subnode properties:
- phy-mode: see ethernet.txt
- phy-handle: see ethernet.txt

Example:

mdio-bus {
	(...)
	phy0: ethernet-phy@1 {
		reg = <1>;
		device_type = "ethernet-phy";
	};
	phy1: ethernet-phy@3 {
		reg = <3>;
		device_type = "ethernet-phy";
	};
};


ethernet@60000000 {
	compatible = "cortina,gemini-ethernet";
	reg = <0x60000000 0x4000>, /* Global registers, queue */
	      <0x60004000 0x2000>, /* V-bit */
	      <0x60006000 0x2000>; /* A-bit */
	syscon = <&syscon>;
	#address-cells = <1>;
	#size-cells = <1>;
	ranges;

	gmac0: ethernet-port@0 {
		compatible = "cortina,gemini-ethernet-port";
		reg = <0x60008000 0x2000>, /* Port 0 DMA/TOE */
		      <0x6000a000 0x2000>; /* Port 0 GMAC */
		interrupt-parent = <&intcon>;
		interrupts = <1 IRQ_TYPE_LEVEL_HIGH>;
		resets = <&syscon GEMINI_RESET_GMAC0>;
		clocks = <&syscon GEMINI_CLK_GATE_GMAC0>;
		clock-names = "PCLK";
		phy-mode = "rgmii";
		phy-handle = <&phy0>;
	};

	gmac1: ethernet-port@1 {
		compatible = "cortina,gemini-ethernet-port";
		reg = <0x6000c000 0x2000>, /* Port 1 DMA/TOE */
		      <0x6000e000 0x2000>; /* Port 1 GMAC */
		interrupt-parent = <&intcon>;
		interrupts = <2 IRQ_TYPE_LEVEL_HIGH>;
		resets = <&syscon GEMINI_RESET_GMAC1>;
		clocks = <&syscon GEMINI_CLK_GATE_GMAC1>;
		clock-names = "PCLK";
		phy-mode = "rgmii";
		phy-handle = <&phy1>;
	};
};
```

## Documentation/devicetree/bindings/net/cortina,gemini-ethernet.yaml
```yaml
# SPDX-License-Identifier: (GPL-2.0-only OR BSD-2-Clause)
%YAML 1.2
---
$id: http://devicetree.org/schemas/net/cortina,gemini-ethernet.yaml#
$schema: http://devicetree.org/meta-schemas/core.yaml#

title: Cortina Systems Gemini Ethernet Controller

maintainers:
  - Linus Walleij <linus.walleij@linaro.org>

description: |
  This ethernet controller is found in the Gemini SoC family:
  StorLink SL3512 and SL3516, also known as Cortina Systems
  CS3512 and CS3516.

properties:
  compatible:
    const: cortina,gemini-ethernet

  reg:
    minItems: 3
    description: must contain the global registers and the V-bit and A-bit
      memory areas, in total three register sets.

  "#address-cells":
    const: 1

  "#size-cells":
    const: 1

  ranges: true

#The subnodes represents the two ethernet ports in this device.
#They are not independent of each other since they share resources
#in the parent node, and are thus children.
patternProperties:
  "^ethernet-port@[0-9]+$":
    type: object
    description: contains the resources for ethernet port
    allOf:
      - $ref: ethernet-controller.yaml#
    properties:
      compatible:
        const: cortina,gemini-ethernet-port

      reg:
        items:
          - description: DMA/TOE memory
          - description: GMAC memory area of the port

      interrupts:
        maxItems: 1
        description: should contain the interrupt line of the port.
                     this is nominally a level interrupt active high.

      resets:
        maxItems: 1
        description: this must provide an SoC-integrated reset line for the port.

      clocks:
        maxItems: 1
        description: this should contain a handle to the PCLK clock for
                     clocking the silicon in this port

      clock-names:
        const: PCLK

    required:
      - reg
      - compatible
      - interrupts
      - resets
      - clocks
      - clock-names

required:
  - compatible
  - reg
  - ranges

additionalProperties: false

examples:
  - |
    #include <dt-bindings/interrupt-controller/irq.h>
    #include <dt-bindings/clock/cortina,gemini-clock.h>
    #include <dt-bindings/reset/cortina,gemini-reset.h>
    mdio0: mdio {
      #address-cells = <1>;
      #size-cells = <0>;
      phy0: ethernet-phy@1 {
        reg = <1>;
        device_type = "ethernet-phy";
      };
      phy1: ethernet-phy@3 {
        reg = <3>;
        device_type = "ethernet-phy";
      };
    };


    ethernet@60000000 {
        compatible = "cortina,gemini-ethernet";
        reg = <0x60000000 0x4000>, /* Global registers, queue */
              <0x60004000 0x2000>, /* V-bit */
              <0x60006000 0x2000>; /* A-bit */
        #address-cells = <1>;
        #size-cells = <1>;
        ranges;

        gmac0: ethernet-port@0 {
                compatible = "cortina,gemini-ethernet-port";
                reg = <0x60008000 0x2000>, /* Port 0 DMA/TOE */
                      <0x6000a000 0x2000>; /* Port 0 GMAC */
                interrupt-parent = <&intcon>;
                interrupts = <1 IRQ_TYPE_LEVEL_HIGH>;
                resets = <&syscon GEMINI_RESET_GMAC0>;
                clocks = <&syscon GEMINI_CLK_GATE_GMAC0>;
                clock-names = "PCLK";
                phy-mode = "rgmii";
                phy-handle = <&phy0>;
        };

        gmac1: ethernet-port@1 {
                compatible = "cortina,gemini-ethernet-port";
                reg = <0x6000c000 0x2000>, /* Port 1 DMA/TOE */
                      <0x6000e000 0x2000>; /* Port 1 GMAC */
                interrupt-parent = <&intcon>;
                interrupts = <2 IRQ_TYPE_LEVEL_HIGH>;
                resets = <&syscon GEMINI_RESET_GMAC1>;
                clocks = <&syscon GEMINI_CLK_GATE_GMAC1>;
                clock-names = "PCLK";
                phy-mode = "rgmii";
                phy-handle = <&phy1>;
        };
    };
```

## Documentation/devicetree/bindings/net/cortina.txt
```
Cortina Phy Driver Device Tree Bindings
---------------------------------------

CORTINA is a registered trademark of Cortina Systems, Inc.

The driver supports the Cortina Electronic Dispersion Compensation (EDC)
devices, equipped with clock and data recovery (CDR) circuits. These
devices make use of registers that are not compatible with Clause 45 or
Clause 22, therefore they need to be described using the
"ethernet-phy-id" compatible.

Since the driver only implements  polling mode support, interrupts info
can be skipped.

Example (CS4340 phy):
	mdio {
		cs4340_phy@10 {
			compatible = "ethernet-phy-id13e5.1002";
			reg = <0x10>;
		};
	};
```

## Documentation/devicetree/bindings/net/cpsw-phy-sel.txt
```
TI CPSW Phy mode Selection Device Tree Bindings
-----------------------------------------------

Required properties:
- compatible		: Should be "ti,am3352-cpsw-phy-sel" for am335x platform and
			  "ti,dra7xx-cpsw-phy-sel" for dra7xx platform
			  "ti,am43xx-cpsw-phy-sel" for am43xx platform
- reg			: physical base address and size of the cpsw
			  registers map
- reg-names		: names of the register map given in "reg" node

Optional properties:
-rmii-clock-ext		: If present, the driver will configure the RMII
			  interface to external clock usage

Examples:

	phy_sel: cpsw-phy-sel@44e10650 {
		compatible = "ti,am3352-cpsw-phy-sel";
		reg= <0x44e10650 0x4>;
		reg-names = "gmii-sel";
	};

(or)
	phy_sel: cpsw-phy-sel@44e10650 {
		compatible = "ti,am3352-cpsw-phy-sel";
		reg= <0x44e10650 0x4>;
		reg-names = "gmii-sel";
		rmii-clock-ext;
	};
```
