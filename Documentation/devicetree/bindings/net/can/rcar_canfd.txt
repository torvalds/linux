## Documentation/devicetree/bindings/net/can/xilinx,can.yaml
```yaml
# SPDX-License-Identifier: (GPL-2.0-only OR BSD-2-Clause)
%YAML 1.2
---
$id: http://devicetree.org/schemas/net/can/xilinx,can.yaml#
$schema: http://devicetree.org/meta-schemas/core.yaml#

title:
  Xilinx CAN and CANFD controller

maintainers:
  - Appana Durga Kedareswara rao <appana.durga.rao@xilinx.com>

properties:
  compatible:
    enum:
      - xlnx,zynq-can-1.0
      - xlnx,axi-can-1.00.a
      - xlnx,canfd-1.0
      - xlnx,canfd-2.0

  reg:
    maxItems: 1

  interrupts:
    maxItems: 1

  clocks:
    minItems: 1
    maxItems: 2

  clock-names:
    maxItems: 2

  power-domains:
    maxItems: 1

  tx-fifo-depth:
    $ref: /schemas/types.yaml#/definitions/uint32
    description: CAN Tx fifo depth (Zynq, Axi CAN).

  rx-fifo-depth:
    $ref: /schemas/types.yaml#/definitions/uint32
    description: CAN Rx fifo depth (Zynq, Axi CAN, CAN FD in sequential Rx mode)

  tx-mailbox-count:
    $ref: /schemas/types.yaml#/definitions/uint32
    description: CAN Tx mailbox buffer count (CAN FD)

  resets:
    maxItems: 1

  xlnx,has-ecc:
    $ref: /schemas/types.yaml#/definitions/flag
    description: CAN TX_OL, TX_TL and RX FIFOs have ECC support(AXI CAN)

required:
  - compatible
  - reg
  - interrupts
  - clocks
  - clock-names

unevaluatedProperties: false

allOf:
  - $ref: can-controller.yaml#
  - if:
      properties:
        compatible:
          contains:
            enum:
              - xlnx,zynq-can-1.0

    then:
      properties:
        clock-names:
          items:
            - const: can_clk
            - const: pclk
      required:
        - tx-fifo-depth
        - rx-fifo-depth

  - if:
      properties:
        compatible:
          contains:
            enum:
              - xlnx,axi-can-1.00.a

    then:
      properties:
        clock-names:
          items:
            - const: can_clk
            - const: s_axi_aclk
      required:
        - tx-fifo-depth
        - rx-fifo-depth

  - if:
      properties:
        compatible:
          contains:
            enum:
              - xlnx,canfd-1.0
              - xlnx,canfd-2.0

    then:
      properties:
        clock-names:
          items:
            - const: can_clk
            - const: s_axi_aclk
      required:
        - tx-mailbox-count
        - rx-fifo-depth

examples:
  - |
    #include <dt-bindings/interrupt-controller/arm-gic.h>

    can@e0008000 {
        compatible = "xlnx,zynq-can-1.0";
        reg = <0xe0008000 0x1000>;
        clocks = <&clkc 19>, <&clkc 36>;
        clock-names = "can_clk", "pclk";
        interrupts = <GIC_SPI 28 IRQ_TYPE_LEVEL_HIGH>;
        interrupt-parent = <&intc>;
        tx-fifo-depth = <0x40>;
        rx-fifo-depth = <0x40>;
    };

  - |
    can@40000000 {
        compatible = "xlnx,axi-can-1.00.a";
        reg = <0x40000000 0x10000>;
        clocks = <&clkc 0>, <&clkc 1>;
        clock-names = "can_clk", "s_axi_aclk";
        interrupt-parent = <&intc>;
        interrupts = <GIC_SPI 59 IRQ_TYPE_EDGE_RISING>;
        tx-fifo-depth = <0x40>;
        rx-fifo-depth = <0x40>;
        xlnx,has-ecc;
    };

  - |
    can@40000000 {
        compatible = "xlnx,canfd-1.0";
        reg = <0x40000000 0x2000>;
        clocks = <&clkc 0>, <&clkc 1>;
        clock-names = "can_clk", "s_axi_aclk";
        interrupt-parent = <&intc>;
        interrupts = <GIC_SPI 59 IRQ_TYPE_EDGE_RISING>;
        tx-mailbox-count = <0x20>;
        rx-fifo-depth = <0x20>;
    };

  - |
    can@ff060000 {
        compatible = "xlnx,canfd-2.0";
        reg = <0xff060000 0x6000>;
        clocks = <&clkc 0>, <&clkc 1>;
        clock-names = "can_clk", "s_axi_aclk";
        interrupt-parent = <&intc>;
        interrupts = <GIC_SPI 59 IRQ_TYPE_EDGE_RISING>;
        tx-mailbox-count = <0x20>;
        rx-fifo-depth = <0x40>;
    };
```

## Documentation/devicetree/bindings/net/can/xilinx_can.txt
```
Xilinx Axi CAN/Zynq CANPS controller Device Tree Bindings
---------------------------------------------------------

Required properties:
- compatible		: Should be:
			  - "xlnx,zynq-can-1.0" for Zynq CAN controllers
			  - "xlnx,axi-can-1.00.a" for Axi CAN controllers
			  - "xlnx,canfd-1.0" for CAN FD controllers
			  - "xlnx,canfd-2.0" for CAN FD 2.0 controllers
- reg			: Physical base address and size of the controller
			  registers map.
- interrupts		: Property with a value describing the interrupt
			  number.
- clock-names		: List of input clock names
			  - "can_clk", "pclk" (For CANPS),
			  - "can_clk", "s_axi_aclk" (For AXI CAN and CAN FD).
			  (See clock bindings for details).
- clocks		: Clock phandles (see clock bindings for details).
- tx-fifo-depth		: Can Tx fifo depth (Zynq, Axi CAN).
- rx-fifo-depth		: Can Rx fifo depth (Zynq, Axi CAN, CAN FD in
                          sequential Rx mode).
- tx-mailbox-count	: Can Tx mailbox buffer count (CAN FD).
- rx-mailbox-count	: Can Rx mailbox buffer count (CAN FD in mailbox Rx
			  mode).


Example:

For Zynq CANPS Dts file:
	zynq_can_0: can@e0008000 {
			compatible = "xlnx,zynq-can-1.0";
			clocks = <&clkc 19>, <&clkc 36>;
			clock-names = "can_clk", "pclk";
			reg = <0xe0008000 0x1000>;
			interrupts = <0 28 4>;
			interrupt-parent = <&intc>;
			tx-fifo-depth = <0x40>;
			rx-fifo-depth = <0x40>;
		};
For Axi CAN Dts file:
	axi_can_0: axi-can@40000000 {
			compatible = "xlnx,axi-can-1.00.a";
			clocks = <&clkc 0>, <&clkc 1>;
			clock-names = "can_clk","s_axi_aclk" ;
			reg = <0x40000000 0x10000>;
			interrupt-parent = <&intc>;
			interrupts = <0 59 1>;
			tx-fifo-depth = <0x40>;
			rx-fifo-depth = <0x40>;
		};
For CAN FD Dts file:
	canfd_0: canfd@40000000 {
			compatible = "xlnx,canfd-1.0";
			clocks = <&clkc 0>, <&clkc 1>;
			clock-names = "can_clk", "s_axi_aclk";
			reg = <0x40000000 0x2000>;
			interrupt-parent = <&intc>;
			interrupts = <0 59 1>;
			tx-mailbox-count = <0x20>;
			rx-fifo-depth = <0x20>;
		};
```

## Documentation/devicetree/bindings/net/cavium-mdio.txt
```
* System Management Interface (SMI) / MDIO

Properties:
- compatible: One of:

   "cavium,octeon-3860-mdio": Compatibility with all cn3XXX, cn5XXX
                       and cn6XXX SOCs.

   "cavium,thunder-8890-mdio": Compatibility with all cn8XXX SOCs.

- reg: The base address of the MDIO bus controller register bank.

- #address-cells: Must be <1>.

- #size-cells: Must be <0>.  MDIO addresses have no size component.

Typically an MDIO bus might have several children.

Example:
	mdio@1180000001800 {
		compatible = "cavium,octeon-3860-mdio";
		#address-cells = <1>;
		#size-cells = <0>;
		reg = <0x11800 0x00001800 0x0 0x40>;

		ethernet-phy@0 {
			...
			reg = <0>;
		};
	};


* System Management Interface (SMI) / MDIO Nexus

  Several mdio buses may be gathered as children of a single PCI
  device, this PCI device is the nexus of the buses.

Properties:

- compatible: "cavium,thunder-8890-mdio-nexus";

- reg: The PCI device and function numbers of the nexus device.

- #address-cells: Must be <2>.

- #size-cells: Must be <2>.

- ranges: As needed for mapping of the MDIO bus device registers.

- assigned-addresses: As needed for mapping of the MDIO bus device registers.

Example:

        mdio-nexus@1,3 {
                compatible = "cavium,thunder-8890-mdio-nexus";
                #address-cells = <2>;
                #size-cells = <2>;
                reg = <0x0b00 0 0 0 0>; /* DEVFN = 0x0b (1:3) */
                assigned-addresses = <0x03000000 0x87e0 0x05000000 0x0 0x800000>;
                ranges = <0x87e0 0x05000000 0x03000000 0x87e0 0x05000000 0x0 0x800000>;

                mdio0@87e0,05003800 {
                        compatible = "cavium,thunder-8890-mdio";
                        #address-cells = <1>;
                        #size-cells = <0>;
                        reg = <0x87e0 0x05003800 0x0 0x30>;

                        ethernet-phy@0 {
                                ...
                                reg = <0>;
                        };
                };
                mdio0@87e0,05003880 {
                        compatible = "cavium,thunder-8890-mdio";
                        #address-cells = <1>;
                        #size-cells = <0>;
                        reg = <0x87e0 0x05003880 0x0 0x30>;

                        ethernet-phy@0 {
                                ...
                                reg = <0>;
                        };
                };
        };
```

## Documentation/devicetree/bindings/net/cavium-mix.txt
```
* MIX Ethernet controller.

Properties:
- compatible: "cavium,octeon-5750-mix"

  Compatibility with all cn5XXX and cn6XXX SOCs populated with MIX
  devices.

- reg: The base addresses of four separate register banks.  The first
  bank contains the MIX registers.  The second bank the corresponding
  AGL registers.  The third bank are the AGL registers shared by all
  MIX devices present.  The fourth bank is the AGL_PRT_CTL shared by
  all MIX devices present.

- cell-index: A single cell specifying which portion of the shared
  register banks corresponds to this MIX device.

- interrupts: Two interrupt specifiers.  The first is the MIX
  interrupt routing and the second the routing for the AGL interrupts.

- phy-handle: Optional, see ethernet.txt file in the same directory.

Example:
	ethernet@1070000100800 {
		compatible = "cavium,octeon-5750-mix";
		reg = <0x10700 0x00100800 0x0 0x100>, /* MIX */
		      <0x11800 0xE0000800 0x0 0x300>, /* AGL */
		      <0x11800 0xE0000400 0x0 0x400>, /* AGL_SHARED  */
		      <0x11800 0xE0002008 0x0 0x8>;   /* AGL_PRT_CTL */
		cell-index = <1>;
		interrupts = <1 18>, < 1 46>;
		local-mac-address = [ 00 0f b7 10 63 54 ];
		phy-handle = <&phy1>;
	};
```

## Documentation/devicetree/bindings/net/cavium-pip.txt
```
* PIP Ethernet nexus.

The PIP Ethernet nexus can control several data packet input/output
devices.  The devices have a two level grouping scheme.  There may be
several interfaces, and each interface may have several ports.  These
ports might be an individual Ethernet PHY.


Properties for the PIP nexus:
- compatible: "cavium,octeon-3860-pip"

  Compatibility with all cn3XXX, cn5XXX and cn6XXX SOCs.

- reg: The base address of the PIP's register bank.

- #address-cells: Must be <1>.

- #size-cells: Must be <0>.

Properties for PIP interfaces which is a child the PIP nexus:
- compatible: "cavium,octeon-3860-pip-interface"

  Compatibility with all cn3XXX, cn5XXX and cn6XXX SOCs.

- reg: The interface number.

- #address-cells: Must be <1>.

- #size-cells: Must be <0>.

Properties for PIP port which is a child the PIP interface:
- compatible: "cavium,octeon-3860-pip-port"

  Compatibility with all cn3XXX, cn5XXX and cn6XXX SOCs.

- reg: The port number within the interface group.

- mac-address: Optional, the MAC address to assign to the device.

- local-mac-address: Optional, the MAC address to assign to the device
  if mac-address is not specified.

- phy-handle: Optional, a phandle for the PHY device connected to this device.

Example:

	pip@11800a0000000 {
		compatible = "cavium,octeon-3860-pip";
		#address-cells = <1>;
		#size-cells = <0>;
		reg = <0x11800 0xa0000000 0x0 0x2000>;

		interface@0 {
			compatible = "cavium,octeon-3860-pip-interface";
			#address-cells = <1>;
			#size-cells = <0>;
			reg = <0>; /* interface */

			ethernet@0 {
				compatible = "cavium,octeon-3860-pip-port";
				reg = <0x0>; /* Port */
				local-mac-address = [ 00 0f b7 10 63 60 ];
				phy-handle = <&phy2>;
			};
			ethernet@1 {
				compatible = "cavium,octeon-3860-pip-port";
				reg = <0x1>; /* Port */
				local-mac-address = [ 00 0f b7 10 63 61 ];
				phy-handle = <&phy3>;
			};
			ethernet@2 {
				compatible = "cavium,octeon-3860-pip-port";
				reg = <0x2>; /* Port */
				local-mac-address = [ 00 0f b7 10 63 62 ];
				phy-handle = <&phy4>;
			};
			ethernet@3 {
				compatible = "cavium,octeon-3860-pip-port";
				reg = <0x3>; /* Port */
				local-mac-address = [ 00 0f b7 10 63 63 ];
				phy-handle = <&phy5>;
			};
		};

		interface@1 {
			compatible = "cavium,octeon-3860-pip-interface";
			#address-cells = <1>;
			#size-cells = <0>;
			reg = <1>; /* interface */

			ethernet@0 {
				compatible = "cavium,octeon-3860-pip-port";
				reg = <0x0>; /* Port */
				local-mac-address = [ 00 0f b7 10 63 64 ];
				phy-handle = <&phy6>;
			};
		};
	};
```
