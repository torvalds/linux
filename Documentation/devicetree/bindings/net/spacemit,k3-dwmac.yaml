## Documentation/devicetree/bindings/net/ti,dp83867.txt
```
* Texas Instruments - dp83867 Giga bit ethernet phy

Required properties:
	- reg - The ID number for the phy, usually a small integer
	- ti,rx-internal-delay - RGMII Receive Clock Delay - see dt-bindings/net/ti-dp83867.h
		for applicable values. Required only if interface type is
		PHY_INTERFACE_MODE_RGMII_ID or PHY_INTERFACE_MODE_RGMII_RXID
	- ti,tx-internal-delay - RGMII Transmit Clock Delay - see dt-bindings/net/ti-dp83867.h
		for applicable values. Required only if interface type is
		PHY_INTERFACE_MODE_RGMII_ID or PHY_INTERFACE_MODE_RGMII_TXID

Note: If the interface type is PHY_INTERFACE_MODE_RGMII the TX/RX clock delays
      will be left at their default values, as set by the PHY's pin strapping.
      The default strapping will use a delay of 2.00 ns.  Thus
      PHY_INTERFACE_MODE_RGMII, by default, does not behave as RGMII with no
      internal delay, but as PHY_INTERFACE_MODE_RGMII_ID.  The device tree
      should use "rgmii-id" if internal delays are desired as this may be
      changed in future to cause "rgmii" mode to disable delays.

Optional property:
	- ti,min-output-impedance - MAC Interface Impedance control to set
				    the programmable output impedance to
				    minimum value (35 ohms).
	- ti,max-output-impedance - MAC Interface Impedance control to set
				    the programmable output impedance to
				    maximum value (70 ohms).
	- ti,dp83867-rxctrl-strap-quirk - This denotes the fact that the
				    board has RX_DV/RX_CTRL pin strapped in
				    mode 1 or 2. To ensure PHY operation,
				    there are specific actions that
				    software needs to take when this pin is
				    strapped in these modes. See data manual
				    for details.
	- ti,clk-output-sel - Muxing option for CLK_OUT pin.  See dt-bindings/net/ti-dp83867.h
			      for applicable values.  The CLK_OUT pin can also
			      be disabled by this property.  When omitted, the
			      PHY's default will be left as is.
	- ti,sgmii-ref-clock-output-enable - This denotes which
				    SGMII configuration is used (4 or 6-wire modes).
				    Some MACs work with differential SGMII clock.
				    See data manual for details.

	- ti,fifo-depth - Transmitt FIFO depth- see dt-bindings/net/ti-dp83867.h
		for applicable values (deprecated)

	-tx-fifo-depth - As defined in the ethernet-controller.yaml.  Values for
			 the depth can be found in dt-bindings/net/ti-dp83867.h
	-rx-fifo-depth - As defined in the ethernet-controller.yaml.  Values for
			 the depth can be found in dt-bindings/net/ti-dp83867.h

Note: ti,min-output-impedance and ti,max-output-impedance are mutually
      exclusive. When both properties are present ti,max-output-impedance
      takes precedence.

Default child nodes are standard Ethernet PHY device
nodes as described in Documentation/devicetree/bindings/net/phy.txt

Example:

	ethernet-phy@0 {
		reg = <0>;
		ti,rx-internal-delay = <DP83867_RGMIIDCTL_2_25_NS>;
		ti,tx-internal-delay = <DP83867_RGMIIDCTL_2_75_NS>;
		tx-fifo-depth = <DP83867_PHYCR_FIFO_DEPTH_4_B_NIB>;
	};

Datasheet can be found:
http://www.ti.com/product/DP83867IR/datasheet
```

## Documentation/devicetree/bindings/net/ti,dp83867.yaml
```yaml
# SPDX-License-Identifier: (GPL-2.0+ OR BSD-2-Clause)
# Copyright (C) 2019 Texas Instruments Incorporated
%YAML 1.2
---
$id: "http://devicetree.org/schemas/net/ti,dp83867.yaml#"
$schema: "http://devicetree.org/meta-schemas/core.yaml#"

title: TI DP83867 ethernet PHY

allOf:
  - $ref: "ethernet-controller.yaml#"

maintainers:
  - Dan Murphy <dmurphy@ti.com>

description: |
  The DP83867 device is a robust, low power, fully featured Physical Layer
  transceiver with integrated PMD sublayers to support 10BASE-Te, 100BASE-TX
  and 1000BASE-T Ethernet protocols.

  The DP83867 is designed for easy implementation of 10/100/1000 Mbps Ethernet
  LANs. It interfaces directly to twisted pair media via an external
  transformer. This device interfaces directly to the MAC layer through the
  IEEE 802.3 Standard Media Independent Interface (MII), the IEEE 802.3 Gigabit
  Media Independent Interface (GMII) or Reduced GMII (RGMII).

  Specifications about the Ethernet PHY can be found at:
    https://www.ti.com/lit/gpn/dp83867ir

properties:
  reg:
    maxItems: 1

  ti,min-output-impedance:
    type: boolean
    description: |
       MAC Interface Impedance control to set the programmable output impedance
       to a minimum value (35 ohms).

  ti,max-output-impedance:
    type: boolean
    description: |
      MAC Interface Impedance control to set the programmable output impedance
      to a maximum value (70 ohms).
      Note: ti,min-output-impedance and ti,max-output-impedance are mutually
        exclusive. When both properties are present ti,max-output-impedance
        takes precedence.

  tx-fifo-depth:
    $ref: /schemas/types.yaml#definitions/uint32
    description: |
       Transmitt FIFO depth see dt-bindings/net/ti-dp83867.h for values

  rx-fifo-depth:
    $ref: /schemas/types.yaml#definitions/uint32
    description: |
       Receive FIFO depth see dt-bindings/net/ti-dp83867.h for values

  ti,clk-output-sel:
    $ref: /schemas/types.yaml#definitions/uint32
    description: |
      Muxing option for CLK_OUT pin.  See dt-bindings/net/ti-dp83867.h
      for applicable values. The CLK_OUT pin can also be disabled by this
      property.  When omitted, the PHY's default will be left as is.

  ti,rx-internal-delay:
    $ref: /schemas/types.yaml#definitions/uint32
    description: |
      RGMII Receive Clock Delay - see dt-bindings/net/ti-dp83867.h
      for applicable values. Required only if interface type is
      PHY_INTERFACE_MODE_RGMII_ID or PHY_INTERFACE_MODE_RGMII_RXID.

  ti,tx-internal-delay:
    $ref: /schemas/types.yaml#definitions/uint32
    description: |
      RGMII Transmit Clock Delay - see dt-bindings/net/ti-dp83867.h
      for applicable values. Required only if interface type is
      PHY_INTERFACE_MODE_RGMII_ID or PHY_INTERFACE_MODE_RGMII_TXID.

        Note: If the interface type is PHY_INTERFACE_MODE_RGMII the TX/RX clock
          delays will be left at their default values, as set by the PHY's pin
          strapping. The default strapping will use a delay of 2.00 ns.  Thus
          PHY_INTERFACE_MODE_RGMII, by default, does not behave as RGMII with no
          internal delay, but as PHY_INTERFACE_MODE_RGMII_ID.  The device tree
          should use "rgmii-id" if internal delays are desired as this may be
          changed in future to cause "rgmii" mode to disable delays.

  ti,dp83867-rxctrl-strap-quirk:
    type: boolean
    description: |
      This denotes the fact that the board has RX_DV/RX_CTRL pin strapped in
      mode 1 or 2. To ensure PHY operation, there are specific actions that
      software needs to take when this pin is strapped in these modes.
      See data manual for details.

  ti,sgmii-ref-clock-output-enable:
    type: boolean
    description: |
      This denotes which SGMII configuration is used (4 or 6-wire modes).
      Some MACs work with differential SGMII clock. See data manual for details.

  ti,fifo-depth:
    deprecated: true
    $ref: /schemas/types.yaml#definitions/uint32
    description: |
      Transmitt FIFO depth- see dt-bindings/net/ti-dp83867.h for applicable
      values.

required:
  - reg

unevaluatedProperties: false

examples:
  - |
    #include <dt-bindings/net/ti-dp83867.h>
    mdio0 {
      #address-cells = <1>;
      #size-cells = <0>;
      ethphy0: ethernet-phy@0 {
        reg = <0>;
        tx-fifo-depth = <DP83867_PHYCR_FIFO_DEPTH_4_B_NIB>;
        rx-fifo-depth = <DP83867_PHYCR_FIFO_DEPTH_4_B_NIB>;
        ti,max-output-impedance;
        ti,clk-output-sel = <DP83867_CLK_O_SEL_CHN_A_RCLK>;
        ti,rx-internal-delay = <DP83867_RGMIIDCTL_2_25_NS>;
        ti,tx-internal-delay = <DP83867_RGMIIDCTL_2_75_NS>;
      };
    };
```

## Documentation/devicetree/bindings/net/ti,dp83869.yaml
```yaml
# SPDX-License-Identifier: (GPL-2.0+ OR BSD-2-Clause)
# Copyright (C) 2019 Texas Instruments Incorporated
%YAML 1.2
---
$id: "http://devicetree.org/schemas/net/ti,dp83869.yaml#"
$schema: "http://devicetree.org/meta-schemas/core.yaml#"

title: TI DP83869 ethernet PHY

allOf:
  - $ref: "ethernet-phy.yaml#"

maintainers:
  - Dan Murphy <dmurphy@ti.com>

description: |
  The DP83869HM device is a robust, fully-featured Gigabit (PHY) transceiver
  with integrated PMD sublayers that supports 10BASE-Te, 100BASE-TX and
  1000BASE-T Ethernet protocols. The DP83869 also supports 1000BASE-X and
  100BASE-FX Fiber protocols.
  This device interfaces to the MAC layer through Reduced GMII (RGMII) and
  SGMII The DP83869HM supports Media Conversion in Managed mode. In this mode,
  the DP83869HM can run 1000BASE-X-to-1000BASE-T and 100BASE-FX-to-100BASE-TX
  conversions.  The DP83869HM can also support Bridge Conversion from RGMII to
  SGMII and SGMII to RGMII.

  Specifications about the Ethernet PHY can be found at:
    http://www.ti.com/lit/ds/symlink/dp83869hm.pdf

properties:
  reg:
    maxItems: 1

  ti,min-output-impedance:
    type: boolean
    description: |
       MAC Interface Impedance control to set the programmable output impedance
       to a minimum value (35 ohms).

  ti,max-output-impedance:
    type: boolean
    description: |
       MAC Interface Impedance control to set the programmable output impedance
       to a maximum value (70 ohms).

  tx-fifo-depth:
    $ref: /schemas/types.yaml#definitions/uint32
    description: |
       Transmitt FIFO depth see dt-bindings/net/ti-dp83869.h for values

  rx-fifo-depth:
    $ref: /schemas/types.yaml#definitions/uint32
    description: |
       Receive FIFO depth see dt-bindings/net/ti-dp83869.h for values

  ti,clk-output-sel:
    $ref: /schemas/types.yaml#definitions/uint32
    description: |
       Muxing option for CLK_OUT pin see dt-bindings/net/ti-dp83869.h for values.

  ti,op-mode:
    $ref: /schemas/types.yaml#definitions/uint32
    description: |
       Operational mode for the PHY.  If this is not set then the operational
       mode is set by the straps. see dt-bindings/net/ti-dp83869.h for values

  rx-internal-delay-ps:
    description: Delay is in pico seconds
    enum: [ 250, 500, 750, 1000, 1250, 1500, 1750, 2000, 2250, 2500, 2750, 3000,
            3250, 3500, 3750, 4000 ]
    default: 2000

  tx-internal-delay-ps:
    description: Delay is in pico seconds
    enum: [ 250, 500, 750, 1000, 1250, 1500, 1750, 2000, 2250, 2500, 2750, 3000,
            3250, 3500, 3750, 4000 ]
    default: 2000

required:
  - reg

unevaluatedProperties: false

examples:
  - |
    #include <dt-bindings/net/ti-dp83869.h>
    mdio0 {
      #address-cells = <1>;
      #size-cells = <0>;
      ethphy0: ethernet-phy@0 {
        reg = <0>;
        tx-fifo-depth = <DP83869_PHYCR_FIFO_DEPTH_4_B_NIB>;
        rx-fifo-depth = <DP83869_PHYCR_FIFO_DEPTH_4_B_NIB>;
        ti,op-mode = <DP83869_RGMII_COPPER_ETHERNET>;
        ti,max-output-impedance = "true";
        ti,clk-output-sel = <DP83869_CLK_O_SEL_CHN_A_RCLK>;
        rx-internal-delay-ps = <2000>;
        tx-internal-delay-ps = <2000>;
      };
    };
```

## Documentation/devicetree/bindings/net/ti,icss-iep.yaml
```yaml
# SPDX-License-Identifier: (GPL-2.0-only OR BSD-2-Clause)
%YAML 1.2
---
$id: http://devicetree.org/schemas/net/ti,icss-iep.yaml#
$schema: http://devicetree.org/meta-schemas/core.yaml#

title: Texas Instruments ICSS Industrial Ethernet Peripheral (IEP) module

maintainers:
  - Md Danish Anwar <danishanwar@ti.com>
  - Parvathi Pudi <parvathi@couthit.com>
  - Basharath Hussain Khaja <basharath@couthit.com>

properties:
  compatible:
    oneOf:
      - items:
          - enum:
              - ti,am642-icss-iep
              - ti,j721e-icss-iep
          - const: ti,am654-icss-iep
      - enum:
          - ti,am654-icss-iep
          - ti,am5728-icss-iep
          - ti,am4376-icss-iep
          - ti,am3356-icss-iep

  reg:
    maxItems: 1

  clocks:
    maxItems: 1
    description: phandle to the IEP source clock

  interrupts:
    maxItems: 1
    description:
      Interrupt specifier for capture/compare IRQ.

  interrupt-names:
    items:
      - const: iep_cap_cmp

required:
  - compatible
  - reg
  - clocks

additionalProperties: false

examples:
  - |
    /* AM65x */
    icssg0_iep0: iep@2e000 {
        compatible = "ti,am654-icss-iep";
        reg = <0x2e000 0x1000>;
        clocks = <&icssg0_iepclk_mux>;
    };
```
