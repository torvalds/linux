## Documentation/devicetree/bindings/net/spacemit,k3-dwmac.yaml
```yaml
# SPDX-License-Identifier: (GPL-2.0-only OR BSD-2-Clause)
%YAML 1.2
---
$id: http://devicetree.org/schemas/net/spacemit,k3-dwmac.yaml#
$schema: http://devicetree.org/meta-schemas/core.yaml#

title: Spacemit K3 DWMAC glue layer

maintainers:
  - Inochi Amaoto <inochiama@gmail.com>

select:
  properties:
    compatible:
      contains:
        const: spacemit,k3-dwmac
  required:
    - compatible

properties:
  compatible:
    items:
      - const: spacemit,k3-dwmac
      - const: snps,dwmac-5.40a

  reg:
    maxItems: 1

  clocks:
    items:
      - description: GMAC application clock
      - description: PTP clock
      - description: TX clock

  clock-names:
    items:
      - const: stmmaceth
      - const: ptp_ref
      - const: tx

  interrupts:
    minItems: 1
    items:
      - description: MAC interrupt
      - description: MAC wake interrupt

  interrupt-names:
    minItems: 1
    items:
      - const: macirq
      - const: eth_wake_irq

  resets:
    maxItems: 1

  reset-names:
    const: stmmaceth

  spacemit,apmu:
    $ref: /schemas/types.yaml#/definitions/phandle-array
    items:
      - items:
          - description: phandle to the syscon node which control the glue register
          - description: offset of the control register
          - description: offset of the dline register
    description:
      A phandle to syscon with offset to control registers for this MAC

required:
  - compatible
  - reg
  - clocks
  - clock-names
  - interrupts
  - interrupt-names
  - resets
  - reset-names
  - spacemit,apmu

allOf:
  - $ref: snps,dwmac.yaml#

unevaluatedProperties: false

examples:
  - |
    #include <dt-bindings/interrupt-controller/irq.h>

    ethernet@cac80000 {
      compatible = "spacemit,k3-dwmac", "snps,dwmac-5.40a";
      reg = <0xcac80000 0x2000>;
      clocks = <&syscon_apmu 66>, <&syscon_apmu 68>,
               <&syscon_apmu 69>;
      clock-names = "stmmaceth", "ptp_ref", "tx";
      interrupts = <131 IRQ_TYPE_LEVEL_HIGH>, <276 IRQ_TYPE_LEVEL_HIGH>;
      interrupt-names = "macirq", "eth_wake_irq";
      phy-mode = "rgmii-id";
      phy-handle = <&phy0>;
      resets = <&syscon_apmu 67>;
      reset-names = "stmmaceth";
      spacemit,apmu = <&syscon_apmu 0x384 0x38c>;
    };
```

## Documentation/devicetree/bindings/net/starfive,dwmac-plat.yaml
```yaml
# SPDX-License-Identifier: (GPL-2.0-only OR BSD-2-Clause)
%YAML 1.2
---
$id: http://devicetree.org/schemas/net/starfive,dwmac-plat.yaml#
$schema: http://devicetree.org/meta-schemas/core.yaml#

title: StarFive DWMAC glue layer Device Tree Bindings

maintainers:
  - Tan Chun Hau <chunhau.tan@starfivetech.com>

select:
  properties:
    compatible:
      contains:
        enum:
          - starfive,dwmac
  required:
    - compatible

allOf:
  - $ref: "snps,dwmac.yaml#"

properties:
  compatible:
    oneOf:
      - items:
          - enum:
              - starfive,dwmac
          - const: snps,dwmac-5.10a

  clocks:
    items:
      - description: Gtx clock
      - description: Tx clock
      - description: PTP reference clock
      - description: GMAC main clock
      - description: PTP reference clock
      - description: Gtxc clock

  clock-names:
    items:
      - const: gtx
      - const: tx
      - const: ptp_ref
      - const: stmmaceth
      - const: pclk
      - const: gtxc

required:
  - compatible
  - clocks
  - clock-names

unevaluatedProperties: false

Example:
  - |
    #include <dt-bindings/reset/starfive-jh7110.h>
    #include <dt-bindings/clock/starfive-jh7110-clkgen.h>

    /* gmac device configuration */
    stmmac_axi_setup: stmmac-axi-config {
      snps,wr_osr_lmt = <0xf>;
      snps,rd_osr_lmt = <0xf>;
      snps,blen = <256 128 64 32 0 0 0>;
    };

    gmac0: gmac@17020000 {
      compatible = "starfive,dwmac","snps,dwmac-5.10a";
      reg = <0x0 0x17020000 0x0 0x10000>;
      interrupts = <7>, <6>, <5>;
      interrupt-names = "macirq", "eth_wake_irq", "eth_lpi";
      phy-reset-gpios = <&gpio 63 0>;
      clock-names = "gtx",
        "tx",
        "ptp_ref",
        "stmmaceth",
        "pclk",
        "gtxc";
      clocks = <&clkgen JH7110_GMAC0_GTXCLK>,
         <&clkgen JH7110_U0_GMAC5_CLK_TX>,
         <&clkgen JH7110_GMAC0_PTP>,
         <&clkgen JH7110_U0_GMAC5_CLK_AHB>,
         <&clkgen JH7110_U0_GMAC5_CLK_AXI>,
         <&clkgen JH7110_GMAC0_GTXC>;
      resets = <&rstgen RSTN_U0_DW_GMAC5_AXI64_AHB>,
         <&rstgen RSTN_U0_DW_GMAC5_AXI64_AXI>;
      reset-names = "ahb", "stmmaceth";
      max-frame-size = <1500>;
      phy-mode = "rgmii-id";
      snps,multicast-filter-bins = <64>;
      snps,perfect-filter-entries = <128>;
      rx-fifo-depth = <2048>;
      tx-fifo-depth = <2048>;
      snps,fixed-burst;
      snps,no-pbl-x8;
      snps,force_thresh_dma_mode;
      snps,axi-config = <&stmmac_axi_setup>;
      snps,tso;
      snps,en-tx-lpi-clockgating;
      snps,txpbl = <4>;
      snps,rxpbl = <4>;
    };
```

## Documentation/devicetree/bindings/net/starfive,jh7110-dwmac.yaml
```yaml
# SPDX-License-Identifier: (GPL-2.0-only OR BSD-2-Clause)
# Copyright (C) 2022 StarFive Technology Co., Ltd.
%YAML 1.2
---
$id: http://devicetree.org/schemas/net/starfive,jh7110-dwmac.yaml#
$schema: http://devicetree.org/meta-schemas/core.yaml#

title: StarFive JH7110 DWMAC glue layer

maintainers:
  - Emil Renner Berthing <kernel@esmil.dk>
  - Samin Guo <samin.guo@starfivetech.com>

select:
  properties:
    compatible:
      contains:
        enum:
          - starfive,jh7100-dwmac
          - starfive,jh7110-dwmac
  required:
    - compatible

properties:
  compatible:
    oneOf:
      - items:
          - const: starfive,jh7100-dwmac
          - const: snps,dwmac
      - items:
          - const: starfive,jh7110-dwmac
          - const: snps,dwmac-5.20
      - items:
          - const: starfive,jh8100-dwmac
          - const: starfive,jh7110-dwmac
          - const: snps,dwmac-5.20

  reg:
    maxItems: 1

  clocks:
    items:
      - description: GMAC main clock
      - description: GMAC AHB clock
      - description: PTP clock
      - description: TX clock
      - description: GTX clock

  clock-names:
    items:
      - const: stmmaceth
      - const: pclk
      - const: ptp_ref
      - const: tx
      - const: gtx

  starfive,tx-use-rgmii-clk:
    description:
      Tx clock is provided by external rgmii clock.
    type: boolean

  starfive,syscon:
    $ref: /schemas/types.yaml#/definitions/phandle-array
    items:
      - items:
          - description: phandle to syscon that configures phy mode
          - description: Offset of phy mode selection
          - description: Shift of phy mode selection
    description:
      A phandle to syscon with two arguments that configure phy mode.
      The argument one is the offset of phy mode selection, the
      argument two is the shift of phy mode selection.

required:
  - compatible
  - reg
  - clocks
  - clock-names
  - interrupts
  - interrupt-names
  - resets
  - reset-names

allOf:
  - $ref: snps,dwmac.yaml#

  - if:
      properties:
        compatible:
          contains:
            const: starfive,jh7100-dwmac
    then:
      properties:
        interrupts:
          minItems: 2
          maxItems: 2

        interrupt-names:
          minItems: 2
          maxItems: 2

        resets:
          maxItems: 1

        reset-names:
          const: ahb

  - if:
      properties:
        compatible:
          contains:
            const: starfive,jh7110-dwmac
    then:
      properties:
        interrupts:
          minItems: 3
          maxItems: 3

        interrupt-names:
          minItems: 3
          maxItems: 3

      if:
        properties:
          compatible:
            contains:
              const: starfive,jh8100-dwmac
      then:
        properties:
          resets:
            maxItems: 1

          reset-names:
            const: stmmaceth
      else:
        properties:
          resets:
            minItems: 2

          reset-names:
            minItems: 2

unevaluatedProperties: false

examples:
  - |
    ethernet@16030000 {
        compatible = "starfive,jh7110-dwmac", "snps,dwmac-5.20";
        reg = <0x16030000 0x10000>;
        clocks = <&clk 3>, <&clk 2>, <&clk 109>,
                 <&clk 6>, <&clk 111>;
        clock-names = "stmmaceth", "pclk", "ptp_ref",
                      "tx", "gtx";
        resets = <&rst 1>, <&rst 2>;
        reset-names = "stmmaceth", "ahb";
        interrupts = <7>, <6>, <5>;
        interrupt-names = "macirq", "eth_wake_irq", "eth_lpi";
        phy-mode = "rgmii-id";
        snps,multicast-filter-bins = <64>;
        snps,perfect-filter-entries = <8>;
        rx-fifo-depth = <2048>;
        tx-fifo-depth = <2048>;
        snps,fixed-burst;
        snps,no-pbl-x8;
        snps,tso;
        snps,force_thresh_dma_mode;
        snps,axi-config = <&stmmac_axi_setup>;
        snps,en-tx-lpi-clockgating;
        snps,txpbl = <16>;
        snps,rxpbl = <16>;
        starfive,syscon = <&aon_syscon 0xc 0x12>;
        phy-handle = <&phy0>;

        mdio {
            #address-cells = <1>;
            #size-cells = <0>;
            compatible = "snps,dwmac-mdio";

            phy0: ethernet-phy@0 {
                reg = <0>;
            };
        };

        stmmac_axi_setup: stmmac-axi-config {
            snps,lpi_en;
            snps,wr_osr_lmt = <4>;
            snps,rd_osr_lmt = <4>;
            snps,blen = <256 128 64 32 0 0 0>;
        };
    };
```

## Documentation/devicetree/bindings/net/sti-dwmac.txt
```
STMicroelectronics SoC DWMAC glue layer controller

This file documents differences between the core properties in
Documentation/devicetree/bindings/net/stmmac.txt
and what is needed on STi platforms to program the stmmac glue logic.

The device node has following properties.

Required properties:
 - compatible	: Can be "st,stih415-dwmac", "st,stih416-dwmac",
   "st,stih407-dwmac", "st,stid127-dwmac".
 - st,syscon : Should be phandle/offset pair. The phandle to the syscon node which
   encompases the glue register, and the offset of the control register.
 - st,gmac_en: this is to enable the gmac into a dedicated sysctl control
   register available on STiH407 SoC.
 - pinctrl-0: pin-control for all the MII mode supported.

Optional properties:
 - resets : phandle pointing to the system reset controller with correct
   reset line index for ethernet reset.
 - st,ext-phyclk: valid only for RMII where PHY can generate 50MHz clock or
   MAC can generate it.
 - st,tx-retime-src: This specifies which clk is wired up to the mac for
   retimeing tx lines. This is totally board dependent and can take one of the
   posssible values from "txclk", "clk_125" or "clkgen".
   If not passed, the internal clock will be used by default.
 - sti-ethclk: this is the phy clock.
 - sti-clkconf: this is an extra sysconfig register, available in new SoCs,
   to program the clk retiming.
 - st,gmac_en: to enable the GMAC, this only is present in some SoCs; e.g.
   STiH407.

Example:

ethernet0: dwmac@9630000 {
	device_type = "network";
	compatible = "st,stih407-dwmac", "snps,dwmac", "snps,dwmac-3.710";
	reg = <0x9630000 0x8000>;
	reg-names = "stmmaceth";

	st,syscon = <&syscfg_sbc_reg 0x80>;
	st,gmac_en;
	resets = <&softreset STIH407_ETH1_SOFTRESET>;
	reset-names = "stmmaceth";

	interrupts = <GIC_SPI 98 IRQ_TYPE_NONE>,
		     <GIC_SPI 99 IRQ_TYPE_NONE>,
		     <GIC_SPI 100 IRQ_TYPE_NONE>;
	interrupt-names = "macirq", "eth_wake_irq", "eth_lpi";

	snps,pbl = <32>;
	snps,mixed-burst;

	pinctrl-names = "default";
	pinctrl-0 = <&pinctrl_rgmii1>;

	clock-names = "stmmaceth", "sti-ethclk";
	clocks = <&CLK_S_C0_FLEXGEN CLK_EXT2F_A9>,
		 <&CLK_S_C0_FLEXGEN CLK_ETH_PHY>;
};
```

## Documentation/devicetree/bindings/net/stm32-dwmac.txt
```
STMicroelectronics STM32 / MCU DWMAC glue layer controller

This file documents platform glue layer for stmmac.
Please see stmmac.txt for the other unchanged properties.

The device node has following properties.

Required properties:
- compatible:  For MCU family should be "st,stm32-dwmac" to select glue, and
	       "snps,dwmac-3.50a" to select IP version.
	       For MPU family should be "st,stm32mp1-dwmac" to select
	       glue, and "snps,dwmac-4.20a" to select IP version.
- clocks: Must contain a phandle for each entry in clock-names.
- clock-names: Should be "stmmaceth" for the host clock.
	       Should be "mac-clk-tx" for the MAC TX clock.
	       Should be "mac-clk-rx" for the MAC RX clock.
	       For MPU family need to add also "ethstp" for power mode clock and,
	                                       "syscfg-clk" for SYSCFG clock.
- interrupt-names: Should contain a list of interrupt names corresponding to
           the interrupts in the interrupts property, if available.
		   Should be "macirq" for the main MAC IRQ
		   Should be "eth_wake_irq" for the IT which wake up system
- st,syscon : Should be phandle/offset pair. The phandle to the syscon node which
	       encompases the glue register, and the offset of the control register.

Optional properties:
- clock-names:     For MPU family "mac-clk-ck" for PHY without quartz
- st,int-phyclk (boolean) :  valid only where PHY do not have quartz and need to be clock
	           by RCC

Example:

	ethernet@40028000 {
		compatible = "st,stm32-dwmac", "snps,dwmac-3.50a";
		reg = <0x40028000 0x8000>;
		reg-names = "stmmaceth";
		interrupts = <0 61 0>, <0 62 0>;
		interrupt-names = "macirq", "eth_wake_irq";
		clock-names = "stmmaceth", "mac-clk-tx", "mac-clk-rx";
		clocks = <&rcc 0 25>, <&rcc 0 26>, <&rcc 0 27>;
		st,syscon = <&syscfg 0x4>;
		snps,pbl = <8>;
		snps,mixed-burst;
		dma-ranges;
	};
```
