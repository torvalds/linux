## Documentation/devicetree/bindings/net/stm32-dwmac.yaml
```yaml
# SPDX-License-Identifier: (GPL-2.0 OR BSD-2-Clause)
# Copyright 2019 BayLibre, SAS
%YAML 1.2
---
$id: http://devicetree.org/schemas/net/stm32-dwmac.yaml#
$schema: http://devicetree.org/meta-schemas/core.yaml#

title: STMicroelectronics STM32 / MCU DWMAC glue layer controller

maintainers:
  - Alexandre Torgue <alexandre.torgue@foss.st.com>
  - Christophe Roullier <christophe.roullier@foss.st.com>

description:
  This file documents platform glue layer for stmmac.

# We need a select here so we don't match all nodes with 'snps,dwmac'
select:
  properties:
    compatible:
      contains:
        enum:
          - st,stm32-dwmac
          - st,stm32mp1-dwmac
          - st,stm32mp13-dwmac
          - st,stm32mp25-dwmac
  required:
    - compatible

properties:
  compatible:
    oneOf:
      - items:
          - enum:
              - st,stm32mp25-dwmac
          - const: snps,dwmac-5.20
      - items:
          - enum:
              - st,stm32mp1-dwmac
              - st,stm32mp13-dwmac
          - const: snps,dwmac-4.20a
      - items:
          - enum:
              - st,stm32-dwmac
          - const: snps,dwmac-4.10a
      - items:
          - enum:
              - st,stm32-dwmac
          - const: snps,dwmac-3.50a

  reg: true

  reg-names:
    items:
      - const: stmmaceth

  clocks:
    minItems: 3
    items:
      - description: GMAC main clock
      - description: MAC TX clock
      - description: MAC RX clock
      - description: For MPU family, used for power mode
      - description: For MPU family, used for PHY without quartz
      - description: PTP clock

  clock-names:
    minItems: 3
    maxItems: 6
    contains:
      enum:
        - stmmaceth
        - mac-clk-tx
        - mac-clk-rx
        - ethstp
        - eth-ck
        - ptp_ref

  st,syscon:
    $ref: /schemas/types.yaml#/definitions/phandle-array
    items:
      - minItems: 2
        items:
          - description: phandle to the syscon node which encompases the glue register
          - description: offset of the control register
          - description: field to set mask in register
    description:
      Should be phandle/offset pair. The phandle to the syscon node which
      encompases the glue register, the offset of the control register and
      the mask to set bitfield in control register

  st,ext-phyclk:
    description:
      set this property in RMII mode when you have PHY without crystal 50MHz and want to
      select RCC clock instead of ETH_REF_CLK. OR in RGMII mode when you want to select
      RCC clock instead of ETH_CLK125.
    type: boolean

  st,eth-clk-sel:
    description:
      set this property in RGMII PHY when you want to select RCC clock instead of ETH_CLK125.
    type: boolean

  st,eth-ref-clk-sel:
    description:
      set this property in RMII mode when you have PHY without crystal 50MHz and want to
      select RCC clock instead of ETH_REF_CLK.
    type: boolean

  access-controllers:
    minItems: 1
    maxItems: 2

required:
  - compatible
  - clocks
  - clock-names
  - st,syscon

unevaluatedProperties: false

allOf:
  - $ref: snps,dwmac.yaml#
  - if:
      properties:
        compatible:
          contains:
            enum:
              - st,stm32-dwmac
              - st,stm32mp1-dwmac
              - st,stm32mp25-dwmac
    then:
      properties:
        st,syscon:
          items:
            minItems: 2
            maxItems: 2

  - if:
      properties:
        compatible:
          contains:
            enum:
              - st,stm32mp13-dwmac
    then:
      properties:
        st,syscon:
          items:
            minItems: 3
            maxItems: 3

examples:
  - |
    #include <dt-bindings/interrupt-controller/arm-gic.h>
    #include <dt-bindings/clock/stm32mp1-clks.h>
    //Example 1
     ethernet0: ethernet@5800a000 {
           compatible = "st,stm32mp1-dwmac", "snps,dwmac-4.20a";
           reg = <0x5800a000 0x2000>;
           reg-names = "stmmaceth";
           interrupts = <GIC_SPI 61 IRQ_TYPE_LEVEL_HIGH>;
           interrupt-names = "macirq";
           clock-names = "stmmaceth",
                     "mac-clk-tx",
                     "mac-clk-rx",
                     "ethstp",
                     "eth-ck";
           clocks = <&rcc ETHMAC>,
                <&rcc ETHTX>,
                <&rcc ETHRX>,
                <&rcc ETHSTP>,
                <&rcc ETHCK_K>;
           st,syscon = <&syscfg 0x4>;
           snps,pbl = <2>;
           snps,axi-config = <&stmmac_axi_config_0>;
           snps,tso;
           phy-mode = "rgmii";
       };

  - |
    //Example 2 (MCU example)
     ethernet1: ethernet@40028000 {
           compatible = "st,stm32-dwmac", "snps,dwmac-3.50a";
           reg = <0x40028000 0x8000>;
           reg-names = "stmmaceth";
           interrupts = <0 61 0>, <0 62 0>;
           interrupt-names = "macirq", "eth_wake_irq";
           clock-names = "stmmaceth", "mac-clk-tx", "mac-clk-rx";
           clocks = <&rcc 0 25>, <&rcc 0 26>, <&rcc 0 27>;
           st,syscon = <&syscfg 0x4>;
           snps,pbl = <8>;
           snps,mixed-burst;
           phy-mode = "mii";
       };

  - |
    //Example 3
     ethernet2: ethernet@40027000 {
           compatible = "st,stm32-dwmac", "snps,dwmac-4.10a";
           reg = <0x40028000 0x8000>;
           reg-names = "stmmaceth";
           interrupts = <61>;
           interrupt-names = "macirq";
           clock-names = "stmmaceth", "mac-clk-tx", "mac-clk-rx";
           clocks = <&rcc 62>, <&rcc 61>, <&rcc 60>;
           st,syscon = <&syscfg 0x4>;
           snps,pbl = <8>;
           phy-mode = "mii";
       };
```

## Documentation/devicetree/bindings/net/sunplus,sp7021-emac.yaml
```yaml
# SPDX-License-Identifier: (GPL-2.0-only OR BSD-2-Clause)
# Copyright (C) Sunplus Co., Ltd. 2021
%YAML 1.2
---
$id: http://devicetree.org/schemas/net/sunplus,sp7021-emac.yaml#
$schema: http://devicetree.org/meta-schemas/core.yaml#

title: Sunplus SP7021 Dual Ethernet MAC Device Tree Bindings

maintainers:
  - Wells Lu <wellslutw@gmail.com>

description: |
  Sunplus SP7021 dual 10M/100M Ethernet MAC controller.
  Device node of the controller has following properties.

properties:
  compatible:
    const: sunplus,sp7021-emac

  reg:
    maxItems: 1

  interrupts:
    maxItems: 1

  clocks:
    maxItems: 1

  resets:
    maxItems: 1

  ethernet-ports:
    type: object
    description: Ethernet ports to PHY

    properties:
      "#address-cells":
        const: 1

      "#size-cells":
        const: 0

    patternProperties:
      "^port@[0-1]$":
        type: object
        description: Port to PHY

        properties:
          reg:
            minimum: 0
            maximum: 1

          phy-handle:
            maxItems: 1

          phy-mode:
            maxItems: 1

          nvmem-cells:
            items:
              - description: nvmem cell address of MAC address

          nvmem-cell-names:
            description: names corresponding to the nvmem cells
            items:
              - const: mac-address

        required:
          - reg
          - phy-handle
          - phy-mode
          - nvmem-cells
          - nvmem-cell-names

  mdio:
    $ref: mdio.yaml#
    unevaluatedProperties: false

additionalProperties: false

required:
  - compatible
  - reg
  - interrupts
  - clocks
  - resets
  - pinctrl-0
  - pinctrl-names
  - ethernet-ports
  - mdio

examples:
  - |
    #include <dt-bindings/interrupt-controller/irq.h>

    ethernet@9c108000 {
        compatible = "sunplus,sp7021-emac";
        reg = <0x9c108000 0x400>;
        interrupt-parent = <&intc>;
        interrupts = <66 IRQ_TYPE_LEVEL_HIGH>;
        clocks = <&clkc 0xa7>;
        resets = <&rstc 0x97>;
        pinctrl-0 = <&emac_demo_board_v3_pins>;
        pinctrl-names = "default";

        ethernet-ports {
            #address-cells = <1>;
            #size-cells = <0>;

            port@0 {
                reg = <0>;
                phy-handle = <&eth_phy0>;
                phy-mode = "rmii";
                nvmem-cells = <&mac_addr0>;
                nvmem-cell-names = "mac-address";
            };

            port@1 {
                reg = <1>;
                phy-handle = <&eth_phy1>;
                phy-mode = "rmii";
                nvmem-cells = <&mac_addr1>;
                nvmem-cell-names = "mac-address";
            };
        };

        mdio {
            #address-cells = <1>;
            #size-cells = <0>;

            eth_phy0: ethernet-phy@0 {
                reg = <0>;
            };

            eth_phy1: ethernet-phy@1 {
                reg = <1>;
            };
        };
    };
...
```

## Documentation/devicetree/bindings/net/tesla,fsd-ethqos.yaml
```yaml
# SPDX-License-Identifier: GPL-2.0-only OR BSD-2-Clause
%YAML 1.2
---
$id: http://devicetree.org/schemas/net/tesla,fsd-ethqos.yaml#
$schema: http://devicetree.org/meta-schemas/core.yaml#

title: FSD Ethernet Quality of Service

maintainers:
  - Swathi K S <swathi.ks@samsung.com>

description:
  Tesla ethernet devices based on dwmmac support Gigabit ethernet.

allOf:
  - $ref: snps,dwmac.yaml#

properties:
  compatible:
    const: tesla,fsd-ethqos

  reg:
    maxItems: 1

  interrupts:
    maxItems: 1

  interrupt-names:
    items:
      - const: macirq

  clocks:
    minItems: 5
    items:
      - description: PTP clock
      - description: Master bus clock
      - description: Slave bus clock
      - description: MAC TX clock
      - description: MAC RX clock
      - description: Master2 bus clock
      - description: Slave2 bus clock
      - description: RX MUX clock
      - description: PHY RX clock
      - description: PERIC RGMII clock

  clock-names:
    minItems: 5
    items:
      - const: ptp_ref
      - const: master_bus
      - const: slave_bus
      - const: tx
      - const: rx
      - const: master2_bus
      - const: slave2_bus
      - const: eqos_rxclk_mux
      - const: eqos_phyrxclk
      - const: dout_peric_rgmii_clk

  iommus:
    maxItems: 1

  phy-mode:
    enum:
      - rgmii
      - rgmii-id
      - rgmii-rxid
      - rgmii-txid

required:
  - compatible
  - reg
  - interrupts
  - clocks
  - clock-names
  - iommus
  - phy-mode

unevaluatedProperties: false

examples:
  - |
    #include <dt-bindings/clock/fsd-clk.h>
    #include <dt-bindings/interrupt-controller/arm-gic.h>
    soc {
        #address-cells = <2>;
        #size-cells = <2>;
        ethernet1: ethernet@14300000 {
            compatible = "tesla,fsd-ethqos";
            reg = <0x0 0x14300000 0x0 0x10000>;
            interrupts = <GIC_SPI 176 IRQ_TYPE_LEVEL_HIGH>;
            interrupt-names = "macirq";
            clocks = <&clock_peric PERIC_EQOS_TOP_IPCLKPORT_CLK_PTP_REF_I>,
                     <&clock_peric PERIC_EQOS_TOP_IPCLKPORT_ACLK_I>,
                     <&clock_peric PERIC_EQOS_TOP_IPCLKPORT_HCLK_I>,
                     <&clock_peric PERIC_EQOS_TOP_IPCLKPORT_RGMII_CLK_I>,
                     <&clock_peric PERIC_EQOS_TOP_IPCLKPORT_CLK_RX_I>,
                     <&clock_peric PERIC_BUS_D_PERIC_IPCLKPORT_EQOSCLK>,
                     <&clock_peric PERIC_BUS_P_PERIC_IPCLKPORT_EQOSCLK>,
                     <&clock_peric PERIC_EQOS_PHYRXCLK_MUX>,
                     <&clock_peric PERIC_EQOS_PHYRXCLK>,
                     <&clock_peric PERIC_DOUT_RGMII_CLK>;
            clock-names = "ptp_ref", "master_bus", "slave_bus","tx",
                          "rx", "master2_bus", "slave2_bus", "eqos_rxclk_mux",
                          "eqos_phyrxclk","dout_peric_rgmii_clk";
            assigned-clocks = <&clock_peric PERIC_EQOS_PHYRXCLK_MUX>,
                              <&clock_peric PERIC_EQOS_PHYRXCLK>;
            assigned-clock-parents = <&clock_peric PERIC_EQOS_PHYRXCLK>;
            pinctrl-names = "default";
            pinctrl-0 = <&eth1_tx_clk>, <&eth1_tx_data>, <&eth1_tx_ctrl>,
                        <&eth1_phy_intr>, <&eth1_rx_clk>, <&eth1_rx_data>,
                        <&eth1_rx_ctrl>, <&eth1_mdio>;
            iommus = <&smmu_peric 0x0 0x1>;
            phy-mode = "rgmii-id";
        };
    };

...
```

## Documentation/devicetree/bindings/net/thead,th1520-gmac.yaml
```yaml
# SPDX-License-Identifier: (GPL-2.0-only OR BSD-2-Clause)
%YAML 1.2
---
$id: http://devicetree.org/schemas/net/thead,th1520-gmac.yaml#
$schema: http://devicetree.org/meta-schemas/core.yaml#

title: T-HEAD TH1520 GMAC Ethernet controller

maintainers:
  - Drew Fustini <dfustini@tenstorrent.com>

description: |
  The TH1520 GMAC is described in the TH1520 Peripheral Interface User Manual
  https://git.beagleboard.org/beaglev-ahead/beaglev-ahead/-/tree/main/docs

  Features include
    - Compliant with IEEE802.3 Specification
    - IEEE 1588-2008 standard for precision networked clock synchronization
    - Supports 10/100/1000Mbps data transfer rate
    - Supports RGMII/MII interface
    - Preamble and start of frame data (SFD) insertion in Transmit path
    - Preamble and SFD deletion in the Receive path
    - Automatic CRC and pad generation options for receive frames
    - MDIO master interface for PHY device configuration and management

  The GMAC Registers consists of two parts
    - APB registers are used to configure clock frequency/clock enable/clock
      direction/PHY interface type.
    - AHB registers are use to configure GMAC core (DesignWare Core part).
      GMAC core register consists of DMA registers and GMAC registers.

select:
  properties:
    compatible:
      contains:
        enum:
          - thead,th1520-gmac
  required:
    - compatible

allOf:
  - $ref: snps,dwmac.yaml#

properties:
  compatible:
    items:
      - enum:
          - thead,th1520-gmac
      - const: snps,dwmac-3.70a

  reg:
    items:
      - description: DesignWare GMAC IP core registers
      - description: GMAC APB registers

  reg-names:
    items:
      - const: dwmac
      - const: apb

  clocks:
    items:
      - description: GMAC main clock
      - description: Peripheral registers interface clock

  clock-names:
    items:
      - const: stmmaceth
      - const: pclk

  interrupts:
    items:
      - description: Combined signal for various interrupt events

  interrupt-names:
    items:
      - const: macirq

required:
  - clocks
  - clock-names

unevaluatedProperties: false

examples:
  - |
    gmac0: ethernet@e7070000 {
        compatible = "thead,th1520-gmac", "snps,dwmac-3.70a";
        reg = <0xe7070000 0x2000>, <0xec003000 0x1000>;
        reg-names = "dwmac", "apb";
        clocks = <&clk 1>, <&clk 2>;
        clock-names = "stmmaceth", "pclk";
        interrupts = <66>;
        interrupt-names = "macirq";
        phy-mode = "rgmii-id";
        snps,fixed-burst;
        snps,axi-config = <&stmmac_axi_setup>;
        snps,pbl = <32>;
        phy-handle = <&phy0>;

        mdio {
            #address-cells = <1>;
            #size-cells = <0>;
            compatible = "snps,dwmac-mdio";

            phy0: ethernet-phy@0 {
                reg = <0>;
            };
        };
    };
```
