## Documentation/devicetree/bindings/net/ti,bluetooth.yaml
```yaml
# SPDX-License-Identifier: (GPL-2.0-only OR BSD-2-Clause)
%YAML 1.2
---
$id: http://devicetree.org/schemas/net/ti,bluetooth.yaml#
$schema: http://devicetree.org/meta-schemas/core.yaml#

title: Texas Instruments Bluetooth Chips

maintainers:
  - David Lechner <david@lechnology.com>

description: |
  This documents the binding structure and common properties for serial
  attached TI Bluetooth devices. The following chips are included in this
  binding:

  * TI CC256x Bluetooth devices
  * TI WiLink 7/8 (wl12xx/wl18xx) Shared Transport BT/FM/GPS devices

  TI WiLink devices have a UART interface for providing Bluetooth, FM radio,
  and GPS over what's called "shared transport". The shared transport is
  standard BT HCI protocol with additional channels for the other functions.

  TI WiLink devices also have a separate WiFi interface as described in
  wireless/ti,wlcore.yaml.

  This bindings follows the UART slave device binding in ../serial/serial.yaml.

properties:
  compatible:
    enum:
      - ti,cc2560
      - ti,wl1271-st
      - ti,wl1273-st
      - ti,wl1281-st
      - ti,wl1283-st
      - ti,wl1285-st
      - ti,wl1801-st
      - ti,wl1805-st
      - ti,wl1807-st
      - ti,wl1831-st
      - ti,wl1835-st
      - ti,wl1837-st

  enable-gpios:
    maxItems: 1

  vio-supply:
    description: Vio input supply (1.8V)

  vbat-supply:
    description: Vbat input supply (2.9-4.8V)

  clocks:
    maxItems: 1

  clock-names:
    items:
      - const: ext_clock

  max-speed:
    default: 3000000

  nvmem-cells:
    maxItems: 1
    description:
      Nvmem data cell that contains a 6 byte BD address with the most
      significant byte first (big-endian).

  nvmem-cell-names:
    items:
      - const: bd-address

required:
  - compatible

additionalProperties: false

examples:
  - |
    #include <dt-bindings/gpio/gpio.h>

    serial {
            bluetooth {
                    compatible = "ti,wl1835-st";
                    enable-gpios = <&gpio1 7 GPIO_ACTIVE_HIGH>;
                    clocks = <&clk32k_wl18xx>;
                    clock-names = "ext_clock";
                    nvmem-cells = <&bd_address>;
                    nvmem-cell-names = "bd-address";
            };
    };
```

## Documentation/devicetree/bindings/net/ti,cc1352p7.yaml
```yaml
# SPDX-License-Identifier: GPL-2.0-only OR BSD-2-Clause
%YAML 1.2
---
$id: http://devicetree.org/schemas/net/ti,cc1352p7.yaml#
$schema: http://devicetree.org/meta-schemas/core.yaml#

title: Texas Instruments Simplelink CC1352P7 wireless MCU

description:
  The CC1352P7 MCU can be connected via SPI or UART.

maintainers:
  - Ayush Singh <ayushdevel1325@gmail.com>

properties:
  compatible:
    const: ti,cc1352p7

  clocks:
    items:
      - description: high-frequency main system (MCU and peripherals) clock
      - description: low-frequency system clock

  clock-names:
    items:
      - const: sclk_hf
      - const: sclk_lf

  reset-gpios:
    maxItems: 1

  bootloader-backdoor-gpios:
    maxItems: 1
    description: |
      gpios to enable bootloader backdoor in cc1352p7 bootloader to allow
      flashing new firmware.

  vdds-supply: true

required:
  - compatible

additionalProperties: false

examples:
  - |
    #include <dt-bindings/gpio/gpio.h>

    serial {
      mcu {
        compatible = "ti,cc1352p7";
        clocks = <&sclk_hf 0>, <&sclk_lf 25>;
        clock-names = "sclk_hf", "sclk_lf";
        reset-gpios = <&pio 35 GPIO_ACTIVE_LOW>;
        bootloader-backdoor-gpios = <&pio 36 GPIO_ACTIVE_LOW>;
        vdds-supply = <&vdds>;
      };
    };
```

## Documentation/devicetree/bindings/net/ti,cpsw-switch.yaml
```yaml
# SPDX-License-Identifier: (GPL-2.0-only OR BSD-2-Clause)
%YAML 1.2
---
$id: http://devicetree.org/schemas/net/ti,cpsw-switch.yaml#
$schema: http://devicetree.org/meta-schemas/core.yaml#

title: TI SoC Ethernet Switch Controller (CPSW) Device Tree Bindings

maintainers:
  - Grygorii Strashko <grygorii.strashko@ti.com>
  - Sekhar Nori <nsekhar@ti.com>

description:
  The 3-port switch gigabit ethernet subsystem provides ethernet packet
  communication and can be configured as an ethernet switch. It provides the
  gigabit media independent interface (GMII),reduced gigabit media
  independent interface (RGMII), reduced media independent interface (RMII),
  the management data input output (MDIO) for physical layer device (PHY)
  management.

properties:
  compatible:
    oneOf:
      - const: ti,cpsw-switch
      - items:
          - const: ti,am335x-cpsw-switch
          - const: ti,cpsw-switch
      - items:
          - const: ti,am4372-cpsw-switch
          - const: ti,cpsw-switch
      - items:
          - const: ti,dra7-cpsw-switch
          - const: ti,cpsw-switch

  reg:
    maxItems: 1
    description:
      The physical base address and size of full the CPSW module IO range

  '#address-cells':
    const: 1

  '#size-cells':
    const: 1

  ranges: true

  clocks:
    maxItems: 1
    description: CPSW functional clock

  clock-names:
    items:
      - const: fck

  interrupts:
    items:
      - description: RX_THRESH interrupt
      - description: RX interrupt
      - description: TX interrupt
      - description: MISC interrupt

  interrupt-names:
    items:
      - const: "rx_thresh"
      - const: "rx"
      - const: "tx"
      - const: "misc"

  pinctrl-names: true

  syscon:
    $ref: /schemas/types.yaml#/definitions/phandle
    description:
      Phandle to the system control device node which provides access to
      efuse IO range with MAC addresses

  ethernet-ports:
    type: object
    properties:
      '#address-cells':
        const: 1
      '#size-cells':
        const: 0

    patternProperties:
      "^port@[0-9]+$":
        type: object
        description: CPSW external ports

        $ref: ethernet-controller.yaml#

        properties:
          reg:
            items:
              - enum: [1, 2]
            description: CPSW port number

          phys:
            maxItems: 1
            description: phandle on phy-gmii-sel PHY

          label:
            description: label associated with this port

          ti,dual-emac-pvid:
            $ref: /schemas/types.yaml#/definitions/uint32
            minimum: 1
            maximum: 1024
            description:
              Specifies default PORT VID to be used to segregate
              ports. Default value - CPSW port number.

        required:
          - reg
          - phys

  cpts:
    type: object
    description:
      The Common Platform Time Sync (CPTS) module

    properties:
      clocks:
        maxItems: 1
        description: CPTS reference clock

      clock-names:
        items:
          - const: cpts

      cpts_clock_mult:
        $ref: /schemas/types.yaml#/definitions/uint32
        description:
          Numerator to convert input clock ticks into ns

      cpts_clock_shift:
        $ref: /schemas/types.yaml#/definitions/uint32
        description:
          Denominator to convert input clock ticks into ns.
          Mult and shift will be calculated basing on CPTS rftclk frequency if
          both cpts_clock_shift and cpts_clock_mult properties are not provided.

    required:
      - clocks
      - clock-names

patternProperties:
  "^mdio@":
    type: object
    description:
      CPSW MDIO bus.
    $ref: "ti,davinci-mdio.yaml#"


required:
  - compatible
  - reg
  - ranges
  - clocks
  - clock-names
  - interrupts
  - interrupt-names
  - '#address-cells'
  - '#size-cells'

additionalProperties: false

examples:
  - |
    #include <dt-bindings/interrupt-controller/irq.h>
    #include <dt-bindings/interrupt-controller/arm-gic.h>
    #include <dt-bindings/clock/dra7.h>

    mac_sw: switch@0 {
        compatible = "ti,dra7-cpsw-switch","ti,cpsw-switch";
        reg = <0x0 0x4000>;
        ranges = <0 0 0x4000>;
        clocks = <&gmac_main_clk>;
        clock-names = "fck";
        #address-cells = <1>;
        #size-cells = <1>;
        syscon = <&scm_conf>;

        interrupts = <GIC_SPI 334 IRQ_TYPE_LEVEL_HIGH>,
                     <GIC_SPI 335 IRQ_TYPE_LEVEL_HIGH>,
                     <GIC_SPI 336 IRQ_TYPE_LEVEL_HIGH>,
                     <GIC_SPI 337 IRQ_TYPE_LEVEL_HIGH>;
        interrupt-names = "rx_thresh", "rx", "tx", "misc";

        ethernet-ports {
                #address-cells = <1>;
                #size-cells = <0>;

                cpsw_port1: port@1 {
                        reg = <1>;
                        label = "port1";
                        mac-address = [ 00 00 00 00 00 00 ];
                        phys = <&phy_gmii_sel 1>;
                        phy-handle = <&ethphy0_sw>;
                        phy-mode = "rgmii";
                        ti,dual-emac-pvid = <1>;
                };

                cpsw_port2: port@2 {
                        reg = <2>;
                        label = "wan";
                        mac-address = [ 00 00 00 00 00 00 ];
                        phys = <&phy_gmii_sel 2>;
                        phy-handle = <&ethphy1_sw>;
                        phy-mode = "rgmii";
                        ti,dual-emac-pvid = <2>;
                };
        };

        davinci_mdio_sw: mdio@1000 {
                compatible = "ti,cpsw-mdio","ti,davinci_mdio";
                reg = <0x1000 0x100>;
                clocks = <&gmac_clkctrl DRA7_GMAC_GMAC_CLKCTRL 0>;
                clock-names = "fck";
                #address-cells = <1>;
                #size-cells = <0>;
                bus_freq = <1000000>;

                ethphy0_sw: ethernet-phy@0 {
                        reg = <0>;
                };

                ethphy1_sw: ethernet-phy@1 {
                        reg = <1>;
                };
        };

        cpts {
                clocks = <&gmac_clkctrl DRA7_GMAC_GMAC_CLKCTRL 25>;
                clock-names = "cpts";
        };
    };
```

## Documentation/devicetree/bindings/net/ti,davinci-mdio.yaml
```yaml
# SPDX-License-Identifier: GPL-2.0
%YAML 1.2
---
$id: http://devicetree.org/schemas/net/ti,davinci-mdio.yaml#
$schema: http://devicetree.org/meta-schemas/core.yaml#

title: TI SoC Davinci/Keystone2 MDIO Controller

maintainers:
  - Grygorii Strashko <grygorii.strashko@ti.com>

description:
  TI SoC Davinci/Keystone2 MDIO Controller

allOf:
  - $ref: "mdio.yaml#"

properties:
  compatible:
    oneOf:
      - const: ti,davinci_mdio
      - items:
          - const: ti,keystone_mdio
          - const: ti,davinci_mdio
      - items:
          - const: ti,cpsw-mdio
          - const: ti,davinci_mdio
      - items:
          - const: ti,am4372-mdio
          - const: ti,cpsw-mdio
          - const: ti,davinci_mdio

  reg:
    maxItems: 1

  bus_freq:
    maximum: 2500000
    description: MDIO Bus frequency

  ti,hwmods:
    description: TI hwmod name
    deprecated: true
    $ref: /schemas/types.yaml#/definitions/string-array
    items:
      const: davinci_mdio

if:
  properties:
    compatible:
      contains:
        const: ti,davinci_mdio
  required:
    - bus_freq

required:
  - compatible
  - reg
  - "#address-cells"
  - "#size-cells"

unevaluatedProperties: false

examples:
  - |
    davinci_mdio: mdio@4a101000 {
         compatible = "ti,davinci_mdio";
         #address-cells = <1>;
         #size-cells = <0>;
         reg = <0x4a101000 0x1000>;
         bus_freq = <1000000>;
    };
```

## Documentation/devicetree/bindings/net/ti,dp83822.yaml
```yaml
# SPDX-License-Identifier: (GPL-2.0+ OR BSD-2-Clause)
# Copyright (C) 2020 Texas Instruments Incorporated
%YAML 1.2
---
$id: http://devicetree.org/schemas/net/ti,dp83822.yaml#
$schema: http://devicetree.org/meta-schemas/core.yaml#

title: TI DP83822 ethernet PHY

maintainers:
  - Andrew Davis <afd@ti.com>

description: |
  The DP83822 is a low-power, single-port, 10/100 Mbps Ethernet PHY. It
  provides all of the physical layer functions needed to transmit and receive
  data over standard, twisted-pair cables or to connect to an external,
  fiber-optic transceiver. Additionally, the DP83822 provides flexibility to
  connect to a MAC through a standard MII, RMII, or RGMII interface

  Specifications about the Ethernet PHY can be found at:
    http://www.ti.com/lit/ds/symlink/dp83822i.pdf

allOf:
  - $ref: ethernet-phy.yaml#

properties:
  reg:
    maxItems: 1

  ti,link-loss-low:
    type: boolean
    description: |
       DP83822 PHY in Fiber mode only.
       Sets the DP83822 to detect a link drop condition when the signal goes
       high.  If not set then link drop will occur when the signal goes low.
       This property is only applicable if the fiber mode support is strapped
       to on.

  ti,fiber-mode:
    type: boolean
    description: |
       DP83822 PHY only.
       If present the DP83822 PHY is configured to operate in fiber mode
       Fiber mode support can also be strapped. If the strap pin is not set
       correctly or not set at all then this boolean can be used to enable it.
       If the fiber mode is not strapped then signal detection for the PHY
       is disabled.
       In fiber mode, auto-negotiation is disabled and the PHY can only work in
       100base-fx (full and half duplex) modes.

  rx-internal-delay-ps:
    description: |
       DP83822 PHY only.
       Setting this property to a non-zero number sets the RX internal delay
       for the PHY.  The internal delay for the PHY is fixed to 3.5ns relative
       to receive data.

  tx-internal-delay-ps:
    description: |
       DP83822 PHY only.
       Setting this property to a non-zero number sets the TX internal delay
       for the PHY.  The internal delay for the PHY is fixed to 3.5ns relative
       to transmit data.

  ti,cfg-dac-minus-one-bp:
    description: |
       DP83826 PHY only.
       Sets the voltage ratio (with respect to the nominal value)
       of the logical level -1 for the MLT-3 encoded TX data.
    enum: [5000, 5625, 6250, 6875, 7500, 8125, 8750, 9375, 10000,
           10625, 11250, 11875, 12500, 13125, 13750, 14375, 15000]
    default: 10000

  ti,cfg-dac-plus-one-bp:
    description: |
       DP83826 PHY only.
       Sets the voltage ratio (with respect to the nominal value)
       of the logical level +1 for the MLT-3 encoded TX data.
    enum: [5000, 5625, 6250, 6875, 7500, 8125, 8750, 9375, 10000,
           10625, 11250, 11875, 12500, 13125, 13750, 14375, 15000]
    default: 10000

  ti,rmii-mode:
    description: |
       If present, select the RMII operation mode. Two modes are
       available:
         - RMII master, where the PHY outputs a 50MHz reference clock which can
         be connected to the MAC.
         - RMII slave, where the PHY expects a 50MHz reference clock input
         shared with the MAC.
       The RMII operation mode can also be configured by its straps.
       If the strap pin is not set correctly or not set at all, then this can be
       used to configure it.
    $ref: /schemas/types.yaml#/definitions/string
    enum:
      - master
      - slave

required:
  - reg

unevaluatedProperties: false

examples:
  - |
    mdio0 {
      #address-cells = <1>;
      #size-cells = <0>;
      ethphy0: ethernet-phy@0 {
        reg = <0>;
        rx-internal-delay-ps = <1>;
        tx-internal-delay-ps = <1>;
      };
    };

...
```
