## Documentation/devicetree/bindings/net/wireless/mediatek,mt76.yaml
```yaml
# SPDX-License-Identifier: (GPL-2.0-only OR BSD-2-Clause)
# Copyright (c) 2018-2019 The Linux Foundation. All rights reserved.

%YAML 1.2
---
$id: http://devicetree.org/schemas/net/wireless/mediatek,mt76.yaml#
$schema: http://devicetree.org/meta-schemas/core.yaml#

title: MediaTek mt76 wireless devices Generic Binding

maintainers:
  - Felix Fietkau <nbd@nbd.name>
  - Lorenzo Bianconi <lorenzo@kernel.org>
  - Ryder Lee <ryder.lee@mediatek.com>

description: |
  This node provides properties for configuring the MediaTek mt76xx
  wireless device. The node is expected to be specified as a child
  node of the PCI controller to which the wireless chip is connected.
  Alternatively, it can specify the wireless part of the MT7628/MT7688
  or MT7622/MT7986 SoC.

allOf:
  - $ref: ieee80211.yaml#

properties:
  compatible:
    enum:
      - mediatek,mt76
      - mediatek,mt7628-wmac
      - mediatek,mt7622-wmac
      - mediatek,mt7986-wmac

  reg:
    minItems: 1
    maxItems: 3
    description:
      MT7986 should contain 3 regions consys, dcm, and sku, in this order.

  interrupts:
    maxItems: 1

  power-domains:
    maxItems: 1

  memory-region:
    maxItems: 1

  resets:
    maxItems: 1
    description:
      Specify the consys reset for mt7986.

  reset-names:
    const: consys

  clocks:
    maxItems: 2
    description:
      Specify the consys clocks for mt7986.

  clock-names:
    items:
      - const: mcu
      - const: ap2conn

  mediatek,infracfg:
    $ref: /schemas/types.yaml#/definitions/phandle
    description:
      Phandle to the infrastructure bus fabric syscon node.
      This property is MT7622 specific

  ieee80211-freq-limit: true

  mediatek,eeprom-data:
    $ref: /schemas/types.yaml#/definitions/uint32-array
    description:
      EEPROM data embedded as array.

  mediatek,mtd-eeprom:
    $ref: /schemas/types.yaml#/definitions/phandle-array
    items:
      - items:
          - description: phandle to MTD partition
          - description: offset containing EEPROM data
    description:
      Phandle to a MTD partition + offset containing EEPROM data

  big-endian:
    $ref: /schemas/types.yaml#/definitions/flag
    description:
      Specify if the radio eeprom partition is written in big-endian

  mediatek,eeprom-merge-otp:
    type: boolean
    description:
      Merge EEPROM data with OTP data. Can be used on boards where the flash
      calibration data is generic and specific calibration data should be
      pulled from the OTP ROM

  mediatek,disable-radar-background:
    type: boolean
    description:
      Disable/enable radar/CAC detection running on a dedicated offchannel
      chain available on some hw.
      Background radar/CAC detection allows to avoid the CAC downtime
      switching on a different channel during CAC detection on the selected
      radar channel.

  led:
    type: object
    $ref: /schemas/leds/common.yaml#
    additionalProperties: false
    properties:
      led-sources:
        maxItems: 1

  power-limits:
    type: object
    additionalProperties: false
    patternProperties:
      "^r[0-9]+":
        type: object
        additionalProperties: false
        properties:
          regdomain:
            $ref: /schemas/types.yaml#/definitions/string
            description:
              Regdomain refers to a legal regulatory region. Different
              countries define different levels of allowable transmitter
              power, time that a channel can be occupied, and different
              available channels
            enum:
              - FCC
              - ETSI
              - JP

        patternProperties:
          "^txpower-[256]g$":
            type: object
            additionalProperties: false
            patternProperties:
              "^b[0-9]+$":
                type: object
                additionalProperties: false
                properties:
                  channels:
                    $ref: /schemas/types.yaml#/definitions/uint32-array
                    minItems: 2
                    maxItems: 2
                    description:
                      Pairs of first and last channel number of the selected
                      band

                  rates-cck:
                    $ref: /schemas/types.yaml#/definitions/uint8-array
                    minItems: 4
                    maxItems: 4
                    description:
                      4 half-dBm per-rate power limit values

                  rates-ofdm:
                    $ref: /schemas/types.yaml#/definitions/uint8-array
                    minItems: 8
                    maxItems: 8
                    description:
                      8 half-dBm per-rate power limit values

                  rates-mcs:
                    $ref: /schemas/types.yaml#/definitions/uint8-matrix
                    description:
                      Sets of per-rate power limit values for 802.11n/802.11ac
                      rates for multiple channel bandwidth settings.
                      Each set starts with the number of channel bandwidth
                      settings for which the rate set applies, followed by
                      either 8 or 10 power limit values. The order of the
                      channel bandwidth settings is 20, 40, 80 and 160 MHz.
                    maxItems: 4
                    items:
                      minItems: 9
                      maxItems: 11

                  rates-ru:
                    $ref: /schemas/types.yaml#/definitions/uint8-matrix
                    description:
                      Sets of per-rate power limit values for 802.11ax rates
                      for multiple channel bandwidth or resource unit settings.
                      Each set starts with the number of channel bandwidth or
                      resource unit settings for which the rate set applies,
                      followed by 12 power limit values. The order of the
                      channel resource unit settings is RU26, RU52, RU106,
                      RU242/SU20, RU484/SU40, RU996/SU80 and RU2x996/SU160.
                    items:
                      minItems: 13
                      maxItems: 13

                  txs-delta:
                    $ref: /schemas/types.yaml#/definitions/uint32-array
                    description:
                      Half-dBm power delta for different numbers of antennas

required:
  - compatible
  - reg

unevaluatedProperties: false

examples:
  - |
    pcie0 {
      #address-cells = <3>;
      #size-cells = <2>;
      wifi@0,0 {
        compatible = "mediatek,mt76";
        reg = <0x0000 0 0 0 0>;
        ieee80211-freq-limit = <5000000 6000000>;
        mediatek,mtd-eeprom = <&factory 0x8000>;
        big-endian;

        led {
          led-sources = <2>;
        };

        power-limits {
          r0 {
            regdomain = "FCC";
            txpower-5g {
               b0 {
                   channels = <36 48>;
                   rates-ofdm = /bits/ 8 <23 23 23 23 23 23 23 23>;
                   rates-mcs = /bits/ 8 <1 23 23 23 23 23 23 23 23 23 23>,
                               /bits/ 8 <3 22 22 22 22 22 22 22 22 22 22>;
                   rates-ru = /bits/ 8 <3 22 22 22 22 22 22 22 22 22 22 22 22>,
                              /bits/ 8 <4 20 20 20 20 20 20 20 20 20 20 20 20>;
               };
               b1 {
                   channels = <100 181>;
                   rates-ofdm = /bits/ 8 <14 14 14 14 14 14 14 14>;
                   rates-mcs = /bits/ 8  <4 14 14 14 14 14 14 14 14 14 14>;
                   txs-delta = <12 9 6>;
                   rates-ru = /bits/ 8  <7 14 14 14 14 14 14 14 14 14 14 14 14>;
               };
             };
          };
        };
      };
    };

  - |
    wifi@10300000 {
      compatible = "mediatek,mt7628-wmac";
      reg = <0x10300000 0x100000>;

      interrupt-parent = <&cpuintc>;
      interrupts = <6>;

      mediatek,mtd-eeprom = <&factory 0x0>;
    };

  - |
    #include <dt-bindings/interrupt-controller/arm-gic.h>
    #include <dt-bindings/interrupt-controller/irq.h>
    wifi@18000000 {
      compatible = "mediatek,mt7622-wmac";
      reg = <0x10300000 0x100000>;
      interrupts = <GIC_SPI 211 IRQ_TYPE_LEVEL_LOW>;

      mediatek,infracfg = <&infracfg>;

      power-domains = <&scpsys 3>;
    };

  - |
    wifi@18000000 {
        compatible = "mediatek,mt7986-wmac";
        resets = <&watchdog 23>;
        reset-names = "consys";
        reg = <0x18000000 0x1000000>,
              <0x10003000 0x1000>,
              <0x11d10000 0x1000>;
        interrupts = <GIC_SPI 213 IRQ_TYPE_LEVEL_HIGH>;
        clocks = <&topckgen 50>,
                 <&topckgen 62>;
        clock-names = "mcu", "ap2conn";
        memory-region = <&wmcpu_emi>;
    };
```

## Documentation/devicetree/bindings/net/wireless/microchip,wilc1000.yaml
```yaml
# SPDX-License-Identifier: (GPL-2.0-only OR BSD-2-Clause)
%YAML 1.2
---
$id: http://devicetree.org/schemas/net/wireless/microchip,wilc1000.yaml#
$schema: http://devicetree.org/meta-schemas/core.yaml#

title: Microchip WILC wireless devicetree bindings

maintainers:
  - Adham Abozaeid <adham.abozaeid@microchip.com>
  - Ajay Singh <ajay.kathat@microchip.com>

description:
  The wilc1000 chips can be connected via SPI or SDIO. This document
  describes the binding to connect wilc devices.

properties:
  compatible:
    const: microchip,wilc1000

  reg: true

  spi-max-frequency: true

  interrupts:
    maxItems: 1

  clocks:
    description: phandle to the clock connected on rtc clock line.
    maxItems: 1

  clock-names:
    const: rtc

  enable-gpios:
    maxItems: 1
    description: Used by wilc1000-spi to determine the GPIO line
      connected to the ENABLE line.  If specified, reset-gpios
      must be specified as well as otherwise the driver cannot
      ensure the timing required between asserting ENABLE
      and deasserting RESET.  This should be declared as an
      active-high signal.

  reset-gpios:
    maxItems: 1
    description: Used by wilc1000-spi to determine the GPIO line
      connected to the RESET line.  This should be declared as an
      active-low signal.

required:
  - compatible
  - interrupts

additionalProperties: false

examples:
  - |
    #include <dt-bindings/gpio/gpio.h>

    spi {
      #address-cells = <1>;
      #size-cells = <0>;
      wifi@0 {
        compatible = "microchip,wilc1000";
        spi-max-frequency = <48000000>;
        reg = <0>;
        interrupt-parent = <&pioC>;
        interrupts = <27 0>;
        clocks = <&pck1>;
        clock-names = "rtc";
        enable-gpios = <&pioA 5 GPIO_ACTIVE_HIGH>;
        reset-gpios = <&pioA 6 GPIO_ACTIVE_LOW>;
      };
    };

  - |
    mmc {
      #address-cells = <1>;
      #size-cells = <0>;
      pinctrl-names = "default";
      pinctrl-0 = <&pinctrl_mmc1_clk_cmd_dat0 &pinctrl_mmc1_dat1_3>;
      non-removable;
      vmmc-supply = <&vcc_mmc1_reg>;
      vqmmc-supply = <&vcc_3v3_reg>;
      bus-width = <4>;
      wifi@0 {
        compatible = "microchip,wilc1000";
        reg = <0>;
        interrupt-parent = <&pioC>;
        interrupts = <27 0>;
        clocks = <&pck1>;
        clock-names = "rtc";
      };
    };
```

## Documentation/devicetree/bindings/net/wireless/qca,ath9k.txt
```
* Qualcomm Atheros ath9k wireless devices

This node provides properties for configuring the ath9k wireless device. The
node is expected to be specified as a child node of the PCI controller to
which the wireless chip is connected.

Required properties:
- compatible: For PCI and PCIe devices this should be an identifier following
		the format as defined in "PCI Bus Binding to Open Firmware"
		Revision 2.1. One of the possible formats is "pciVVVV,DDDD"
		where VVVV is the PCI vendor ID and DDDD is PCI device ID.
		Typically QCA's PCI vendor ID 168c is used while the PCI device
		ID depends on the chipset - see the following (possibly
		incomplete) list:
			- 0023 for AR5416
			- 0024 for AR5418
			- 0027 for AR9160
			- 0029 for AR9220 and AR9223
			- 002a for AR9280 and AR9283
			- 002b for AR9285
			- 002c for AR2427
			- 002d for AR9227
			- 002e for AR9287
			- 0030 for AR9380, AR9381 and AR9382
			- 0032 for AR9485
			- 0033 for AR9580 and AR9590
			- 0034 for AR9462
			- 0036 for AR9565
			- 0037 for AR9485
- reg: Address and length of the register set for the device.

Optional properties:
- qca,no-eeprom: Indicates that there is no physical EEPROM connected to the
			ath9k wireless chip (in this case the calibration /
			EEPROM data will be loaded from userspace using the
			kernel firmware loader).

The MAC address will be determined using the optional properties defined in
net/ethernet.txt.

In this example, the node is defined as child node of the PCI controller:
&pci0 {
	wifi@168c,002d {
		compatible = "pci168c,002d";
		reg = <0x7000 0 0 0 0x1000>;
		qca,no-eeprom;
	};
};
```

## Documentation/devicetree/bindings/net/wireless/qca,ath9k.yaml
```yaml
# SPDX-License-Identifier: (GPL-2.0-only OR BSD-2-Clause)
%YAML 1.2
---
$id: http://devicetree.org/schemas/net/wireless/qca,ath9k.yaml#
$schema: http://devicetree.org/meta-schemas/core.yaml#

title: Qualcomm Atheros ath9k wireless devices

maintainers:
  - Toke Høiland-Jørgensen <toke@toke.dk>

description: |
  This node provides properties for configuring the ath9k wireless device.
  The node is expected to be specified as a child node of the PCI controller
  or AHB bus to which the wireless chip is connected.

allOf:
  - $ref: ieee80211.yaml#

properties:
  compatible:
    enum:
      - pci168c,0023  # AR5416
      - pci168c,0024  # AR5418
      - pci168c,0027  # AR9160
      - pci168c,0029  # AR9220 and AR9223
      - pci168c,002a  # AR9280 and AR9283
      - pci168c,002b  # AR9285
      - pci168c,002c  # AR2427 - 802.11n bonded out
      - pci168c,002d  # AR9227
      - pci168c,002e  # AR9287
      - pci168c,0030  # AR9380, AR9381 and AR9382
      - pci168c,0032  # AR9485
      - pci168c,0033  # AR9580 and AR9590
      - pci168c,0034  # AR9462
      - pci168c,0036  # AR9565
      - pci168c,0037  # AR1111 and AR9485
      - qca,ar9130-wifi
      - qca,ar9330-wifi
      - qca,ar9340-wifi
      - qca,qca9530-wifi
      - qca,qca9550-wifi
      - qca,qca9560-wifi

  reg:
    maxItems: 1

  interrupts:
    maxItems: 1

  ieee80211-freq-limit: true

  qca,no-eeprom:
    $ref: /schemas/types.yaml#/definitions/flag
    description:
      Indicates that there is no physical EEPROM connected

  nvmem-cells:
    items:
      - description: Reference to an nvmem node for the MAC address
      - description: Reference to an nvmem node for calibration data

  nvmem-cell-names:
    items:
      - const: mac-address
      - const: calibration

required:
  - compatible
  - reg

additionalProperties: false

examples:
  - |
    pcie0 {
      #address-cells = <3>;
      #size-cells = <2>;
      wifi@0,0 {
        compatible = "pci168c,002d";
        reg = <0 0 0 0 0>;
        interrupts = <3>;
        qca,no-eeprom;
      };
    };
  - |
    pci0 {
      #address-cells = <3>;
      #size-cells = <2>;
      wifi@0,11 {
        compatible = "pci168c,0029";
        reg = <0x8800 0 0 0 0>;
        nvmem-cells = <&macaddr_art_c>, <&cal_art_1000>;
        nvmem-cell-names = "mac-address", "calibration";
      };
    };
  - |
    ahb {
      #address-cells = <1>;
      #size-cells = <1>;
      wifi@180c0000 {
        compatible = "qca,ar9130-wifi";
        reg = <0x180c0000 0x230000>;
        interrupts = <2>;
      };
    };
```
