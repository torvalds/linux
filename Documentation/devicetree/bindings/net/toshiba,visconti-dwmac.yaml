## Documentation/devicetree/bindings/net/wireless/ieee80211.yaml
```yaml
# SPDX-License-Identifier: (GPL-2.0-only OR BSD-2-Clause)
# Copyright (c) 2018-2019 The Linux Foundation. All rights reserved.

%YAML 1.2
---
$id: http://devicetree.org/schemas/net/wireless/ieee80211.yaml#
$schema: http://devicetree.org/meta-schemas/core.yaml#

title: Common IEEE 802.11 Binding

maintainers:
  - Lorenzo Bianconi <lorenzo@kernel.org>

description: |
  This provides documentation of common properties that are valid for
  all wireless devices

properties:
  ieee80211-freq-limit:
    $ref: /schemas/types.yaml#/definitions/uint32-matrix
    items:
      minItems: 2
      maxItems: 2
    description:
      List of supported frequency ranges in KHz. This can be used for devices
      that in a given config support less channels than normally. It may happen
      chipset supports a wide wireless band but it is limited to some part of
      it due to used antennas or power amplifier. An example case for this
      can be tri-band wireless router with two identical chipsets used for two
      different 5 GHz subbands. Using them incorrectly could not work or
      decrease performance noticeably

additionalProperties: true

examples:
  - |
    pcie0 {
      #address-cells = <3>;
      #size-cells = <2>;
      wifi@0,0 {
        reg = <0x0000 0 0 0 0>;
        ieee80211-freq-limit = <2402000 2482000>,
                               <5170000 5250000>;
      };
    };
```

## Documentation/devicetree/bindings/net/wireless/marvell,sd8787.yaml
```yaml
# SPDX-License-Identifier: (GPL-2.0-only OR BSD-2-Clause)
%YAML 1.2
---
$id: http://devicetree.org/schemas/net/wireless/marvell,sd8787.yaml#
$schema: http://devicetree.org/meta-schemas/core.yaml#

title: Marvell 8787/8897/8978/8997 (sd8787/sd8897/sd8978/sd8997/pcie8997) SDIO/PCIE devices

maintainers:
  - Brian Norris <briannorris@chromium.org>
  - Frank Li <Frank.Li@nxp.com>

description:
  This node provides properties for describing the Marvell SDIO/PCIE wireless device.
  The node is expected to be specified as a child node to the SDIO/PCIE controller that
  connects the device to the system.

properties:
  compatible:
    enum:
      - marvell,sd8787
      - marvell,sd8897
      - marvell,sd8978
      - marvell,sd8997
      - nxp,iw416
      - pci11ab,2b42
      - pci1b4b,2b42

  reg:
    maxItems: 1

  interrupts:
    maxItems: 1

  wakeup-source: true

  marvell,caldata-txpwrlimit-2g:
    $ref: /schemas/types.yaml#/definitions/uint8-array
    description: Calibration data for the 2GHz band.
    maxItems: 566

  marvell,caldata-txpwrlimit-5g-sub0:
    $ref: /schemas/types.yaml#/definitions/uint8-array
    description: Calibration data for sub-band 0 in the 5GHz band.
    maxItems: 502

  marvell,caldata-txpwrlimit-5g-sub1:
    $ref: /schemas/types.yaml#/definitions/uint8-array
    description: Calibration data for sub-band 1 in the 5GHz band.
    maxItems: 688

  marvell,caldata-txpwrlimit-5g-sub2:
    $ref: /schemas/types.yaml#/definitions/uint8-array
    description: Calibration data for sub-band 2 in the 5GHz band.
    maxItems: 750

  marvell,caldata-txpwrlimit-5g-sub3:
    $ref: /schemas/types.yaml#/definitions/uint8-array
    description: Calibration data for sub-band 3 in the 5GHz band.
    maxItems: 502

  marvell,wakeup-pin:
    $ref: /schemas/types.yaml#/definitions/uint32
    description:
      Provides the pin number for the wakeup pin from the device's point of
      view. The wakeup pin is used for the device to wake the host system
      from sleep. This property is only necessary if the wakeup pin is
      wired in a non-standard way, such that the default pin assignments
      are invalid.

required:
  - compatible
  - reg

additionalProperties: false

examples:
  - |
    #include <dt-bindings/interrupt-controller/irq.h>

    mmc {
        #address-cells = <1>;
        #size-cells = <0>;

        wifi@1 {
            compatible = "marvell,sd8897";
            reg = <1>;
            interrupt-parent = <&pio>;
            interrupts = <38 IRQ_TYPE_LEVEL_LOW>;
            marvell,wakeup-pin = <3>;
        };
    };
```

## Documentation/devicetree/bindings/net/wireless/marvell-8xxx.txt
```
Marvell 8787/8897/8997 (sd8787/sd8897/sd8997/pcie8997) SDIO/PCIE devices
------

This node provides properties for controlling the Marvell SDIO/PCIE wireless device.
The node is expected to be specified as a child node to the SDIO/PCIE controller that
connects the device to the system.

Required properties:

  - compatible : should be one of the following:
	* "marvell,sd8787"
	* "marvell,sd8897"
	* "marvell,sd8997"
	* "pci11ab,2b42"
	* "pci1b4b,2b42"

Optional properties:

  - marvell,caldata* : A series of properties with marvell,caldata prefix,
		      represent calibration data downloaded to the device during
		      initialization. This is an array of unsigned 8-bit values.
		      the properties should follow below property name and
		      corresponding array length:
	"marvell,caldata-txpwrlimit-2g" (length = 566).
	"marvell,caldata-txpwrlimit-5g-sub0" (length = 502).
	"marvell,caldata-txpwrlimit-5g-sub1" (length = 688).
	"marvell,caldata-txpwrlimit-5g-sub2" (length = 750).
	"marvell,caldata-txpwrlimit-5g-sub3" (length = 502).
  - marvell,wakeup-pin : a wakeup pin number of wifi chip which will be configured
		      to firmware. Firmware will wakeup the host using this pin
		      during suspend/resume.
  - interrupt-parent: phandle of the parent interrupt controller
  - interrupts : interrupt pin number to the cpu. driver will request an irq based on
		 this interrupt number. during system suspend, the irq will be enabled
		 so that the wifi chip can wakeup host platform under certain condition.
		 during system resume, the irq will be disabled to make sure
		 unnecessary interrupt is not received.
  - vmmc-supply: a phandle of a regulator, supplying VCC to the card
  - mmc-pwrseq:  phandle to the MMC power sequence node. See "mmc-pwrseq-*"
		 for documentation of MMC power sequence bindings.

Example:

Tx power limit calibration data is configured in below example.
The calibration data is an array of unsigned values, the length
can vary between hw versions.
IRQ pin 38 is used as system wakeup source interrupt. wakeup pin 3 is configured
so that firmware can wakeup host using this device side pin.

&mmc3 {
	status = "okay";
	vmmc-supply = <&wlan_en_reg>;
	mmc-pwrseq = <&wifi_pwrseq>;
	bus-width = <4>;
	cap-power-off-card;
	keep-power-in-suspend;

	#address-cells = <1>;
	#size-cells = <0>;
	mwifiex: wifi@1 {
		compatible = "marvell,sd8897";
		reg = <1>;
		interrupt-parent = <&pio>;
		interrupts = <38 IRQ_TYPE_LEVEL_LOW>;

		marvell,caldata_00_txpwrlimit_2g_cfg_set = /bits/ 8 <
	0x01 0x00 0x06 0x00 0x08 0x02 0x89 0x01>;
		marvell,wakeup-pin = <3>;
	};
};
```

## Documentation/devicetree/bindings/net/wireless/marvell-sd8xxx.txt
```
Marvell 8897/8997 (sd8897/sd8997) SDIO devices
------

This node provides properties for controlling the marvell sdio wireless device.
The node is expected to be specified as a child node to the SDIO controller that
connects the device to the system.

Required properties:

  - compatible : should be one of the following:
	* "marvell,sd8897"
	* "marvell,sd8997"

Optional properties:

  - marvell,caldata* : A series of properties with marvell,caldata prefix,
		      represent calibration data downloaded to the device during
		      initialization. This is an array of unsigned 8-bit values.
		      the properties should follow below property name and
		      corresponding array length:
	"marvell,caldata-txpwrlimit-2g" (length = 566).
	"marvell,caldata-txpwrlimit-5g-sub0" (length = 502).
	"marvell,caldata-txpwrlimit-5g-sub1" (length = 688).
	"marvell,caldata-txpwrlimit-5g-sub2" (length = 750).
	"marvell,caldata-txpwrlimit-5g-sub3" (length = 502).
  - marvell,wakeup-pin : a wakeup pin number of wifi chip which will be configured
		      to firmware. Firmware will wakeup the host using this pin
		      during suspend/resume.
  - interrupt-parent: phandle of the parent interrupt controller
  - interrupts : interrupt pin number to the cpu. driver will request an irq based on
		 this interrupt number. during system suspend, the irq will be enabled
		 so that the wifi chip can wakeup host platform under certain condition.
		 during system resume, the irq will be disabled to make sure
		 unnecessary interrupt is not received.

Example:

Tx power limit calibration data is configured in below example.
The calibration data is an array of unsigned values, the length
can vary between hw versions.
IRQ pin 38 is used as system wakeup source interrupt. wakeup pin 3 is configured
so that firmware can wakeup host using this device side pin.

&mmc3 {
	status = "okay";
	vmmc-supply = <&wlan_en_reg>;
	bus-width = <4>;
	cap-power-off-card;
	keep-power-in-suspend;

	#address-cells = <1>;
	#size-cells = <0>;
	mwifiex: wifi@1 {
		compatible = "marvell,sd8897";
		reg = <1>;
		interrupt-parent = <&pio>;
		interrupts = <38 IRQ_TYPE_LEVEL_LOW>;

		marvell,caldata_00_txpwrlimit_2g_cfg_set = /bits/ 8 <
	0x01 0x00 0x06 0x00 0x08 0x02 0x89 0x01>;
		marvell,wakeup-pin = <3>;
	};
};
```

## Documentation/devicetree/bindings/net/wireless/mediatek,mt76.txt
```
* MediaTek mt76xx devices

This node provides properties for configuring the MediaTek mt76xx wireless
device. The node is expected to be specified as a child node of the PCI
controller to which the wireless chip is connected.

Alternatively, it can specify the wireless part of the MT7628/MT7688 or
MT7622 SoC. For SoC, use the following compatible strings:

compatible:
- "mediatek,mt7628-wmac" for MT7628/MT7688
- "mediatek,mt7622-wmac" for MT7622

properties:
- reg: Address and length of the register set for the device.
- interrupts: Main device interrupt

MT7622 specific properties:
- power-domains: phandle to the power domain that the WMAC is part of
- mediatek,infracfg: phandle to the infrastructure bus fabric syscon node

Optional properties:

- ieee80211-freq-limit: See ieee80211.txt
- mediatek,mtd-eeprom: Specify a MTD partition + offset containing EEPROM data
- big-endian: if the radio eeprom partition is written in big-endian, specify
  this property
- mediatek,eeprom-merge-otp: Merge EEPROM data with OTP data. Can be used on
  boards where the flash calibration data is generic and specific calibration
  data should be pulled from the OTP ROM

The MAC address can as well be set with corresponding optional properties
defined in net/ethernet.txt.

Optional nodes:
- led: Properties for a connected LED
  Optional properties:
    - led-sources: See Documentation/devicetree/bindings/leds/common.txt

&pcie {
	pcie0 {
		wifi@0,0 {
			compatible = "mediatek,mt76";
			reg = <0x0000 0 0 0 0>;
			ieee80211-freq-limit = <5000000 6000000>;
			mediatek,mtd-eeprom = <&factory 0x8000>;
			big-endian;

			led {
				led-sources = <2>;
			};
		};
	};
};

MT7628 example:

wmac: wmac@10300000 {
	compatible = "mediatek,mt7628-wmac";
	reg = <0x10300000 0x100000>;

	interrupt-parent = <&cpuintc>;
	interrupts = <6>;

	mediatek,mtd-eeprom = <&factory 0x0000>;
};

MT7622 example:

wmac: wmac@18000000 {
	compatible = "mediatek,mt7622-wmac";
	reg = <0 0x18000000 0 0x100000>;
	interrupts = <GIC_SPI 211 IRQ_TYPE_LEVEL_LOW>;

	mediatek,infracfg = <&infracfg>;

	power-domains = <&scpsys MT7622_POWER_DOMAIN_WB>;
};
```
