## Documentation/devicetree/bindings/net/toshiba,visconti-dwmac.yaml
```yaml
# SPDX-License-Identifier: (GPL-2.0 OR BSD-2-Clause)
%YAML 1.2
---
$id: http://devicetree.org/schemas/net/toshiba,visconti-dwmac.yaml#
$schema: http://devicetree.org/meta-schemas/core.yaml#

title: Toshiba Visconti DWMAC Ethernet controller

maintainers:
  - Nobuhiro Iwamatsu <nobuhiro1.iwamatsu@toshiba.co.jp>

select:
  properties:
    compatible:
      contains:
        enum:
          - toshiba,visconti-dwmac
  required:
    - compatible

allOf:
  - $ref: snps,dwmac.yaml#

properties:
  compatible:
    oneOf:
      - items:
          - enum:
              - toshiba,visconti-dwmac
          - const: snps,dwmac-4.20a

  reg:
    maxItems: 1

  clocks:
    items:
      - description: main clock
      - description: PHY reference clock

  clock-names:
    items:
      - const: stmmaceth
      - const: phy_ref_clk

required:
  - compatible
  - reg
  - clocks
  - clock-names

unevaluatedProperties: false

examples:
  - |
    #include <dt-bindings/clock/toshiba,tmpv770x.h>
    #include <dt-bindings/interrupt-controller/arm-gic.h>

    soc {
        #address-cells = <2>;
        #size-cells = <2>;

        piether: ethernet@28000000 {
            compatible = "toshiba,visconti-dwmac", "snps,dwmac-4.20a";
            reg = <0 0x28000000 0 0x10000>;
            interrupts = <GIC_SPI 156 IRQ_TYPE_LEVEL_HIGH>;
            interrupt-names = "macirq";
            clocks = <&pismu TMPV770X_CLK_PIETHER_BUS>, <&pismu TMPV770X_CLK_PIETHER_125M>;
            clock-names = "stmmaceth", "phy_ref_clk";
            snps,txpbl = <4>;
            snps,rxpbl = <4>;
            snps,tso;
            phy-mode = "rgmii-id";
            phy-handle = <&phy0>;

            mdio {
                #address-cells = <0x1>;
                #size-cells = <0x0>;
                compatible = "snps,dwmac-mdio";

                phy0: ethernet-phy@1 {
                    device_type = "ethernet-phy";
                    reg = <0x1>;
                };
            };
        };
    };
```

## Documentation/devicetree/bindings/net/vertexcom-mse102x.yaml
```yaml
# SPDX-License-Identifier: (GPL-2.0-only OR BSD-2-Clause)
%YAML 1.2
---
$id: "http://devicetree.org/schemas/net/vertexcom-mse102x.yaml#"
$schema: "http://devicetree.org/meta-schemas/core.yaml#"

title: The Vertexcom MSE102x (SPI) Device Tree Bindings

maintainers:
  - Stefan Wahren <stefan.wahren@in-tech.com>

description:
  Vertexcom's MSE102x are a family of HomePlug GreenPHY chips.
  They can be connected either via RGMII, RMII or SPI to a host CPU.

  In order to use a MSE102x chip as SPI device, it must be defined as
  a child of an SPI master device in the device tree.

  More information can be found at
    http://www.vertexcom.com/doc/MSE1022%20Product%20Brief.pdf

allOf:
  - $ref: ethernet-controller.yaml#

properties:
  compatible:
    enum:
      - vertexcom,mse1021
      - vertexcom,mse1022

  reg:
    maxItems: 1

  interrupts:
    maxItems: 1

  spi-cpha: true

  spi-cpol: true

  spi-max-frequency:
    minimum: 6000000
    maximum: 7142857

required:
  - compatible
  - reg
  - interrupts
  - spi-cpha
  - spi-cpol
  - spi-max-frequency

additionalProperties: false

examples:
  - |
    #include <dt-bindings/interrupt-controller/irq.h>
    spi0 {
        #address-cells = <1>;
        #size-cells = <0>;

        ethernet@0 {
            compatible = "vertexcom,mse1021";
            reg = <0>;
            interrupt-parent = <&gpio>;
            interrupts = <23 IRQ_TYPE_EDGE_RISING>;
            spi-cpha;
            spi-cpol;
            spi-max-frequency = <7142857>;
        };
    };
```

## Documentation/devicetree/bindings/net/via,vt8500-rhine.yaml
```yaml
# SPDX-License-Identifier: GPL-2.0-only OR BSD-2-Clause
%YAML 1.2
---
$id: http://devicetree.org/schemas/net/via,vt8500-rhine.yaml#
$schema: http://devicetree.org/meta-schemas/core.yaml#

title: VIA Rhine 10/100 Network Controller

description:
  VIA's Ethernet controller integrated into VIA VT8500,
  WonderMedia WM8950 and related SoCs

maintainers:
  - Alexey Charkov <alchark@gmail.com>

allOf:
  - $ref: ethernet-controller.yaml#

properties:
  compatible:
    const: via,vt8500-rhine

  reg:
    maxItems: 1

  interrupts:
    maxItems: 1

required:
  - reg
  - interrupts

unevaluatedProperties: false

examples:
  - |
    ethernet@d8004000 {
        compatible = "via,vt8500-rhine";
        reg = <0xd8004000 0x100>;
        interrupts = <10>;
    };
```

## Documentation/devicetree/bindings/net/via-rhine.txt
```
* VIA Rhine 10/100 Network Controller

Required properties:
- compatible : Should be "via,vt8500-rhine" for integrated
	Rhine controllers found in VIA VT8500, WonderMedia WM8950
	and similar. These are listed as 1106:3106 rev. 0x84 on the
	virtual PCI bus under vendor-provided kernels
- reg : Address and length of the io space
- interrupts : Should contain the controller interrupt line

Examples:

ethernet@d8004000 {
	compatible = "via,vt8500-rhine";
	reg = <0xd8004000 0x100>;
	interrupts = <10>;
};
```

## Documentation/devicetree/bindings/net/via-velocity.txt
```
* VIA Velocity 10/100/1000 Network Controller

Required properties:
- compatible : Should be "via,velocity-vt6110"
- reg : Address and length of the io space
- interrupts : Should contain the controller interrupt line

Optional properties:
- no-eeprom : PCI network cards use an external EEPROM to store data. Embedded
	devices quite often set this data in uboot and do not provide an eeprom.
	Specify this option if you have no external eeprom.

Examples:

eth0@d8004000 {
	compatible = "via,velocity-vt6110";
	reg = <0xd8004000 0x400>;
	interrupts = <10>;
	no-eeprom;
};
```

## Documentation/devicetree/bindings/net/wireless/brcm,bcm4329-fmac.yaml
```yaml
# SPDX-License-Identifier: (GPL-2.0 OR BSD-2-Clause)
%YAML 1.2
---
$id: http://devicetree.org/schemas/net/wireless/brcm,bcm4329-fmac.yaml#
$schema: http://devicetree.org/meta-schemas/core.yaml#

title: Broadcom BCM4329 family fullmac wireless SDIO/PCIE devices

maintainers:
  - Arend van Spriel <arend@broadcom.com>

description:
  The Broadcom Single chip MAC part for the BCM4329 family and
  later Cypress chips in the same family named CYW4373 and similar.
  These chips also have a Bluetooth portion described in a separate
  binding.

properties:
  compatible:
    oneOf:
      - items:
          - enum:
              - brcm,bcm43143-fmac
              - brcm,bcm4341b0-fmac
              - brcm,bcm4341b4-fmac
              - brcm,bcm4341b5-fmac
              - brcm,bcm4329-fmac
              - brcm,bcm4330-fmac
              - brcm,bcm4334-fmac
              - brcm,bcm43340-fmac
              - brcm,bcm4335-fmac
              - brcm,bcm43362-fmac
              - brcm,bcm4339-fmac
              - brcm,bcm43430a0-fmac
              - brcm,bcm43430a1-fmac
              - brcm,bcm43455-fmac
              - brcm,bcm43456-fmac
              - brcm,bcm4354-fmac
              - brcm,bcm4356-fmac
              - brcm,bcm4359-fmac
              - cypress,cyw4373-fmac
              - cypress,cyw43012-fmac
          - const: brcm,bcm4329-fmac
      - enum:
          - brcm,bcm4329-fmac
          - pci14e4,43dc  # BCM4355
          - pci14e4,4464  # BCM4364
          - pci14e4,4488  # BCM4377
          - pci14e4,4425  # BCM4378
          - pci14e4,4433  # BCM4387

  reg:
    description: SDIO function number for the device (for most cases
      this will be 1) or PCI device identifier.

  interrupts:
    maxItems: 1
    description: Out-of-band (OOB) IRQ line for waking up the host
      in response to WLAN activity. This corresponds to the HOST_WAKE
      line into the chip.

  interrupt-names:
    description: Name for the OOB IRQ, this must be set to "host-wake".
    const: host-wake

  brcm,drive-strength:
    $ref: /schemas/types.yaml#/definitions/uint32
    description: Drive strength used for the SDIO pins on the device in mA.
    minimum: 0
    maximum: 32

  reset-gpios:
    maxItems: 1
    description: A GPIO line connected to the WL_RST line, if present
      this shall be flagged as active low.

  brcm,ccode-map:
    $ref: /schemas/types.yaml#/definitions/string-array
    description: Multiple strings for translating ISO3166 country code to
      brcmfmac firmware country code and revision.
    items:
      pattern: '^[A-Z][A-Z]-[A-Z][0-9A-Z]-[0-9]+$'

  brcm,ccode-map-trivial:
    description: |
      Use a trivial mapping of ISO3166 country codes to brcmfmac firmware
      country code and revision: cc -> { cc, 0 }. In other words, assume that
      the CLM blob firmware uses ISO3166 country codes as well, and that all
      revisions are zero. This property is mutually exclusive with
      brcm,ccode-map. If both properties are specified, then brcm,ccode-map
      takes precedence.
    type: boolean

  brcm,cal-blob:
    $ref: /schemas/types.yaml#/definitions/uint8-array
    description: A per-device calibration blob for the Wi-Fi radio. This
      should be filled in by the bootloader from platform configuration
      data, if necessary, and will be uploaded to the device if present.

  brcm,board-type:
    $ref: /schemas/types.yaml#/definitions/string
    description: Overrides the board type, which is normally the compatible of
      the root node. This can be used to decouple the overall system board or
      device name from the board type for WiFi purposes, which is used to
      construct firmware and NVRAM configuration filenames, allowing for
      multiple devices that share the same module or characteristics for the
      WiFi subsystem to share the same firmware/NVRAM files. On Apple platforms,
      this should be the Apple module-instance codename prefixed by "apple,",
      e.g. "apple,honshu".

  apple,antenna-sku:
    $ref: /schemas/types.yaml#/definitions/string
    description: Antenna SKU used to identify a specific antenna configuration
      on Apple platforms. This is use to build firmware filenames, to allow
      platforms with different antenna configs to have different firmware and/or
      NVRAM. This would normally be filled in by the bootloader from platform
      configuration data.

required:
  - compatible
  - reg

additionalProperties: false

examples:
  - |
    #include <dt-bindings/interrupt-controller/irq.h>
    #include <dt-bindings/gpio/gpio.h>
    mmc@80118000 {
      compatible = "arm,pl18x", "arm,primecell";
      reg = <0x80118000 0x1000>;
      clocks = <&clk 0>, <&clk 1>;
      clock-names = "mclk", "apb_pclk";
      interrupts = <0 60 IRQ_TYPE_LEVEL_HIGH>;
      bus-width = <4>;
      non-removable;
      vmmc-supply = <&wl_bt_reg>;
      #address-cells = <1>;
      #size-cells = <0>;

      wifi@1 {
        compatible = "brcm,bcm4334-fmac", "brcm,bcm4329-fmac";
        reg = <1>;
        interrupt-parent = <&gpio>;
        interrupts = <24 IRQ_TYPE_EDGE_FALLING>;
        interrupt-names = "host-wake";
        reset-gpios = <&gpio 23 GPIO_ACTIVE_LOW>;
        brcm,ccode-map = "JP-JP-78", "US-Q2-86";
      };
    };
```

## Documentation/devicetree/bindings/net/wireless/brcm,bcm43xx-fmac.txt
```
Broadcom BCM43xx Fullmac wireless SDIO devices

This node provides properties for controlling the Broadcom wireless device. The
node is expected to be specified as a child node to the SDIO controller that
connects the device to the system.

Required properties:

 - compatible : Should be "brcm,bcm4329-fmac".

Optional properties:
 - brcm,drive-strength : drive strength used for SDIO pins on device in mA
	(default = 6).
 - interrupt-parent : the phandle for the interrupt controller to which the
	device interrupts are connected.
 - interrupts : specifies attributes for the out-of-band interrupt (host-wake).
	When not specified the device will use in-band SDIO interrupts.
 - interrupt-names : name of the out-of-band interrupt, which must be set
	to "host-wake".

Example:

mmc3: mmc@01c12000 {
	#address-cells = <1>;
	#size-cells = <0>;

	pinctrl-names = "default";
	pinctrl-0 = <&mmc3_pins_a>;
	vmmc-supply = <&reg_vmmc3>;
	bus-width = <4>;
	non-removable;
	status = "okay";

	brcmf: wifi@1 {
		reg = <1>;
		compatible = "brcm,bcm4329-fmac";
		interrupt-parent = <&pio>;
		interrupts = <10 8>; /* PH10 / EINT10 */
		interrupt-names = "host-wake";
	};
};
```

## Documentation/devicetree/bindings/net/wireless/esp,esp8089.txt
```
Espressif ESP8089 wireless SDIO devices

This node provides properties for controlling the ESP8089 wireless device.
The node is expected to be specified as a child node to the SDIO controller
that connects the device to the system.

Required properties:

 - compatible : Should be "esp,esp8089".

Optional properties:
 - esp,crystal-26M-en: Integer value for the crystal_26M_en firmware parameter

Example:

&mmc1 {
	#address-cells = <1>;
	#size-cells = <0>;

	vmmc-supply = <&reg_dldo1>;
	mmc-pwrseq = <&wifi_pwrseq>;
	bus-width = <4>;
	non-removable;

	esp8089: sdio_wifi@1 {
		compatible = "esp,esp8089";
		reg = <1>;
		esp,crystal-26M-en = <2>;
	};
};
```

## Documentation/devicetree/bindings/net/wireless/esp,esp8089.yaml
```yaml
# SPDX-License-Identifier: GPL-2.0
%YAML 1.2
---
$id: http://devicetree.org/schemas/net/wireless/esp,esp8089.yaml#
$schema: http://devicetree.org/meta-schemas/core.yaml#

title: Espressif ESP8089

maintainers:
  - Hans de Goede <hdegoede@redhat.com>

properties:
  compatible:
    const: esp,esp8089

  reg:
    maxItems: 1

  esp,crystal-26M-en:
    $ref: /schemas/types.yaml#/definitions/uint32
    description: >
      Value for the crystal_26M_en firmware parameter

required:
  - compatible
  - reg

additionalProperties: false

examples:
  - |
      mmc {
          #address-cells = <1>;
          #size-cells = <0>;

          wifi@1 {
              compatible = "esp,esp8089";
              reg = <1>;
              esp,crystal-26M-en = <2>;
          };
      };

...
```

## Documentation/devicetree/bindings/net/wireless/ieee80211.txt
```
Common IEEE 802.11 properties

This provides documentation of common properties that are valid for all wireless
devices.

Optional properties:
 - ieee80211-freq-limit : list of supported frequency ranges in KHz. This can be
	used for devices that in a given config support less channels than
	normally. It may happen chipset supports a wide wireless band but it is
	limited to some part of it due to used antennas or power amplifier.
	An example case for this can be tri-band wireless router with two
	identical chipsets used for two different 5 GHz subbands. Using them
	incorrectly could not work or decrease performance noticeably.

Example:

pcie@0,0 {
	reg = <0x0000 0 0 0 0>;
	wifi@0,0 {
		reg = <0x0000 0 0 0 0>;
		ieee80211-freq-limit = <2402000 2482000>,
				       <5170000 5250000>;
	};
};
```
