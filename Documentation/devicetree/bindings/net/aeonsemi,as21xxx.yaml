## Documentation/devicetree/bindings/net/allwinner,sun4i-a10-emac.yaml
```yaml
# SPDX-License-Identifier: GPL-2.0
%YAML 1.2
---
$id: http://devicetree.org/schemas/net/allwinner,sun4i-a10-emac.yaml#
$schema: http://devicetree.org/meta-schemas/core.yaml#

title: Allwinner A10 EMAC Ethernet Controller

allOf:
  - $ref: ethernet-controller.yaml#

maintainers:
  - Chen-Yu Tsai <wens@csie.org>
  - Maxime Ripard <mripard@kernel.org>

properties:
  compatible:
    const: allwinner,sun4i-a10-emac

  reg:
    maxItems: 1

  interrupts:
    maxItems: 1

  clocks:
    maxItems: 1

  allwinner,sram:
    description: Phandle to the device SRAM
    $ref: /schemas/types.yaml#/definitions/phandle-array
    items:
      - items:
          - description: phandle to SRAM
          - description: register value for device
  dmas:
    items:
      - description: RX DMA Channel
      - description: TX DMA Channel

  dma-names:
    items:
      - const: rx
      - const: tx

required:
  - compatible
  - reg
  - interrupts
  - clocks
  - phy-handle
  - allwinner,sram

unevaluatedProperties: false

examples:
  - |
    emac: ethernet@1c0b000 {
        compatible = "allwinner,sun4i-a10-emac";
        reg = <0x01c0b000 0x1000>;
        interrupts = <55>;
        clocks = <&ahb_gates 17>;
        phy-handle = <&phy0>;
        allwinner,sram = <&emac_sram 1>;
    };

...
```

## Documentation/devicetree/bindings/net/allwinner,sun4i-a10-mdio.yaml
```yaml
# SPDX-License-Identifier: GPL-2.0
%YAML 1.2
---
$id: http://devicetree.org/schemas/net/allwinner,sun4i-a10-mdio.yaml#
$schema: http://devicetree.org/meta-schemas/core.yaml#

title: Allwinner A10 MDIO Controller

maintainers:
  - Chen-Yu Tsai <wens@csie.org>
  - Maxime Ripard <mripard@kernel.org>

allOf:
  - $ref: "mdio.yaml#"

# Select every compatible, including the deprecated ones. This way, we
# will be able to report a warning when we have that compatible, since
# we will validate the node thanks to the select, but won't report it
# as a valid value in the compatible property description
select:
  properties:
    compatible:
      enum:
        - allwinner,sun4i-a10-mdio

        # Deprecated
        - allwinner,sun4i-mdio

  required:
    - compatible

properties:
  "#address-cells":
    const: 1

  "#size-cells":
    const: 0

  compatible:
    const: allwinner,sun4i-a10-mdio

  reg:
    maxItems: 1

  phy-supply:
    description: PHY regulator

required:
  - compatible
  - reg

unevaluatedProperties: false

examples:
  - |
    mdio@1c0b080 {
        compatible = "allwinner,sun4i-a10-mdio";
        reg = <0x01c0b080 0x14>;
        #address-cells = <1>;
        #size-cells = <0>;
        phy-supply = <&reg_emac_3v3>;

        phy0: ethernet-phy@0 {
            reg = <0>;
        };
    };

...
```

## Documentation/devicetree/bindings/net/allwinner,sun4i-emac.txt
```
* Allwinner EMAC ethernet controller

Required properties:
- compatible: should be "allwinner,sun4i-a10-emac" (Deprecated:
              "allwinner,sun4i-emac")
- reg: address and length of the register set for the device.
- interrupts: interrupt for the device
- phy: see ethernet.txt file in the same directory.
- clocks: A phandle to the reference clock for this device

Example:

emac: ethernet@01c0b000 {
       compatible = "allwinner,sun4i-a10-emac";
       reg = <0x01c0b000 0x1000>;
       interrupts = <55>;
       clocks = <&ahb_gates 17>;
       phy = <&phy0>;
};
```

## Documentation/devicetree/bindings/net/allwinner,sun4i-mdio.txt
```
* Allwinner A10 MDIO Ethernet Controller interface

Required properties:
- compatible: should be "allwinner,sun4i-a10-mdio"
              (Deprecated: "allwinner,sun4i-mdio").
- reg: address and length of the register set for the device.

Optional properties:
- phy-supply: phandle to a regulator if the PHY needs one

Example at the SoC level:
mdio@1c0b080 {
	compatible = "allwinner,sun4i-a10-mdio";
	reg = <0x01c0b080 0x14>;
	#address-cells = <1>;
	#size-cells = <0>;
};

And at the board level:

mdio@1c0b080 {
	phy-supply = <&reg_emac_3v3>;

	phy0: ethernet-phy@0 {
		reg = <0>;
	};
};
```

## Documentation/devicetree/bindings/net/allwinner,sun7i-a20-gmac.txt
```
* Allwinner GMAC ethernet controller

This device is a platform glue layer for stmmac.
Please see stmmac.txt for the other unchanged properties.

Required properties:
 - compatible:  Should be "allwinner,sun7i-a20-gmac"
 - clocks: Should contain the GMAC main clock, and tx clock
   The tx clock type should be "allwinner,sun7i-a20-gmac-clk"
 - clock-names: Should contain the clock names "stmmaceth",
   and "allwinner_gmac_tx"

Optional properties:
- phy-supply: phandle to a regulator if the PHY needs one

Examples:

	gmac: ethernet@1c50000 {
		compatible = "allwinner,sun7i-a20-gmac";
		reg = <0x01c50000 0x10000>,
		      <0x01c20164 0x4>;
		interrupts = <0 85 1>;
		interrupt-names = "macirq";
		clocks = <&ahb_gates 49>, <&gmac_tx>;
		clock-names = "stmmaceth", "allwinner_gmac_tx";
		phy-mode = "mii";
	};
```

## Documentation/devicetree/bindings/net/allwinner,sun7i-a20-gmac.yaml
```yaml
# SPDX-License-Identifier: GPL-2.0
%YAML 1.2
---
$id: http://devicetree.org/schemas/net/allwinner,sun7i-a20-gmac.yaml#
$schema: http://devicetree.org/meta-schemas/core.yaml#

title: Allwinner A20 GMAC Device Tree Bindings

allOf:
  - $ref: "snps,dwmac.yaml#"

maintainers:
  - Chen-Yu Tsai <wens@csie.org>
  - Maxime Ripard <maxime.ripard@bootlin.com>

properties:
  compatible:
    const: allwinner,sun7i-a20-gmac

  interrupts:
    maxItems: 1

  interrupt-names:
    const: macirq

  clocks:
    items:
      - description: GMAC main clock
      - description: TX clock

  clock-names:
    items:
      - const: stmmaceth
      - const: allwinner_gmac_tx

  phy-supply:
    description:
      PHY regulator

required:
  - compatible
  - reg
  - interrupts
  - interrupt-names
  - clocks
  - clock-names
  - phy-connection-type

examples:
  - |
    gmac: ethernet@1c50000 {
        compatible = "allwinner,sun7i-a20-gmac";
        reg = <0x01c50000 0x10000>;
        interrupts = <0 85 1>;
        interrupt-names = "macirq";
        clocks = <&ahb_gates 49>, <&gmac_tx>;
        clock-names = "stmmaceth", "allwinner_gmac_tx";
        phy-connection-type = "mii";
    };

# FIXME: We should set it, but it would report all the generic
# properties as additional properties.
# additionalProperties: false

...
```
