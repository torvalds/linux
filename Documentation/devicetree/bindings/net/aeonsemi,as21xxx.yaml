## Documentation/devicetree/bindings/net/altera_tse.txt
```
* Altera Triple-Speed Ethernet MAC driver (TSE)

Required properties:
- compatible: Should be "altr,tse-1.0" for legacy SGDMA based TSE, and should
		be "altr,tse-msgdma-1.0" for the preferred MSGDMA based TSE.
		ALTR is supported for legacy device trees, but is deprecated.
		altr should be used for all new designs.
- reg: Address and length of the register set for the device. It contains
  the information of registers in the same order as described by reg-names
- reg-names: Should contain the reg names
  "control_port": MAC configuration space region
  "tx_csr":       xDMA Tx dispatcher control and status space region
  "tx_desc":      MSGDMA Tx dispatcher descriptor space region
  "rx_csr" :      xDMA Rx dispatcher control and status space region
  "rx_desc":      MSGDMA Rx dispatcher descriptor space region
  "rx_resp":      MSGDMA Rx dispatcher response space region
  "s1":		  SGDMA descriptor memory
- interrupts: Should contain the TSE interrupts and it's mode.
- interrupt-names: Should contain the interrupt names
  "rx_irq":       xDMA Rx dispatcher interrupt
  "tx_irq":       xDMA Tx dispatcher interrupt
- rx-fifo-depth: MAC receive FIFO buffer depth in bytes
- tx-fifo-depth: MAC transmit FIFO buffer depth in bytes
- phy-mode: See ethernet.txt in the same directory.
- phy-handle: See ethernet.txt in the same directory.
- phy-addr: See ethernet.txt in the same directory. A configuration should
		include phy-handle or phy-addr.
- altr,has-supplementary-unicast:
		If present, TSE supports additional unicast addresses.
		Otherwise additional unicast addresses are not supported.
- altr,has-hash-multicast-filter:
		If present, TSE supports a hash based multicast filter.
		Otherwise, hash-based multicast filtering is not supported.

- mdio device tree subnode: When the TSE has a phy connected to its local
		mdio, there must be device tree subnode with the following
		required properties:

	- compatible: Must be "altr,tse-mdio".
	- #address-cells: Must be <1>.
	- #size-cells: Must be <0>.

	For each phy on the mdio bus, there must be a node with the following
	fields:

	- reg: phy id used to communicate to phy.
	- device_type: Must be "ethernet-phy".

Optional properties:
- local-mac-address: See ethernet.txt in the same directory.
- max-frame-size: See ethernet.txt in the same directory.

Example:

	tse_sub_0_eth_tse_0: ethernet@0x1,00000000 {
		compatible = "altr,tse-msgdma-1.0";
		reg =	<0x00000001 0x00000000 0x00000400>,
			<0x00000001 0x00000460 0x00000020>,
			<0x00000001 0x00000480 0x00000020>,
			<0x00000001 0x000004A0 0x00000008>,
			<0x00000001 0x00000400 0x00000020>,
			<0x00000001 0x00000420 0x00000020>;
		reg-names = "control_port", "rx_csr", "rx_desc", "rx_resp", "tx_csr", "tx_desc";
		interrupt-parent = <&hps_0_arm_gic_0>;
		interrupts = <0 41 4>, <0 40 4>;
		interrupt-names = "rx_irq", "tx_irq";
		rx-fifo-depth = <2048>;
		tx-fifo-depth = <2048>;
		address-bits = <48>;
		max-frame-size = <1500>;
		local-mac-address = [ 00 00 00 00 00 00 ];
		phy-mode = "gmii";
		altr,has-supplementary-unicast;
		altr,has-hash-multicast-filter;
		phy-handle = <&phy0>;
		mdio {
			compatible = "altr,tse-mdio";
			#address-cells = <1>;
			#size-cells = <0>;
			phy0: ethernet-phy@0 {
				reg = <0x0>;
				device_type = "ethernet-phy";
			};

			phy1: ethernet-phy@1 {
				reg = <0x1>;
				device_type = "ethernet-phy";
			};

		};
	};

	tse_sub_1_eth_tse_0: ethernet@0x1,00001000 {
		compatible = "altr,tse-msgdma-1.0";
		reg = 	<0x00000001 0x00001000 0x00000400>,
			<0x00000001 0x00001460 0x00000020>,
			<0x00000001 0x00001480 0x00000020>,
			<0x00000001 0x000014A0 0x00000008>,
			<0x00000001 0x00001400 0x00000020>,
			<0x00000001 0x00001420 0x00000020>;
		reg-names = "control_port", "rx_csr", "rx_desc", "rx_resp", "tx_csr", "tx_desc";
		interrupt-parent = <&hps_0_arm_gic_0>;
		interrupts = <0 43 4>, <0 42 4>;
		interrupt-names = "rx_irq", "tx_irq";
		rx-fifo-depth = <2048>;
		tx-fifo-depth = <2048>;
		address-bits = <48>;
		max-frame-size = <1500>;
		local-mac-address = [ 00 00 00 00 00 00 ];
		phy-mode = "gmii";
		altr,has-supplementary-unicast;
		altr,has-hash-multicast-filter;
		phy-handle = <&phy1>;
	};
```

## Documentation/devicetree/bindings/net/altr,gmii-to-sgmii-2.0.yaml
```yaml
# SPDX-License-Identifier: GPL-2.0-only OR BSD-2-Clause
# Copyright (C) 2025 Altera Corporation
%YAML 1.2
---
$id: http://devicetree.org/schemas/net/altr,gmii-to-sgmii-2.0.yaml#
$schema: http://devicetree.org/meta-schemas/core.yaml#

title: Altera GMII to SGMII Converter

maintainers:
  - Matthew Gerlach <matthew.gerlach@altera.com>

description:
  This binding describes the Altera GMII to SGMII converter.

properties:
  compatible:
    const: altr,gmii-to-sgmii-2.0

  reg:
    items:
      - description: Registers for the emac splitter IP
      - description: Registers for the GMII to SGMII converter.
      - description: Registers for TSE control.

  reg-names:
    items:
      - const: hps_emac_interface_splitter_avalon_slave
      - const: gmii_to_sgmii_adapter_avalon_slave
      - const: eth_tse_control_port

required:
  - compatible
  - reg
  - reg-names

unevaluatedProperties: false

examples:
  - |
    phy@ff000240 {
        compatible = "altr,gmii-to-sgmii-2.0";
        reg = <0xff000240 0x00000008>,
              <0xff000200 0x00000040>,
              <0xff000250 0x00000008>;
        reg-names = "hps_emac_interface_splitter_avalon_slave",
                    "gmii_to_sgmii_adapter_avalon_slave",
                    "eth_tse_control_port";
    };
```

## Documentation/devicetree/bindings/net/altr,socfpga-stmmac.yaml
```yaml
# SPDX-License-Identifier: GPL-2.0-only OR BSD-2-Clause
%YAML 1.2
---
$id: http://devicetree.org/schemas/net/altr,socfpga-stmmac.yaml#
$schema: http://devicetree.org/meta-schemas/core.yaml#

title: Altera SOCFPGA SoC DWMAC controller

maintainers:
  - Matthew Gerlach <matthew.gerlach@altera.com>

description:
  This binding describes the Altera SOCFPGA SoC implementation of the
  Synopsys DWMAC for the Cyclone5, Arria5, Stratix10, Agilex5 and Agilex7
  families of chips.
  # TODO: Determine how to handle the Arria10 reset-name, stmmaceth-ocp, that
  # does not validate against net/snps,dwmac.yaml.

select:
  properties:
    compatible:
      contains:
        enum:
          - altr,socfpga-stmmac
          - altr,socfpga-stmmac-a10-s10
          - altr,socfpga-stmmac-agilex5

  required:
    - compatible

properties:
  compatible:
    oneOf:
      - items:
          - const: altr,socfpga-stmmac
          - const: snps,dwmac-3.70a
          - const: snps,dwmac
      - items:
          - const: altr,socfpga-stmmac-a10-s10
          - const: snps,dwmac-3.72a
          - const: snps,dwmac
      - items:
          - const: altr,socfpga-stmmac-a10-s10
          - const: snps,dwmac-3.74a
          - const: snps,dwmac
      - items:
          - const: altr,socfpga-stmmac-agilex5
          - const: snps,dwxgmac-2.10

  clocks:
    minItems: 1
    items:
      - description: GMAC main clock
      - description:
          PTP reference clock. This clock is used for programming the
          Timestamp Addend Register. If not passed then the system
          clock will be used and this is fine on some platforms.

  clock-names:
    minItems: 1
    items:
      - const: stmmaceth
      - const: ptp_ref

  interrupts:
    maxItems: 1

  interrupt-names:
    items:
      - const: macirq

  iommus:
    minItems: 1
    maxItems: 2

  phy-mode:
    enum:
      - gmii
      - mii
      - rgmii
      - rgmii-id
      - rgmii-rxid
      - rgmii-txid
      - sgmii
      - 1000base-x

  rxc-skew-ps:
    description: Skew control of RXC pad

  rxd0-skew-ps:
    description: Skew control of RX data 0 pad

  rxd1-skew-ps:
    description: Skew control of RX data 1 pad

  rxd2-skew-ps:
    description: Skew control of RX data 2 pad

  rxd3-skew-ps:
    description: Skew control of RX data 3 pad

  rxdv-skew-ps:
    description: Skew control of RX CTL pad

  txc-skew-ps:
    description: Skew control of TXC pad

  txen-skew-ps:
    description: Skew control of TXC pad

  altr,emac-splitter:
    $ref: /schemas/types.yaml#/definitions/phandle
    description:
      Should be the phandle to the emac splitter soft IP node if DWMAC
      controller is connected an emac splitter.

  altr,f2h_ptp_ref_clk:
    $ref: /schemas/types.yaml#/definitions/phandle
    description:
      Phandle to Precision Time Protocol reference clock. This clock is
      common to gmac instances and defaults to osc1.

  altr,gmii-to-sgmii-converter:
    $ref: /schemas/types.yaml#/definitions/phandle
    description:
      Should be the phandle to the gmii to sgmii converter soft IP.

  altr,sysmgr-syscon:
    $ref: /schemas/types.yaml#/definitions/phandle-array
    description:
      Should be the phandle to the system manager node that encompass
      the glue register, the register offset, and the register shift.
      On Cyclone5/Arria5, the register shift represents the PHY mode
      bits, while on the Arria10/Stratix10/Agilex platforms, the
      register shift represents bit for each emac to enable/disable
      signals from the FPGA fabric to the EMAC modules.
    items:
      - items:
          - description: phandle to the system manager node
          - description: offset of the control register
          - description: shift within the control register

patternProperties:
  "^mdio[0-9]$":
    type: object

required:
  - compatible
  - clocks
  - clock-names
  - altr,sysmgr-syscon

allOf:
  - $ref: snps,dwmac.yaml#

unevaluatedProperties: false

examples:

  - |
    #include <dt-bindings/interrupt-controller/arm-gic.h>
    #include <dt-bindings/interrupt-controller/irq.h>
    soc {
        #address-cells = <1>;
        #size-cells = <1>;
        ethernet@ff700000 {
            compatible = "altr,socfpga-stmmac", "snps,dwmac-3.70a",
            "snps,dwmac";
            altr,sysmgr-syscon = <&sysmgr 0x60 0>;
            reg = <0xff700000 0x2000>;
            interrupts = <GIC_SPI 116 IRQ_TYPE_LEVEL_HIGH>;
            interrupt-names = "macirq";
            mac-address = [00 00 00 00 00 00]; /* Filled in by U-Boot */
            clocks = <&emac_0_clk>;
            clock-names = "stmmaceth";
            phy-mode = "sgmii";
        };
    };
```

## Documentation/devicetree/bindings/net/altr,tse.yaml
```yaml
# SPDX-License-Identifier: (GPL-2.0-only OR BSD-2-Clause)
%YAML 1.2
---
$id: http://devicetree.org/schemas/net/altr,tse.yaml#
$schema: http://devicetree.org/meta-schemas/core.yaml#

title: Altera Triple Speed Ethernet MAC driver (TSE)

maintainers:
  - Maxime Chevallier <maxime.chevallier@bootlin.com>

properties:
  compatible:
    oneOf:
      - const: altr,tse-1.0
      - const: ALTR,tse-1.0
        deprecated: true
      - const: altr,tse-msgdma-1.0

  interrupts:
    minItems: 2

  interrupt-names:
    items:
      - const: rx_irq
      - const: tx_irq

  rx-fifo-depth:
    $ref: /schemas/types.yaml#/definitions/uint32
    description:
      Depth in bytes of the RX FIFO

  tx-fifo-depth:
    $ref: /schemas/types.yaml#/definitions/uint32
    description:
      Depth in bytes of the TX FIFO

  altr,has-supplementary-unicast:
    type: boolean
    description:
      If present, TSE supports additional unicast addresses.

  altr,has-hash-multicast-filter:
    type: boolean
    description:
      If present, TSE supports hash based multicast filter.

  mdio:
    $ref: mdio.yaml#
    unevaluatedProperties: false
    description:
      Creates and registers an MDIO bus.

    properties:
      compatible:
        const: altr,tse-mdio

    required:
      - compatible

required:
  - compatible
  - reg
  - interrupts
  - rx-fifo-depth
  - tx-fifo-depth

allOf:
  - $ref: ethernet-controller.yaml#
  - if:
      properties:
        compatible:
          contains:
            enum:
              - altr,tse-1.0
              - ALTR,tse-1.0
    then:
      properties:
        reg:
          minItems: 4
        reg-names:
          items:
            - const: control_port
            - const: rx_csr
            - const: tx_csr
            - const: s1

  - if:
      properties:
        compatible:
          contains:
            enum:
              - altr,tse-msgdma-1.0
    then:
      properties:
        reg:
          minItems: 6
          maxItems: 7
        reg-names:
          minItems: 6
          items:
            - const: control_port
            - const: rx_csr
            - const: rx_desc
            - const: rx_resp
            - const: tx_csr
            - const: tx_desc
            - const: pcs

unevaluatedProperties: false

examples:
  - |
    tse_sub_0: ethernet@c0100000 {
        compatible = "altr,tse-msgdma-1.0";
        reg = <0xc0100000 0x00000400>,
              <0xc0101000 0x00000020>,
              <0xc0102000 0x00000020>,
              <0xc0103000 0x00000008>,
              <0xc0104000 0x00000020>,
              <0xc0105000 0x00000020>,
              <0xc0106000 0x00000100>;
        reg-names = "control_port", "rx_csr", "rx_desc", "rx_resp", "tx_csr", "tx_desc", "pcs";
        interrupt-parent = <&intc>;
        interrupts = <0 44 4>,<0 45 4>;
        interrupt-names = "rx_irq","tx_irq";
        rx-fifo-depth = <2048>;
        tx-fifo-depth = <2048>;
        max-frame-size = <1500>;
        local-mac-address = [ 00 00 00 00 00 00 ];
        altr,has-supplementary-unicast;
        altr,has-hash-multicast-filter;
        sfp = <&sfp0>;
        phy-mode = "sgmii";
        managed = "in-band-status";
    };
  - |
    tse_sub_1_eth_tse_0: ethernet@1,00001000 {
        compatible = "altr,tse-msgdma-1.0";
        reg = <0x00001000 0x00000400>,
              <0x00001460 0x00000020>,
              <0x00001480 0x00000020>,
              <0x000014A0 0x00000008>,
              <0x00001400 0x00000020>,
              <0x00001420 0x00000020>;
        reg-names = "control_port", "rx_csr", "rx_desc", "rx_resp", "tx_csr", "tx_desc";
        interrupt-parent = <&hps_0_arm_gic_0>;
        interrupts = <0 43 4>, <0 42 4>;
        interrupt-names = "rx_irq", "tx_irq";
        rx-fifo-depth = <2048>;
        tx-fifo-depth = <2048>;
        max-frame-size = <1500>;
        local-mac-address = [ 00 00 00 00 00 00 ];
        phy-mode = "gmii";
        altr,has-supplementary-unicast;
        altr,has-hash-multicast-filter;
        phy-handle = <&phy1>;
        mdio {
            compatible = "altr,tse-mdio";
            #address-cells = <1>;
            #size-cells = <0>;
            phy1: ethernet-phy@1 {
                reg = <0x1>;
            };
        };
    };

...
```
