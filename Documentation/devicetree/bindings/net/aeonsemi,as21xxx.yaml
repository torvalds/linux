## Documentation/devicetree/bindings/net/aeonsemi,as21xxx.yaml
```yaml
# SPDX-License-Identifier: (GPL-2.0-only OR BSD-2-Clause)
%YAML 1.2
---
$id: http://devicetree.org/schemas/net/aeonsemi,as21xxx.yaml#
$schema: http://devicetree.org/meta-schemas/core.yaml#

title: Aeonsemi AS21XXX Ethernet PHY

maintainers:
  - Christian Marangi <ansuelsmth@gmail.com>

description: |
  Aeonsemi AS21xxx Ethernet PHYs requires a firmware to be loaded to actually
  work. The same firmware is compatible with various PHYs of the same family.

  A PHY with not firmware loaded will be exposed on the MDIO bus with ID
  0x7500 0x7500 or 0x7500 0x9410 on C45 registers.

  This can be done and is implemented by OEM in 2 different way:
    - Attached SPI flash directly to the PHY with the firmware. The PHY
      will self load the firmware in the presence of this configuration.
    - Manually provided firmware loaded from a file in the filesystem.

  Each PHY can support up to 5 LEDs.

  AS2xxx PHY Name logic:

  AS21x1xxB1
      ^ ^^
      | |J: Supports SyncE/PTP
      | |P: No SyncE/PTP support
      | 1: Supports 2nd Serdes
      | 2: Not 2nd Serdes support
      0: 10G, 5G, 2.5G
      5: 5G, 2.5G
      2: 2.5G

allOf:
  - $ref: ethernet-phy.yaml#

select:
  properties:
    compatible:
      contains:
        enum:
          - ethernet-phy-id7500.9410
          - ethernet-phy-id7500.9402
          - ethernet-phy-id7500.9412
          - ethernet-phy-id7500.9422
          - ethernet-phy-id7500.9432
          - ethernet-phy-id7500.9442
          - ethernet-phy-id7500.9452
          - ethernet-phy-id7500.9462
          - ethernet-phy-id7500.9472
          - ethernet-phy-id7500.9482
          - ethernet-phy-id7500.9492
  required:
    - compatible

properties:
  reg:
    maxItems: 1

  firmware-name:
    description: specify the name of PHY firmware to load
    maxItems: 1

required:
  - compatible
  - reg

if:
  properties:
    compatible:
      contains:
        const: ethernet-phy-id7500.9410
then:
  required:
    - firmware-name
else:
  properties:
    firmware-name: false

unevaluatedProperties: false

examples:
  - |
    #include <dt-bindings/leds/common.h>

    mdio {
        #address-cells = <1>;
        #size-cells = <0>;

        ethernet-phy@1f {
            compatible = "ethernet-phy-id7500.9410",
                         "ethernet-phy-ieee802.3-c45";

            reg = <31>;
            firmware-name = "as21x1x_fw.bin";

            leds {
                #address-cells = <1>;
                #size-cells = <0>;

                led@0 {
                    reg = <0>;
                    color = <LED_COLOR_ID_GREEN>;
                    function = LED_FUNCTION_LAN;
                    function-enumerator = <0>;
                    default-state = "keep";
                };

                led@1 {
                    reg = <1>;
                    color = <LED_COLOR_ID_GREEN>;
                    function = LED_FUNCTION_LAN;
                    function-enumerator = <1>;
                    default-state = "keep";
                };
            };
        };
    };
```

## Documentation/devicetree/bindings/net/airoha,an7583-mdio.yaml
```yaml
# SPDX-License-Identifier: GPL-2.0-only OR BSD-2-Clause
%YAML 1.2
---
$id: http://devicetree.org/schemas/net/airoha,an7583-mdio.yaml#
$schema: http://devicetree.org/meta-schemas/core.yaml#

title: Airoha AN7583 Dedicated MDIO Controller

maintainers:
  - Christian Marangi <ansuelsmth@gmail.com>

description:
  Airoha AN7583 SoC have 3 different MDIO Controller.

  One comes from the intergated Switch based on MT7530.

  The other 2 (that this schema describe) live under the SCU
  register supporting both C22 and C45 PHYs.

$ref: mdio.yaml#

properties:
  compatible:
    const: airoha,an7583-mdio

  reg:
    enum: [0xc8, 0xcc]

  clocks:
    maxItems: 1

  resets:
    maxItems: 1

  clock-frequency:
    default: 2500000

required:
  - compatible
  - reg
  - clocks
  - resets

unevaluatedProperties: false

examples:
  - |
    system-controller {
        #address-cells = <1>;
        #size-cells = <0>;

        mdio-bus@c8 {
            compatible = "airoha,an7583-mdio";
            reg = <0xc8>;

            clocks = <&scu>;
            resets = <&scu>;
        };
    };
```

## Documentation/devicetree/bindings/net/airoha,an8801.yaml
```yaml
# SPDX-License-Identifier: (GPL-2.0-only OR BSD-2-Clause)
%YAML 1.2
---
$id: http://devicetree.org/schemas/net/airoha,an8801.yaml#
$schema: http://devicetree.org/meta-schemas/core.yaml#

title: Airoha AN8801R Series PHY

maintainers:
  - AngeloGioacchino Del Regno <angelogioacchino.delregno@collabora.com>

description:
  The Airoha AN8801R is a low power single-port Ethernet PHY Transceiver
  with Single-port serdes interface for 1000Base-X/RGMII; this chip is
  compliant with 10Base-T, 100Base-TX and 1000Base-T IEEE 802.3(u,ab)
  and supports Energy Efficient Ethernet (802.3az), Full Duplex Control
  Flow (802.3x), auto-negotiation, crossover detect and autocorrection,
  Wake-on-LAN with Magic Packet, and Jumbo Frame up to 9 Kilobytes.
  This PHY also supports up to three user-configurable LEDs, which are
  usually used for LAN Activity, 100M, 1000M indication.

allOf:
  - $ref: ethernet-phy.yaml#

properties:
  compatible:
    enum:
      - ethernet-phy-idc0ff.0421

  reg:
    maxItems: 1

  leds:
    type: object
    description:
      Describes the LEDs associated to the PHY

    properties:
      "#address-cells":
        const: 1

      "#size-cells":
        const: 0

    patternProperties:
      "^led@[0-2]$":
        type: object
        description: PHY LEDs
        $ref: /schemas/leds/common.yaml#

        properties:
          reg:
            enum: [0, 1, 2]

          function-enumerator:
            enum: [0, 1, 2]
            description: |
              Specifies a function for offloading LED functionality to the PHY:
              0 - No offloading
              1 - Link Availability
              2 - Network Activity

        required:
          - reg

        unevaluatedProperties: false

    additionalProperties: false

  wakeup-source:
    $ref: /schemas/types.yaml#/definitions/flag
    description:
      Enable Wake-on-LAN support

required:
  - reg

unevaluatedProperties: false

examples:
  - |
    #include <dt-bindings/leds/common.h>

    mdio {
        #address-cells = <1>;
        #size-cells = <0>;

        ethernet-phy@0 {
            compatible = "ethernet-phy-idc0ff.0421";
            reg = <0>;

            leds {
                #address-cells = <1>;
                #size-cells = <0>;

                led@0 {
                    reg = <0>;
                    color = <LED_COLOR_ID_GREEN>;
                    function = LED_FUNCTION_LAN;
                    default-state = "keep";
                };

                led@1 {
                    reg = <1>;
                    color = <LED_COLOR_ID_GREEN>;
                    function = LED_FUNCTION_LAN;
                    function-enumerator = <1>;
                    default-state = "keep";
                };

                led@2 {
                    reg = <2>;
                    color = <LED_COLOR_ID_YELLOW>;
                    function = LED_FUNCTION_LAN;
                    function-enumerator = <2>;
                    default-state = "keep";
                };
            };
        };
    };
```

## Documentation/devicetree/bindings/net/airoha,en7581-eth.yaml
```yaml
# SPDX-License-Identifier: (GPL-2.0-only OR BSD-2-Clause)
%YAML 1.2
---
$id: http://devicetree.org/schemas/net/airoha,en7581-eth.yaml#
$schema: http://devicetree.org/meta-schemas/core.yaml#

title: Airoha EN7581 Frame Engine Ethernet controller

maintainers:
  - Lorenzo Bianconi <lorenzo@kernel.org>

description:
  The frame engine ethernet controller can be found on Airoha SoCs.
  These SoCs have multi-GMAC ports.

properties:
  compatible:
    enum:
      - airoha,en7581-eth

  reg:
    items:
      - description: Frame engine base address
      - description: QDMA0 base address
      - description: QDMA1 base address

  reg-names:
    items:
      - const: fe
      - const: qdma0
      - const: qdma1

  interrupts:
    items:
      - description: QDMA lan irq0
      - description: QDMA lan irq1
      - description: QDMA lan irq2
      - description: QDMA lan irq3
      - description: QDMA wan irq0
      - description: QDMA wan irq1
      - description: QDMA wan irq2
      - description: QDMA wan irq3
      - description: FE error irq
      - description: PDMA irq

  resets:
    maxItems: 8

  reset-names:
    items:
      - const: fe
      - const: pdma
      - const: qdma
      - const: xsi-mac
      - const: hsi0-mac
      - const: hsi1-mac
      - const: hsi-mac
      - const: xfp-mac

  memory-region:
    items:
      - description: QDMA0 buffer memory
      - description: QDMA1 buffer memory

  memory-region-names:
    items:
      - const: qdma0-buf
      - const: qdma1-buf

  "#address-cells":
    const: 1

  "#size-cells":
    const: 0

  airoha,npu:
    $ref: /schemas/types.yaml#/definitions/phandle
    description:
      Phandle to the node used to configure the NPU module.
      The Airoha Network Processor Unit (NPU) provides a configuration
      interface to implement hardware flow offloading programming Packet
      Processor Engine (PPE) flow table.

patternProperties:
  "^ethernet@[1-4]$":
    type: object
    unevaluatedProperties: false
    $ref: ethernet-controller.yaml#
    description:
      Ethernet GMAC port associated to the MAC controller
    properties:
      compatible:
        const: airoha,eth-mac

      reg:
        minimum: 1
        maximum: 4
        description: GMAC port identifier

    required:
      - reg
      - compatible

required:
  - compatible
  - reg
  - interrupts
  - resets
  - reset-names

unevaluatedProperties: false

examples:
  - |
    #include <dt-bindings/interrupt-controller/arm-gic.h>
    #include <dt-bindings/interrupt-controller/irq.h>
    #include <dt-bindings/clock/en7523-clk.h>

    soc {
      #address-cells = <2>;
      #size-cells = <2>;

      eth: ethernet@1fb50000 {
        compatible = "airoha,en7581-eth";
        reg = <0 0x1fb50000 0 0x2600>,
              <0 0x1fb54000 0 0x2000>,
              <0 0x1fb56000 0 0x2000>;
        reg-names = "fe", "qdma0", "qdma1";

        resets = <&scuclk 44>,
                 <&scuclk 30>,
                 <&scuclk 31>,
                 <&scuclk 6>,
                 <&scuclk 15>,
                 <&scuclk 16>,
                 <&scuclk 17>,
                 <&scuclk 26>;
        reset-names = "fe", "pdma", "qdma", "xsi-mac",
                      "hsi0-mac", "hsi1-mac", "hsi-mac",
                      "xfp-mac";

        interrupts = <GIC_SPI 37 IRQ_TYPE_LEVEL_HIGH>,
                     <GIC_SPI 55 IRQ_TYPE_LEVEL_HIGH>,
                     <GIC_SPI 56 IRQ_TYPE_LEVEL_HIGH>,
                     <GIC_SPI 57 IRQ_TYPE_LEVEL_HIGH>,
                     <GIC_SPI 38 IRQ_TYPE_LEVEL_HIGH>,
                     <GIC_SPI 58 IRQ_TYPE_LEVEL_HIGH>,
                     <GIC_SPI 59 IRQ_TYPE_LEVEL_HIGH>,
                     <GIC_SPI 60 IRQ_TYPE_LEVEL_HIGH>,
                     <GIC_SPI 49 IRQ_TYPE_LEVEL_HIGH>,
                     <GIC_SPI 64 IRQ_TYPE_LEVEL_HIGH>;

        memory-region = <&qdma0_buf>, <&qdma1_buf>;
        memory-region-names = "qdma0-buf", "qdma1-buf";

        airoha,npu = <&npu>;

        #address-cells = <1>;
        #size-cells = <0>;

        mac: ethernet@1 {
          compatible = "airoha,eth-mac";
          reg = <1>;
        };
      };
    };
```

## Documentation/devicetree/bindings/net/airoha,en7581-npu.yaml
```yaml
# SPDX-License-Identifier: (GPL-2.0 OR BSD-2-Clause)
%YAML 1.2
---
$id: http://devicetree.org/schemas/net/airoha,en7581-npu.yaml#
$schema: http://devicetree.org/meta-schemas/core.yaml#

title: Airoha Network Processor Unit for EN7581 SoC

maintainers:
  - Lorenzo Bianconi <lorenzo@kernel.org>

description:
  The Airoha Network Processor Unit (NPU) provides a configuration interface
  to implement wired and wireless hardware flow offloading programming Packet
  Processor Engine (PPE) flow table.

properties:
  compatible:
    enum:
      - airoha,en7581-npu

  reg:
    maxItems: 1

  interrupts:
    items:
      - description: mbox host irq line
      - description: watchdog0 irq line
      - description: watchdog1 irq line
      - description: watchdog2 irq line
      - description: watchdog3 irq line
      - description: watchdog4 irq line
      - description: watchdog5 irq line
      - description: watchdog6 irq line
      - description: watchdog7 irq line
      - description: wlan irq line0
      - description: wlan irq line1
      - description: wlan irq line2
      - description: wlan irq line3
      - description: wlan irq line4
      - description: wlan irq line5

  memory-region:
    maxItems: 1
    description:
      Memory used to store NPU firmware binary.

required:
  - compatible
  - reg
  - interrupts
  - memory-region

additionalProperties: false

examples:
  - |
    #include <dt-bindings/interrupt-controller/arm-gic.h>
    #include <dt-bindings/interrupt-controller/irq.h>
    soc {
      #address-cells = <2>;
      #size-cells = <2>;

      npu@1e900000 {
        compatible = "airoha,en7581-npu";
        reg = <0 0x1e900000 0 0x313000>;
        interrupts = <GIC_SPI 125 IRQ_TYPE_LEVEL_HIGH>,
                     <GIC_SPI 103 IRQ_TYPE_LEVEL_HIGH>,
                     <GIC_SPI 109 IRQ_TYPE_LEVEL_HIGH>,
                     <GIC_SPI 113 IRQ_TYPE_LEVEL_HIGH>,
                     <GIC_SPI 117 IRQ_TYPE_LEVEL_HIGH>,
                     <GIC_SPI 134 IRQ_TYPE_LEVEL_HIGH>,
                     <GIC_SPI 135 IRQ_TYPE_LEVEL_HIGH>,
                     <GIC_SPI 136 IRQ_TYPE_LEVEL_HIGH>,
                     <GIC_SPI 137 IRQ_TYPE_LEVEL_HIGH>,
                     <GIC_SPI 118 IRQ_TYPE_LEVEL_HIGH>,
                     <GIC_SPI 119 IRQ_TYPE_LEVEL_HIGH>,
                     <GIC_SPI 120 IRQ_TYPE_LEVEL_HIGH>,
                     <GIC_SPI 121 IRQ_TYPE_LEVEL_HIGH>,
                     <GIC_SPI 122 IRQ_TYPE_LEVEL_HIGH>,
                     <GIC_SPI 123 IRQ_TYPE_LEVEL_HIGH>;
        memory-region = <&npu_binary>;
      };
    };
```

## Documentation/devicetree/bindings/net/airoha,en8811h.yaml
```yaml
# SPDX-License-Identifier: (GPL-2.0-only OR BSD-2-Clause)
%YAML 1.2
---
$id: http://devicetree.org/schemas/net/airoha,en8811h.yaml#
$schema: http://devicetree.org/meta-schemas/core.yaml#

title: Airoha EN8811H PHY

maintainers:
  - Eric Woudstra <ericwouds@gmail.com>

description:
  The Airoha EN8811H PHY has the ability to reverse polarity
  on the lines to and/or from the MAC. It is reversed by
  the booleans in the devicetree node of the phy.

allOf:
  - $ref: ethernet-phy.yaml#

properties:
  compatible:
    enum:
      - ethernet-phy-id03a2.a411

  reg:
    maxItems: 1

  airoha,pnswap-rx:
    type: boolean
    description:
      Reverse rx polarity of the SERDES. This is the receiving
      side of the lines from the MAC towards the EN881H.

  airoha,pnswap-tx:
    type: boolean
    description:
      Reverse tx polarity of SERDES. This is the transmitting
      side of the lines from EN8811H towards the MAC.

required:
  - reg

unevaluatedProperties: false

examples:
  - |
    mdio {
        #address-cells = <1>;
        #size-cells = <0>;

        ethernet-phy@1 {
            compatible = "ethernet-phy-id03a2.a411";
            reg = <1>;
            airoha,pnswap-rx;
        };
    };
```
