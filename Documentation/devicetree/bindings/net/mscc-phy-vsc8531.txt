## Documentation/devicetree/bindings/net/nfc/nxp,pn532.yaml
```yaml
# SPDX-License-Identifier: GPL-2.0-only OR BSD-2-Clause
%YAML 1.2
---
$id: http://devicetree.org/schemas/net/nfc/nxp,pn532.yaml#
$schema: http://devicetree.org/meta-schemas/core.yaml#

title: NXP Semiconductors PN532 NFC controller

maintainers:
  - Krzysztof Kozlowski <krzysztof.kozlowski@canonical.com>

properties:
  compatible:
    oneOf:
      - const: nxp,pn532
      - description: Deprecated bindings
        enum:
          - nxp,pn532-i2c
          - nxp,pn533-i2c
        deprecated: true

  interrupts:
    description: Required if connected via I2C
    maxItems: 1

  reg:
    description: Required if connected via I2C
    maxItems: 1

required:
  - compatible

dependencies:
  interrupts: [ 'reg' ]

additionalProperties: false

examples:
  # PN532 on I2C bus
  - |
    #include <dt-bindings/interrupt-controller/irq.h>

    i2c {
        #address-cells = <1>;
        #size-cells = <0>;

        nfc@24 {
            compatible = "nxp,pn532";

            reg = <0x24>;

            interrupt-parent = <&gpio1>;
            interrupts = <17 IRQ_TYPE_LEVEL_HIGH>;
        };
    };

  # PN532 connected via UART
  - |
    serial@49042000 {
        reg = <0x49042000 0x400>;

        nfc {
            compatible = "nxp,pn532";
        };
    };
```

## Documentation/devicetree/bindings/net/nfc/nxp,pn544.yaml
```yaml
# SPDX-License-Identifier: (GPL-2.0-only OR BSD-2-Clause)
%YAML 1.2
---
$id: http://devicetree.org/schemas/net/nfc/nxp,pn544.yaml#
$schema: http://devicetree.org/meta-schemas/core.yaml#

title: NXP Semiconductors PN544 NFC Controller

maintainers:
  - Krzysztof Kozlowski <krzysztof.kozlowski@canonical.com>

properties:
  compatible:
    const: nxp,pn544-i2c

  reg:
    maxItems: 1

  interrupts:
    maxItems: 1

  enable-gpios:
    description: Output GPIO pin used for enabling/disabling the PN544
    maxItems: 1

  firmware-gpios:
    description: Output GPIO pin used to enter firmware download mode
    maxItems: 1

required:
  - compatible
  - reg
  - interrupts
  - enable-gpios
  - firmware-gpios

additionalProperties: false

examples:
  - |
    #include <dt-bindings/gpio/gpio.h>
    #include <dt-bindings/interrupt-controller/irq.h>

    i2c {
        #address-cells = <1>;
        #size-cells = <0>;

        nfc@28 {
            compatible = "nxp,pn544-i2c";
            reg = <0x28>;

            interrupt-parent = <&gpio1>;
            interrupts = <17 IRQ_TYPE_LEVEL_HIGH>;

            enable-gpios = <&gpio3 21 GPIO_ACTIVE_HIGH>;
            firmware-gpios = <&gpio3 19 GPIO_ACTIVE_HIGH>;
        };
    };
```

## Documentation/devicetree/bindings/net/nfc/nxp-nci.txt
```
* NXP Semiconductors NXP NCI NFC Controllers

Required properties:
- compatible: Should be "nxp,nxp-nci-i2c".
- clock-frequency: I²C work frequency.
- reg: address on the bus
- interrupts: GPIO interrupt to which the chip is connected
- enable-gpios: Output GPIO pin used for enabling/disabling the chip
- firmware-gpios: Output GPIO pin used to enter firmware download mode

Optional SoC Specific Properties:
- pinctrl-names: Contains only one value - "default".
- pintctrl-0: Specifies the pin control groups used for this controller.

Example (for ARM-based BeagleBone with NPC100 NFC controller on I2C2):

&i2c2 {


	npc100: npc100@29 {

		compatible = "nxp,nxp-nci-i2c";

		reg = <0x29>;
		clock-frequency = <100000>;

		interrupt-parent = <&gpio1>;
		interrupts = <29 GPIO_ACTIVE_HIGH>;

		enable-gpios = <&gpio0 30 GPIO_ACTIVE_HIGH>;
		firmware-gpios = <&gpio0 31 GPIO_ACTIVE_HIGH>;
	};
};
```

## Documentation/devicetree/bindings/net/nfc/pn532.txt
```
* NXP Semiconductors PN532 NFC Controller

Required properties:
- compatible: Should be
    - "nxp,pn532" Place a node with this inside the devicetree node of the bus
                  where the NFC chip is connected to.
                  Currently the kernel has phy bindings for uart and i2c.
    - "nxp,pn532-i2c" (DEPRECATED) only works for the i2c binding.
    - "nxp,pn533-i2c" (DEPRECATED) only works for the i2c binding.

Required properties if connected on i2c:
- clock-frequency: I²C work frequency.
- reg: for the I²C bus address. This is fixed at 0x24 for the PN532.
- interrupts: GPIO interrupt to which the chip is connected

Optional SoC Specific Properties:
- pinctrl-names: Contains only one value - "default".
- pintctrl-0: Specifies the pin control groups used for this controller.

Example (for ARM-based BeagleBone with PN532 on I2C2):

&i2c2 {


	pn532: nfc@24 {

		compatible = "nxp,pn532";

		reg = <0x24>;
		clock-frequency = <400000>;

		interrupt-parent = <&gpio1>;
		interrupts = <17 IRQ_TYPE_EDGE_FALLING>;

	};
};

Example (for PN532 connected via uart):

uart4: serial@49042000 {
        compatible = "ti,omap3-uart";

        pn532: nfc {
                compatible = "nxp,pn532";
        };
};
```

## Documentation/devicetree/bindings/net/nfc/pn533-i2c.txt
```
* NXP Semiconductors PN532 NFC Controller

Required properties:
- compatible: Should be "nxp,pn532-i2c" or "nxp,pn533-i2c".
- clock-frequency: I²C work frequency.
- reg: address on the bus
- interrupt-parent: phandle for the interrupt gpio controller
- interrupts: GPIO interrupt to which the chip is connected

Optional SoC Specific Properties:
- pinctrl-names: Contains only one value - "default".
- pintctrl-0: Specifies the pin control groups used for this controller.

Example (for ARM-based BeagleBone with PN532 on I2C2):

&i2c2 {


	pn532: pn532@24 {

		compatible = "nxp,pn532-i2c";

		reg = <0x24>;
		clock-frequency = <400000>;

		interrupt-parent = <&gpio1>;
		interrupts = <17 IRQ_TYPE_EDGE_FALLING>;

	};
};
```

## Documentation/devicetree/bindings/net/nfc/pn544.txt
```
* NXP Semiconductors PN544 NFC Controller

Required properties:
- compatible: Should be "nxp,pn544-i2c".
- clock-frequency: I²C work frequency.
- reg: address on the bus
- interrupts: GPIO interrupt to which the chip is connected
- enable-gpios: Output GPIO pin used for enabling/disabling the PN544
- firmware-gpios: Output GPIO pin used to enter firmware download mode

Optional SoC Specific Properties:
- pinctrl-names: Contains only one value - "default".
- pintctrl-0: Specifies the pin control groups used for this controller.

Example (for ARM-based BeagleBone with PN544 on I2C2):

&i2c2 {


	pn544: pn544@28 {

		compatible = "nxp,pn544-i2c";

		reg = <0x28>;
		clock-frequency = <400000>;

		interrupt-parent = <&gpio1>;
		interrupts = <17 IRQ_TYPE_LEVEL_HIGH>;

		enable-gpios = <&gpio3 21 GPIO_ACTIVE_HIGH>;
		firmware-gpios = <&gpio3 19 GPIO_ACTIVE_HIGH>;
	};
};
```

## Documentation/devicetree/bindings/net/nfc/s3fwrn5.txt
```
* Samsung S3FWRN5 NCI NFC Controller

Required properties:
- compatible: Should be "samsung,s3fwrn5-i2c".
- reg: address on the bus
- interrupts: GPIO interrupt to which the chip is connected
- s3fwrn5,en-gpios: Output GPIO pin used for enabling/disabling the chip
- s3fwrn5,fw-gpios: Output GPIO pin used to enter firmware mode and
  sleep/wakeup control

Example:

&hsi2c_4 {
	s3fwrn5@27 {
		compatible = "samsung,s3fwrn5-i2c";

		reg = <0x27>;

		interrupt-parent = <&gpa1>;
		interrupts = <3 0 0>;

		s3fwrn5,en-gpios = <&gpf1 4 0>;
		s3fwrn5,fw-gpios = <&gpj0 2 0>;
	};
};
```

## Documentation/devicetree/bindings/net/nfc/samsung,s3fwrn5.yaml
```yaml
# SPDX-License-Identifier: GPL-2.0-only OR BSD-2-Clause
%YAML 1.2
---
$id: http://devicetree.org/schemas/net/nfc/samsung,s3fwrn5.yaml#
$schema: http://devicetree.org/meta-schemas/core.yaml#

title: Samsung S3FWRN5 NCI NFC Controller

maintainers:
  - Krzysztof Kozlowski <krzk@kernel.org>
  - Krzysztof Opasiak <k.opasiak@samsung.com>

properties:
  compatible:
    enum:
      - samsung,s3fwrn5-i2c
      - samsung,s3fwrn82

  en-gpios:
    maxItems: 1
    description:
      Output GPIO pin used for enabling/disabling the chip

  interrupts:
    maxItems: 1

  reg:
    maxItems: 1

  clocks:
    maxItems: 1

  wake-gpios:
    maxItems: 1
    description:
      Output GPIO pin used to enter firmware mode and sleep/wakeup control

  s3fwrn5,en-gpios:
    maxItems: 1
    deprecated: true
    description:
      Use en-gpios

  s3fwrn5,fw-gpios:
    maxItems: 1
    deprecated: true
    description:
      Use wake-gpios

additionalProperties: false

required:
  - compatible
  - en-gpios
  - wake-gpios

allOf:
  - if:
      properties:
        compatible:
          contains:
            const: samsung,s3fwrn5-i2c
    then:
      required:
        - interrupts
        - reg

examples:
  - |
    #include <dt-bindings/gpio/gpio.h>
    #include <dt-bindings/interrupt-controller/irq.h>

    i2c4 {
        #address-cells = <1>;
        #size-cells = <0>;

        s3fwrn5@27 {
            compatible = "samsung,s3fwrn5-i2c";
            reg = <0x27>;

            interrupt-parent = <&gpa1>;
            interrupts = <3 IRQ_TYPE_EDGE_RISING>;

            en-gpios = <&gpf1 4 GPIO_ACTIVE_HIGH>;
            wake-gpios = <&gpj0 2 GPIO_ACTIVE_HIGH>;

            clocks = <&rpmcc 20>;
        };
    };
  # UART example on Raspberry Pi
  - |
    uart0 {
        nfc {
            compatible = "samsung,s3fwrn82";

            en-gpios = <&gpio 20 GPIO_ACTIVE_HIGH>;
            wake-gpios = <&gpio 16 GPIO_ACTIVE_HIGH>;

        };
    };
```

## Documentation/devicetree/bindings/net/nfc/st,st-nci.yaml
```yaml
# SPDX-License-Identifier: GPL-2.0-only OR BSD-2-Clause
%YAML 1.2
---
$id: http://devicetree.org/schemas/net/nfc/st,st-nci.yaml#
$schema: http://devicetree.org/meta-schemas/core.yaml#

title: STMicroelectronics ST NCI NFC controller

maintainers:
  - Krzysztof Kozlowski <krzysztof.kozlowski@canonical.com>

properties:
  compatible:
    enum:
      - st,st21nfcb-i2c
      - st,st21nfcb-spi
      - st,st21nfcc-i2c

  reset-gpios:
    description: Output GPIO pin used for resetting the controller

  ese-present:
    type: boolean
    description: |
      Specifies that an ese is physically connected to the controller

  interrupts:
    maxItems: 1

  reg:
    maxItems: 1

  spi-max-frequency: true

  uicc-present:
    type: boolean
    description: |
      Specifies that the uicc swp signal can be physically connected to the
      controller

required:
  - compatible
  - interrupts
  - reg
  - reset-gpios

if:
  properties:
    compatible:
      contains:
        enum:
          - st,st21nfcb-i2c
          - st,st21nfcc-i2c
then:
  properties:
    spi-max-frequency: false
else:
  required:
    - spi-max-frequency

additionalProperties: false

examples:
  - |
    #include <dt-bindings/gpio/gpio.h>
    #include <dt-bindings/interrupt-controller/irq.h>

    i2c {
        #address-cells = <1>;
        #size-cells = <0>;

        nfc@8 {
            compatible = "st,st21nfcb-i2c";
            reg = <0x08>;

            interrupt-parent = <&gpio5>;
            interrupts = <2 IRQ_TYPE_LEVEL_HIGH>;
            reset-gpios = <&gpio5 29 GPIO_ACTIVE_HIGH>;

            ese-present;
            uicc-present;
        };
    };

  - |
    #include <dt-bindings/gpio/gpio.h>
    #include <dt-bindings/interrupt-controller/irq.h>

    spi {
        #address-cells = <1>;
        #size-cells = <0>;

        nfc@0 {
            compatible = "st,st21nfcb-spi";
            reg = <0>;

            spi-max-frequency = <4000000>;

            interrupt-parent = <&gpio5>;
            interrupts = <2 IRQ_TYPE_EDGE_RISING>;
            reset-gpios = <&gpio5 29 GPIO_ACTIVE_HIGH>;

            ese-present;
            uicc-present;
        };
    };
```

## Documentation/devicetree/bindings/net/nfc/st,st21nfca.yaml
```yaml
# SPDX-License-Identifier: GPL-2.0-only OR BSD-2-Clause
%YAML 1.2
---
$id: http://devicetree.org/schemas/net/nfc/st,st21nfca.yaml#
$schema: http://devicetree.org/meta-schemas/core.yaml#

title: STMicroelectronics SAS ST21NFCA NFC controller

maintainers:
  - Krzysztof Kozlowski <krzk@kernel.org>

properties:
  compatible:
    const: st,st21nfca-i2c

  enable-gpios:
    description: Output GPIO pin used for enabling/disabling the controller

  ese-present:
    type: boolean
    description: |
      Specifies that an ese is physically connected to the controller

  interrupts:
    maxItems: 1

  reg:
    maxItems: 1

  uicc-present:
    type: boolean
    description: |
      Specifies that the uicc swp signal can be physically connected to the
      controller

required:
  - compatible
  - enable-gpios
  - interrupts
  - reg

additionalProperties: false

examples:
  - |
    #include <dt-bindings/gpio/gpio.h>
    #include <dt-bindings/interrupt-controller/irq.h>

    i2c {
        #address-cells = <1>;
        #size-cells = <0>;

        nfc@1 {
            compatible = "st,st21nfca-i2c";
            reg = <0x1>;

            interrupt-parent = <&gpio5>;
            interrupts = <2 IRQ_TYPE_LEVEL_LOW>;
            enable-gpios = <&gpio5 29 GPIO_ACTIVE_HIGH>;

            ese-present;
            uicc-present;
        };
    };
```

## Documentation/devicetree/bindings/net/nfc/st,st95hf.yaml
```yaml
# SPDX-License-Identifier: GPL-2.0-only OR BSD-2-Clause
%YAML 1.2
---
$id: http://devicetree.org/schemas/net/nfc/st,st95hf.yaml#
$schema: http://devicetree.org/meta-schemas/core.yaml#

title: STMicroelectronics ST95HF NFC controller

maintainers:
  - Krzysztof Kozlowski <krzysztof.kozlowski@canonical.com>

properties:
  compatible:
    const: st,st95hf

  enable-gpio:
    description: Output GPIO pin used for enabling/disabling the controller

  interrupts:
    maxItems: 1

  reg:
    maxItems: 1

  st95hfvin-supply:
    description: ST95HF transceiver's Vin regulator supply

  spi-max-frequency: true

required:
  - compatible
  - enable-gpio
  - interrupts
  - reg
  - spi-max-frequency

additionalProperties: false

examples:
  - |
    #include <dt-bindings/gpio/gpio.h>
    #include <dt-bindings/interrupt-controller/irq.h>

    spi {
        #address-cells = <1>;
        #size-cells = <0>;

        nfc@0{
            compatible = "st,st95hf";
            reg = <0>;

            spi-max-frequency = <1000000>;
            enable-gpio = <&pio4 GPIO_ACTIVE_HIGH>;
            interrupt-parent = <&pio0>;
            interrupts = <7 IRQ_TYPE_EDGE_FALLING>;
        };
    };
```

## Documentation/devicetree/bindings/net/nfc/st-nci-i2c.txt
```
* STMicroelectronics SAS. ST NCI NFC Controller

Required properties:
- compatible: Should be "st,st21nfcb-i2c" or "st,st21nfcc-i2c".
- clock-frequency: I²C work frequency.
- reg: address on the bus
- interrupt-parent: phandle for the interrupt gpio controller
- interrupts: GPIO interrupt to which the chip is connected
- reset-gpios: Output GPIO pin used to reset the ST21NFCB

Optional SoC Specific Properties:
- pinctrl-names: Contains only one value - "default".
- pintctrl-0: Specifies the pin control groups used for this controller.
- ese-present: Specifies that an ese is physically connected to the nfc
controller.
- uicc-present: Specifies that the uicc swp signal can be physically
connected to the nfc controller.

Example (for ARM-based BeagleBoard xM with ST21NFCB on I2C2):

&i2c2 {

	status = "okay";

	st21nfcb: st21nfcb@8 {

		compatible = "st,st21nfcb-i2c";

		reg = <0x08>;
		clock-frequency = <400000>;

		interrupt-parent = <&gpio5>;
		interrupts = <2 IRQ_TYPE_LEVEL_HIGH>;

		reset-gpios = <&gpio5 29 GPIO_ACTIVE_HIGH>;

		ese-present;
		uicc-present;
	};
};
```
