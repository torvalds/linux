## Documentation/devicetree/bindings/net/mscc-phy-vsc8531.txt
```
* Microsemi - vsc8531 Giga bit ethernet phy

Optional properties:
- vsc8531,vddmac	: The vddmac in mV. Allowed values is listed
			  in the first row of Table 1 (below).
			  This property is only used in combination
			  with the 'edge-slowdown' property.
			  Default value is 3300.
- vsc8531,edge-slowdown	: % the edge should be slowed down relative to
			  the fastest possible edge time.
			  Edge rate sets the drive strength of the MAC
			  interface output signals.  Changing the
			  drive strength will affect the edge rate of
			  the output signal.  The goal of this setting
			  is to help reduce electrical emission (EMI)
			  by being able to reprogram drive strength
			  and in effect slow down the edge rate if
			  desired.
			  To adjust the edge-slowdown, the 'vddmac'
			  must be specified. Table 1 lists the
			  supported edge-slowdown values for a given
			  'vddmac'.
			  Default value is 0%.
			  Ref: Table:1 - Edge rate change (below).
- vsc8531,led-[N]-mode	: LED mode. Specify how the LED[N] should behave.
			  N depends on the number of LEDs supported by a
			  PHY.
			  Allowed values are defined in
			  "include/dt-bindings/net/mscc-phy-vsc8531.h".
			  Default values are VSC8531_LINK_1000_ACTIVITY (1),
			  VSC8531_LINK_100_ACTIVITY (2),
			  VSC8531_LINK_ACTIVITY (0) and
			  VSC8531_DUPLEX_COLLISION (8).
- load-save-gpios	: GPIO used for the load/save operation of the PTP
			  hardware clock (PHC).


Table: 1 - Edge rate change
----------------------------------------------------------------|
| 		Edge Rate Change (VDDMAC)			|
|								|
| 3300 mV	2500 mV		1800 mV		1500 mV		|
|---------------------------------------------------------------|
| 0%		0%		0%		0%		|
| (Fastest)			(recommended)	(recommended)	|
|---------------------------------------------------------------|
| 2%		3%		5%		6%		|
|---------------------------------------------------------------|
| 4%		6%		9%		14%		|
|---------------------------------------------------------------|
| 7%		10%		16%		21%		|
|(recommended)	(recommended)					|
|---------------------------------------------------------------|
| 10%		14%		23%		29%		|
|---------------------------------------------------------------|
| 17%		23%		35%		42%		|
|---------------------------------------------------------------|
| 29%		37%		52%		58%		|
|---------------------------------------------------------------|
| 53%		63%		76%		77%		|
| (slowest)							|
|---------------------------------------------------------------|

Example:

        vsc8531_0: ethernet-phy@0 {
                compatible = "ethernet-phy-id0007.0570";
                vsc8531,vddmac		= <3300>;
                vsc8531,edge-slowdown	= <7>;
                vsc8531,led-0-mode	= <VSC8531_LINK_1000_ACTIVITY>;
                vsc8531,led-1-mode	= <VSC8531_LINK_100_ACTIVITY>;
		load-save-gpios		= <&gpio 10 GPIO_ACTIVE_HIGH>;
        };
```

## Documentation/devicetree/bindings/net/mscc-phy-vsc8531.yaml
```yaml
# SPDX-License-Identifier: (GPL-2.0-only OR BSD-2-Clause)
%YAML 1.2
---
$id: http://devicetree.org/schemas/net/mscc-phy-vsc8531.yaml#
$schema: http://devicetree.org/meta-schemas/core.yaml#

title: Microsemi VSC8531 Gigabit Ethernet PHY

maintainers:
  - Lad Prabhakar <prabhakar.mahadev-lad.rj@bp.renesas.com>

description:
  The VSC8531 is a Gigabit Ethernet PHY with configurable MAC interface
  drive strength and LED modes.

allOf:
  - $ref: ethernet-phy.yaml#

select:
  properties:
    compatible:
      contains:
        enum:
          - ethernet-phy-id0007.0570 # VSC8531
          - ethernet-phy-id0007.0772 # VSC8541
  required:
    - compatible

properties:
  compatible:
    items:
      - enum:
          - ethernet-phy-id0007.0570 # VSC8531
          - ethernet-phy-id0007.0772 # VSC8541
      - const: ethernet-phy-ieee802.3-c22

  vsc8531,vddmac:
    $ref: /schemas/types.yaml#/definitions/uint32
    description:
      The VDDMAC voltage in millivolts. This property is used in combination
      with the edge-slowdown property to control the drive strength of the
      MAC interface output signals.
    enum: [3300, 2500, 1800, 1500]
    default: 3300

  vsc8531,edge-slowdown:
    $ref: /schemas/types.yaml#/definitions/uint32
    description: >
      Percentage by which the edge rate should be slowed down relative to
      the fastest possible edge time. This setting helps reduce electromagnetic
      interference (EMI) by adjusting the drive strength of the MAC interface
      output signals. Valid values depend on the vddmac voltage setting
      according to the edge rate change table in the datasheet.

      - When vsc8531,vddmac = 3300 mV: allowed values are 0, 2, 4, 7, 10, 17, 29, and 53.
        (Recommended: 7)
      - When vsc8531,vddmac = 2500 mV: allowed values are 0, 3, 6, 10, 14, 23, 37, and 63.
        (Recommended: 10)
      - When vsc8531,vddmac = 1800 mV: allowed values are 0, 5, 9, 16, 23, 35, 52, and 76.
        (Recommended: 0)
      - When vsc8531,vddmac = 1500 mV: allowed values are 0, 6, 14, 21, 29, 42, 58, and 77.
        (Recommended: 0)
    enum: [0, 2, 3, 4, 5, 6, 7, 9, 10, 14, 16, 17, 21, 23, 29, 35, 37, 42, 52, 53, 58, 63, 76, 77]
    default: 0

  vsc8531,led-0-mode:
    $ref: /schemas/types.yaml#/definitions/uint32
    description: LED[0] behavior mode. See include/dt-bindings/net/mscc-phy-vsc8531.h
      for available modes.
    minimum: 0
    maximum: 15
    default: 1

  vsc8531,led-1-mode:
    $ref: /schemas/types.yaml#/definitions/uint32
    description: LED[1] behavior mode. See include/dt-bindings/net/mscc-phy-vsc8531.h
      for available modes.
    minimum: 0
    maximum: 15
    default: 2

  vsc8531,led-2-mode:
    $ref: /schemas/types.yaml#/definitions/uint32
    description: LED[2] behavior mode. See include/dt-bindings/net/mscc-phy-vsc8531.h
      for available modes.
    minimum: 0
    maximum: 15
    default: 0

  vsc8531,led-3-mode:
    $ref: /schemas/types.yaml#/definitions/uint32
    description: LED[3] behavior mode. See include/dt-bindings/net/mscc-phy-vsc8531.h
      for available modes.
    minimum: 0
    maximum: 15
    default: 8

  load-save-gpios:
    description: GPIO phandle used for the load/save operation of the PTP hardware
      clock (PHC).
    maxItems: 1

dependencies:
  vsc8531,edge-slowdown:
    - vsc8531,vddmac

required:
  - compatible
  - reg

unevaluatedProperties: false

examples:
  - |
    #include <dt-bindings/gpio/gpio.h>
    #include <dt-bindings/net/mscc-phy-vsc8531.h>

    mdio {
        #address-cells = <1>;
        #size-cells = <0>;

        ethernet-phy@0 {
            compatible = "ethernet-phy-id0007.0772", "ethernet-phy-ieee802.3-c22";
            reg = <0>;
            vsc8531,vddmac = <3300>;
            vsc8531,edge-slowdown = <7>;
            vsc8531,led-0-mode = <VSC8531_LINK_1000_ACTIVITY>;
            vsc8531,led-1-mode = <VSC8531_LINK_100_ACTIVITY>;
            load-save-gpios = <&gpio 10 GPIO_ACTIVE_HIGH>;
        };
    };
```

## Documentation/devicetree/bindings/net/network-class.yaml
```yaml
# SPDX-License-Identifier: GPL-2.0-only OR BSD-2-Clause
%YAML 1.2
---
$id: http://devicetree.org/schemas/net/network-class.yaml#
$schema: http://devicetree.org/meta-schemas/core.yaml#

title: Network Class Common Properties

maintainers:
  - Devicetree Specification Mailing List <devicetree-spec@vger.kernel.org>

properties:
  address-bits:
    description:
      Specifies number of address bits required to address the device
      described by this node, e.g. size of the MAC address.
    default: 48
    const: 48

  local-mac-address:
    description:
      Specifies MAC address that was assigned to the network device described by
      the node containing this property.
    $ref: /schemas/types.yaml#/definitions/uint8-array
    minItems: 6
    maxItems: 6

  mac-address:
    description:
      Specifies the MAC address that was last used by the boot program. This
      property should be used in cases where the MAC address assigned to the
      device by the boot program is different from the
      local-mac-address property. This property shall be used only if the value
      differs from local-mac-address property value.
    $ref: /schemas/types.yaml#/definitions/uint8-array
    minItems: 6
    maxItems: 6

  max-frame-size:
    $ref: /schemas/types.yaml#/definitions/uint32
    description:
      Maximum transfer unit (IEEE defined MTU), rather than the
      maximum frame size (there\'s contradiction in the Devicetree
      Specification).

additionalProperties: true
```

## Documentation/devicetree/bindings/net/nfc/marvell,nci.yaml
```yaml
# SPDX-License-Identifier: GPL-2.0-only OR BSD-2-Clause
%YAML 1.2
---
$id: http://devicetree.org/schemas/net/nfc/marvell,nci.yaml#
$schema: http://devicetree.org/meta-schemas/core.yaml#

title: Marvell International Ltd. NCI NFC controller

maintainers:
  - Krzysztof Kozlowski <krzysztof.kozlowski@canonical.com>

properties:
  compatible:
    enum:
      - marvell,nfc-i2c
      - marvell,nfc-spi
      - marvell,nfc-uart

  hci-muxed:
    type: boolean
    description: |
      Specifies that the chip is muxing NCI over HCI frames

  interrupts:
    maxItems: 1

  reg:
    maxItems: 1

  reset-n-io:
    $ref: "/schemas/types.yaml#/definitions/phandle-array"
    maxItems: 1
    description: |
      Output GPIO pin used to reset the chip (active low)

  i2c-int-falling:
    type: boolean
    description: |
      For I2C type of connection. Specifies that the chip read event shall be
      trigged on falling edge.

  i2c-int-rising:
    type: boolean
    description: |
      For I2C type of connection.  Specifies that the chip read event shall be
      trigged on rising edge.

  break-control:
    type: boolean
    description: |
      For UART type of connection. Specifies that the chip needs specific break
      management.

  flow-control:
    type: boolean
    description: |
      For UART type of connection. Specifies that the chip is using RTS/CTS.

  spi-cpha: true
  spi-cpol: true
  spi-max-frequency: true

required:
  - compatible

allOf:
  - if:
      properties:
        compatible:
          contains:
            const: marvell,nfc-i2c
    then:
      properties:
        break-control: false
        flow-control: false
        spi-cpha: false
        spi-cpol: false
        spi-max-frequency: false
      required:
        - reg

  - if:
      properties:
        compatible:
          contains:
            const: marvell,nfc-spi
    then:
      properties:
        break-control: false
        flow-control: false
        i2c-int-falling: false
        i2c-int-rising: false
      required:
        - reg

  - if:
      properties:
        compatible:
          contains:
            const: marvell,nfc-uart
    then:
      properties:
        i2c-int-falling: false
        i2c-int-rising: false
        interrupts: false
        spi-cpha: false
        spi-cpol: false
        spi-max-frequency: false
        reg: false

additionalProperties: false

examples:
  - |
    #include <dt-bindings/gpio/gpio.h>
    #include <dt-bindings/interrupt-controller/irq.h>

    i2c {
        #address-cells = <1>;
        #size-cells = <0>;

        nfc@8 {
            compatible = "marvell,nfc-i2c";
            reg = <0x8>;

            interrupt-parent = <&gpio3>;
            interrupts = <21 IRQ_TYPE_EDGE_RISING>;

            i2c-int-rising;

            reset-n-io = <&gpio3 19 GPIO_ACTIVE_HIGH>;
        };
    };

  - |
    #include <dt-bindings/gpio/gpio.h>
    #include <dt-bindings/interrupt-controller/irq.h>

    spi {
        #address-cells = <1>;
        #size-cells = <0>;

        nfc@0 {
            compatible = "marvell,nfc-spi";
            reg = <0>;

            spi-max-frequency = <3000000>;
            spi-cpha;
            spi-cpol;

            interrupt-parent = <&gpio1>;
            interrupts = <17 IRQ_TYPE_EDGE_RISING>;

            reset-n-io = <&gpio3 19 GPIO_ACTIVE_HIGH>;
        };
    };

  - |
    #include <dt-bindings/gpio/gpio.h>

    uart {
        nfc {
            compatible = "marvell,nfc-uart";

            reset-n-io = <&gpio3 16 GPIO_ACTIVE_HIGH>;

            hci-muxed;
            flow-control;
        };
    };
```

## Documentation/devicetree/bindings/net/nfc/nfcmrvl.txt
```
* Marvell International Ltd. NCI NFC Controller

Required properties:
- compatible: Should be:
  - "marvell,nfc-uart" or "mrvl,nfc-uart" for UART devices
  - "marvell,nfc-i2c" for I2C devices
  - "marvell,nfc-spi" for SPI devices

Optional SoC specific properties:
- pinctrl-names: Contains only one value - "default".
- pintctrl-0: Specifies the pin control groups used for this controller.
- reset-n-io: Output GPIO pin used to reset the chip (active low).
- hci-muxed: Specifies that the chip is muxing NCI over HCI frames.

Optional UART-based chip specific properties:
- flow-control: Specifies that the chip is using RTS/CTS.
- break-control: Specifies that the chip needs specific break management.

Optional I2C-based chip specific properties:
- i2c-int-falling: Specifies that the chip read event shall be trigged on
  		   falling edge.
- i2c-int-rising: Specifies that the chip read event shall be trigged on
  		  rising edge.

Example (for ARM-based BeagleBoard Black with 88W8887 on UART5):

&uart5 {

	nfcmrvluart: nfcmrvluart@5 {
		compatible = "marvell,nfc-uart";

		reset-n-io = <&gpio3 16 0>;

		hci-muxed;
		flow-control;
        }
};


Example (for ARM-based BeagleBoard Black with 88W8887 on I2C1):

&i2c1 {
	clock-frequency = <400000>;

	nfcmrvli2c0: i2c@1 {
		compatible = "marvell,nfc-i2c";

		reg = <0x8>;

		/* I2C INT configuration */
		interrupt-parent = <&gpio3>;
		interrupts = <21 0>;

		/* I2C INT trigger configuration */
		i2c-int-rising;

		/* Reset IO */
		reset-n-io = <&gpio3 19 0>;
	};
};


Example (for ARM-based BeagleBoard Black on SPI0):

&spi0 {

	mrvlnfcspi0: spi@0 {
		compatible = "marvell,nfc-spi";

		reg = <0>;

		/* SPI Bus configuration */
		spi-max-frequency = <3000000>;
		spi-cpha;
		spi-cpol;

		/* SPI INT configuration */
		interrupt-parent = <&gpio1>;
		interrupts = <17 0>;

		/* Reset IO */
       		reset-n-io = <&gpio3 19 0>;
	};
};
```

## Documentation/devicetree/bindings/net/nfc/nxp,nci.yaml
```yaml
# SPDX-License-Identifier: GPL-2.0-only OR BSD-2-Clause
%YAML 1.2
---
$id: http://devicetree.org/schemas/net/nfc/nxp,nci.yaml#
$schema: http://devicetree.org/meta-schemas/core.yaml#

title: NXP Semiconductors NCI NFC controller

maintainers:
  - Krzysztof Kozlowski <krzk@kernel.org>

properties:
  compatible:
    oneOf:
      - const: nxp,nxp-nci-i2c
      - items:
          - enum:
              - nxp,nq310
              - nxp,pn547
              - nxp,pn553
          - const: nxp,nxp-nci-i2c

  enable-gpios:
    description: Output GPIO pin used for enabling/disabling the controller

  firmware-gpios:
    description: Output GPIO pin used to enter firmware download mode

  interrupts:
    maxItems: 1

  reg:
    maxItems: 1

required:
  - compatible
  - enable-gpios
  - interrupts
  - reg

additionalProperties: false

examples:
  - |
    #include <dt-bindings/gpio/gpio.h>
    #include <dt-bindings/interrupt-controller/irq.h>

    i2c {
        #address-cells = <1>;
        #size-cells = <0>;

        nfc@29 {
            compatible = "nxp,nxp-nci-i2c";

            reg = <0x29>;

            interrupt-parent = <&gpio1>;
            interrupts = <29 IRQ_TYPE_LEVEL_HIGH>;

            enable-gpios = <&gpio0 30 GPIO_ACTIVE_HIGH>;
            firmware-gpios = <&gpio0 31 GPIO_ACTIVE_HIGH>;
        };
    };
```
