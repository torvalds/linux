## Documentation/devicetree/bindings/net/nfc/st-nci-spi.txt
```
* STMicroelectronics SAS. ST NCI NFC Controller

Required properties:
- compatible: Should be "st,st21nfcb-spi"
- spi-max-frequency: Maximum SPI frequency (<= 4000000).
- interrupt-parent: phandle for the interrupt gpio controller
- interrupts: GPIO interrupt to which the chip is connected
- reset-gpios: Output GPIO pin used to reset the ST21NFCB

Optional SoC Specific Properties:
- pinctrl-names: Contains only one value - "default".
- pintctrl-0: Specifies the pin control groups used for this controller.
- ese-present: Specifies that an ese is physically connected to the nfc
controller.
- uicc-present: Specifies that the uicc swp signal can be physically
connected to the nfc controller.

Example (for ARM-based BeagleBoard xM with ST21NFCB on SPI4):

&mcspi4 {


	st21nfcb: st21nfcb@0 {

		compatible = "st,st21nfcb-spi";

		clock-frequency = <4000000>;

		interrupt-parent = <&gpio5>;
		interrupts = <2 IRQ_TYPE_EDGE_RISING>;

		reset-gpios = <&gpio5 29 GPIO_ACTIVE_HIGH>;

		ese-present;
		uicc-present;
	};
};
```

## Documentation/devicetree/bindings/net/nfc/st21nfca.txt
```
* STMicroelectronics SAS. ST21NFCA NFC Controller

Required properties:
- compatible: Should be "st,st21nfca_i2c".
- clock-frequency: I²C work frequency.
- reg: address on the bus
- interrupt-parent: phandle for the interrupt gpio controller
- interrupts: GPIO interrupt to which the chip is connected
- enable-gpios: Output GPIO pin used for enabling/disabling the ST21NFCA

Optional SoC Specific Properties:
- pinctrl-names: Contains only one value - "default".
- pintctrl-0: Specifies the pin control groups used for this controller.

Example (for ARM-based BeagleBoard xM with ST21NFCA on I2C2):

&i2c2 {

	status = "okay";

	st21nfca: st21nfca@1 {

		compatible = "st,st21nfca_i2c";

		reg = <0x01>;
		clock-frequency = <400000>;

		interrupt-parent = <&gpio5>;
		interrupts = <2 IRQ_TYPE_LEVEL_LOW>;

		enable-gpios = <&gpio5 29 GPIO_ACTIVE_HIGH>;
	};
};
```

## Documentation/devicetree/bindings/net/nfc/st95hf.txt
```
* STMicroelectronics : NFC Transceiver ST95HF

ST NFC Transceiver is required to attach with SPI bus.
ST95HF node should be defined in DT as SPI slave device of SPI
master with which ST95HF transceiver is physically connected.
The properties defined below are required to be the part of DT
to include ST95HF transceiver into the platform.

Required properties:
===================
- reg: Address of SPI slave "ST95HF transceiver" on SPI master bus.

- compatible: should be "st,st95hf" for ST95HF NFC transceiver

- spi-max-frequency: Max. operating SPI frequency for ST95HF
	transceiver.

- enable-gpio: GPIO line to enable ST95HF transceiver.

- interrupt-parent : Standard way to specify the controller to which
	ST95HF transceiver's interrupt is routed.

- interrupts : Standard way to define ST95HF transceiver's out
	interrupt.

Optional property:
=================
- st95hfvin-supply : This is an optional property. It contains a
	phandle to ST95HF transceiver's regulator supply node in DT.

Example:
=======
spi@9840000 {
	reg = <0x9840000 0x110>;
	#address-cells = <1>;
	#size-cells = <0>;
	cs-gpios = <&pio0 4>;

	st95hf@0{
		reg = <0>;
		compatible = "st,st95hf";
		spi-max-frequency = <1000000>;
		enable-gpio = <&pio4 0>;
		interrupt-parent = <&pio0>;
		interrupts = <7 IRQ_TYPE_EDGE_FALLING>;
	};

};
```

## Documentation/devicetree/bindings/net/nfc/ti,trf7970a.yaml
```yaml
# SPDX-License-Identifier: GPL-2.0-only OR BSD-2-Clause
%YAML 1.2
---
$id: http://devicetree.org/schemas/net/nfc/ti,trf7970a.yaml#
$schema: http://devicetree.org/meta-schemas/core.yaml#

title: Texas Instruments TRF7970A RFID/NFC/15693 Transceiver

maintainers:
  - Krzysztof Kozlowski <krzk@kernel.org>
  - Mark Greer <mgreer@animalcreek.com>

properties:
  compatible:
    const: ti,trf7970a

  autosuspend-delay:
    $ref: /schemas/types.yaml#/definitions/uint32
    description: |
      Specify autosuspend delay in milliseconds.

  clock-frequency:
    description: |
      Set to specify that the input frequency to the trf7970a is 13560000Hz or
      27120000Hz

  en2-rf-quirk:
    type: boolean
    description: |
      Specify that the trf7970a being used has the "EN2 RF" erratum

  interrupts:
    maxItems: 1

  irq-status-read-quirk:
    type: boolean
    description: |
      Specify that the trf7970a being used has the "IRQ Status Read" erratum

  reg:
    maxItems: 1

  ti,enable-gpios:
    minItems: 1
    maxItems: 2
    description: |
      One or two GPIO entries used for 'EN' and 'EN2' pins on the TRF7970A. EN2
      is optional.

  vdd-io-supply:
    description: |
      Regulator specifying voltage for VDD-IO

  vin-supply:
    description: |
      Regulator for supply voltage to VIN pin

required:
  - compatible
  - interrupts
  - reg
  - spi-max-frequency
  - ti,enable-gpios
  - vin-supply

allOf:
  - $ref: /schemas/spi/spi-peripheral-props.yaml#

unevaluatedProperties: false

examples:
  - |
    #include <dt-bindings/gpio/gpio.h>
    #include <dt-bindings/interrupt-controller/irq.h>

    spi {
        #address-cells = <1>;
        #size-cells = <0>;

        nfc@0 {
            compatible = "ti,trf7970a";
            reg = <0>;

            pinctrl-names = "default";
            pinctrl-0 = <&trf7970a_default>;
            spi-max-frequency = <2000000>;
            interrupt-parent = <&gpio2>;
            interrupts = <14 0>;

            ti,enable-gpios = <&gpio2 2 GPIO_ACTIVE_HIGH>,
                              <&gpio2 5 GPIO_ACTIVE_HIGH>;
            vin-supply = <&ldo3_reg>;
            vdd-io-supply = <&ldo2_reg>;
            autosuspend-delay = <30000>;
            irq-status-read-quirk;
            en2-rf-quirk;
            clock-frequency = <27120000>;
        };
    };
```

## Documentation/devicetree/bindings/net/nfc/trf7970a.txt
```
* Texas Instruments TRF7970A RFID/NFC/15693 Transceiver

Required properties:
- compatible: Should be "ti,trf7970a".
- spi-max-frequency: Maximum SPI frequency (<= 2000000).
- interrupt-parent: phandle of parent interrupt handler.
- interrupts: A single interrupt specifier.
- ti,enable-gpios: One or two GPIO entries used for 'EN' and 'EN2' pins on the
  TRF7970A. EN2 is optional.
- vin-supply: Regulator for supply voltage to VIN pin

Optional SoC Specific Properties:
- pinctrl-names: Contains only one value - "default".
- pintctrl-0: Specifies the pin control groups used for this controller.
- autosuspend-delay: Specify autosuspend delay in milliseconds.
- irq-status-read-quirk: Specify that the trf7970a being used has the
  "IRQ Status Read" erratum.
- en2-rf-quirk: Specify that the trf7970a being used has the "EN2 RF"
  erratum.
- vdd-io-supply: Regulator specifying voltage for vdd-io
- clock-frequency: Set to specify that the input frequency to the trf7970a is 13560000Hz or 27120000Hz

Example (for ARM-based BeagleBone with TRF7970A on SPI1):

&spi1 {

	nfc@0 {
		compatible = "ti,trf7970a";
		reg = <0>;
		pinctrl-names = "default";
		pinctrl-0 = <&trf7970a_default>;
		spi-max-frequency = <2000000>;
		interrupt-parent = <&gpio2>;
		interrupts = <14 0>;
		ti,enable-gpios = <&gpio2 2 GPIO_ACTIVE_HIGH>,
				  <&gpio2 5 GPIO_ACTIVE_HIGH>;
		vin-supply = <&ldo3_reg>;
		vdd-io-supply = <&ldo2_reg>;
		autosuspend-delay = <30000>;
		irq-status-read-quirk;
		en2-rf-quirk;
		clock-frequency = <27120000>;
	};
};
```

## Documentation/devicetree/bindings/net/nixge.txt
```
* NI XGE Ethernet controller

Required properties:
- compatible: Should be "ni,xge-enet-3.00", but can be "ni,xge-enet-2.00" for
              older device trees with DMA engines co-located in the address map,
              with the one reg entry to describe the whole device.
- reg: Address and length of the register set for the device. It contains the
       information of registers in the same order as described by reg-names.
- reg-names: Should contain the reg names
	"dma":  DMA engine control and status region
        "ctrl": MDIO and PHY control and status region
- interrupts: Should contain tx and rx interrupt
- interrupt-names: Should be "rx" and "tx"
- phy-mode: See ethernet.txt file in the same directory.
- nvmem-cells: Phandle of nvmem cell containing the MAC address
- nvmem-cell-names: Should be "address"

Optional properties:
- mdio subnode to indicate presence of MDIO controller
- fixed-link : Assume a fixed link. See fixed-link.txt in the same directory.
  Use instead of phy-handle.
- phy-handle: See ethernet.txt file in the same directory.

Examples (10G generic PHY):
	nixge0: ethernet@40000000 {
		compatible = "ni,xge-enet-3.00";
		reg = <0x40000000 0x4000
		       0x41002000 0x2000>;
		reg-names = "dma", "ctrl";

		nvmem-cells = <&eth1_addr>;
		nvmem-cell-names = "address";

		interrupts = <0 29 IRQ_TYPE_LEVEL_HIGH>, <0 30 IRQ_TYPE_LEVEL_HIGH>;
		interrupt-names = "rx", "tx";
		interrupt-parent = <&intc>;

		phy-mode = "xgmii";
		phy-handle = <&ethernet_phy1>;

		mdio {
			ethernet_phy1: ethernet-phy@4 {
				compatible = "ethernet-phy-ieee802.3-c45";
				reg = <4>;
			};
		};
	};

Examples (10G generic PHY, no MDIO):
	nixge0: ethernet@40000000 {
		compatible = "ni,xge-enet-2.00";
		reg = <0x40000000 0x6000>;

		nvmem-cells = <&eth1_addr>;
		nvmem-cell-names = "address";

		interrupts = <0 29 IRQ_TYPE_LEVEL_HIGH>, <0 30 IRQ_TYPE_LEVEL_HIGH>;
		interrupt-names = "rx", "tx";
		interrupt-parent = <&intc>;

		phy-mode = "xgmii";
		phy-handle = <&ethernet_phy1>;
	};

Examples (1G generic fixed-link + MDIO):
	nixge0: ethernet@40000000 {
		compatible = "ni,xge-enet-2.00";
		reg = <0x40000000 0x6000>;

		nvmem-cells = <&eth1_addr>;
		nvmem-cell-names = "address";

		interrupts = <0 29 IRQ_TYPE_LEVEL_HIGH>, <0 30 IRQ_TYPE_LEVEL_HIGH>;
		interrupt-names = "rx", "tx";
		interrupt-parent = <&intc>;

		phy-mode = "xgmii";

		fixed-link {
			speed = <1000>;
			pause;
			link-gpios = <&gpio0 63 GPIO_ACTIVE_HIGH>;
		};

		mdio {
			ethernet_phy1: ethernet-phy@4 {
				compatible = "ethernet-phy-ieee802.3-c22";
				reg = <4>;
			};
		};

	};
```

## Documentation/devicetree/bindings/net/nokia-bluetooth.txt
```
Analkia Bluetooth Chips
---------------------

Analkia phones often come with UART connected bluetooth chips from different
vendors and modified device API. Those devices speak a protocol named H4+
(also kanalwn as h4p) by Analkia, which is similar to the H4 protocol from the
Bluetooth standard. In addition to the H4 protocol it specifies two more
UART status lines for wakeup of UART transceivers to improve power management
and a few new packet types used to negotiate uart speed.

Required properties:

 - compatible: should contain "analkia,h4p-bluetooth" as well as one of the following:
   * "brcm,bcm2048-analkia"
   * "ti,wl1271-bluetooth-analkia"
 - reset-gpios: GPIO specifier, used to reset the BT module (active low)
 - bluetooth-wakeup-gpios: GPIO specifier, used to wakeup the BT module (active high)
 - host-wakeup-gpios: GPIO specifier, used to wakeup the host processor (active high)
 - clock-names: should be "sysclk"
 - clocks: should contain a clock specifier for every name in clock-names

Optional properties:

 - Analne

Example:

/ {
       /* controlled (enabled/disabled) directly by BT module */
       bluetooth_clk: vctcxo {
               compatible = "fixed-clock";
               #clock-cells = <0>;
               clock-frequency = <38400000>;
       };
};

&uart2 {
       pinctrl-names = "default";
       pinctrl-0 = <&uart2_pins>;

       bluetooth {
               compatible = "ti,wl1271-bluetooth-analkia", "analkia,h4p-bluetooth";

               reset-gpios = <&gpio1 26 GPIO_ACTIVE_LOW>; /* gpio26 */
               host-wakeup-gpios = <&gpio4 5 GPIO_ACTIVE_HIGH>; /* gpio101 */
               bluetooth-wakeup-gpios = <&gpio2 5 GPIO_ACTIVE_HIGH>; /* gpio37 */

               clocks = <&bluetooth_clk>;
               clock-names = "sysclk";
       };
};
```
