## Documentation/devicetree/bindings/net/realtek,rtl82xx.yaml
```yaml
# SPDX-License-Identifier: GPL-2.0+
%YAML 1.2
---
$id: http://devicetree.org/schemas/net/realtek,rtl82xx.yaml#
$schema: http://devicetree.org/meta-schemas/core.yaml#

title: Realtek RTL82xx PHY

maintainers:
  - Andrew Lunn <andrew@lunn.ch>
  - Florian Fainelli <f.fainelli@gmail.com>
  - Heiner Kallweit <hkallweit1@gmail.com>

description:
  Bindings for Realtek RTL82xx PHYs

properties:
  compatible:
    enum:
      - ethernet-phy-id001c.c800
      - ethernet-phy-id001c.c816
      - ethernet-phy-id001c.c838
      - ethernet-phy-id001c.c840
      - ethernet-phy-id001c.c848
      - ethernet-phy-id001c.c849
      - ethernet-phy-id001c.c84a
      - ethernet-phy-id001c.c862
      - ethernet-phy-id001c.c878
      - ethernet-phy-id001c.c880
      - ethernet-phy-id001c.c910
      - ethernet-phy-id001c.c912
      - ethernet-phy-id001c.c913
      - ethernet-phy-id001c.c914
      - ethernet-phy-id001c.c915
      - ethernet-phy-id001c.c916
      - ethernet-phy-id001c.c942
      - ethernet-phy-id001c.c961
      - ethernet-phy-id001c.cad0
      - ethernet-phy-id001c.cb00

  leds: true

  realtek,clkout-disable:
    type: boolean
    description:
      Disable CLKOUT clock, CLKOUT clock default is enabled after hardware reset.

  realtek,aldps-enable:
    type: boolean
    description:
      Enable ALDPS mode, ALDPS mode default is disabled after hardware reset.

  wakeup-source:
    type: boolean
    description:
      Enable Wake-on-LAN support for the RTL8211F PHY.

unevaluatedProperties: false

allOf:
  - $ref: ethernet-phy.yaml#
  - if:
      not:
        properties:
          compatible:
            contains:
              const: ethernet-phy-id001c.c916
    then:
      properties:
        leds: false

examples:
  - |
    mdio {
        #address-cells = <1>;
        #size-cells = <0>;

        ethphy1: ethernet-phy@1 {
                reg = <1>;
                realtek,clkout-disable;
                realtek,aldps-enable;
        };
    };
```

## Documentation/devicetree/bindings/net/realtek,rtl9301-switch.yaml
```yaml
# SPDX-License-Identifier: (GPL-2.0-only OR BSD-2-Clause)
%YAML 1.2
---
$id: http://devicetree.org/schemas/net/realtek,rtl9301-switch.yaml#
$schema: http://devicetree.org/meta-schemas/core.yaml#

title: Realtek Switch with Internal CPU

maintainers:
  - Chris Packham <chris.packham@alliedtelesis.co.nz>

description:
  The RTL9300 is a series of is an Ethernet switches with an integrated CPU. A
  number of different peripherals are accessed through a common register block,
  represented here as a syscon node.

$ref: ethernet-switch.yaml#/$defs/ethernet-ports

properties:
  compatible:
    items:
      - enum:
          - realtek,rtl9301-switch
          - realtek,rtl9302b-switch
          - realtek,rtl9302c-switch
          - realtek,rtl9303-switch
      - const: syscon
      - const: simple-mfd

  reg:
    maxItems: 1

  interrupts:
    maxItems: 2

  interrupt-names:
    items:
      - const: switch
      - const: nic

  '#address-cells':
    const: 1

  '#size-cells':
    const: 1

  ethernet-ports:
    type: object

patternProperties:
  'reboot@[0-9a-f]+$':
    $ref: /schemas/power/reset/syscon-reboot.yaml#

  'i2c@[0-9a-f]+$':
    $ref: /schemas/i2c/realtek,rtl9301-i2c.yaml#

  'mdio-controller@[0-9a-f]+$':
    $ref: realtek,rtl9301-mdio.yaml#

required:
  - compatible
  - reg
  - interrupts
  - interrupt-names

additionalProperties: false

examples:
  - |
    ethernet-switch@1b000000 {
      compatible = "realtek,rtl9301-switch", "syscon", "simple-mfd";
      reg = <0x1b000000 0x10000>;
      interrupt-parent = <&intc>;
      interrupts = <23>, <24>;
      interrupt-names = "switch", "nic";
      #address-cells = <1>;
      #size-cells = <1>;

      reboot@c {
        compatible = "syscon-reboot";
        reg = <0x0c 0x4>;
        value = <0x01>;
      };

      i2c@36c {
        compatible = "realtek,rtl9301-i2c";
        reg = <0x36c 0x14>;
        #address-cells = <1>;
        #size-cells = <0>;

        i2c@0 {
          reg = <0>;
          #address-cells = <1>;
          #size-cells = <0>;
          gpio@20 {
            compatible = "nxp,pca9555";
            gpio-controller;
            #gpio-cells = <2>;
            reg = <0x20>;
          };
        };

        i2c@2 {
          reg = <2>;
          #address-cells = <1>;
          #size-cells = <0>;
          gpio@20 {
            compatible = "nxp,pca9555";
            gpio-controller;
            #gpio-cells = <2>;
            reg = <0x20>;
          };
        };
      };

      i2c@388 {
        compatible = "realtek,rtl9301-i2c";
        reg = <0x388 0x14>;
        #address-cells = <1>;
        #size-cells = <0>;

        i2c@7 {
          reg = <7>;
          #address-cells = <1>;
          #size-cells = <0>;
          gpio@20 {
            compatible = "nxp,pca9555";
            gpio-controller;
            #gpio-cells = <2>;
            reg = <0x20>;
          };
        };
      };

      mdio-controller@ca00 {
        compatible = "realtek,rtl9301-mdio";
        reg = <0xca00 0x200>;
        #address-cells = <1>;
        #size-cells = <0>;

        mdio-bus@0 {
          reg = <0>;
          #address-cells = <1>;
          #size-cells = <0>;

          phy1: ethernet-phy@0 {
            reg = <0>;
          };
        };
        mdio-bus@1 {
          reg = <1>;
          #address-cells = <1>;
          #size-cells = <0>;

          phy2: ethernet-phy@0 {
            reg = <0>;
          };
        };
      };

      ethernet-ports {
        #address-cells = <1>;
        #size-cells = <0>;

        port@0 {
          reg = <0>;
          phy-handle = <&phy1>;
        };
        port@1 {
          reg = <1>;
          phy-handle = <&phy2>;
        };
      };
    };
```

## Documentation/devicetree/bindings/net/realtek-bluetooth.yaml
```yaml
# SPDX-License-Identifier: GPL-2.0
%YAML 1.2
---
$id: http://devicetree.org/schemas/net/realtek-bluetooth.yaml#
$schema: http://devicetree.org/meta-schemas/core.yaml#

title: RTL8723BS/RTL8723CS/RTL8822CS Bluetooth

maintainers:
  - Vasily Khoruzhick <anarsoul@gmail.com>
  - Alistair Francis <alistair@alistair23.me>

description:
  RTL8723CS/RTL8723CS/RTL8822CS is WiFi + BT chip. WiFi part is connected over
  SDIO, while BT is connected over serial. It speaks H5 protocol with few
  extra commands to upload firmware and change module speed.

properties:
  compatible:
    enum:
      - realtek,rtl8723bs-bt
      - realtek,rtl8723cs-bt
      - realtek,rtl8723ds-bt
      - realtek,rtl8822cs-bt

  device-wake-gpios:
    maxItems: 1
    description: GPIO specifier, used to wakeup the BT module

  enable-gpios:
    maxItems: 1
    description: GPIO specifier, used to enable the BT module

  host-wake-gpios:
    maxItems: 1
    description: GPIO specifier, used to wakeup the host processor

  max-speed: true

required:
  - compatible

additionalProperties: false

examples:
  - |
    #include <dt-bindings/gpio/gpio.h>

    uart1 {
        pinctrl-names = "default";
        pinctrl-0 = <&uart1_pins>, <&uart1_rts_cts_pins>;
        uart-has-rtscts;

        bluetooth {
            compatible = "realtek,rtl8723bs-bt";
            device-wake-gpios = <&r_pio 0 5 GPIO_ACTIVE_HIGH>; /* PL5 */
            host-wake-gpios = <&r_pio 0 6 GPIO_ACTIVE_HIGH>; /* PL6 */
        };
    };
```

## Documentation/devicetree/bindings/net/renesas,ether.yaml
```yaml
# SPDX-License-Identifier: GPL-2.0
%YAML 1.2
---
$id: http://devicetree.org/schemas/net/renesas,ether.yaml#
$schema: http://devicetree.org/meta-schemas/core.yaml#

title: Renesas Electronics SH EtherMAC

allOf:
  - $ref: ethernet-controller.yaml#

maintainers:
  - Sergei Shtylyov <sergei.shtylyov@gmail.com>

properties:
  compatible:
    oneOf:
      - items:
          - enum:
              - renesas,gether-r8a7740   # device is a part of R8A7740 SoC
              - renesas,gether-r8a77980  # device is a part of R8A77980 SoC
              - renesas,ether-r7s72100   # device is a part of R7S72100 SoC
              - renesas,ether-r7s9210    # device is a part of R7S9210 SoC
      - items:
          - enum:
              - renesas,ether-r8a7778    # device is a part of R8A7778 SoC
              - renesas,ether-r8a7779    # device is a part of R8A7779 SoC
          - enum:
              - renesas,rcar-gen1-ether  # a generic R-Car Gen1 device
      - items:
          - enum:
              - renesas,ether-r8a7742    # device is a part of R8A7742 SoC
              - renesas,ether-r8a7743    # device is a part of R8A7743 SoC
              - renesas,ether-r8a7745    # device is a part of R8A7745 SoC
              - renesas,ether-r8a7790    # device is a part of R8A7790 SoC
              - renesas,ether-r8a7791    # device is a part of R8A7791 SoC
              - renesas,ether-r8a7793    # device is a part of R8A7793 SoC
              - renesas,ether-r8a7794    # device is a part of R8A7794 SoC
          - enum:
              - renesas,rcar-gen2-ether  # a generic R-Car Gen2 or RZ/G1 device

  reg:
    items:
      - description: E-DMAC/feLic registers
      - description: TSU registers
    minItems: 1

  interrupts:
    maxItems: 1

  '#address-cells':
    description: number of address cells for the MDIO bus
    const: 1

  '#size-cells':
    description: number of size cells on the MDIO bus
    const: 0

  clocks:
    maxItems: 1

  power-domains:
    maxItems: 1

  resets:
    maxItems: 1

  phy-mode: true

  phy-handle: true

  renesas,no-ether-link:
    type: boolean
    description:
      specify when a board does not provide a proper Ether LINK signal

  renesas,ether-link-active-low:
    type: boolean
    description:
      specify when the Ether LINK signal is active-low instead of normal
      active-high

patternProperties:
  "^ethernet-phy@[0-9a-f]$":
    type: object
    $ref: ethernet-phy.yaml#

required:
  - compatible
  - reg
  - interrupts
  - phy-mode
  - phy-handle
  - '#address-cells'
  - '#size-cells'
  - clocks

additionalProperties: false

examples:
  # Lager board
  - |
    #include <dt-bindings/clock/r8a7790-cpg-mssr.h>
    #include <dt-bindings/interrupt-controller/arm-gic.h>
    #include <dt-bindings/power/r8a7790-sysc.h>
    #include <dt-bindings/gpio/gpio.h>

    ethernet@ee700000 {
        compatible = "renesas,ether-r8a7790", "renesas,rcar-gen2-ether";
        reg = <0xee700000 0x400>;
        interrupts = <GIC_SPI 162 IRQ_TYPE_LEVEL_HIGH>;
        clocks = <&cpg CPG_MOD 813>;
        power-domains = <&sysc R8A7790_PD_ALWAYS_ON>;
        resets = <&cpg 813>;
        phy-mode = "rmii";
        phy-handle = <&phy1>;
        renesas,ether-link-active-low;
        #address-cells = <1>;
        #size-cells = <0>;

        phy1: ethernet-phy@1 {
            compatible = "ethernet-phy-id0022.1537",
                         "ethernet-phy-ieee802.3-c22";
            reg = <1>;
            interrupt-parent = <&irqc0>;
            interrupts = <0 IRQ_TYPE_LEVEL_LOW>;
            micrel,led-mode = <1>;
            reset-gpios = <&gpio5 31 GPIO_ACTIVE_LOW>;
        };
    };
```
