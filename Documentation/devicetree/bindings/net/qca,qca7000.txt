## Documentation/devicetree/bindings/net/qca,qca7000.txt
```
* Qualcomm QCA7000

The QCA7000 is a serial-to-powerline bridge with a host interface which could
be configured either as SPI or UART slave. This configuration is done by
the QCA7000 firmware.

(a) Ethernet over SPI

In order to use the QCA7000 as SPI device it must be defined as a child of a
SPI master in the device tree.

Required properties:
- compatible	    : Should be "qca,qca7000"
- reg		    : Should specify the SPI chip select
- interrupts	    : The first cell should specify the index of the source
		      interrupt and the second cell should specify the trigger
		      type as rising edge
- spi-cpha	    : Must be set
- spi-cpol	    : Must be set

Optional properties:
- spi-max-frequency : Maximum frequency of the SPI bus the chip can operate at.
		      Numbers smaller than 1000000 or greater than 16000000
		      are invalid. Missing the property will set the SPI
		      frequency to 8000000 Hertz.
- local-mac-address : see ./ethernet.txt
- qca,legacy-mode   : Set the SPI data transfer of the QCA7000 to legacy mode.
		      In this mode the SPI master must toggle the chip select
		      between each data word. In burst mode these gaps aren't
		      necessary, which is faster. This setting depends on how
		      the QCA7000 is setup via GPIO pin strapping. If the
		      property is missing the driver defaults to burst mode.

SPI Example:

/* Freescale i.MX28 SPI master*/
ssp2: spi@80014000 {
	#address-cells = <1>;
	#size-cells = <0>;
	compatible = "fsl,imx28-spi";
	pinctrl-names = "default";
	pinctrl-0 = <&spi2_pins_a>;

	qca7000: ethernet@0 {
		compatible = "qca,qca7000";
		reg = <0x0>;
		interrupt-parent = <&gpio3>;      /* GPIO Bank 3 */
		interrupts = <25 0x1>;            /* Index: 25, rising edge */
		spi-cpha;                         /* SPI mode: CPHA=1 */
		spi-cpol;                         /* SPI mode: CPOL=1 */
		spi-max-frequency = <8000000>;    /* freq: 8 MHz */
		local-mac-address = [ A0 B0 C0 D0 E0 F0 ];
	};
};

(b) Ethernet over UART

In order to use the QCA7000 as UART slave it must be defined as a child of a
UART master in the device tree. It is possible to preconfigure the UART
settings of the QCA7000 firmware, but it's not possible to change them during
runtime.

Required properties:
- compatible        : Should be "qca,qca7000"

Optional properties:
- local-mac-address : see ./ethernet.txt
- current-speed     : current baud rate of QCA7000 which defaults to 115200
		      if absent, see also ../serial/slave-device.txt

UART Example:

/* Freescale i.MX28 UART */
auart0: serial@8006a000 {
	compatible = "fsl,imx28-auart", "fsl,imx23-auart";
	reg = <0x8006a000 0x2000>;
	pinctrl-names = "default";
	pinctrl-0 = <&auart0_2pins_a>;

	qca7000: ethernet {
		compatible = "qca,qca7000";
		local-mac-address = [ A0 B0 C0 D0 E0 F0 ];
		current-speed = <38400>;
	};
};
```

## Documentation/devicetree/bindings/net/qca,qca7000.yaml
```yaml
# SPDX-License-Identifier: (GPL-2.0-only OR BSD-2-Clause)
%YAML 1.2
---
$id: http://devicetree.org/schemas/net/qca,qca7000.yaml#
$schema: http://devicetree.org/meta-schemas/core.yaml#

title: Qualcomm QCA7000

maintainers:
  - Frank Li <Frank.Li@nxp.com>

description: |
  The QCA7000 is a serial-to-powerline bridge with a host interface which could
  be configured either as SPI or UART slave. This configuration is done by
  the QCA7000 firmware.

  (a) Ethernet over SPI

  In order to use the QCA7000 as SPI device it must be defined as a child of a
  SPI master in the device tree.

  (b) Ethernet over UART

  In order to use the QCA7000 as UART slave it must be defined as a child of a
  UART master in the device tree. It is possible to preconfigure the UART
  settings of the QCA7000 firmware, but it's not possible to change them during
  runtime

properties:
  compatible:
    const: qca,qca7000

  reg:
    maxItems: 1

  interrupts:
    maxItems: 1

  qca,legacy-mode:
    $ref: /schemas/types.yaml#/definitions/flag
    description:
      Set the SPI data transfer of the QCA7000 to legacy mode.
      In this mode the SPI master must toggle the chip select
      between each data word. In burst mode these gaps aren't
      necessary, which is faster. This setting depends on how
      the QCA7000 is setup via GPIO pin strapping. If the
      property is missing the driver defaults to burst mode.

allOf:
  - $ref: ethernet-controller.yaml#

  - if:
      required:
        - reg

    then:
      properties:
        spi-cpha: true

        spi-cpol: true

        spi-max-frequency:
          default: 8000000
          maximum: 16000000
          minimum: 1000000

      allOf:
        - $ref: /schemas/spi/spi-peripheral-props.yaml#

    else:
      properties:
        current-speed:
          default: 115200

        qca,legacy-mode: false

      allOf:
        - $ref: /schemas/serial/serial-peripheral-props.yaml#

unevaluatedProperties: false

examples:
  - |
    #include <dt-bindings/interrupt-controller/irq.h>

    spi {
        #address-cells = <1>;
        #size-cells = <0>;

        ethernet@0 {
            compatible = "qca,qca7000";
            reg = <0x0>;
            interrupt-parent = <&gpio3>;
            interrupts = <25 IRQ_TYPE_EDGE_RISING>;
            spi-cpha;
            spi-cpol;
            spi-max-frequency = <8000000>;
            local-mac-address = [ a0 b0 c0 d0 e0 f0 ];
        };
    };

  - |
    serial {
        ethernet {
            compatible = "qca,qca7000";
            local-mac-address = [ a0 b0 c0 d0 e0 f0 ];
            current-speed = <38400>;
        };
    };
```

## Documentation/devicetree/bindings/net/qca,qca808x.yaml
```yaml
# SPDX-License-Identifier: GPL-2.0-only OR BSD-2-Clause
%YAML 1.2
---
$id: http://devicetree.org/schemas/net/qca,qca808x.yaml#
$schema: http://devicetree.org/meta-schemas/core.yaml#

title: Qualcomm Atheros QCA808X PHY

maintainers:
  - Christian Marangi <ansuelsmth@gmail.com>

description:
  QCA808X PHYs can have up to 3 LEDs attached.
  All 3 LEDs are disabled by default.
  2 LEDs have dedicated pins with the 3rd LED having the
  double function of Interrupt LEDs/GPIO or additional LED.

  By default this special PIN is set to LED function.

allOf:
  - $ref: ethernet-phy.yaml#

properties:
  compatible:
    enum:
      - ethernet-phy-id004d.d101

unevaluatedProperties: false

examples:
  - |
    #include <dt-bindings/leds/common.h>

    mdio {
        #address-cells = <1>;
        #size-cells = <0>;

        ethernet-phy@0 {
            compatible = "ethernet-phy-id004d.d101";
            reg = <0>;

            leds {
                #address-cells = <1>;
                #size-cells = <0>;

                led@0 {
                    reg = <0>;
                    color = <LED_COLOR_ID_GREEN>;
                    function = LED_FUNCTION_WAN;
                    default-state = "keep";
                };
            };
        };
    };
```

## Documentation/devicetree/bindings/net/qcom,bam-dmux.yaml
```yaml
# SPDX-License-Identifier: (GPL-2.0-only OR BSD-2-Clause)
%YAML 1.2
---
$id: http://devicetree.org/schemas/net/qcom,bam-dmux.yaml#
$schema: http://devicetree.org/meta-schemas/core.yaml#

title: Qualcomm BAM Data Multiplexer

maintainers:
  - Stephan Gerhold <stephan@gerhold.net>

description: |
  The BAM Data Multiplexer provides access to the network data channels
  of modems integrated into many older Qualcomm SoCs, e.g. Qualcomm MSM8916
  or MSM8974. It is built using a simple protocol layer on top of a DMA engine
  (Qualcomm BAM DMA) and bidirectional interrupts to coordinate power control.

  Note that this schema does not directly describe a hardware block but rather
  a firmware convention that combines several other hardware blocks (such as the
  DMA engine). As such it is specific to a firmware version, not a particular
  SoC or hardware version.

properties:
  compatible:
    const: qcom,bam-dmux

  interrupts:
    description:
      Interrupts used by the modem to signal the AP.
      Both interrupts must be declared as IRQ_TYPE_EDGE_BOTH.
    items:
      - description: Power control
      - description: Power control acknowledgment

  interrupt-names:
    items:
      - const: pc
      - const: pc-ack

  qcom,smem-states:
    $ref: /schemas/types.yaml#/definitions/phandle-array
    description: State bits used by the AP to signal the modem.
    items:
      - description: Power control
      - description: Power control acknowledgment

  qcom,smem-state-names:
    description: Names for the state bits used by the AP to signal the modem.
    items:
      - const: pc
      - const: pc-ack

  dmas:
    items:
      - description: TX DMA channel phandle
      - description: RX DMA channel phandle

  dma-names:
    items:
      - const: tx
      - const: rx

required:
  - compatible
  - interrupts
  - interrupt-names
  - qcom,smem-states
  - qcom,smem-state-names
  - dmas
  - dma-names

additionalProperties: false

examples:
  - |
    #include <dt-bindings/interrupt-controller/irq.h>

    mpss: remoteproc {
        bam-dmux {
            compatible = "qcom,bam-dmux";

            interrupt-parent = <&modem_smsm>;
            interrupts = <1 IRQ_TYPE_EDGE_BOTH>, <11 IRQ_TYPE_EDGE_BOTH>;
            interrupt-names = "pc", "pc-ack";

            qcom,smem-states = <&apps_smsm 1>, <&apps_smsm 11>;
            qcom,smem-state-names = "pc", "pc-ack";

            dmas = <&bam_dmux_dma 4>, <&bam_dmux_dma 5>;
            dma-names = "tx", "rx";
        };
    };
```

## Documentation/devicetree/bindings/net/qcom,ethqos.txt
```
Qualcomm Ethernet ETHQOS device

This documents dwmmac based ethernet device which supports Gigabit
ethernet for version v2.3.0 onwards.

This device has following properties:

Required properties:

- compatible: Should be one of:
		"qcom,qcs404-ethqos"
		"qcom,sm8150-ethqos"

- reg: Address and length of the register set for the device

- reg-names: Should contain register names "stmmaceth", "rgmii"

- clocks: Should contain phandle to clocks

- clock-names: Should contain clock names "stmmaceth", "pclk",
		"ptp_ref", "rgmii"

- interrupts: Should contain phandle to interrupts

- interrupt-names: Should contain interrupt names "macirq", "eth_lpi"

Rest of the properties are defined in stmmac.txt file in same directory


Example:

ethernet: ethernet@7a80000 {
	compatible = "qcom,qcs404-ethqos";
	reg = <0x07a80000 0x10000>,
		<0x07a96000 0x100>;
	reg-names = "stmmaceth", "rgmii";
	clock-names = "stmmaceth", "pclk", "ptp_ref", "rgmii";
	clocks = <&gcc GCC_ETH_AXI_CLK>,
		<&gcc GCC_ETH_SLAVE_AHB_CLK>,
		<&gcc GCC_ETH_PTP_CLK>,
		<&gcc GCC_ETH_RGMII_CLK>;
	interrupts = <GIC_SPI 56 IRQ_TYPE_LEVEL_HIGH>,
			<GIC_SPI 55 IRQ_TYPE_LEVEL_HIGH>;
	interrupt-names = "macirq", "eth_lpi";
	snps,reset-gpio = <&tlmm 60 GPIO_ACTIVE_LOW>;
	snps,reset-active-low;

	snps,txpbl = <8>;
	snps,rxpbl = <2>;
	snps,aal;
	snps,tso;

	phy-handle = <&phy1>;
	phy-mode = "rgmii";

	mdio {
		#address-cells = <0x1>;
		#size-cells = <0x0>;
		compatible = "snps,dwmac-mdio";
		phy1: phy@4 {
			device_type = "ethernet-phy";
			reg = <0x4>;
		};
	};

};
```

## Documentation/devicetree/bindings/net/qcom,ethqos.yaml
```yaml
# SPDX-License-Identifier: GPL-2.0 OR BSD-2-Clause
%YAML 1.2
---
$id: http://devicetree.org/schemas/net/qcom,ethqos.yaml#
$schema: http://devicetree.org/meta-schemas/core.yaml#

title: Qualcomm Ethernet ETHQOS device

maintainers:
  - Bhupesh Sharma <bhupesh.sharma@linaro.org>

description:
  dwmmac based Qualcomm ethernet devices which support Gigabit
  ethernet (version v2.3.0 and onwards).

allOf:
  - $ref: snps,dwmac.yaml#

properties:
  compatible:
    enum:
      - qcom,qcs404-ethqos
      - qcom,sa8775p-ethqos
      - qcom,sc8280xp-ethqos
      - qcom,sm8150-ethqos

  reg:
    maxItems: 2

  reg-names:
    items:
      - const: stmmaceth
      - const: rgmii

  interrupts:
    minItems: 1
    items:
      - description: Combined signal for various interrupt events
      - description: The interrupt that occurs when Rx exits the LPI state
      - description: The interrupt that occurs when HW safety error triggered

  interrupt-names:
    minItems: 1
    items:
      - const: macirq
      - enum: [eth_lpi, sfty]
      - const: sfty

  clocks:
    maxItems: 4

  clock-names:
    items:
      - const: stmmaceth
      - const: pclk
      - const: ptp_ref
      - enum:
          - rgmii
          - phyaux

  iommus:
    maxItems: 1

  phys: true

  phy-names:
    const: serdes

required:
  - compatible
  - clocks
  - clock-names
  - reg-names

unevaluatedProperties: false

examples:
  - |
    #include <dt-bindings/interrupt-controller/arm-gic.h>
    #include <dt-bindings/clock/qcom,gcc-qcs404.h>
    #include <dt-bindings/gpio/gpio.h>

    ethernet: ethernet@7a80000 {
      compatible = "qcom,qcs404-ethqos";
      reg = <0x07a80000 0x10000>,
            <0x07a96000 0x100>;
      reg-names = "stmmaceth", "rgmii";
      clock-names = "stmmaceth", "pclk", "ptp_ref", "rgmii";
      clocks = <&gcc GCC_ETH_AXI_CLK>,
               <&gcc GCC_ETH_SLAVE_AHB_CLK>,
               <&gcc GCC_ETH_PTP_CLK>,
               <&gcc GCC_ETH_RGMII_CLK>;
      interrupts = <GIC_SPI 56 IRQ_TYPE_LEVEL_HIGH>,
                   <GIC_SPI 55 IRQ_TYPE_LEVEL_HIGH>,
                   <GIC_SPI 782 IRQ_TYPE_LEVEL_HIGH>;
      interrupt-names = "macirq", "eth_lpi", "sfty";

      rx-fifo-depth = <4096>;
      tx-fifo-depth = <4096>;

      snps,tso;
      snps,reset-gpio = <&tlmm 60 GPIO_ACTIVE_LOW>;
      snps,reset-active-low;
      snps,reset-delays-us = <0 10000 10000>;

      pinctrl-names = "default";
      pinctrl-0 = <&ethernet_defaults>;

      phy-handle = <&phy1>;
      phy-mode = "rgmii";
      mdio {
        #address-cells = <0x1>;
        #size-cells = <0x0>;

        compatible = "snps,dwmac-mdio";
        phy1: phy@4 {
          compatible = "ethernet-phy-ieee802.3-c22";
          device_type = "ethernet-phy";
          reg = <0x4>;

          #phy-cells = <0>;
        };
      };
    };
```
