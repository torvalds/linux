## Documentation/devicetree/bindings/net/davicom,dm9000.yaml
```yaml
# SPDX-License-Identifier: GPL-2.0-only OR BSD-2-Clause
%YAML 1.2
---
$id: http://devicetree.org/schemas/net/davicom,dm9000.yaml#
$schema: http://devicetree.org/meta-schemas/core.yaml#

title: Davicom DM9000 Fast Ethernet Controller

maintainers:
  - Paul Cercueil <paul@crapouillou.net>

properties:
  compatible:
    const: davicom,dm9000

  reg:
    items:
      - description: Address registers
      - description: Data registers

  interrupts:
    maxItems: 1

  davicom,no-eeprom:
    type: boolean
    description: Configuration EEPROM is not available

  davicom,ext-phy:
    type: boolean
    description: Use external PHY

  reset-gpios:
    maxItems: 1

  vcc-supply: true

required:
  - compatible
  - reg
  - interrupts

allOf:
  - $ref: /schemas/memory-controllers/mc-peripheral-props.yaml#
  - $ref: /schemas/net/ethernet-controller.yaml#

unevaluatedProperties: false

examples:
  - |
    #include <dt-bindings/interrupt-controller/irq.h>

    ethernet@a8000000 {
        compatible = "davicom,dm9000";
        reg = <0xa8000000 0x2>, <0xa8000002 0x2>;
        interrupt-parent = <&gph1>;
        interrupts = <1 IRQ_TYPE_LEVEL_HIGH>;
        local-mac-address = [00 00 de ad be ef];
        davicom,no-eeprom;
    };
```

## Documentation/devicetree/bindings/net/davicom,dm9051.yaml
```yaml
# SPDX-License-Identifier: (GPL-2.0-only OR BSD-2-Clause)
%YAML 1.2
---
$id: http://devicetree.org/schemas/net/davicom,dm9051.yaml#
$schema: http://devicetree.org/meta-schemas/core.yaml#

title: Davicom DM9051 SPI Ethernet Controller

maintainers:
  - Joseph CHANG <josright123@gmail.com>

description: |
  The DM9051 is a fully integrated and cost-effective low pin count single
  chip Fast Ethernet controller with a Serial Peripheral Interface (SPI).

allOf:
  - $ref: ethernet-controller.yaml#

properties:
  compatible:
    const: davicom,dm9051

  reg:
    maxItems: 1

  spi-max-frequency:
    maximum: 45000000

  interrupts:
    maxItems: 1

  local-mac-address: true

  mac-address: true

required:
  - compatible
  - reg
  - spi-max-frequency
  - interrupts

additionalProperties: false

examples:
  # Raspberry Pi platform
  - |
    /* for Raspberry Pi with pin control stuff for GPIO irq */
    #include <dt-bindings/interrupt-controller/irq.h>
    #include <dt-bindings/gpio/gpio.h>
    spi {
        #address-cells = <1>;
        #size-cells = <0>;

        ethernet@0 {
            compatible = "davicom,dm9051";
            reg = <0>; /* spi chip select */
            local-mac-address = [00 00 00 00 00 00];
            interrupt-parent = <&gpio>;
            interrupts = <26 IRQ_TYPE_LEVEL_LOW>;
            spi-max-frequency = <31200000>;
        };
    };
```

## Documentation/devicetree/bindings/net/davicom-dm9000.txt
```
Davicom DM9000 Fast Ethernet controller

Required properties:
- compatible = "davicom,dm9000";
- reg : physical addresses and sizes of registers, must contain 2 entries:
    first entry : address register,
    second entry : data register.
- interrupt-parent : interrupt controller to which the device is connected
- interrupts : interrupt specifier specific to interrupt controller

Optional properties:
- davicom,no-eeprom : Configuration EEPROM is not available
- davicom,ext-phy : Use external PHY
- reset-gpios : phandle of gpio that will be used to reset chip during probe
- vcc-supply : phandle of regulator that will be used to enable power to chip

Example:

	ethernet@18000000 {
		compatible = "davicom,dm9000";
		reg = <0x18000000 0x2 0x18000004 0x2>;
		interrupt-parent = <&gpn>;
		interrupts = <7 4>;
		local-mac-address = [00 00 de ad be ef];
		davicom,no-eeprom;
		reset-gpios = <&gpf 12 GPIO_ACTIVE_LOW>;
		vcc-supply = <&eth0_power>;
	};
```

## Documentation/devicetree/bindings/net/davinci-mdio.txt
```
TI SoC Davinci/Keystone2 MDIO Controller Device Tree Bindings
---------------------------------------------------

Required properties:
- compatible		: Should be "ti,davinci_mdio"
			  and "ti,keystone_mdio" for Keystone 2 SoCs
			  and "ti,cpsw-mdio" for am335x, am472x, am57xx/dra7, dm814x SoCs
			  and "ti,am4372-mdio" for am472x SoC
- reg			: physical base address and size of the davinci mdio
			  registers map
- bus_freq		: Mdio Bus frequency

Optional properties:
- ti,hwmods		: Must be "davinci_mdio"

Note: "ti,hwmods" field is used to fetch the base address and irq
resources from TI, omap hwmod data base during device registration.
Future plan is to migrate hwmod data base contents into device tree
blob so that, all the required data will be used from device tree dts
file.

Examples:

	mdio: davinci_mdio@4A101000 {
		compatible = "ti,davinci_mdio";
		reg = <0x4A101000 0x1000>;
		bus_freq = <1000000>;
	};

(or)

	mdio: davinci_mdio@4A101000 {
		compatible = "ti,davinci_mdio";
		ti,hwmods = "davinci_mdio";
		bus_freq = <1000000>;
	};
```

## Documentation/devicetree/bindings/net/davinci_emac.txt
```
* Texas Instruments Davinci EMAC

This file provides information, what the device node
for the davinci_emac interface contains.

Required properties:
- compatible: "ti,davinci-dm6467-emac", "ti,am3517-emac" or
  "ti,dm816-emac"
- reg: Offset and length of the register set for the device
- ti,davinci-ctrl-reg-offset: offset to control register
- ti,davinci-ctrl-mod-reg-offset: offset to control module register
- ti,davinci-ctrl-ram-offset: offset to control module ram
- ti,davinci-ctrl-ram-size: size of control module ram
- interrupts: interrupt mapping for the davinci emac interrupts sources:
              4 sources: <Receive Threshold Interrupt
			  Receive Interrupt
			  Transmit Interrupt
			  Miscellaneous Interrupt>

Optional properties:
- phy-handle: See ethernet.txt file in the same directory.
              If absent, davinci_emac driver defaults to 100/FULL.
- ti,davinci-rmii-en: 1 byte, 1 means use RMII
- ti,davinci-no-bd-ram: boolean, does EMAC have BD RAM?

The MAC address will be determined using the optional properties
defined in ethernet.txt.

Example (enbw_cmc board):
	eth0: emac@1e20000 {
		compatible = "ti,davinci-dm6467-emac";
		reg = <0x220000 0x4000>;
		ti,davinci-ctrl-reg-offset = <0x3000>;
		ti,davinci-ctrl-mod-reg-offset = <0x2000>;
		ti,davinci-ctrl-ram-offset = <0>;
		ti,davinci-ctrl-ram-size = <0x2000>;
		local-mac-address = [ 00 00 00 00 00 00 ];
		interrupts = <33
				34
				35
				36
				>;
		interrupt-parent = <&intc>;
	};
```

## Documentation/devicetree/bindings/net/dsa/ar9331.txt
```
Atheros AR9331 built-in switch
=============================

It is a switch built-in to Atheros AR9331 WiSoC and addressable over internal
MDIO bus. All PHYs are built-in as well.

Required properties:

 - compatible: should be: "qca,ar9331-switch"
 - reg: Address on the MII bus for the switch.
 - resets : Must contain an entry for each entry in reset-names.
 - reset-names : Must include the following entries: "switch"
 - interrupt-parent: Phandle to the parent interrupt controller
 - interrupts: IRQ line for the switch
 - interrupt-controller: Indicates the switch is itself an interrupt
   controller. This is used for the PHY interrupts.
 - #interrupt-cells: must be 1
 - mdio: Container of PHY and devices on the switches MDIO bus.

See Documentation/devicetree/bindings/net/dsa/dsa.txt for a list of additional
required and optional properties.
Examples:

eth0: ethernet@19000000 {
	compatible = "qca,ar9330-eth";
	reg = <0x19000000 0x200>;
	interrupts = <4>;

	resets = <&rst 9>, <&rst 22>;
	reset-names = "mac", "mdio";
	clocks = <&pll ATH79_CLK_AHB>, <&pll ATH79_CLK_AHB>;
	clock-names = "eth", "mdio";

	phy-mode = "mii";
	phy-handle = <&phy_port4>;
};

eth1: ethernet@1a000000 {
	compatible = "qca,ar9330-eth";
	reg = <0x1a000000 0x200>;
	interrupts = <5>;
	resets = <&rst 13>, <&rst 23>;
	reset-names = "mac", "mdio";
	clocks = <&pll ATH79_CLK_AHB>, <&pll ATH79_CLK_AHB>;
	clock-names = "eth", "mdio";

	phy-mode = "gmii";

	fixed-link {
		speed = <1000>;
		full-duplex;
	};

	mdio {
		#address-cells = <1>;
		#size-cells = <0>;

		switch10: switch@10 {
			#address-cells = <1>;
			#size-cells = <0>;

			compatible = "qca,ar9331-switch";
			reg = <0x10>;
			resets = <&rst 8>;
			reset-names = "switch";

			interrupt-parent = <&miscintc>;
			interrupts = <12>;

			interrupt-controller;
			#interrupt-cells = <1>;

			ports {
				#address-cells = <1>;
				#size-cells = <0>;

				switch_port0: port@0 {
					reg = <0x0>;
					ethernet = <&eth1>;

					phy-mode = "gmii";

					fixed-link {
						speed = <1000>;
						full-duplex;
					};
				};

				switch_port1: port@1 {
					reg = <0x1>;
					phy-handle = <&phy_port0>;
					phy-mode = "internal";
				};

				switch_port2: port@2 {
					reg = <0x2>;
					phy-handle = <&phy_port1>;
					phy-mode = "internal";
				};

				switch_port3: port@3 {
					reg = <0x3>;
					phy-handle = <&phy_port2>;
					phy-mode = "internal";
				};

				switch_port4: port@4 {
					reg = <0x4>;
					phy-handle = <&phy_port3>;
					phy-mode = "internal";
				};
			};

			mdio {
				#address-cells = <1>;
				#size-cells = <0>;

				interrupt-parent = <&switch10>;

				phy_port0: phy@0 {
					reg = <0x0>;
					interrupts = <0>;
				};

				phy_port1: phy@1 {
					reg = <0x1>;
					interrupts = <0>;
				};

				phy_port2: phy@2 {
					reg = <0x2>;
					interrupts = <0>;
				};

				phy_port3: phy@3 {
					reg = <0x3>;
					interrupts = <0>;
				};

				phy_port4: phy@4 {
					reg = <0x4>;
					interrupts = <0>;
				};
			};
		};
	};
};
```

## Documentation/devicetree/bindings/net/dsa/arrow,xrs700x.yaml
```yaml
# SPDX-License-Identifier: (GPL-2.0-only OR BSD-2-Clause)
%YAML 1.2
---
$id: http://devicetree.org/schemas/net/dsa/arrow,xrs700x.yaml#
$schema: http://devicetree.org/meta-schemas/core.yaml#

title: Arrow SpeedChips XRS7000 Series Switch

allOf:
  - $ref: dsa.yaml#/$defs/ethernet-ports

maintainers:
  - George McCollister <george.mccollister@gmail.com>

description:
  The Arrow SpeedChips XRS7000 Series of single chip gigabit Ethernet switches
  are designed for critical networking applications. They have up to three
  RGMII ports and one RMII port and are managed via i2c or mdio.

properties:
  compatible:
    oneOf:
      - enum:
          - arrow,xrs7003e
          - arrow,xrs7003f
          - arrow,xrs7004e
          - arrow,xrs7004f

  reg:
    maxItems: 1

required:
  - compatible
  - reg

unevaluatedProperties: false

examples:
  - |
    i2c {
        #address-cells = <1>;
        #size-cells = <0>;
        switch@8 {
            compatible = "arrow,xrs7004e";
            reg = <0x8>;

            ethernet-ports {
                #address-cells = <1>;
                #size-cells = <0>;
                ethernet-port@1 {
                    reg = <1>;
                    label = "lan0";
                    phy-handle = <&swphy0>;
                    phy-mode = "rgmii-id";
                };
                ethernet-port@2 {
                    reg = <2>;
                    label = "lan1";
                    phy-handle = <&swphy1>;
                    phy-mode = "rgmii-id";
                };
                ethernet-port@3 {
                    reg = <3>;
                    ethernet = <&fec1>;
                    phy-mode = "rgmii-id";

                    fixed-link {
                        speed = <1000>;
                        full-duplex;
                    };
                };
            };
        };
    };
```

## Documentation/devicetree/bindings/net/dsa/b53.txt
```
Broadcom BCM53xx Ethernet switches
==================================

Required properties:

- compatible: For external switch chips, compatible string must be exactly one
  of: "brcm,bcm5325"
      "brcm,bcm53115"
      "brcm,bcm53125"
      "brcm,bcm53128"
      "brcm,bcm5365"
      "brcm,bcm5395"
      "brcm,bcm5389"
      "brcm,bcm5397"
      "brcm,bcm5398"

  For the BCM11360 SoC, must be:
      "brcm,bcm11360-srab" and the mandatory "brcm,cygnus-srab" string

  For the BCM5310x SoCs with an integrated switch, must be one of:
      "brcm,bcm53010-srab"
      "brcm,bcm53011-srab"
      "brcm,bcm53012-srab"
      "brcm,bcm53018-srab"
      "brcm,bcm53019-srab" and the mandatory "brcm,bcm5301x-srab" string

  For the BCM5831X/BCM1140x SoCs with an integrated switch, must be one of:
      "brcm,bcm11404-srab"
      "brcm,bcm11407-srab"
      "brcm,bcm11409-srab"
      "brcm,bcm58310-srab"
      "brcm,bcm58311-srab"
      "brcm,bcm58313-srab" and the mandatory "brcm,omega-srab" string

  For the BCM585xx/586XX/88312 SoCs with an integrated switch, must be one of:
      "brcm,bcm58522-srab"
      "brcm,bcm58523-srab"
      "brcm,bcm58525-srab"
      "brcm,bcm58622-srab"
      "brcm,bcm58623-srab"
      "brcm,bcm58625-srab"
      "brcm,bcm88312-srab" and the mandatory "brcm,nsp-srab string

  For the BCM63xx/33xx SoCs with an integrated switch, must be one of:
      "brcm,bcm3384-switch"
      "brcm,bcm6328-switch"
      "brcm,bcm6368-switch" and the mandatory "brcm,bcm63xx-switch"

Required properties for BCM585xx/586xx/88312 SoCs:

 - reg: a total of 3 register base addresses, the first one must be the
   Switch Register Access block base, the second is the port 5/4 mux
   configuration register and the third one is the SGMII configuration
   and status register base address.

 - interrupts: a total of 13 interrupts must be specified, in the following
   order: port 0-5, 7-8 link status change, then the integrated PHY interrupt,
   then the timestamping interrupt and the sleep timer interrupts for ports
   5,7,8.

Optional properties for BCM585xx/586xx/88312 SoCs:

  - reg-names: a total of 3 names matching the 3 base register address, must
    be in the following order:
	"srab"
	"mux_config"
	"sgmii_config"

  - interrupt-names: a total of 13 names matching the 13 interrupts specified
    must be in the following order:
	"link_state_p0"
	"link_state_p1"
	"link_state_p2"
	"link_state_p3"
	"link_state_p4"
	"link_state_p5"
	"link_state_p7"
	"link_state_p8"
	"phy"
	"ts"
	"imp_sleep_timer_p5"
	"imp_sleep_timer_p7"
	"imp_sleep_timer_p8"

See Documentation/devicetree/bindings/net/dsa/dsa.txt for a list of additional
required and optional properties.

Examples:

Ethernet switch connected via MDIO to the host, CPU port wired to eth0:

	eth0: ethernet@10001000 {
		compatible = "brcm,unimac";
		reg = <0x10001000 0x1000>;

		fixed-link {
			speed = <1000>;
			duplex-full;
		};
	};

	mdio0: mdio@10000000 {
		compatible = "brcm,unimac-mdio";
		#address-cells = <1>;
		#size-cells = <0>;

		switch0: ethernet-switch@1e {
			compatible = "brcm,bcm53125";
			reg = <30>;
			#address-cells = <1>;
			#size-cells = <0>;

			ports {
				#address-cells = <1>;
				#size-cells = <0>;

				port0@0 {
					reg = <0>;
					label = "lan1";
				};

				port1@1 {
					reg = <1>;
					label = "lan2";
				};

				port5@5 {
					reg = <5>;
					label = "cable-modem";
					fixed-link {
						speed = <1000>;
						duplex-full;
					};
					phy-mode = "rgmii-txid";
				};

				port8@8 {
					reg = <8>;
					label = "cpu";
					fixed-link {
						speed = <1000>;
						duplex-full;
					};
					phy-mode = "rgmii-txid";
					ethernet = <&eth0>;
				};
			};
		};
	};
```
