## Documentation/devicetree/bindings/net/sh_eth.txt
```
* Renesas Electronics SH EtherMAC

This file provides information on what the device node for the SH EtherMAC
interface contains.

Required properties:
- compatible: Must contain one or more of the following:
	      "renesas,gether-r8a7740" if the device is a part of R8A7740 SoC.
	      "renesas,ether-r8a7743"  if the device is a part of R8A7743 SoC.
	      "renesas,ether-r8a7745"  if the device is a part of R8A7745 SoC.
	      "renesas,ether-r8a7778"  if the device is a part of R8A7778 SoC.
	      "renesas,ether-r8a7779"  if the device is a part of R8A7779 SoC.
	      "renesas,ether-r8a7790"  if the device is a part of R8A7790 SoC.
	      "renesas,ether-r8a7791"  if the device is a part of R8A7791 SoC.
	      "renesas,ether-r8a7793"  if the device is a part of R8A7793 SoC.
	      "renesas,ether-r8a7794"  if the device is a part of R8A7794 SoC.
	      "renesas,gether-r8a77980" if the device is a part of R8A77980 SoC.
	      "renesas,ether-r7s72100" if the device is a part of R7S72100 SoC.
	      "renesas,rcar-gen1-ether" for a generic R-Car Gen1 device.
	      "renesas,rcar-gen2-ether" for a generic R-Car Gen2 or RZ/G1
	                                device.

	      When compatible with the generic version, nodes must list
	      the SoC-specific version corresponding to the platform
	      first followed by the generic version.

- reg: offset and length of (1) the E-DMAC/feLic register block (required),
       (2) the TSU register block (optional).
- interrupts: interrupt specifier for the sole interrupt.
- phy-mode: see ethernet.txt file in the same directory.
- phy-handle: see ethernet.txt file in the same directory.
- #address-cells: number of address cells for the MDIO bus, must be equal to 1.
- #size-cells: number of size cells on the MDIO bus, must be equal to 0.
- clocks: clock phandle and specifier pair.
- pinctrl-0: phandle, referring to a default pin configuration node.

Optional properties:
- interrupt-parent: the phandle for the interrupt controller that services
		    interrupts for this device.
- pinctrl-names: pin configuration state name ("default").
- renesas,no-ether-link: boolean, specify when a board does not provide a proper
			 Ether LINK signal.
- renesas,ether-link-active-low: boolean, specify when the Ether LINK signal is
				 active-low instead of normal active-high.

Example (Lager board):

	ethernet@ee700000 {
		compatible = "renesas,ether-r8a7790",
		             "renesas,rcar-gen2-ether";
		reg = <0 0xee700000 0 0x400>;
		interrupt-parent = <&gic>;
		interrupts = <0 162 IRQ_TYPE_LEVEL_HIGH>;
		clocks = <&mstp8_clks R8A7790_CLK_ETHER>;
		phy-mode = "rmii";
		phy-handle = <&phy1>;
		pinctrl-0 = <&ether_pins>;
		pinctrl-names = "default";
		renesas,ether-link-active-low;
		#address-cells = <1>;
		#size-cells = <0>;

		phy1: ethernet-phy@1 {
			reg = <1>;
			interrupt-parent = <&irqc0>;
			interrupts = <0 IRQ_TYPE_LEVEL_LOW>;
			pinctrl-0 = <&phy1_pins>;
			pinctrl-names = "default";
		};
	};
```

## Documentation/devicetree/bindings/net/smsc,lan9115.yaml
```yaml
# SPDX-License-Identifier: (GPL-2.0-only OR BSD-2-Clause)
%YAML 1.2
---
$id: http://devicetree.org/schemas/net/smsc,lan9115.yaml#
$schema: http://devicetree.org/meta-schemas/core.yaml#

title: Smart Mixed-Signal Connectivity (SMSC) LAN911x/912x Controller

maintainers:
  - Shawn Guo <shawnguo@kernel.org>

allOf:
  - $ref: ethernet-controller.yaml#
  - $ref: /schemas/memory-controllers/mc-peripheral-props.yaml#

properties:
  compatible:
    oneOf:
      - const: smsc,lan9115
      - items:
          - enum:
              - smsc,lan89218
              - smsc,lan9117
              - smsc,lan9118
              - smsc,lan9220
              - smsc,lan9221
          - const: smsc,lan9115

  reg:
    maxItems: 1

  reg-shift: true

  reg-io-width:
    enum: [ 2, 4 ]
    default: 2

  interrupts:
    minItems: 1
    items:
      - description:
          LAN interrupt line
      - description:
          Optional PME (power management event) interrupt that is able to wake
          up the host system with a 50ms pulse on network activity

  clocks:
    maxItems: 1

  phy-mode: true

  smsc,irq-active-high:
    type: boolean
    description: Indicates the IRQ polarity is active-high

  smsc,irq-push-pull:
    type: boolean
    description: Indicates the IRQ type is push-pull

  smsc,force-internal-phy:
    type: boolean
    description: Forces SMSC LAN controller to use internal PHY

  smsc,force-external-phy:
    type: boolean
    description: Forces SMSC LAN controller to use external PHY

  smsc,save-mac-address:
    type: boolean
    description:
      Indicates that MAC address needs to be saved before resetting the
      controller

  reset-gpios:
    maxItems: 1
    description:
      A GPIO line connected to the RESET (active low) signal of the device.
      On many systems this is wired high so the device goes out of reset at
      power-on, but if it is under program control, this optional GPIO can
      wake up in response to it.

  vdd33a-supply:
    description: 3.3V analog power supply

  vddvario-supply:
    description: IO logic power supply

required:
  - compatible
  - reg
  - interrupts

unevaluatedProperties: false

examples:
  - |
    #include <dt-bindings/gpio/gpio.h>

    ethernet@f4000000 {
            compatible = "smsc,lan9220", "smsc,lan9115";
            reg = <0xf4000000 0x2000000>;
            phy-mode = "mii";
            interrupt-parent = <&gpio1>;
            interrupts = <31>, <32>;
            reset-gpios = <&gpio1 30 GPIO_ACTIVE_LOW>;
            reg-io-width = <4>;
            smsc,irq-push-pull;
    };
```

## Documentation/devicetree/bindings/net/smsc,lan91c111.yaml
```yaml
# SPDX-License-Identifier: GPL-2.0
%YAML 1.2
---
$id: http://devicetree.org/schemas/net/smsc,lan91c111.yaml#
$schema: http://devicetree.org/meta-schemas/core.yaml#

title: Smart Mixed-Signal Connectivity (SMSC) LAN91C9x/91C1xx Controller

maintainers:
  - Nicolas Pitre <nico@fluxnic.net>

allOf:
  - $ref: ethernet-controller.yaml#

properties:
  compatible:
    const: smsc,lan91c111

  reg:
    maxItems: 1

  interrupts:
    maxItems: 1

  reg-shift: true

  reg-io-width:
    enum: [ 1, 2, 4 ]
    default: 4

  reset-gpios:
    description: GPIO connected to control RESET pin
    maxItems: 1

  power-gpios:
    description: GPIO connect to control PWRDWN pin
    maxItems: 1

  pxa-u16-align4:
    description: put in place the workaround the force all u16 writes to be
      32 bits aligned
    type: boolean

required:
  - compatible
  - reg
  - interrupts

unevaluatedProperties: false

examples:
  - |
    #include <dt-bindings/interrupt-controller/arm-gic.h>

    ethernet@4010000 {
          compatible = "smsc,lan91c111";
          reg = <0x40100000 0x10000>;
          phy-mode = "mii";
          interrupts = <GIC_SPI 116 IRQ_TYPE_LEVEL_HIGH>;
          reg-io-width = <2>;
    };
```

## Documentation/devicetree/bindings/net/smsc-lan87xx.txt
```
SMSC LAN87xx Ethernet PHY

Some boards require special tuning values. Configure them
through an Ethernet OF device node.

Optional properties:

- smsc,disable-energy-detect:
  If set, do not enable energy detect mode for the SMSC phy.
  default: enable energy detect mode

Examples:
smsc phy with disabled energy detect mode on an am335x based board.
&davinci_mdio {
	pinctrl-names = "default", "sleep";
	pinctrl-0 = <&davinci_mdio_default>;
	pinctrl-1 = <&davinci_mdio_sleep>;

	ethernetphy0: ethernet-phy@0 {
		reg = <0>;
		smsc,disable-energy-detect;
	};
};
```

## Documentation/devicetree/bindings/net/smsc-lan91c111.txt
```
SMSC LAN91c111 Ethernet mac

Required properties:
- compatible = "smsc,lan91c111";
- reg : physical address and size of registers
- interrupts : interrupt connection

Optional properties:
- phy-device : see ethernet.txt file in the same directory
- reg-io-width : Mask of sizes (in bytes) of the IO accesses that
  are supported on the device.  Valid value for SMSC LAN91c111 are
  1, 2 or 4.  If it's omitted or invalid, the size would be 2 meaning
  16-bit access only.
```

## Documentation/devicetree/bindings/net/smsc911x.txt
```
* Smart Mixed-Signal Connectivity (SMSC) LAN911x/912x Controller

Required properties:
- compatible : Should be "smsc,lan<model>", "smsc,lan9115"
- reg : Address and length of the io space for SMSC LAN
- interrupts : one or two interrupt specifiers
  - The first interrupt is the SMSC LAN interrupt line
  - The second interrupt (if present) is the PME (power
    management event) interrupt that is able to wake up the host
     system with a 50ms pulse on network activity
- phy-mode : See ethernet.txt file in the same directory

Optional properties:
- reg-shift : Specify the quantity to shift the register offsets by
- reg-io-width : Specify the size (in bytes) of the IO accesses that
  should be performed on the device.  Valid value for SMSC LAN is
  2 or 4.  If it's omitted or invalid, the size would be 2.
- smsc,irq-active-high : Indicates the IRQ polarity is active-high
- smsc,irq-push-pull : Indicates the IRQ type is push-pull
- smsc,force-internal-phy : Forces SMSC LAN controller to use
  internal PHY
- smsc,force-external-phy : Forces SMSC LAN controller to use
  external PHY
- smsc,save-mac-address : Indicates that mac address needs to be saved
  before resetting the controller
- reset-gpios : a GPIO line connected to the RESET (active low) signal
  of the device. On many systems this is wired high so the device goes
  out of reset at power-on, but if it is under program control, this
  optional GPIO can wake up in response to it.
- vdd33a-supply, vddvario-supply : 3.3V analog and IO logic power supplies

Examples:

lan9220@f4000000 {
	compatible = "smsc,lan9220", "smsc,lan9115";
	reg = <0xf4000000 0x2000000>;
	phy-mode = "mii";
	interrupt-parent = <&gpio1>;
	interrupts = <31>, <32>;
	reset-gpios = <&gpio1 30 GPIO_ACTIVE_LOW>;
	reg-io-width = <4>;
	smsc,irq-push-pull;
};
```
