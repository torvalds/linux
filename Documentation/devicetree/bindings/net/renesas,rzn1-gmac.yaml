## Documentation/devicetree/bindings/net/rockchip-dwmac.txt
```
Rockchip SoC RK3288 10/100/1000 Ethernet driver(GMAC)

The device node has following properties.

Required properties:
 - compatible: should be "rockchip,<name>-gamc"
   "rockchip,rk3228-gmac": found on RK322x SoCs
   "rockchip,rk3288-gmac": found on RK3288 SoCs
   "rockchip,rk3328-gmac": found on RK3328 SoCs
   "rockchip,rk3366-gmac": found on RK3366 SoCs
   "rockchip,rk3368-gmac": found on RK3368 SoCs
   "rockchip,rk3399-gmac": found on RK3399 SoCs
 - reg: addresses and length of the register sets for the device.
 - interrupts: Should contain the GMAC interrupts.
 - interrupt-names: Should contain the interrupt names "macirq".
 - rockchip,grf: phandle to the syscon grf used to control speed and mode.
 - clocks: <&cru SCLK_MAC>: clock selector for main clock, from PLL or PHY.
	   <&cru SCLK_MAC_PLL>: PLL clock for SCLK_MAC
	   <&cru SCLK_MAC_RX>: clock gate for RX
	   <&cru SCLK_MAC_TX>: clock gate for TX
	   <&cru SCLK_MACREF>: clock gate for RMII referce clock
	   <&cru SCLK_MACREF_OUT> clock gate for RMII reference clock output
	   <&cru ACLK_GMAC>: AXI clock gate for GMAC
	   <&cru PCLK_GMAC>: APB clock gate for GMAC
 - clock-names: One name for each entry in the clocks property.
 - phy-mode: See ethernet.txt file in the same directory.
 - pinctrl-names: Names corresponding to the numbered pinctrl states.
 - pinctrl-0: pin-control mode. can be <&rgmii_pins> or <&rmii_pins>.
 - clock_in_out: For RGMII, it must be "input", means main clock(125MHz)
   is not sourced from SoC's PLL, but input from PHY; For RMII, "input" means
   PHY provides the reference clock(50MHz), "output" means GMAC provides the
   reference clock.
 - snps,reset-gpio       gpio number for phy reset.
 - snps,reset-active-low boolean flag to indicate if phy reset is active low.
 - assigned-clocks: main clock, should be <&cru SCLK_MAC>;
 - assigned-clock-parents = parent of main clock.
   can be <&ext_gmac> or <&cru SCLK_MAC_PLL>.

Optional properties:
 - tx_delay: Delay value for TXD timing. Range value is 0~0x7F, 0x30 as default.
 - rx_delay: Delay value for RXD timing. Range value is 0~0x7F, 0x10 as default.
 - phy-supply: phandle to a regulator if the PHY needs one

Example:

gmac: ethernet@ff290000 {
	compatible = "rockchip,rk3288-gmac";
	reg = <0xff290000 0x10000>;
	interrupts = <GIC_SPI 27 IRQ_TYPE_LEVEL_HIGH>;
	interrupt-names = "macirq";
	rockchip,grf = <&grf>;
	clocks = <&cru SCLK_MAC>,
		<&cru SCLK_MAC_RX>, <&cru SCLK_MAC_TX>,
		<&cru SCLK_MACREF>, <&cru SCLK_MACREF_OUT>,
		<&cru ACLK_GMAC>, <&cru PCLK_GMAC>;
	clock-names = "stmmaceth",
		"mac_clk_rx", "mac_clk_tx",
		"clk_mac_ref", "clk_mac_refout",
		"aclk_mac", "pclk_mac";
	phy-mode = "rgmii";
	pinctrl-names = "default";
	pinctrl-0 = <&rgmii_pins /*&rmii_pins*/>;

	clock_in_out = "input";
	snps,reset-gpio = <&gpio4 7 0>;
	snps,reset-active-low;

	assigned-clocks = <&cru SCLK_MAC>;
	assigned-clock-parents = <&ext_gmac>;
	tx_delay = <0x30>;
	rx_delay = <0x10>;

	status = "ok";
};
```

## Documentation/devicetree/bindings/net/rockchip-dwmac.yaml
```yaml
# SPDX-License-Identifier: GPL-2.0
%YAML 1.2
---
$id: http://devicetree.org/schemas/net/rockchip-dwmac.yaml#
$schema: http://devicetree.org/meta-schemas/core.yaml#

title: Rockchip 10/100/1000 Ethernet driver(GMAC)

maintainers:
  - David Wu <david.wu@rock-chips.com>

# We need a select here so we don't match all nodes with 'snps,dwmac'
select:
  properties:
    compatible:
      contains:
        enum:
          - rockchip,px30-gmac
          - rockchip,rk3128-gmac
          - rockchip,rk3228-gmac
          - rockchip,rk3288-gmac
          - rockchip,rk3308-gmac
          - rockchip,rk3328-gmac
          - rockchip,rk3366-gmac
          - rockchip,rk3368-gmac
          - rockchip,rk3399-gmac
          - rockchip,rk3568-gmac
          - rockchip,rk3588-gmac
          - rockchip,rv1108-gmac
          - rockchip,rv1126-gmac
  required:
    - compatible

allOf:
  - $ref: "snps,dwmac.yaml#"

properties:
  compatible:
    oneOf:
      - items:
          - enum:
              - rockchip,px30-gmac
              - rockchip,rk3128-gmac
              - rockchip,rk3228-gmac
              - rockchip,rk3288-gmac
              - rockchip,rk3308-gmac
              - rockchip,rk3328-gmac
              - rockchip,rk3366-gmac
              - rockchip,rk3368-gmac
              - rockchip,rk3399-gmac
              - rockchip,rv1108-gmac
      - items:
          - enum:
              - rockchip,rk3568-gmac
              - rockchip,rk3588-gmac
              - rockchip,rv1126-gmac
          - const: snps,dwmac-4.20a

  clocks:
    minItems: 5
    maxItems: 8

  clock-names:
    contains:
      enum:
        - stmmaceth
        - mac_clk_tx
        - mac_clk_rx
        - aclk_mac
        - pclk_mac
        - clk_mac_ref
        - clk_mac_refout
        - clk_mac_speed

  clock_in_out:
    description:
      For RGMII, it must be "input", means main clock(125MHz)
      is not sourced from SoC's PLL, but input from PHY.
      For RMII, "input" means PHY provides the reference clock(50MHz),
      "output" means GMAC provides the reference clock.
    $ref: /schemas/types.yaml#/definitions/string
    enum: [input, output]

  rockchip,grf:
    description: The phandle of the syscon node for the general register file.
    $ref: /schemas/types.yaml#/definitions/phandle

  rockchip,php-grf:
    description:
      The phandle of the syscon node for the peripheral general register file.
    $ref: /schemas/types.yaml#/definitions/phandle

  tx_delay:
    description: Delay value for TXD timing. Range value is 0~0x7F, 0x30 as default.
    $ref: /schemas/types.yaml#/definitions/uint32

  rx_delay:
    description: Delay value for RXD timing. Range value is 0~0x7F, 0x10 as default.
    $ref: /schemas/types.yaml#/definitions/uint32

  phy-supply:
    description: PHY regulator

required:
  - compatible
  - clocks
  - clock-names

unevaluatedProperties: false

examples:
  - |
    #include <dt-bindings/interrupt-controller/arm-gic.h>
    #include <dt-bindings/clock/rk3288-cru.h>

    gmac: ethernet@ff290000 {
        compatible = "rockchip,rk3288-gmac";
        reg = <0xff290000 0x10000>;
        interrupts = <GIC_SPI 27 IRQ_TYPE_LEVEL_HIGH>;
        interrupt-names = "macirq";
        clocks = <&cru SCLK_MAC>,
                 <&cru SCLK_MAC_RX>, <&cru SCLK_MAC_TX>,
                 <&cru SCLK_MACREF>, <&cru SCLK_MACREF_OUT>,
                 <&cru ACLK_GMAC>, <&cru PCLK_GMAC>;
        clock-names = "stmmaceth",
                      "mac_clk_rx", "mac_clk_tx",
                      "clk_mac_ref", "clk_mac_refout",
                      "aclk_mac", "pclk_mac";
        assigned-clocks = <&cru SCLK_MAC>;
        assigned-clock-parents = <&ext_gmac>;

        rockchip,grf = <&grf>;
        phy-mode = "rgmii";
        clock_in_out = "input";
        tx_delay = <0x30>;
        rx_delay = <0x10>;
    };
```

## Documentation/devicetree/bindings/net/samsung-sxgbe.txt
```
* Samsung 10G Ethernet driver (SXGBE)

Required properties:
- compatible: Should be "samsung,sxgbe-v2.0a"
- reg: Address and length of the register set for the device
- interrupts: Should contain the SXGBE interrupts
  These interrupts are ordered by fixed and follows variable
  transmit DMA interrupts, receive DMA interrupts and lpi interrupt.
  index 0 - this is fixed common interrupt of SXGBE and it is always
  available.
  index 1 to 25 - 8 variable transmit interrupts, variable 16 receive interrupts
  and 1 optional lpi interrupt.
- phy-mode: String, operation mode of the PHY interface.
  Supported values are: "sgmii", "xgmii".
- samsung,pbl: Integer, Programmable Burst Length.
  Supported values are 1, 2, 4, 8, 16, or 32.
- samsung,burst-map: Integer, Program the possible bursts supported by sxgbe
  This is an integer and represents allowable DMA bursts when fixed burst.
  Allowable range is 0x01-0x3F. When this field is set fixed burst is enabled.
  When fixed length is needed for burst mode, it can be set within allowable
  range.

Optional properties:
- max-frame-size: Maximum Transfer Unit (IEEE defined MTU), rather
		  than the maximum frame size.

The MAC address will be determined using the optional properties
defined in ethernet.txt.

Example:

	aliases {
		ethernet0 = <&sxgbe0>;
	};

	sxgbe0: ethernet@1a040000 {
		compatible = "samsung,sxgbe-v2.0a";
		reg = <0 0x1a040000 0 0x10000>;
		interrupt-parent = <&gic>;
		interrupts = <0 209 4>, <0 185 4>, <0 186 4>, <0 187 4>,
			     <0 188 4>, <0 189 4>, <0 190 4>, <0 191 4>,
			     <0 192 4>, <0 193 4>, <0 194 4>, <0 195 4>,
			     <0 196 4>, <0 197 4>, <0 198 4>, <0 199 4>,
			     <0 200 4>, <0 201 4>, <0 202 4>, <0 203 4>,
			     <0 204 4>, <0 205 4>, <0 206 4>, <0 207 4>,
			     <0 208 4>, <0 210 4>;
		samsung,pbl = <0x08>
		samsung,burst-map = <0x20>
		mac-address = [ 00 11 22 33 44 55 ]; /* Filled in by U-Boot */
		max-frame-size = <9000>;
		phy-mode = "xgmii";
	};
```

## Documentation/devicetree/bindings/net/sff,sfp.txt
```
Small Form Factor (SFF) Committee Small Form-factor Pluggable (SFP)
Transceiver

Required properties:

- compatible : must be "sff,sfp"

Optional Properties:

- i2c-bus : phandle of an I2C bus controller for the SFP two wire serial
  interface

- mod-def0-gpios : GPIO phandle and a specifier of the MOD-DEF0 (AKA Mod_ABS)
  module presence input gpio signal, active (module absent) high

- los-gpios : GPIO phandle and a specifier of the Receiver Loss of Signal
  Indication input gpio signal, active (signal lost) high

- tx-fault-gpios : GPIO phandle and a specifier of the Module Transmitter
  Fault input gpio signal, active (fault condition) high

- tx-disable-gpios : GPIO phandle and a specifier of the Transmitter Disable
  output gpio signal, active (Tx disable) high

- rate-select0-gpios : GPIO phandle and a specifier of the Rx Signaling Rate
  Select (AKA RS0) output gpio signal, low: low Rx rate, high: high Rx rate

- rate-select1-gpios : GPIO phandle and a specifier of the Tx Signaling Rate
  Select (AKA RS1) output gpio signal (SFP+ only), low: low Tx rate, high:
  high Tx rate

Example #1: Direct serdes to SFP connection

sfp_eth3: sfp-eth3 {
	compatible = "sff,sfp";
	i2c-bus = <&sfp_1g_i2c>;
	los-gpios = <&cpm_gpio2 22 GPIO_ACTIVE_HIGH>;
	mod-def0-gpios = <&cpm_gpio2 21 GPIO_ACTIVE_LOW>;
	pinctrl-names = "default";
	pinctrl-0 = <&cpm_sfp_1g_pins &cps_sfp_1g_pins>;
	tx-disable-gpios = <&cps_gpio1 24 GPIO_ACTIVE_HIGH>;
	tx-fault-gpios = <&cpm_gpio2 19 GPIO_ACTIVE_HIGH>;
};

&cps_emac3 {
	phy-names = "comphy";
	phys = <&cps_comphy5 0>;
	sfp = <&sfp_eth3>;
};

Example #2: Serdes to PHY to SFP connection

sfp_eth0: sfp-eth0 {
	compatible = "sff,sfp";
	i2c-bus = <&sfpp0_i2c>;
	los-gpios = <&cps_gpio1 28 GPIO_ACTIVE_HIGH>;
	mod-def0-gpios = <&cps_gpio1 27 GPIO_ACTIVE_LOW>;
	pinctrl-names = "default";
	pinctrl-0 = <&cps_sfpp0_pins>;
	tx-disable-gpios = <&cps_gpio1 29 GPIO_ACTIVE_HIGH>;
	tx-fault-gpios  = <&cps_gpio1 26 GPIO_ACTIVE_HIGH>;
};

p0_phy: ethernet-phy@0 {
	compatible = "ethernet-phy-ieee802.3-c45";
	pinctrl-names = "default";
	pinctrl-0 = <&cpm_phy0_pins &cps_phy0_pins>;
	reg = <0>;
	interrupt = <&cpm_gpio2 18 IRQ_TYPE_EDGE_FALLING>;
	sfp = <&sfp_eth0>;
};

&cpm_eth0 {
	phy = <&p0_phy>;
	phy-mode = "10gbase-kr";
};
```

## Documentation/devicetree/bindings/net/sff,sfp.yaml
```yaml
# SPDX-License-Identifier: (GPL-2.0-only OR BSD-2-Clause)
%YAML 1.2
---
$id: http://devicetree.org/schemas/net/sff,sfp.yaml#
$schema: http://devicetree.org/meta-schemas/core.yaml#

title: Small Form Factor (SFF) Committee Small Form-factor Pluggable (SFP)
  Transceiver

maintainers:
  - Russell King <linux@armlinux.org.uk>

properties:
  compatible:
    enum:
      - sff,sfp  # for SFP modules
      - sff,sff  # for soldered down SFF modules

  i2c-bus:
    $ref: /schemas/types.yaml#/definitions/phandle
    description:
      phandle of an I2C bus controller for the SFP two wire serial

  maximum-power-milliwatt:
    minimum: 1000
    default: 1000
    description:
      Maximum module power consumption Specifies the maximum power consumption
      allowable by a module in the slot, in milli-Watts. Presently, modules can
      be up to 1W, 1.5W or 2W.

  "mod-def0-gpios":
    maxItems: 1
    description:
      GPIO phandle and a specifier of the MOD-DEF0 (AKA Mod_ABS) module
      presence input gpio signal, active (module absent) high. Must not be
      present for SFF modules

  "los-gpios":
    maxItems: 1
    description:
      GPIO phandle and a specifier of the Receiver Loss of Signal Indication
      input gpio signal, active (signal lost) high

  "tx-fault-gpios":
    maxItems: 1
    description:
      GPIO phandle and a specifier of the Module Transmitter Fault input gpio
      signal, active (fault condition) high

  "tx-disable-gpios":
    maxItems: 1
    description:
      GPIO phandle and a specifier of the Transmitter Disable output gpio
      signal, active (Tx disable) high

  "rate-select0-gpios":
    maxItems: 1
    description:
      GPIO phandle and a specifier of the Rx Signaling Rate Select (AKA RS0)
      output gpio signal, low - low Rx rate, high - high Rx rate Must not be
      present for SFF modules

  "rate-select1-gpios":
    maxItems: 1
    description:
      GPIO phandle and a specifier of the Tx Signaling Rate Select (AKA RS1)
      output gpio signal (SFP+ only), low - low Tx rate, high - high Tx rate. Must
      not be present for SFF modules

allOf:
  - if:
      properties:
        compatible:
          contains:
            const: sff,sff
    then:
      properties:
        mod-def0-gpios: false
        rate-select0-gpios: false
        rate-select1-gpios: false

required:
  - compatible
  - i2c-bus

additionalProperties: false

examples:
  - | # Direct serdes to SFP connection
    #include <dt-bindings/gpio/gpio.h>

    sfp1: sfp {
      compatible = "sff,sfp";
      i2c-bus = <&sfp_1g_i2c>;
      los-gpios = <&cpm_gpio2 22 GPIO_ACTIVE_HIGH>;
      mod-def0-gpios = <&cpm_gpio2 21 GPIO_ACTIVE_LOW>;
      maximum-power-milliwatt = <1000>;
      pinctrl-names = "default";
      pinctrl-0 = <&cpm_sfp_1g_pins &cps_sfp_1g_pins>;
      tx-disable-gpios = <&cps_gpio1 24 GPIO_ACTIVE_HIGH>;
      tx-fault-gpios = <&cpm_gpio2 19 GPIO_ACTIVE_HIGH>;
    };

    ethernet {
      phy-names = "comphy";
      phys = <&cps_comphy5 0>;
      sfp = <&sfp1>;
    };

  - | # Serdes to PHY to SFP connection
    #include <dt-bindings/gpio/gpio.h>
    #include <dt-bindings/interrupt-controller/arm-gic.h>

    sfp2: sfp {
      compatible = "sff,sfp";
      i2c-bus = <&sfp_i2c>;
      los-gpios = <&cps_gpio1 28 GPIO_ACTIVE_HIGH>;
      mod-def0-gpios = <&cps_gpio1 27 GPIO_ACTIVE_LOW>;
      pinctrl-names = "default";
      pinctrl-0 = <&cps_sfpp0_pins>;
      tx-disable-gpios = <&cps_gpio1 29 GPIO_ACTIVE_HIGH>;
      tx-fault-gpios  = <&cps_gpio1 26 GPIO_ACTIVE_HIGH>;
    };

    mdio {
      #address-cells = <1>;
      #size-cells = <0>;

      phy: ethernet-phy@0 {
        compatible = "ethernet-phy-ieee802.3-c45";
        pinctrl-names = "default";
        pinctrl-0 = <&cpm_phy0_pins &cps_phy0_pins>;
        reg = <0>;
        interrupt = <&cpm_gpio2 18 IRQ_TYPE_EDGE_FALLING>;
        sfp = <&sfp2>;
      };
    };

    ethernet {
      phy = <&phy>;
      phy-mode = "10gbase-kr";
    };
```
