## Documentation/devicetree/bindings/net/socionext,synquacer-netsec.yaml
```yaml
# SPDX-License-Identifier: (GPL-2.0-only OR BSD-2-Clause)
%YAML 1.2
---
$id: http://devicetree.org/schemas/net/socionext,synquacer-netsec.yaml#
$schema: http://devicetree.org/meta-schemas/core.yaml#

title: Socionext NetSec Ethernet Controller IP

maintainers:
  - Jassi Brar <jaswinder.singh@linaro.org>
  - Ilias Apalodimas <ilias.apalodimas@linaro.org>

allOf:
  - $ref: ethernet-controller.yaml#

properties:
  compatible:
    const: socionext,synquacer-netsec

  reg:
    items:
      - description: control register area
      - description: EEPROM holding the MAC address and microengine firmware

  clocks:
    maxItems: 1

  clock-names:
    const: phy_ref_clk

  dma-coherent: true

  interrupts:
    maxItems: 1

  mdio:
    $ref: mdio.yaml#

required:
  - compatible
  - reg
  - clocks
  - clock-names
  - interrupts
  - mdio

unevaluatedProperties: false

examples:
  - |
    #include <dt-bindings/interrupt-controller/arm-gic.h>

    ethernet@522d0000 {
        compatible = "socionext,synquacer-netsec";
        reg = <0x522d0000 0x10000>, <0x10000000 0x10000>;
        interrupts = <GIC_SPI 176 IRQ_TYPE_LEVEL_HIGH>;
        clocks = <&clk_netsec>;
        clock-names = "phy_ref_clk";
        phy-mode = "rgmii";
        max-speed = <1000>;
        max-frame-size = <9000>;
        phy-handle = <&phy1>;

        mdio {
            #address-cells = <1>;
            #size-cells = <0>;
            phy1: ethernet-phy@1 {
                compatible = "ethernet-phy-ieee802.3-c22";
                reg = <1>;
            };
        };
    };
...
```

## Documentation/devicetree/bindings/net/socionext,uniphier-ave4.txt
```
* Socionext AVE ethernet controller

This describes the devicetree bindings for AVE ethernet controller
implemented on Socionext UniPhier SoCs.

Required properties:
 - compatible: Should be
	- "socionext,uniphier-pro4-ave4" : for Pro4 SoC
	- "socionext,uniphier-pxs2-ave4" : for PXs2 SoC
	- "socionext,uniphier-ld11-ave4" : for LD11 SoC
	- "socionext,uniphier-ld20-ave4" : for LD20 SoC
	- "socionext,uniphier-pxs3-ave4" : for PXs3 SoC
 - reg: Address where registers are mapped and size of region.
 - interrupts: Should contain the MAC interrupt.
 - phy-mode: See ethernet.txt in the same directory. Allow to choose
	"rgmii", "rmii", "mii", or "internal" according to the PHY.
	The acceptable mode is SoC-dependent.
 - phy-handle: Should point to the external phy device.
	See ethernet.txt file in the same directory.
 - clocks: A phandle to the clock for the MAC.
	For Pro4 SoC, that is "socionext,uniphier-pro4-ave4",
	another MAC clock, GIO bus clock and PHY clock are also required.
 - clock-names: Should contain
	- "ether", "ether-gb", "gio", "ether-phy" for Pro4 SoC
	- "ether" for others
 - resets: A phandle to the reset control for the MAC. For Pro4 SoC,
	GIO bus reset is also required.
 - reset-names: Should contain
	- "ether", "gio" for Pro4 SoC
	- "ether" for others
 - socionext,syscon-phy-mode: A phandle to syscon with one argument
	that configures phy mode. The argument is the ID of MAC instance.

Optional properties:
 - local-mac-address: See ethernet.txt in the same directory.

Required subnode:
 - mdio: A container for child nodes representing phy nodes.
         See phy.txt in the same directory.

Example:

	ether: ethernet@65000000 {
		compatible = "socionext,uniphier-ld20-ave4";
		reg = <0x65000000 0x8500>;
		interrupts = <0 66 4>;
		phy-mode = "rgmii";
		phy-handle = <&ethphy>;
		clock-names = "ether";
		clocks = <&sys_clk 6>;
		reset-names = "ether";
		resets = <&sys_rst 6>;
		socionext,syscon-phy-mode = <&soc_glue 0>;
		local-mac-address = [00 00 00 00 00 00];

		mdio {
			#address-cells = <1>;
			#size-cells = <0>;

			ethphy: ethphy@1 {
				reg = <1>;
			};
		};
	};
```

## Documentation/devicetree/bindings/net/socionext,uniphier-ave4.yaml
```yaml
# SPDX-License-Identifier: (GPL-2.0-only OR BSD-2-Clause)
%YAML 1.2
---
$id: http://devicetree.org/schemas/net/socionext,uniphier-ave4.yaml#
$schema: http://devicetree.org/meta-schemas/core.yaml#

title: Socionext AVE ethernet controller

maintainers:
  - Kunihiko Hayashi <hayashi.kunihiko@socionext.com>

description: |
  This describes the devicetree bindings for AVE ethernet controller
  implemented on Socionext UniPhier SoCs.

properties:
  compatible:
    enum:
      - socionext,uniphier-pro4-ave4
      - socionext,uniphier-pxs2-ave4
      - socionext,uniphier-ld11-ave4
      - socionext,uniphier-ld20-ave4
      - socionext,uniphier-pxs3-ave4
      - socionext,uniphier-nx1-ave4

  reg:
    maxItems: 1

  interrupts:
    maxItems: 1

  phy-mode: true

  phy-handle: true

  mac-address: true

  local-mac-address: true

  clocks:
    minItems: 1
    maxItems: 4

  clock-names:
    minItems: 1
    maxItems: 4

  resets:
    minItems: 1
    maxItems: 2

  reset-names:
    minItems: 1
    maxItems: 2

  socionext,syscon-phy-mode:
    $ref: /schemas/types.yaml#/definitions/phandle-array
    items:
      - items:
          - description: phandle to syscon that configures phy mode
          - description: ID of MAC instance
    description:
      A phandle to syscon with one argument that configures phy mode.
      The argument is the ID of MAC instance.

  mdio:
    $ref: mdio.yaml#
    unevaluatedProperties: false

allOf:
  - $ref: ethernet-controller.yaml#
  - if:
      properties:
        compatible:
          contains:
            const: socionext,uniphier-pro4-ave4
    then:
      properties:
        clocks:
          minItems: 4
          maxItems: 4
        clock-names:
          items:
            - const: gio
            - const: ether
            - const: ether-gb
            - const: ether-phy
        resets:
          minItems: 2
          maxItems: 2
        reset-names:
          items:
            - const: gio
            - const: ether
    else:
      properties:
        clocks:
          maxItems: 1
        clock-names:
          const: ether
        resets:
          maxItems: 1
        reset-names:
          const: ether

required:
  - compatible
  - reg
  - interrupts
  - phy-mode
  - phy-handle
  - clocks
  - clock-names
  - resets
  - reset-names
  - mdio

unevaluatedProperties: false

examples:
  - |
    ether: ethernet@65000000 {
        compatible = "socionext,uniphier-ld20-ave4";
                reg = <0x65000000 0x8500>;
                interrupts = <0 66 4>;
                phy-mode = "rgmii";
                phy-handle = <&ethphy>;
                clock-names = "ether";
                clocks = <&sys_clk 6>;
                reset-names = "ether";
                resets = <&sys_rst 6>;
                socionext,syscon-phy-mode = <&soc_glue 0>;

                mdio {
                        #address-cells = <1>;
                        #size-cells = <0>;

                        ethphy: ethernet-phy@1 {
                                reg = <1>;
                        };
                };
        };
```

## Documentation/devicetree/bindings/net/socionext-netsec.txt
```
* Socionext NetSec Ethernet Controller IP

Required properties:
- compatible: Should be "socionext,synquacer-netsec"
- reg: Address and length of the control register area, followed by the
       address and length of the EEPROM holding the MAC address and
       microengine firmware
- interrupts: Should contain ethernet controller interrupt
- clocks: phandle to the PHY reference clock
- clock-names: Should be "phy_ref_clk"
- phy-mode: See ethernet.txt file in the same directory
- phy-handle: See ethernet.txt in the same directory.

- mdio device tree subnode: When the Netsec has a phy connected to its local
		mdio, there must be device tree subnode with the following
		required properties:

	- #address-cells: Must be <1>.
	- #size-cells: Must be <0>.

	For each phy on the mdio bus, there must be a node with the following
	fields:
	- compatible: Refer to phy.txt
	- reg: phy id used to communicate to phy.

Optional properties: (See ethernet.txt file in the same directory)
- dma-coherent: Boolean property, must only be present if memory
	accesses performed by the device are cache coherent.
- max-speed: See ethernet.txt in the same directory.
- max-frame-size: See ethernet.txt in the same directory.

The MAC address will be determined using the optional properties
defined in ethernet.txt.

Example:
	eth0: ethernet@522d0000 {
		compatible = "socionext,synquacer-netsec";
		reg = <0 0x522d0000 0x0 0x10000>, <0 0x10000000 0x0 0x10000>;
		interrupts = <GIC_SPI 176 IRQ_TYPE_LEVEL_HIGH>;
		clocks = <&clk_netsec>;
		clock-names = "phy_ref_clk";
		phy-mode = "rgmii";
		max-speed = <1000>;
		max-frame-size = <9000>;
		phy-handle = <&phy1>;

		mdio {
			#address-cells = <1>;
			#size-cells = <0>;
			phy1: ethernet-phy@1 {
				compatible = "ethernet-phy-ieee802.3-c22";
				reg = <1>;
			};
		};
```

## Documentation/devicetree/bindings/net/sophgo,cv1800b-dwmac.yaml
```yaml
# SPDX-License-Identifier: (GPL-2.0-only OR BSD-2-Clause)
%YAML 1.2
---
$id: http://devicetree.org/schemas/net/sophgo,cv1800b-dwmac.yaml#
$schema: http://devicetree.org/meta-schemas/core.yaml#

title: Sophgo CV1800B DWMAC glue layer

maintainers:
  - Inochi Amaoto <inochiama@gmail.com>

select:
  properties:
    compatible:
      contains:
        enum:
          - sophgo,cv1800b-dwmac
  required:
    - compatible

properties:
  compatible:
    items:
      - const: sophgo,cv1800b-dwmac
      - const: snps,dwmac-3.70a

  reg:
    maxItems: 1

  clocks:
    items:
      - description: GMAC main clock
      - description: PTP clock

  clock-names:
    items:
      - const: stmmaceth
      - const: ptp_ref

  interrupts:
    maxItems: 1

  interrupt-names:
    maxItems: 1

  resets:
    maxItems: 1

  reset-names:
    const: stmmaceth

required:
  - compatible
  - reg
  - clocks
  - clock-names
  - interrupts
  - interrupt-names
  - resets
  - reset-names

allOf:
  - $ref: snps,dwmac.yaml#

unevaluatedProperties: false

examples:
  - |
    #include <dt-bindings/interrupt-controller/irq.h>

    ethernet@4070000 {
      compatible = "sophgo,cv1800b-dwmac", "snps,dwmac-3.70a";
      reg = <0x04070000 0x10000>;
      clocks = <&clk 35>, <&clk 36>;
      clock-names = "stmmaceth", "ptp_ref";
      interrupts = <31 IRQ_TYPE_LEVEL_HIGH>;
      interrupt-names = "macirq";
      phy-handle = <&internal_ephy>;
      phy-mode = "internal";
      resets = <&rst 12>;
      reset-names = "stmmaceth";
      rx-fifo-depth = <8192>;
      tx-fifo-depth = <8192>;
      snps,multicast-filter-bins = <0>;
      snps,perfect-filter-entries = <1>;
      snps,aal;
      snps,txpbl = <8>;
      snps,rxpbl = <8>;
      snps,mtl-rx-config = <&gmac0_mtl_rx_setup>;
      snps,mtl-tx-config = <&gmac0_mtl_tx_setup>;
      snps,axi-config = <&gmac0_stmmac_axi_setup>;

      mdio {
        compatible = "snps,dwmac-mdio";
        #address-cells = <1>;
        #size-cells = <0>;
      };

      gmac0_mtl_rx_setup: rx-queues-config {
        snps,rx-queues-to-use = <1>;
        queue0 {};
      };

      gmac0_mtl_tx_setup: tx-queues-config {
        snps,tx-queues-to-use = <1>;
        queue0 {};
      };

      gmac0_stmmac_axi_setup: stmmac-axi-config {
        snps,blen = <16 8 4 0 0 0 0>;
        snps,rd_osr_lmt = <2>;
        snps,wr_osr_lmt = <1>;
      };
    };
```

## Documentation/devicetree/bindings/net/sophgo,sg2044-dwmac.yaml
```yaml
# SPDX-License-Identifier: (GPL-2.0-only OR BSD-2-Clause)
%YAML 1.2
---
$id: http://devicetree.org/schemas/net/sophgo,sg2044-dwmac.yaml#
$schema: http://devicetree.org/meta-schemas/core.yaml#

title: Sophgo SG2044 DWMAC glue layer

maintainers:
  - Inochi Amaoto <inochiama@gmail.com>

select:
  properties:
    compatible:
      contains:
        enum:
          - sophgo,sg2044-dwmac
          - sophgo,sg2042-dwmac
  required:
    - compatible

properties:
  compatible:
    oneOf:
      - items:
          - const: sophgo,sg2042-dwmac
          - const: snps,dwmac-5.00a
      - items:
          - const: sophgo,sg2044-dwmac
          - const: snps,dwmac-5.30a

  reg:
    maxItems: 1

  clocks:
    items:
      - description: GMAC main clock
      - description: PTP clock
      - description: TX clock

  clock-names:
    items:
      - const: stmmaceth
      - const: ptp_ref
      - const: tx

  dma-noncoherent: true

  interrupts:
    maxItems: 1

  interrupt-names:
    maxItems: 1

  resets:
    maxItems: 1

  reset-names:
    const: stmmaceth

required:
  - compatible
  - reg
  - clocks
  - clock-names
  - interrupts
  - interrupt-names
  - resets
  - reset-names

allOf:
  - $ref: snps,dwmac.yaml#

unevaluatedProperties: false

examples:
  - |
    #include <dt-bindings/interrupt-controller/irq.h>

    ethernet@30006000 {
      compatible = "sophgo,sg2044-dwmac", "snps,dwmac-5.30a";
      reg = <0x30006000 0x4000>;
      clocks = <&clk 151>, <&clk 152>, <&clk 154>;
      clock-names = "stmmaceth", "ptp_ref", "tx";
      interrupt-parent = <&intc>;
      interrupts = <296 IRQ_TYPE_LEVEL_HIGH>;
      interrupt-names = "macirq";
      phy-handle = <&phy0>;
      phy-mode = "rgmii-id";
      resets = <&rst 30>;
      reset-names = "stmmaceth";
      snps,multicast-filter-bins = <0>;
      snps,perfect-filter-entries = <1>;
      snps,aal;
      snps,tso;
      snps,txpbl = <32>;
      snps,rxpbl = <32>;
      snps,mtl-rx-config = <&gmac0_mtl_rx_setup>;
      snps,mtl-tx-config = <&gmac0_mtl_tx_setup>;
      snps,axi-config = <&gmac0_stmmac_axi_setup>;

      gmac0_mtl_rx_setup: rx-queues-config {
        snps,rx-queues-to-use = <8>;
        snps,rx-sched-wsp;
        queue0 {};
        queue1 {};
        queue2 {};
        queue3 {};
        queue4 {};
        queue5 {};
        queue6 {};
        queue7 {};
      };

      gmac0_mtl_tx_setup: tx-queues-config {
        snps,tx-queues-to-use = <8>;
        queue0 {};
        queue1 {};
        queue2 {};
        queue3 {};
        queue4 {};
        queue5 {};
        queue6 {};
        queue7 {};
      };

      gmac0_stmmac_axi_setup: stmmac-axi-config {
        snps,blen = <16 8 4 0 0 0 0>;
        snps,wr_osr_lmt = <1>;
        snps,rd_osr_lmt = <2>;
      };
    };
```

## Documentation/devicetree/bindings/net/spacemit,k1-emac.yaml
```yaml
# SPDX-License-Identifier: GPL-2.0-only OR BSD-2-Clause
%YAML 1.2
---
$id: http://devicetree.org/schemas/net/spacemit,k1-emac.yaml#
$schema: http://devicetree.org/meta-schemas/core.yaml#

title: SpacemiT K1 Ethernet MAC

allOf:
  - $ref: ethernet-controller.yaml#

maintainers:
  - Vivian Wang <wangruikang@iscas.ac.cn>

properties:
  compatible:
    const: spacemit,k1-emac

  reg:
    maxItems: 1

  clocks:
    maxItems: 1

  interrupts:
    maxItems: 1

  mdio-bus:
    $ref: mdio.yaml#
    unevaluatedProperties: false

  resets:
    maxItems: 1

  spacemit,apmu:
    $ref: /schemas/types.yaml#/definitions/phandle-array
    items:
      - items:
          - description: phandle to syscon that controls this MAC
          - description: offset of control registers
    description:
      A phandle to syscon with byte offset to control registers for this MAC

required:
  - compatible
  - reg
  - clocks
  - interrupts
  - resets
  - spacemit,apmu

unevaluatedProperties: false

examples:
  - |
    #include <dt-bindings/clock/spacemit,k1-syscon.h>

    ethernet@cac80000 {
        compatible = "spacemit,k1-emac";
        reg = <0xcac80000 0x00000420>;
        clocks = <&syscon_apmu CLK_EMAC0_BUS>;
        interrupts = <131>;
        mac-address = [ 00 00 00 00 00 00 ];
        phy-handle = <&rgmii0>;
        phy-mode = "rgmii-id";
        pinctrl-names = "default";
        pinctrl-0 = <&gmac0_cfg>;
        resets = <&syscon_apmu RESET_EMAC0>;
        rx-internal-delay-ps = <0>;
        tx-internal-delay-ps = <0>;
        spacemit,apmu = <&syscon_apmu 0x3e4>;

        mdio-bus {
            #address-cells = <0x1>;
            #size-cells = <0x0>;

            rgmii0: phy@1 {
                reg = <0x1>;
            };
        };
    };
```
