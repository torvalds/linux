## Documentation/devicetree/bindings/net/microchip,enc28j60.txt
```
* Microchip ENC28J60

This is a standalone 10 MBit ethernet controller with SPI interface.

For each device connected to a SPI bus, define a child node within
the SPI master node.

Required properties:
- compatible: Should be "microchip,enc28j60"
- reg: Specify the SPI chip select the ENC28J60 is wired to
- interrupt-parent: Specify the phandle of the source interrupt, see interrupt
                    binding documentation for details. Usually this is the GPIO bank
                    the interrupt line is wired to.
- interrupts: Specify the interrupt index within the interrupt controller (referred
              to above in interrupt-parent) and interrupt type. The ENC28J60 natively
              generates falling edge interrupts, however, additional board logic
              might invert the signal.
- pinctrl-names: List of assigned state names, see pinctrl binding documentation.
- pinctrl-0: List of phandles to configure the GPIO pin used as interrupt line,
             see also generic and your platform specific pinctrl binding
             documentation.

Optional properties:
- spi-max-frequency: Maximum frequency of the SPI bus when accessing the ENC28J60.
  According to the ENC28J80 datasheet, the chip allows a maximum of 20 MHz, however,
  board designs may need to limit this value.
- local-mac-address: See ethernet.txt in the same directory.


Example (for NXP i.MX28 with pin control stuff for GPIO irq):

        ssp2: ssp@80014000 {
                compatible = "fsl,imx28-spi";
                pinctrl-names = "default";
                pinctrl-0 = <&spi2_pins_b &spi2_sck_cfg>;

                enc28j60: ethernet@0 {
                        compatible = "microchip,enc28j60";
                        pinctrl-names = "default";
                        pinctrl-0 = <&enc28j60_pins>;
                        reg = <0>;
                        interrupt-parent = <&gpio3>;
                        interrupts = <3 IRQ_TYPE_EDGE_FALLING>;
                        spi-max-frequency = <12000000>;
                };
        };

        pinctrl@80018000 {
                enc28j60_pins: enc28j60_pins@0 {
                        reg = <0>;
                        fsl,pinmux-ids = <
                                MX28_PAD_AUART0_RTS__GPIO_3_3    /* Interrupt */
                        >;
                        fsl,drive-strength = <MXS_DRIVE_4mA>;
                        fsl,voltage = <MXS_VOLTAGE_HIGH>;
                        fsl,pull-up = <MXS_PULL_DISABLE>;
                };
        };
```

## Documentation/devicetree/bindings/net/microchip,lan7800.yaml
```yaml
# SPDX-License-Identifier: (GPL-2.0-only OR BSD-2-Clause)
%YAML 1.2
---
$id: http://devicetree.org/schemas/net/microchip,lan7800.yaml#
$schema: http://devicetree.org/meta-schemas/core.yaml#

title: Microchip LAN7800/LAN7801/LAN7850 Gigabit Ethernet controller

maintainers:
  - Thangaraj Samynathan <Thangaraj.S@microchip.com>
  - Rengarajan Sundararajan <Rengarajan.S@microchip.com>

description:
  The LAN7800/LAN7801/LAN7850 devices are usually configured by
  programming their OTP or with an external EEPROM, but some
  platforms (e.g. Raspberry Pi 3 B+) have neither. The Device Tree
  properties, if present, override the OTP and EEPROM.

allOf:
  - $ref: /schemas/usb/usb-device.yaml#
  - $ref: /schemas/net/ethernet-controller.yaml#

properties:
  compatible:
    enum:
      - usb424,7800
      - usb424,7801
      - usb424,7850

  reg:
    maxItems: 1
    description: USB port number

  mdio:
    $ref: /schemas/net/mdio.yaml#
    unevaluatedProperties: false

    patternProperties:
      "^ethernet-phy(@[0-9a-f]+)?$":
        $ref: /schemas/net/ethernet-phy.yaml#
        unevaluatedProperties: false
        type: object

        properties:
          microchip,led-modes:
            $ref: /schemas/types.yaml#/definitions/uint32-array
            minItems: 1
            maxItems: 4
            description:
              Array of LED mode values for each of up to 4 LEDs.
              Omitted LEDs are turned off. Allowed values are defined
              in include/dt-bindings/net/microchip-lan78xx.h.

        required:
          - reg

required:
  - compatible
  - reg

unevaluatedProperties: false

examples:
  - |
    #include <dt-bindings/net/microchip-lan78xx.h>

    usb {
        #address-cells = <1>;
        #size-cells = <0>;

        ethernet@1 {
            compatible = "usb424,7800";
            reg = <1>;
            local-mac-address = [00 11 22 33 44 55];

            mdio {
                #address-cells = <1>;
                #size-cells = <0>;
                ethernet-phy@1 {
                    reg = <1>;
                    microchip,led-modes = <
                        LAN78XX_LINK_1000_ACTIVITY
                        LAN78XX_LINK_10_100_ACTIVITY
                    >;
                };
            };
        };
    };
...
```

## Documentation/devicetree/bindings/net/microchip,lan78xx.txt
```
Microchip LAN78xx Gigabit Ethernet controller

The LAN78XX devices are usually configured by programming their OTP or with
an external EEPROM, but some platforms (e.g. Raspberry Pi 3 B+) have neither.
The Device Tree properties, if present, override the OTP and EEPROM.

Required properties:
- compatible: Should be one of "usb424,7800", "usb424,7801" or "usb424,7850".

The MAC address will be determined using the optional properties
defined in ethernet.txt.

Optional properties of the embedded PHY:
- microchip,led-modes: a 0..4 element vector, with each element configuring
  the operating mode of an LED. Omitted LEDs are turned off. Allowed values
  are defined in "include/dt-bindings/net/microchip-lan78xx.h".

Example:

/* Based on the configuration for a Raspberry Pi 3 B+ */
&usb {
	usb-port@1 {
		compatible = "usb424,2514";
		reg = <1>;
		#address-cells = <1>;
		#size-cells = <0>;

		usb-port@1 {
			compatible = "usb424,2514";
			reg = <1>;
			#address-cells = <1>;
			#size-cells = <0>;

			ethernet: ethernet@1 {
				compatible = "usb424,7800";
				reg = <1>;
				local-mac-address = [ 00 11 22 33 44 55 ];

				mdio {
					#address-cells = <0x1>;
					#size-cells = <0x0>;
					eth_phy: ethernet-phy@1 {
						reg = <1>;
						microchip,led-modes = <
							LAN78XX_LINK_1000_ACTIVITY
							LAN78XX_LINK_10_100_ACTIVITY
						>;
					};
				};
			};
		};
	};
};
```

## Documentation/devicetree/bindings/net/microchip,lan8650.yaml
```yaml
# SPDX-License-Identifier: (GPL-2.0-only OR BSD-2-Clause)
%YAML 1.2
---
$id: http://devicetree.org/schemas/net/microchip,lan8650.yaml#
$schema: http://devicetree.org/meta-schemas/core.yaml#

title: Microchip LAN8650/1 10BASE-T1S MACPHY Ethernet Controllers

maintainers:
  - Parthiban Veerasooran <parthiban.veerasooran@microchip.com>

description:
  The LAN8650/1 combines a Media Access Controller (MAC) and an Ethernet
  PHY to enable 10BASE‑T1S networks. The Ethernet Media Access Controller
  (MAC) module implements a 10 Mbps half duplex Ethernet MAC, compatible
  with the IEEE 802.3 standard and a 10BASE-T1S physical layer transceiver
  integrated into the LAN8650/1. The communication between the Host and
  the MAC-PHY is specified in the OPEN Alliance 10BASE-T1x MACPHY Serial
  Interface (TC6).

allOf:
  - $ref: /schemas/net/ethernet-controller.yaml#
  - $ref: /schemas/spi/spi-peripheral-props.yaml#

properties:
  compatible:
    oneOf:
      - const: microchip,lan8650
      - items:
          - const: microchip,lan8651
          - const: microchip,lan8650

  reg:
    maxItems: 1

  interrupts:
    description:
      Interrupt from MAC-PHY asserted in the event of Receive Chunks
      Available, Transmit Chunk Credits Available and Extended Status
      Event.
    maxItems: 1

  spi-max-frequency:
    minimum: 15000000
    maximum: 25000000

required:
  - compatible
  - reg
  - interrupts
  - spi-max-frequency

unevaluatedProperties: false

examples:
  - |
    #include <dt-bindings/interrupt-controller/irq.h>
    #include <dt-bindings/gpio/gpio.h>

    spi {
      #address-cells = <1>;
      #size-cells = <0>;

      ethernet@0 {
        compatible = "microchip,lan8651", "microchip,lan8650";
        reg = <0>;
        pinctrl-names = "default";
        pinctrl-0 = <&eth0_pins>;
        interrupt-parent = <&gpio>;
        interrupts = <6 IRQ_TYPE_EDGE_FALLING>;
        local-mac-address = [04 05 06 01 02 03];
        spi-max-frequency = <15000000>;
      };
    };
```

## Documentation/devicetree/bindings/net/microchip,lan95xx.yaml
```yaml
# SPDX-License-Identifier: (GPL-2.0-only OR BSD-2-Clause)
%YAML 1.2
---
$id: http://devicetree.org/schemas/net/microchip,lan95xx.yaml#
$schema: http://devicetree.org/meta-schemas/core.yaml#

title: Microchip SMSC9500/LAN9530/LAN9730 USB Ethernet Controllers

maintainers:
  - Oleksij Rempel <o.rempel@pengutronix.de>

description: |
  Device tree properties for hard wired SMSC95xx compatible USB Ethernet
  controller.

allOf:
  - $ref: ethernet-controller.yaml#

properties:
  compatible:
    items:
      - enum:
          - usb424,9500   # SMSC9500 USB Ethernet Device
          - usb424,9505   # SMSC9505 USB Ethernet Device
          - usb424,9530   # SMSC LAN9530 USB Ethernet Device
          - usb424,9730   # SMSC LAN9730 USB Ethernet Device
          - usb424,9900   # SMSC9500 USB Ethernet Device (SAL10)
          - usb424,9901   # SMSC9505 USB Ethernet Device (SAL10)
          - usb424,9902   # SMSC9500A USB Ethernet Device (SAL10)
          - usb424,9903   # SMSC9505A USB Ethernet Device (SAL10)
          - usb424,9904   # SMSC9512/9514 USB Hub & Ethernet Device (SAL10)
          - usb424,9905   # SMSC9500A USB Ethernet Device (HAL)
          - usb424,9906   # SMSC9505A USB Ethernet Device (HAL)
          - usb424,9907   # SMSC9500 USB Ethernet Device (Alternate ID)
          - usb424,9908   # SMSC9500A USB Ethernet Device (Alternate ID)
          - usb424,9909   # SMSC9512/9514 USB Hub & Ethernet Devic.  ID)
          - usb424,9e00   # SMSC9500A USB Ethernet Device
          - usb424,9e01   # SMSC9505A USB Ethernet Device
          - usb424,9e08   # SMSC LAN89530 USB Ethernet Device
          - usb424,ec00   # SMSC9512/9514 USB Hub & Ethernet Device

  reg:
    maxItems: 1

  local-mac-address: true
  mac-address: true

required:
  - compatible
  - reg

additionalProperties: false

examples:
  - |
    usb {
        #address-cells = <1>;
        #size-cells = <0>;

        ethernet@1 {
            compatible = "usb424,9e00";
            reg = <1>;
            local-mac-address = [00 00 00 00 00 00];
        };
    };
```

## Documentation/devicetree/bindings/net/microchip,lan966x-switch.yaml
```yaml
# SPDX-License-Identifier: GPL-2.0-only OR BSD-2-Clause
%YAML 1.2
---
$id: http://devicetree.org/schemas/net/microchip,lan966x-switch.yaml#
$schema: http://devicetree.org/meta-schemas/core.yaml#

title: Microchip Lan966x Ethernet switch controller

maintainers:
  - Horatiu Vultur <horatiu.vultur@microchip.com>

description: |
  The lan966x switch is a multi-port Gigabit AVB/TSN Ethernet Switch with
  two integrated 10/100/1000Base-T PHYs. In addition to the integrated PHYs,
  it supports up to 2RGMII/RMII, up to 3BASE-X/SERDES/2.5GBASE-X and up to
  2 Quad-SGMII/Quad-USGMII interfaces.

properties:
  $nodename:
    pattern: "^switch@[0-9a-f]+$"

  compatible:
    const: microchip,lan966x-switch

  reg:
    items:
      - description: cpu target
      - description: general control block target

  reg-names:
    items:
      - const: cpu
      - const: gcb

  interrupts:
    minItems: 1
    items:
      - description: register based extraction
      - description: frame dma based extraction
      - description: analyzer interrupt
      - description: ptp interrupt
      - description: ptp external interrupt

  interrupt-names:
    minItems: 1
    items:
      - const: xtr
      - const: fdma
      - const: ana
      - const: ptp
      - const: ptp-ext

  resets:
    items:
      - description: Reset controller used for switch core reset (soft reset)

  reset-names:
    items:
      - const: switch

  ethernet-ports:
    type: object

    properties:
      '#address-cells':
        const: 1
      '#size-cells':
        const: 0

    additionalProperties: false

    patternProperties:
      "^port@[0-9a-f]+$":
        type: object

        $ref: "/schemas/net/ethernet-controller.yaml#"
        unevaluatedProperties: false

        properties:
          '#address-cells':
            const: 1
          '#size-cells':
            const: 0

          reg:
            description:
              Switch port number

          phys:
            description:
              Phandle of a Ethernet SerDes PHY

          phy-mode:
            description:
              This specifies the interface used by the Ethernet SerDes towards
              the PHY or SFP.
            enum:
              - gmii
              - sgmii
              - qsgmii
              - 1000base-x
              - 2500base-x

          phy-handle:
            description:
              Phandle of a Ethernet PHY.

          sfp:
            description:
              Phandle of an SFP.

          managed: true

        required:
          - reg
          - phys
          - phy-mode

        oneOf:
          - required:
              - phy-handle
          - required:
              - sfp
              - managed

required:
  - compatible
  - reg
  - reg-names
  - interrupts
  - interrupt-names
  - resets
  - reset-names
  - ethernet-ports

additionalProperties: false

examples:
  - |
    #include <dt-bindings/interrupt-controller/arm-gic.h>
    switch: switch@e0000000 {
      compatible = "microchip,lan966x-switch";
      reg =  <0xe0000000 0x0100000>,
             <0xe2000000 0x0800000>;
      reg-names = "cpu", "gcb";
      interrupts = <GIC_SPI 30 IRQ_TYPE_LEVEL_HIGH>;
      interrupt-names = "xtr";
      resets = <&switch_reset 0>;
      reset-names = "switch";
      ethernet-ports {
        #address-cells = <1>;
        #size-cells = <0>;

        port0: port@0 {
          reg = <0>;
          phy-handle = <&phy0>;
          phys = <&serdes 0 0>;
          phy-mode = "gmii";
        };

        port1: port@1 {
          reg = <1>;
          sfp = <&sfp_eth1>;
          managed = "in-band-status";
          phys = <&serdes 2 4>;
          phy-mode = "sgmii";
        };
      };
    };

...
```

## Documentation/devicetree/bindings/net/microchip,pic64hpsc-mdio.yaml
```yaml
# SPDX-License-Identifier: (GPL-2.0 OR BSD-2-Clause)
%YAML 1.2
---
$id: http://devicetree.org/schemas/net/microchip,pic64hpsc-mdio.yaml#
$schema: http://devicetree.org/meta-schemas/core.yaml#

title: Microchip PIC64-HPSC/HX MDIO controller

maintainers:
  - Charles Perry <charles.perry@microchip.com>

description:
  This is the MDIO bus controller present in Microchip PIC64-HPSC/HX SoCs. It
  supports C22 and C45 register access and is named "MDIO Initiator" in the
  documentation.

allOf:
  - $ref: mdio.yaml#

properties:
  compatible:
    oneOf:
      - const: microchip,pic64hpsc-mdio
      - items:
          - const: microchip,pic64hx-mdio
          - const: microchip,pic64hpsc-mdio

  reg:
    maxItems: 1

  clocks:
    maxItems: 1

  clock-frequency:
    default: 2500000

  interrupts:
    maxItems: 1

required:
  - compatible
  - reg
  - clocks
  - interrupts

unevaluatedProperties: false

examples:
  - |
    #include <dt-bindings/interrupt-controller/irq.h>
    bus {
        #address-cells = <2>;
        #size-cells = <2>;

        mdio@4000c21e000 {
            compatible = "microchip,pic64hpsc-mdio";
            reg = <0x400 0x0c21e000 0x0 0x1000>;
            #address-cells = <1>;
            #size-cells = <0>;
            clocks = <&svc_clk>;
            interrupt-parent = <&saplic0>;
            interrupts = <168 IRQ_TYPE_LEVEL_HIGH>;

            ethernet-phy@0 {
                reg = <0>;
            };
        };
    };
```
