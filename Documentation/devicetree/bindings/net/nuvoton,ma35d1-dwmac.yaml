## Documentation/devicetree/bindings/net/pse-pd/microchip,pd692x0.yaml
```yaml
# SPDX-License-Identifier: (GPL-2.0-only OR BSD-2-Clause)
%YAML 1.2
---
$id: http://devicetree.org/schemas/net/pse-pd/microchip,pd692x0.yaml#
$schema: http://devicetree.org/meta-schemas/core.yaml#

title: Microchip PD692x0 Power Sourcing Equipment controller

maintainers:
  - Kory Maincent <kory.maincent@bootlin.com>

allOf:
  - $ref: pse-controller.yaml#

properties:
  compatible:
    enum:
      - microchip,pd69200
      - microchip,pd69210
      - microchip,pd69220

  reg:
    maxItems: 1

  managers:
    type: object
    description:
      List of the PD69208T4/PD69204T4/PD69208M PSE managers. Each manager
      have 4 or 8 physical ports according to the chip version. No need to
      specify the SPI chip select as it is automatically detected by the
      PD692x0 PSE controller. The PSE managers have to be described from
      the lowest chip select to the greatest one, which is the detection
      behavior of the PD692x0 PSE controller. The PD692x0 support up to
      12 PSE managers which can expose up to 96 physical ports. All
      physical ports available on a manager have to be described in the
      incremental order even if they are not used.

    properties:
      "#address-cells":
        const: 1

      "#size-cells":
        const: 0

    required:
      - "#address-cells"
      - "#size-cells"

    patternProperties:
      "^manager@0[0-9a-b]$":
        type: object
        description:
          PD69208T4/PD69204T4/PD69208M PSE manager exposing 4 or 8 physical
          ports.

        properties:
          reg:
            description:
              Incremental index of the PSE manager starting from 0, ranging
              from lowest to highest chip select, up to 11.
            maxItems: 1

          "#address-cells":
            const: 1

          "#size-cells":
            const: 0

        patternProperties:
          '^port@[0-7]$':
            type: object
            required:
              - reg
            additionalProperties: false

        required:
          - reg
          - "#address-cells"
          - "#size-cells"

required:
  - compatible
  - reg
  - pse-pis

unevaluatedProperties: false

examples:
  - |
    i2c {
      #address-cells = <1>;
      #size-cells = <0>;

      ethernet-pse@3c {
        compatible = "microchip,pd69200";
        reg = <0x3c>;

        managers {
          #address-cells = <1>;
          #size-cells = <0>;

          manager@0 {
            reg = <0>;
            #address-cells = <1>;
            #size-cells = <0>;

            phys0: port@0 {
              reg = <0>;
            };

            phys1: port@1 {
              reg = <1>;
            };

            phys2: port@2 {
              reg = <2>;
            };

            phys3: port@3 {
              reg = <3>;
            };
          };

          manager@1 {
            reg = <1>;
            #address-cells = <1>;
            #size-cells = <0>;

            phys4: port@0 {
              reg = <0>;
            };

            phys5: port@1 {
              reg = <1>;
            };

            phys6: port@2 {
              reg = <2>;
            };

            phys7: port@3 {
              reg = <3>;
            };
          };
        };

        pse-pis {
          #address-cells = <1>;
          #size-cells = <0>;

          pse_pi0: pse-pi@0 {
            reg = <0>;
            #pse-cells = <0>;
            pairset-names = "alternative-a", "alternative-b";
            pairsets = <&phys0>, <&phys1>;
            polarity-supported = "MDI", "S";
            vpwr-supply = <&vpwr1>;
          };
          pse_pi1: pse-pi@1 {
            reg = <1>;
            #pse-cells = <0>;
            pairset-names = "alternative-a";
            pairsets = <&phys2>;
            polarity-supported = "MDI";
            vpwr-supply = <&vpwr2>;
          };
        };
      };
    };
```

## Documentation/devicetree/bindings/net/pse-pd/podl-pse-regulator.yaml
```yaml
# SPDX-License-Identifier: (GPL-2.0-only OR BSD-2-Clause)
%YAML 1.2
---
$id: http://devicetree.org/schemas/net/pse-pd/podl-pse-regulator.yaml#
$schema: http://devicetree.org/meta-schemas/core.yaml#

title: Regulator based Power Sourcing Equipment

maintainers:
  - Oleksij Rempel <o.rempel@pengutronix.de>

description: Regulator based PoDL PSE controller. The device must be referenced
  by the PHY node to control power injection to the Ethernet cable.

allOf:
  - $ref: pse-controller.yaml#

properties:
  compatible:
    const: podl-pse-regulator

  '#pse-cells':
    const: 0

  pse-supply:
    description: Power supply for the PSE controller

additionalProperties: false

required:
  - compatible
  - pse-supply

examples:
  - |
    ethernet-pse {
      compatible = "podl-pse-regulator";
      pse-supply = <&reg_t1l1>;
      #pse-cells = <0>;
    };
```

## Documentation/devicetree/bindings/net/pse-pd/pse-controller.yaml
```yaml
# SPDX-License-Identifier: (GPL-2.0-only OR BSD-2-Clause)
%YAML 1.2
---
$id: http://devicetree.org/schemas/net/pse-pd/pse-controller.yaml#
$schema: http://devicetree.org/meta-schemas/core.yaml#

title: Power Sourcing Equipment (PSE).

description: Binding for the Power Sourcing Equipment (PSE) as defined in the
  IEEE 802.3 specification. It is designed for hardware which is delivering
  power over twisted pair/ethernet cable. The ethernet-pse nodes should be
  used to describe PSE controller and referenced by the ethernet-phy node.

maintainers:
  - Oleksij Rempel <o.rempel@pengutronix.de>

properties:
  $nodename:
    pattern: "^ethernet-pse(@.*)?$"

  "#pse-cells":
    description:
      Used to uniquely identify a PSE instance within an IC. Will be
      0 on PSE nodes with only a single output and at least 1 on nodes
      controlling several outputs.
    enum: [0, 1]

required:
  - "#pse-cells"

additionalProperties: true

...
```

## Documentation/devicetree/bindings/net/pse-pd/skyworks,si3474.yaml
```yaml
# SPDX-License-Identifier: (GPL-2.0-only OR BSD-2-Clause)
%YAML 1.2
---
$id: http://devicetree.org/schemas/net/pse-pd/skyworks,si3474.yaml#
$schema: http://devicetree.org/meta-schemas/core.yaml#

title: Skyworks Si3474 Power Sourcing Equipment controller

maintainers:
  - Piotr Kubik <piotr.kubik@adtran.com>

allOf:
  - $ref: pse-controller.yaml#

properties:
  compatible:
    enum:
      - skyworks,si3474

  reg:
    maxItems: 2

  reg-names:
    items:
      - const: main
      - const: secondary

  channels:
    description: The Si3474 is a single-chip PoE PSE controller managing
      8 physical power delivery channels. Internally, it's structured
      into two logical "Quads".
      Quad 0 Manages physical channels ('ports' in datasheet) 0, 1, 2, 3
      Quad 1 Manages physical channels ('ports' in datasheet) 4, 5, 6, 7.

    type: object
    additionalProperties: false

    properties:
      "#address-cells":
        const: 1

      "#size-cells":
        const: 0

    patternProperties:
      '^channel@[0-7]$':
        type: object
        additionalProperties: false

        properties:
          reg:
            maxItems: 1

        required:
          - reg

    required:
      - "#address-cells"
      - "#size-cells"

required:
  - compatible
  - reg
  - pse-pis

unevaluatedProperties: false

examples:
  - |
    i2c {
      #address-cells = <1>;
      #size-cells = <0>;

      ethernet-pse@26 {
        compatible = "skyworks,si3474";
        reg-names = "main", "secondary";
        reg = <0x26>, <0x27>;

        channels {
          #address-cells = <1>;
          #size-cells = <0>;
          phys0_0: channel@0 {
            reg = <0>;
          };
          phys0_1: channel@1 {
            reg = <1>;
          };
          phys0_2: channel@2 {
            reg = <2>;
          };
          phys0_3: channel@3 {
            reg = <3>;
          };
          phys0_4: channel@4 {
            reg = <4>;
          };
          phys0_5: channel@5 {
            reg = <5>;
          };
          phys0_6: channel@6 {
            reg = <6>;
          };
          phys0_7: channel@7 {
            reg = <7>;
          };
        };
        pse-pis {
          #address-cells = <1>;
          #size-cells = <0>;
          pse_pi0: pse-pi@0 {
            reg = <0>;
            #pse-cells = <0>;
            pairset-names = "alternative-a", "alternative-b";
            pairsets = <&phys0_0>, <&phys0_1>;
            polarity-supported = "MDI-X", "S";
            vpwr-supply = <&reg_pse>;
          };
          pse_pi1: pse-pi@1 {
            reg = <1>;
            #pse-cells = <0>;
            pairset-names = "alternative-a", "alternative-b";
            pairsets = <&phys0_2>, <&phys0_3>;
            polarity-supported = "MDI-X", "S";
            vpwr-supply = <&reg_pse>;
          };
          pse_pi2: pse-pi@2 {
            reg = <2>;
            #pse-cells = <0>;
            pairset-names = "alternative-a", "alternative-b";
            pairsets = <&phys0_4>, <&phys0_5>;
            polarity-supported = "MDI-X", "S";
            vpwr-supply = <&reg_pse>;
          };
          pse_pi3: pse-pi@3 {
            reg = <3>;
            #pse-cells = <0>;
            pairset-names = "alternative-a", "alternative-b";
            pairsets = <&phys0_6>, <&phys0_7>;
            polarity-supported = "MDI-X", "S";
            vpwr-supply = <&reg_pse>;
          };
        };
      };
    };
```

## Documentation/devicetree/bindings/net/pse-pd/ti,tps23881.yaml
```yaml
# SPDX-License-Identifier: (GPL-2.0-only OR BSD-2-Clause)
%YAML 1.2
---
$id: http://devicetree.org/schemas/net/pse-pd/ti,tps23881.yaml#
$schema: http://devicetree.org/meta-schemas/core.yaml#

title: TI TPS23881 Power Sourcing Equipment controller

maintainers:
  - Kory Maincent <kory.maincent@bootlin.com>

allOf:
  - $ref: pse-controller.yaml#

properties:
  compatible:
    enum:
      - ti,tps23881

  reg:
    maxItems: 1

  '#pse-cells':
    const: 1

  reset-gpios:
    maxItems: 1

  channels:
    description: each set of 8 ports can be assigned to one physical
      channels or two for PoE4. This parameter describes the configuration
      of the ports conversion matrix that establishes relationship between
      the logical ports and the physical channels.
    type: object
    additionalProperties: false

    properties:
      "#address-cells":
        const: 1

      "#size-cells":
        const: 0

    patternProperties:
      '^channel@[0-7]$':
        type: object
        additionalProperties: false

        properties:
          reg:
            maxItems: 1

        required:
          - reg

    required:
      - "#address-cells"
      - "#size-cells"

unevaluatedProperties: false

required:
  - compatible
  - reg

examples:
  - |
    i2c {
      #address-cells = <1>;
      #size-cells = <0>;

      ethernet-pse@20 {
        compatible = "ti,tps23881";
        reg = <0x20>;

        channels {
          #address-cells = <1>;
          #size-cells = <0>;

          phys0: channel@0 {
            reg = <0>;
          };

          phys1: channel@1 {
            reg = <1>;
          };

          phys2: channel@2 {
            reg = <2>;
          };
        };

        pse-pis {
          #address-cells = <1>;
          #size-cells = <0>;

          pse_pi0: pse-pi@0 {
            reg = <0>;
            #pse-cells = <0>;
            pairset-names = "alternative-a", "alternative-b";
            pairsets = <&phys0>, <&phys1>;
            polarity-supported = "MDI", "S";
            vpwr-supply = <&vpwr1>;
          };

          pse_pi1: pse-pi@1 {
            reg = <1>;
            #pse-cells = <0>;
            pairset-names = "alternative-a";
            pairsets = <&phys2>;
            polarity-supported = "MDI";
            vpwr-supply = <&vpwr2>;
          };
        };
      };
    };
```

## Documentation/devicetree/bindings/net/qca,ar71xx.txt
```
Required properties:
- compatible:	Should be "qca,<soc>-eth". Currently support compatibles are:
		qca,ar7100-eth - Atheros AR7100
		qca,ar7240-eth - Atheros AR7240
		qca,ar7241-eth - Atheros AR7241
		qca,ar7242-eth - Atheros AR7242
		qca,ar9130-eth - Atheros AR9130
		qca,ar9330-eth - Atheros AR9330
		qca,ar9340-eth - Atheros AR9340
		qca,qca9530-eth - Qualcomm Atheros QCA9530
		qca,qca9550-eth - Qualcomm Atheros QCA9550
		qca,qca9560-eth - Qualcomm Atheros QCA9560

- reg : Address and length of the register set for the device
- interrupts : Should contain eth interrupt
- phy-mode : See ethernet.txt file in the same directory
- clocks: the clock used by the core
- clock-names: the names of the clock listed in the clocks property. These are
	"eth" and "mdio".
- resets: Should contain phandles to the reset signals
- reset-names: Should contain the names of reset signal listed in the resets
		property. These are "mac" and "mdio"

Optional properties:
- phy-handle : phandle to the PHY device connected to this device.
- fixed-link : Assume a fixed link. See fixed-link.txt in the same directory.
  Use instead of phy-handle.

Optional subnodes:
- mdio : specifies the mdio bus, used as a container for phy nodes
  according to phy.txt in the same directory

Example:

ethernet@1a000000 {
	compatible = "qca,ar9330-eth";
	reg = <0x1a000000 0x200>;
	interrupts = <5>;
	resets = <&rst 13>, <&rst 23>;
	reset-names = "mac", "mdio";
	clocks = <&pll ATH79_CLK_AHB>, <&pll ATH79_CLK_MDIO>;
	clock-names = "eth", "mdio";

	phy-mode = "gmii";
};
```
