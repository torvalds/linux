## Documentation/devicetree/bindings/net/nuvoton,ma35d1-dwmac.yaml
```yaml
# SPDX-License-Identifier: (GPL-2.0-only OR BSD-2-Clause)
%YAML 1.2
---
$id: http://devicetree.org/schemas/net/nuvoton,ma35d1-dwmac.yaml#
$schema: http://devicetree.org/meta-schemas/core.yaml#

title: Nuvoton DWMAC glue layer controller

maintainers:
  - Joey Lu <yclu4@nuvoton.com>

description:
  Nuvoton 10/100/1000Mbps Gigabit Ethernet MAC Controller is based on
  Synopsys DesignWare MAC (version 3.73a).

select:
  properties:
    compatible:
      contains:
        enum:
          - nuvoton,ma35d1-dwmac
  required:
    - compatible

allOf:
  - $ref: snps,dwmac.yaml#

properties:
  compatible:
    items:
      - const: nuvoton,ma35d1-dwmac
      - const: snps,dwmac-3.70a

  reg:
    maxItems: 1
    description:
      Register range should be one of the GMAC interface.

  interrupts:
    maxItems: 1

  clocks:
    items:
      - description: MAC clock
      - description: PTP clock

  clock-names:
    items:
      - const: stmmaceth
      - const: ptp_ref

  nuvoton,sys:
    $ref: /schemas/types.yaml#/definitions/phandle-array
    items:
      - items:
          - description: phandle to access syscon registers.
          - description: GMAC interface ID.
            enum:
              - 0
              - 1
    description:
      A phandle to the syscon with one argument that configures system registers
      for MA35D1's two GMACs. The argument specifies the GMAC interface ID.

  resets:
    maxItems: 1

  reset-names:
    items:
      - const: stmmaceth

  phy-mode:
    enum:
      - rmii
      - rgmii
      - rgmii-id
      - rgmii-txid
      - rgmii-rxid

  tx-internal-delay-ps:
    default: 0
    minimum: 0
    maximum: 2000
    description:
      RGMII TX path delay used only when PHY operates in RGMII mode with
      internal delay (phy-mode is 'rgmii-id' or 'rgmii-txid') in pico-seconds.
      Allowed values are from 0 to 2000.

  rx-internal-delay-ps:
    default: 0
    minimum: 0
    maximum: 2000
    description:
      RGMII RX path delay used only when PHY operates in RGMII mode with
      internal delay (phy-mode is 'rgmii-id' or 'rgmii-rxid') in pico-seconds.
      Allowed values are from 0 to 2000.

required:
  - clocks
  - clock-names
  - nuvoton,sys
  - resets
  - reset-names
  - phy-mode

unevaluatedProperties: false

examples:
  - |
    #include <dt-bindings/interrupt-controller/arm-gic.h>
    #include <dt-bindings/clock/nuvoton,ma35d1-clk.h>
    #include <dt-bindings/reset/nuvoton,ma35d1-reset.h>
    ethernet@40120000 {
        compatible = "nuvoton,ma35d1-dwmac", "snps,dwmac-3.70a";
        reg = <0x40120000 0x10000>;
        interrupts = <GIC_SPI 23 IRQ_TYPE_LEVEL_HIGH>;
        interrupt-names = "macirq";
        clocks = <&clk EMAC0_GATE>, <&clk EPLL_DIV8>;
        clock-names = "stmmaceth", "ptp_ref";

        nuvoton,sys = <&sys 0>;
        resets = <&sys MA35D1_RESET_GMAC0>;
        reset-names = "stmmaceth";
        snps,multicast-filter-bins = <0>;
        snps,perfect-filter-entries = <8>;
        rx-fifo-depth = <4096>;
        tx-fifo-depth = <2048>;

        phy-mode = "rgmii-id";
        phy-handle = <&eth_phy0>;
        mdio {
            compatible = "snps,dwmac-mdio";
            #address-cells = <1>;
            #size-cells = <0>;

            eth_phy0: ethernet-phy@0 {
                reg = <0>;
            };
        };
    };
```

## Documentation/devicetree/bindings/net/nuvoton,npcm7xx-emc.txt
```
Nuvoton NPCM7XX 10/100 Ethernet MAC Controller (EMC)

The NPCM750x provides two identical Ethernet MAC Controllers
for WAN/LAN applications

Required properties:
- device_type     : Should be "network"
- compatible      : "nuvoton,npcm750-emc" for Poleg NPCM750.
- reg             : Offset and length of the register set for the device.
- interrupts      : Contain the emc interrupts with flags for falling edge.
                    first interrupt dedicated to Txirq
                    second interrupt dedicated to Rxirq
- phy-mode        : Should be "rmii" (see ethernet.txt in the same directory)
- clocks          : phandle of emc reference clock.
- use-ncsi        : Use the NC-SI stack instead of an MDIO PHY

Example:

emc0: eth@f0825000 {
	device_type = "network";
	compatible = "nuvoton,npcm750-emc";
	reg = <0xf0825000 0x1000>;
	interrupts = <GIC_SPI 16 IRQ_TYPE_LEVEL_HIGH>,
	             <GIC_SPI 15 IRQ_TYPE_LEVEL_HIGH>;
	phy-mode = "rmii";
	clocks = <&clk NPCM7XX_CLK_AHB>;

	#use-ncsi; /* add this to support ncsi */

	clock-names = "clk_emc";
	pinctrl-names = "default";
	pinctrl-0 = <&r1_pins
	             &r1err_pins
	             &r1md_pins>;
	status = "okay";
};
```

## Documentation/devicetree/bindings/net/nvidia,tegra234-mgbe.yaml
```yaml
# SPDX-License-Identifier: (GPL-2.0-only OR BSD-2-Clause)
%YAML 1.2
---
$id: http://devicetree.org/schemas/net/nvidia,tegra234-mgbe.yaml#
$schema: http://devicetree.org/meta-schemas/core.yaml#

title: Tegra234 MGBE Multi-Gigabit Ethernet Controller

maintainers:
  - Thierry Reding <treding@nvidia.com>
  - Jon Hunter <jonathanh@nvidia.com>

properties:
  compatible:
    const: nvidia,tegra234-mgbe

  reg:
    maxItems: 3

  reg-names:
    items:
      - const: hypervisor
      - const: mac
      - const: xpcs

  interrupts:
    minItems: 1
    maxItems: 3

  interrupt-names:
    minItems: 1
    items:
      - const: common
      - const: macsec-ns
      - const: macsec

  clocks:
    maxItems: 12

  clock-names:
    items:
      - const: mgbe
      - const: mac
      - const: mac-divider
      - const: ptp-ref
      - const: rx-input-m
      - const: rx-input
      - const: tx
      - const: eee-pcs
      - const: rx-pcs-input
      - const: rx-pcs-m
      - const: rx-pcs
      - const: tx-pcs

  resets:
    maxItems: 2

  reset-names:
    items:
      - const: mac
      - const: pcs

  interconnects:
    items:
      - description: memory read client
      - description: memory write client

  interconnect-names:
    items:
      - const: dma-mem
      - const: write

  iommus:
    maxItems: 1

  power-domains:
    maxItems: 1

  phy-handle: true

  phy-mode:
    contains:
      enum:
        - usxgmii
        - 10gbase-kr

  mdio:
    $ref: mdio.yaml#
    unevaluatedProperties: false
    description:
      Optional node for embedded MDIO controller.

required:
  - compatible
  - reg
  - interrupts
  - interrupt-names
  - clocks
  - clock-names
  - resets
  - reset-names
  - power-domains
  - phy-handle
  - phy-mode

additionalProperties: false

examples:
  - |
    #include <dt-bindings/clock/tegra234-clock.h>
    #include <dt-bindings/interrupt-controller/arm-gic.h>
    #include <dt-bindings/memory/tegra234-mc.h>
    #include <dt-bindings/power/tegra234-powergate.h>
    #include <dt-bindings/reset/tegra234-reset.h>

    ethernet@6800000 {
        compatible = "nvidia,tegra234-mgbe";
        reg = <0x06800000 0x10000>,
              <0x06810000 0x10000>,
              <0x068a0000 0x10000>;
        reg-names = "hypervisor", "mac", "xpcs";
        interrupts = <GIC_SPI 384 IRQ_TYPE_LEVEL_HIGH>;
        interrupt-names = "common";
        clocks = <&bpmp TEGRA234_CLK_MGBE0_APP>,
                 <&bpmp TEGRA234_CLK_MGBE0_MAC>,
                 <&bpmp TEGRA234_CLK_MGBE0_MAC_DIVIDER>,
                 <&bpmp TEGRA234_CLK_MGBE0_PTP_REF>,
                 <&bpmp TEGRA234_CLK_MGBE0_RX_INPUT_M>,
                 <&bpmp TEGRA234_CLK_MGBE0_RX_INPUT>,
                 <&bpmp TEGRA234_CLK_MGBE0_TX>,
                 <&bpmp TEGRA234_CLK_MGBE0_EEE_PCS>,
                 <&bpmp TEGRA234_CLK_MGBE0_RX_PCS_INPUT>,
                 <&bpmp TEGRA234_CLK_MGBE0_RX_PCS_M>,
                 <&bpmp TEGRA234_CLK_MGBE0_RX_PCS>,
                 <&bpmp TEGRA234_CLK_MGBE0_TX_PCS>;
        clock-names = "mgbe", "mac", "mac-divider", "ptp-ref", "rx-input-m",
                      "rx-input", "tx", "eee-pcs", "rx-pcs-input", "rx-pcs-m",
                      "rx-pcs", "tx-pcs";
        resets = <&bpmp TEGRA234_RESET_MGBE0_MAC>,
                 <&bpmp TEGRA234_RESET_MGBE0_PCS>;
        reset-names = "mac", "pcs";
        interconnects = <&mc TEGRA234_MEMORY_CLIENT_MGBEARD &emc>,
                        <&mc TEGRA234_MEMORY_CLIENT_MGBEAWR &emc>;
        interconnect-names = "dma-mem", "write";
        iommus = <&smmu_niso0 TEGRA234_SID_MGBE>;
        power-domains = <&bpmp TEGRA234_POWER_DOMAIN_MGBEA>;

        phy-handle = <&mgbe0_phy>;
        phy-mode = "usxgmii";

        mdio {
            #address-cells = <1>;
            #size-cells = <0>;

            mgbe0_phy: phy@0 {
                compatible = "ethernet-phy-ieee802.3-c45";
                reg = <0x0>;

                #phy-cells = <0>;
            };
        };
    };
```

## Documentation/devicetree/bindings/net/nxp,dwmac-imx.yaml
```yaml
# SPDX-License-Identifier: (GPL-2.0-only OR BSD-2-Clause)
%YAML 1.2
---
$id: http://devicetree.org/schemas/net/nxp,dwmac-imx.yaml#
$schema: http://devicetree.org/meta-schemas/core.yaml#

title: NXP i.MX8/9 DWMAC glue layer

maintainers:
  - Clark Wang <xiaoning.wang@nxp.com>
  - Shawn Guo <shawnguo@kernel.org>
  - NXP Linux Team <linux-imx@nxp.com>

# We need a select here so we don't match all nodes with 'snps,dwmac'
select:
  properties:
    compatible:
      contains:
        enum:
          - nxp,imx8mp-dwmac-eqos
          - nxp,imx8dxl-dwmac-eqos
          - nxp,imx93-dwmac-eqos
  required:
    - compatible

allOf:
  - $ref: snps,dwmac.yaml#

properties:
  compatible:
    oneOf:
      - items:
          - enum:
              - nxp,imx8mp-dwmac-eqos
              - nxp,imx8dxl-dwmac-eqos
              - nxp,imx93-dwmac-eqos
          - const: snps,dwmac-5.10a

  clocks:
    minItems: 3
    items:
      - description: MAC host clock
      - description: MAC apb clock
      - description: MAC timer clock
      - description: MAC RGMII TX clock
      - description: EQOS MEM clock

  clock-names:
    minItems: 3
    maxItems: 5
    contains:
      enum:
        - stmmaceth
        - pclk
        - ptp_ref
        - tx
        - mem

  interrupts:
    maxItems: 2

  interrupt-names:
    items:
      - const: macirq
      - const: eth_wake_irq

  intf_mode:
    $ref: /schemas/types.yaml#/definitions/phandle-array
    items:
      - items:
          - description: phandle to the GPR syscon
          - description: the offset of the GPR register
    description:
      Should be phandle/offset pair. The phandle to the syscon node which
      encompases the GPR register, and the offset of the GPR register.

  nvmem-cells: true

  nvmem-cell-names: true

  snps,rmii_refclk_ext:
    $ref: /schemas/types.yaml#/definitions/flag
    description:
      To select RMII reference clock from external.

required:
  - compatible
  - clocks
  - clock-names

unevaluatedProperties: false

examples:
  - |
    #include <dt-bindings/interrupt-controller/arm-gic.h>
    #include <dt-bindings/interrupt-controller/irq.h>
    #include <dt-bindings/clock/imx8mp-clock.h>

    eqos: ethernet@30bf0000 {
            compatible = "nxp,imx8mp-dwmac-eqos","snps,dwmac-5.10a";
            reg = <0x30bf0000 0x10000>;
            interrupts = <GIC_SPI 135 IRQ_TYPE_LEVEL_HIGH>,
                         <GIC_SPI 134 IRQ_TYPE_LEVEL_HIGH>;
            interrupt-names = "macirq", "eth_wake_irq";
            clocks = <&clk IMX8MP_CLK_ENET_QOS_ROOT>,
                     <&clk IMX8MP_CLK_QOS_ENET_ROOT>,
                     <&clk IMX8MP_CLK_ENET_QOS_TIMER>,
                     <&clk IMX8MP_CLK_ENET_QOS>;
            clock-names = "stmmaceth", "pclk", "ptp_ref", "tx";
            phy-mode = "rgmii";
    };
```

## Documentation/devicetree/bindings/net/nxp,lpc-eth.yaml
```yaml
# SPDX-License-Identifier: (GPL-2.0-only OR BSD-2-Clause)
%YAML 1.2
---
$id: http://devicetree.org/schemas/net/nxp,lpc-eth.yaml#
$schema: http://devicetree.org/meta-schemas/core.yaml#

title: NXP LPC32xx SoC Ethernet Controller

maintainers:
  - Frank Li <Frank.Li@nxp.com>

properties:
  compatible:
    const: nxp,lpc-eth

  reg:
    maxItems: 1

  clocks:
    maxItems: 1

  interrupts:
    maxItems: 1

  use-iram:
    $ref: /schemas/types.yaml#/definitions/flag
    description: Use LPC32xx internal SRAM (IRAM) for DMA buffering

required:
  - compatible
  - reg
  - interrupts

allOf:
  - $ref: ethernet-controller.yaml#

unevaluatedProperties: false

examples:
  - |
    ethernet@31060000 {
        compatible = "nxp,lpc-eth";
        reg = <0x31060000 0x1000>;
        interrupt-parent = <&mic>;
        interrupts = <29 0>;
        phy-mode = "rmii";
        use-iram;
    };
```

## Documentation/devicetree/bindings/net/nxp,lpc1850-dwmac.txt
```
* NXP LPC1850 GMAC ethernet controller

This device is a platform glue layer for stmmac.
Please see stmmac.txt for the other unchanged properties.

Required properties:
 - compatible:  Should contain "nxp,lpc1850-dwmac"

Examples:

mac: ethernet@40010000 {
	compatible = "nxp,lpc1850-dwmac", "snps,dwmac-3.611", "snps,dwmac";
	reg = <0x40010000 0x2000>;
	interrupts = <5>;
	interrupt-names = "macirq";
	clocks = <&ccu1 CLK_CPU_ETHERNET>;
	clock-names = "stmmaceth";
	resets = <&rgu 22>;
	reset-names = "stmmaceth";
}
```

## Documentation/devicetree/bindings/net/nxp,lpc1850-dwmac.yaml
```yaml
# SPDX-License-Identifier: (GPL-2.0-only OR BSD-2-Clause)
%YAML 1.2
---
$id: http://devicetree.org/schemas/net/nxp,lpc1850-dwmac.yaml#
$schema: http://devicetree.org/meta-schemas/core.yaml#

title: NXP LPC1850 GMAC ethernet controller

maintainers:
  - Frank Li <Frank.Li@nxp.com>

# We need a select here so we don't match all nodes with 'snps,dwmac'
select:
  properties:
    compatible:
      contains:
        enum:
          - nxp,lpc1850-dwmac
  required:
    - compatible

properties:
  compatible:
    items:
      - enum:
          - nxp,lpc1850-dwmac
      - const: snps,dwmac-3.611
      - const: snps,dwmac

  reg:
    maxItems: 1

  clocks:
    maxItems: 1

  clock-names:
    items:
      - const: stmmaceth

  interrupts:
    maxItems: 1

  interrupt-names:
    items:
      - const: macirq

  resets:
    maxItems: 1

  reset-names:
    items:
      - const: stmmaceth

required:
  - compatible
  - reg
  - clocks
  - clock-names
  - interrupts
  - interrupt-names

allOf:
  - $ref: snps,dwmac.yaml#

unevaluatedProperties: false

examples:
  - |
    #include <dt-bindings/clock/lpc18xx-ccu.h>

    ethernet@40010000 {
        compatible = "nxp,lpc1850-dwmac", "snps,dwmac-3.611", "snps,dwmac";
        reg = <0x40010000 0x2000>;
        interrupts = <5>;
        interrupt-names = "macirq";
        clocks = <&ccu1 CLK_CPU_ETHERNET>;
        clock-names = "stmmaceth";
        resets = <&rgu 22>;
        reset-names = "stmmaceth";
        rx-fifo-depth = <256>;
        tx-fifo-depth = <256>;
        snps,pbl = <4>;
        snps,force_thresh_dma_mode;
        phy-mode = "rgmii-id";
    };
```
