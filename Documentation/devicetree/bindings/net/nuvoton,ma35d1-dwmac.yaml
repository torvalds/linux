## Documentation/devicetree/bindings/net/pcs/mediatek,sgmiisys.yaml
```yaml
# SPDX-License-Identifier: (GPL-2.0 OR BSD-2-Clause)
%YAML 1.2
---
$id: http://devicetree.org/schemas/net/pcs/mediatek,sgmiisys.yaml#
$schema: http://devicetree.org/meta-schemas/core.yaml#

title: MediaTek SGMIISYS Controller

maintainers:
  - Matthias Brugger <matthias.bgg@gmail.com>

description:
  The MediaTek SGMIISYS controller provides a SGMII PCS and some clocks
  to the ethernet subsystem to which it is attached.

properties:
  compatible:
    oneOf:
      - items:
          - enum:
              - mediatek,mt7622-sgmiisys
              - mediatek,mt7629-sgmiisys
              - mediatek,mt7981-sgmiisys_0
              - mediatek,mt7981-sgmiisys_1
              - mediatek,mt7986-sgmiisys_0
              - mediatek,mt7986-sgmiisys_1
          - const: syscon
      - items:
          - enum:
              - mediatek,mt7988-sgmiisys0
              - mediatek,mt7988-sgmiisys1
          - const: simple-mfd
          - const: syscon

  reg:
    maxItems: 1

  '#clock-cells':
    const: 1

  mediatek,pnswap:
    description: Invert polarity of the SGMII data lanes
    type: boolean

  pcs:
    type: object
    description: MediaTek LynxI HSGMII PCS
    properties:
      compatible:
        const: mediatek,mt7988-sgmii

      clocks:
        maxItems: 3

      clock-names:
        items:
          - const: sgmii_sel
          - const: sgmii_tx
          - const: sgmii_rx

    required:
      - compatible
      - clocks
      - clock-names

    additionalProperties: false

required:
  - compatible
  - reg
  - '#clock-cells'

allOf:
  - if:
      properties:
        compatible:
          contains:
            enum:
              - mediatek,mt7988-sgmiisys0
              - mediatek,mt7988-sgmiisys1

    then:
      required:
        - pcs

    else:
      properties:
        pcs: false

additionalProperties: false

examples:
  - |
    soc {
      #address-cells = <2>;
      #size-cells = <2>;
      sgmiisys: syscon@1b128000 {
        compatible = "mediatek,mt7622-sgmiisys", "syscon";
        reg = <0 0x1b128000 0 0x1000>;
        #clock-cells = <1>;
      };
    };
```

## Documentation/devicetree/bindings/net/pcs/renesas,rzn1-miic.yaml
```yaml
# SPDX-License-Identifier: (GPL-2.0-only OR BSD-2-Clause)
%YAML 1.2
---
$id: http://devicetree.org/schemas/net/pcs/renesas,rzn1-miic.yaml#
$schema: http://devicetree.org/meta-schemas/core.yaml#

title: Renesas RZ/N1, RZ/N2H and RZ/T2H MII converter

maintainers:
  - Clément Léger <clement.leger@bootlin.com>
  - Lad Prabhakar <prabhakar.mahadev-lad.rj@bp.renesas.com>

description: |
  This MII converter is present on the Renesas RZ/N1, RZ/N2H and RZ/T2H SoC
  families. It is responsible to do MII passthrough or convert it to RMII/RGMII.

properties:
  '#address-cells':
    const: 1

  '#size-cells':
    const: 0

  compatible:
    oneOf:
      - items:
          - enum:
              - renesas,r9a06g032-miic
          - const: renesas,rzn1-miic
      - items:
          - const: renesas,r9a09g077-miic # RZ/T2H
      - items:
          - const: renesas,r9a09g087-miic # RZ/N2H
          - const: renesas,r9a09g077-miic

  reg:
    maxItems: 1

  clocks:
    items:
      - description: MII reference clock
      - description: RGMII reference clock
      - description: RMII reference clock
      - description: AHB clock used for the MII converter register interface

  clock-names:
    items:
      - const: mii_ref
      - const: rgmii_ref
      - const: rmii_ref
      - const: hclk

  resets:
    items:
      - description: Converter register reset
      - description: Converter reset

  reset-names:
    items:
      - const: rst
      - const: crst

  renesas,miic-switch-portin:
    description: MII Switch PORTIN configuration. This value should use one of
      the values defined in dt-bindings/net/pcs-rzn1-miic.h for RZ/N1 SoC and
      include/dt-bindings/net/renesas,r9a09g077-pcs-miic.h for RZ/N2H, RZ/T2H SoCs.
    $ref: /schemas/types.yaml#/definitions/uint32
    enum: [0, 1, 2]

  power-domains:
    maxItems: 1

patternProperties:
  "^mii-conv@[0-5]$":
    type: object
    description: MII converter port

    properties:
      reg:
        description: MII Converter port number.
        enum: [0, 1, 2, 3, 4, 5]

      renesas,miic-input:
        description: Converter input port configuration. This value should use
          one of the values defined in dt-bindings/net/pcs-rzn1-miic.h for RZ/N1 SoC
          and include/dt-bindings/net/renesas,r9a09g077-pcs-miic.h for RZ/N2H, RZ/T2H SoCs.
        $ref: /schemas/types.yaml#/definitions/uint32

    required:
      - reg
      - renesas,miic-input

    additionalProperties: false

allOf:
  - if:
      properties:
        compatible:
          contains:
            const: renesas,rzn1-miic
    then:
      properties:
        renesas,miic-switch-portin:
          enum: [1, 2]
        resets: false
        reset-names: false
      patternProperties:
        "^mii-conv@[0-5]$":
          properties:
            reg:
              enum: [1, 2, 3, 4, 5]
          allOf:
            - if:
                properties:
                  reg:
                    const: 1
              then:
                properties:
                  renesas,miic-input:
                    const: 0
            - if:
                properties:
                  reg:
                    const: 2
              then:
                properties:
                  renesas,miic-input:
                    enum: [1, 11]
            - if:
                properties:
                  reg:
                    const: 3
              then:
                properties:
                  renesas,miic-input:
                    enum: [7, 10]
            - if:
                properties:
                  reg:
                    const: 4
              then:
                properties:
                  renesas,miic-input:
                    enum: [4, 6, 9, 13]
            - if:
                properties:
                  reg:
                    const: 5
              then:
                properties:
                  renesas,miic-input:
                    enum: [3, 5, 8, 12]
    else:
      properties:
        renesas,miic-switch-portin:
          const: 0
      required:
        - resets
        - reset-names
      patternProperties:
        "^mii-conv@[0-5]$":
          properties:
            reg:
              enum: [0, 1, 2, 3]
          allOf:
            - if:
                properties:
                  reg:
                    const: 0
              then:
                properties:
                  renesas,miic-input:
                    enum: [0, 3, 6]
            - if:
                properties:
                  reg:
                    const: 1
              then:
                properties:
                  renesas,miic-input:
                    enum: [1, 4, 7]
            - if:
                properties:
                  reg:
                    const: 2
              then:
                properties:
                  renesas,miic-input:
                    enum: [2, 5, 8]
            - if:
                properties:
                  reg:
                    const: 3
              then:
                properties:
                  renesas,miic-input:
                    const: 1

required:
  - '#address-cells'
  - '#size-cells'
  - compatible
  - reg
  - clocks
  - clock-names
  - power-domains

additionalProperties: false

examples:
  - |
    #include <dt-bindings/net/pcs-rzn1-miic.h>
    #include <dt-bindings/clock/r9a06g032-sysctrl.h>

    eth-miic@44030000 {
      #address-cells = <1>;
      #size-cells = <0>;
      compatible = "renesas,r9a06g032-miic", "renesas,rzn1-miic";
      reg = <0x44030000 0x10000>;
      clocks = <&sysctrl R9A06G032_CLK_MII_REF>,
              <&sysctrl R9A06G032_CLK_RGMII_REF>,
              <&sysctrl R9A06G032_CLK_RMII_REF>,
              <&sysctrl R9A06G032_HCLK_SWITCH_RG>;
      clock-names = "mii_ref", "rgmii_ref", "rmii_ref", "hclk";
      renesas,miic-switch-portin = <MIIC_GMAC2_PORT>;
      power-domains = <&sysctrl>;

      mii_conv1: mii-conv@1 {
        renesas,miic-input = <MIIC_GMAC1_PORT>;
        reg = <1>;
      };

      mii_conv2: mii-conv@2 {
        renesas,miic-input = <MIIC_SWITCH_PORTD>;
        reg = <2>;
      };

      mii_conv3: mii-conv@3 {
        renesas,miic-input = <MIIC_SWITCH_PORTC>;
        reg = <3>;
      };

      mii_conv4: mii-conv@4 {
        renesas,miic-input = <MIIC_SWITCH_PORTB>;
        reg = <4>;
      };

      mii_conv5: mii-conv@5 {
        renesas,miic-input = <MIIC_SWITCH_PORTA>;
        reg = <5>;
      };
    };
```

## Documentation/devicetree/bindings/net/pcs/snps,dw-xpcs.yaml
```yaml
# SPDX-License-Identifier: (GPL-2.0-only OR BSD-2-Clause)
%YAML 1.2
---
$id: http://devicetree.org/schemas/net/pcs/snps,dw-xpcs.yaml#
$schema: http://devicetree.org/meta-schemas/core.yaml#

title: Synopsys DesignWare Ethernet PCS

maintainers:
  - Serge Semin <fancer.lancer@gmail.com>

description:
  Synopsys DesignWare Ethernet Physical Coding Sublayer provides an interface
  between Media Access Control and Physical Medium Attachment Sublayer through
  the Media Independent Interface (XGMII, USXGMII, XLGMII, GMII, etc)
  controlled by means of the IEEE std. Clause 45 registers set. The PCS can be
  optionally synthesized with a vendor-specific interface connected to
  Synopsys PMA (also called DesignWare Consumer/Enterprise PHY) although in
  general it can be used to communicate with any compatible PHY.

  The PCS CSRs can be accessible either over the Ethernet MDIO bus or directly
  by means of the APB3/MCI interfaces. In the later case the XPCS can be mapped
  right to the system IO memory space.

properties:
  compatible:
    oneOf:
      - description: Synopsys DesignWare XPCS with none or unknown PMA
        const: snps,dw-xpcs
      - description: Synopsys DesignWare XPCS with Consumer Gen1 3G PMA
        const: snps,dw-xpcs-gen1-3g
      - description: Synopsys DesignWare XPCS with Consumer Gen2 3G PMA
        const: snps,dw-xpcs-gen2-3g
      - description: Synopsys DesignWare XPCS with Consumer Gen2 6G PMA
        const: snps,dw-xpcs-gen2-6g
      - description: Synopsys DesignWare XPCS with Consumer Gen4 3G PMA
        const: snps,dw-xpcs-gen4-3g
      - description: Synopsys DesignWare XPCS with Consumer Gen4 6G PMA
        const: snps,dw-xpcs-gen4-6g
      - description: Synopsys DesignWare XPCS with Consumer Gen5 10G PMA
        const: snps,dw-xpcs-gen5-10g
      - description: Synopsys DesignWare XPCS with Consumer Gen5 12G PMA
        const: snps,dw-xpcs-gen5-12g

  reg:
    items:
      - description:
          In case of the MDIO management interface this just a 5-bits ID
          of the MDIO bus device. If DW XPCS CSRs space is accessed over the
          MCI or APB3 management interfaces, then the space mapping can be
          either 'direct' or 'indirect'. In the former case all Clause 45
          registers are contiguously mapped within the address space
          MMD '[20:16]', Reg '[15:0]'. In the later case the space is divided
          to the multiple 256 register sets. There is a special viewport CSR
          which is responsible for the set selection. The upper part of
          the CSR address MMD+REG[20:8] is supposed to be written in there
          so the corresponding subset would be mapped to the lowest 255 CSRs.

  reg-names:
    items:
      - enum: [ direct, indirect ]

  reg-io-width:
    description:
      The way the CSRs are mapped to the memory is platform depended. Since
      each Clause 45 CSR is of 16-bits wide the access instructions must be
      two bytes aligned at least.
    default: 2
    enum: [ 2, 4 ]

  interrupts:
    description:
      System interface interrupt output (sbd_intr_o) indicating Clause 73/37
      auto-negotiation events':' Page received, AN is completed or incompatible
      link partner.
    maxItems: 1

  clocks:
    description:
      The MCI and APB3 interfaces are supposed to be equipped with a clock
      source connected to the clk_csr_i line.

      PCS/PMA layer can be clocked by an internal reference clock source
      (phyN_core_refclk) or by an externally connected (phyN_pad_refclk) clock
      generator. Both clocks can be supplied at a time.
    minItems: 1
    maxItems: 3

  clock-names:
    oneOf:
      - minItems: 1
        items: # MDIO
          - enum: [core, pad]
          - const: pad
      - minItems: 1
        items: # MCI or APB
          - const: csr
          - enum: [core, pad]
          - const: pad

required:
  - compatible
  - reg

additionalProperties: false

examples:
  - |
    #include <dt-bindings/interrupt-controller/irq.h>

    ethernet-pcs@1f05d000 {
      compatible = "snps,dw-xpcs";
      reg = <0x1f05d000 0x1000>;
      reg-names = "indirect";

      reg-io-width = <4>;

      interrupts = <79 IRQ_TYPE_LEVEL_HIGH>;

      clocks = <&ccu_pclk>, <&ccu_core>, <&ccu_pad>;
      clock-names = "csr", "core", "pad";
    };
  - |
    mdio-bus {
      #address-cells = <1>;
      #size-cells = <0>;

      ethernet-pcs@0 {
        compatible = "snps,dw-xpcs";
        reg = <0>;

        clocks = <&ccu_core>, <&ccu_pad>;
        clock-names = "core", "pad";
      };
    };
...
```
