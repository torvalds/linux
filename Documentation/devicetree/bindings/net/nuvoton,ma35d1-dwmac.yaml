## Documentation/devicetree/bindings/net/nxp,netc-blk-ctrl.yaml
```yaml
# SPDX-License-Identifier: (GPL-2.0-only OR BSD-2-Clause)
%YAML 1.2
---
$id: http://devicetree.org/schemas/net/nxp,netc-blk-ctrl.yaml#
$schema: http://devicetree.org/meta-schemas/core.yaml#

title: NETC Blocks Control

description:
  Usually, NETC has 2 blocks of 64KB registers, integrated endpoint register
  block (IERB) and privileged register block (PRB). IERB is used for pre-boot
  initialization for all NETC devices, such as ENETC, Timer, EMIDO and so on.
  And PRB controls global reset and global error handling for NETC. Moreover,
  for the i.MX platform, there is also a NETCMIX block for link configuration,
  such as MII protocol, PCS protocol, etc.

maintainers:
  - Wei Fang <wei.fang@nxp.com>
  - Clark Wang <xiaoning.wang@nxp.com>

properties:
  compatible:
    enum:
      - nxp,imx95-netc-blk-ctrl

  reg:
    maxItems: 3

  reg-names:
    items:
      - const: ierb
      - const: prb
      - const: netcmix

  "#address-cells":
    const: 2

  "#size-cells":
    const: 2

  ranges: true

  clocks:
    maxItems: 1

  clock-names:
    items:
      - const: ipg

  power-domains:
    maxItems: 1

patternProperties:
  "^pcie@[0-9a-f]+$":
    $ref: /schemas/pci/host-generic-pci.yaml#

required:
  - compatible
  - reg
  - reg-names
  - "#address-cells"
  - "#size-cells"
  - ranges

additionalProperties: false

examples:
  - |
    bus {
        #address-cells = <2>;
        #size-cells = <2>;

        system-controller@4cde0000 {
            compatible = "nxp,imx95-netc-blk-ctrl";
            reg = <0x0 0x4cde0000 0x0 0x10000>,
                  <0x0 0x4cdf0000 0x0 0x10000>,
                  <0x0 0x4c81000c 0x0 0x18>;
            reg-names = "ierb", "prb", "netcmix";
            #address-cells = <2>;
            #size-cells = <2>;
            ranges;
            clocks = <&scmi_clk 98>;
            clock-names = "ipg";
            power-domains = <&scmi_devpd 18>;

            pcie@4cb00000 {
                compatible = "pci-host-ecam-generic";
                reg = <0x0 0x4cb00000 0x0 0x100000>;
                #address-cells = <3>;
                #size-cells = <2>;
                device_type = "pci";
                bus-range = <0x1 0x1>;
                ranges = <0x82000000 0x0 0x4cce0000  0x0 0x4cce0000  0x0 0x20000
                          0xc2000000 0x0 0x4cd10000  0x0 0x4cd10000  0x0 0x10000>;

                mdio@0,0 {
                    compatible = "pci1131,ee00";
                    reg = <0x010000 0 0 0 0>;
                    #address-cells = <1>;
                    #size-cells = <0>;
                };
            };
        };
    };
```

## Documentation/devicetree/bindings/net/nxp,s32-dwmac.yaml
```yaml
# SPDX-License-Identifier: (GPL-2.0-only OR BSD-2-Clause)
# Copyright 2021-2026 NXP
%YAML 1.2
---
$id: http://devicetree.org/schemas/net/nxp,s32-dwmac.yaml#
$schema: http://devicetree.org/meta-schemas/core.yaml#

title: NXP S32G2xx/S32G3xx/S32R45 GMAC ethernet controller

maintainers:
  - Jan Petrous (OSS) <jan.petrous@oss.nxp.com>

description:
  This device is a Synopsys DWC IP, integrated on NXP S32G/R SoCs.
  The SoC series S32G2xx and S32G3xx feature one DWMAC instance,
  the SoC S32R45 has two instances. The devices can use RGMII/RMII/MII
  interface over Pinctrl device or the output can be routed
  to the embedded SerDes for SGMII connectivity.
  The DWMAC instances have connected all RX/TX queues interrupts,
  enabling load balancing of data traffic across all CPU cores.

properties:
  compatible:
    oneOf:
      - const: nxp,s32g2-dwmac
      - items:
          - enum:
              - nxp,s32g3-dwmac
              - nxp,s32r45-dwmac
          - const: nxp,s32g2-dwmac

  reg:
    items:
      - description: Main GMAC registers
      - description: GMAC PHY mode control register

  nxp,phy-sel:
    $ref: /schemas/types.yaml#/definitions/phandle-array
    items:
      - items:
          - description: phandle to the GPR syscon node
          - description: offset of PHY selection register
    description:
      This phandle points to the GMAC_0_CTRL_STS register which controls the
      GMAC_0 configuration options.  The register lets you select the PHY
      interface and the PHY mode.  It also controls if the FTM_0 or FTM_1
      FlexTimer Modules connect to GMAC_0.

  interrupts:
    minItems: 1
    maxItems: 11

  interrupt-names:
    oneOf:
      - items:
          - const: macirq
      - items:
          - const: macirq
          - const: tx-queue-0
          - const: rx-queue-0
          - const: tx-queue-1
          - const: rx-queue-1
          - const: tx-queue-2
          - const: rx-queue-2
          - const: tx-queue-3
          - const: rx-queue-3
          - const: tx-queue-4
          - const: rx-queue-4

  clocks:
    items:
      - description: Main GMAC clock
      - description: Transmit clock
      - description: Receive clock
      - description: PTP reference clock

  clock-names:
    items:
      - const: stmmaceth
      - const: tx
      - const: rx
      - const: ptp_ref

required:
  - clocks
  - clock-names

allOf:
  - $ref: snps,dwmac.yaml#

unevaluatedProperties: false

examples:
  - |
    #include <dt-bindings/interrupt-controller/arm-gic.h>
    #include <dt-bindings/interrupt-controller/irq.h>
    #include <dt-bindings/phy/phy.h>
    bus {
      #address-cells = <2>;
      #size-cells = <2>;

      ethernet@4033c000 {
        compatible = "nxp,s32g2-dwmac";
        reg = <0x0 0x4033c000 0x0 0x2000>, /* gmac IP */
              <0x0 0x4007c004 0x0 0x4>;    /* GMAC_0_CTRL_STS */
        nxp,phy-sel = <&gpr 0x4>;
        interrupt-parent = <&gic>;
        interrupts = <GIC_SPI 57 IRQ_TYPE_LEVEL_HIGH>,
                     /* CHN 0: tx, rx */
                     <GIC_SPI 58 IRQ_TYPE_LEVEL_HIGH>,
                     <GIC_SPI 59 IRQ_TYPE_LEVEL_HIGH>,
                     /* CHN 1: tx, rx */
                     <GIC_SPI 60 IRQ_TYPE_LEVEL_HIGH>,
                     <GIC_SPI 61 IRQ_TYPE_LEVEL_HIGH>,
                     /* CHN 2: tx, rx */
                     <GIC_SPI 62 IRQ_TYPE_LEVEL_HIGH>,
                     <GIC_SPI 63 IRQ_TYPE_LEVEL_HIGH>,
                     /* CHN 3: tx, rx */
                     <GIC_SPI 64 IRQ_TYPE_LEVEL_HIGH>,
                     <GIC_SPI 65 IRQ_TYPE_LEVEL_HIGH>,
                     /* CHN 4: tx, rx */
                     <GIC_SPI 66 IRQ_TYPE_LEVEL_HIGH>,
                     <GIC_SPI 67 IRQ_TYPE_LEVEL_HIGH>;
        interrupt-names = "macirq",
                          "tx-queue-0", "rx-queue-0",
                          "tx-queue-1", "rx-queue-1",
                          "tx-queue-2", "rx-queue-2",
                          "tx-queue-3", "rx-queue-3",
                          "tx-queue-4", "rx-queue-4";
        snps,mtl-rx-config = <&mtl_rx_setup>;
        snps,mtl-tx-config = <&mtl_tx_setup>;
        clocks = <&clks 24>, <&clks 17>, <&clks 16>, <&clks 15>;
        clock-names = "stmmaceth", "tx", "rx", "ptp_ref";
        phy-mode = "rgmii-id";
        phy-handle = <&phy0>;

        mtl_rx_setup: rx-queues-config {
          snps,rx-queues-to-use = <5>;
        };

        mtl_tx_setup: tx-queues-config {
          snps,tx-queues-to-use = <5>;
        };

        mdio {
          #address-cells = <1>;
          #size-cells = <0>;
          compatible = "snps,dwmac-mdio";

          phy0: ethernet-phy@0 {
            reg = <0>;
          };
        };
      };
    };
```

## Documentation/devicetree/bindings/net/nxp,tja11xx.yaml
```yaml
# SPDX-License-Identifier: GPL-2.0+
%YAML 1.2
---
$id: http://devicetree.org/schemas/net/nxp,tja11xx.yaml#
$schema: http://devicetree.org/meta-schemas/core.yaml#

title: NXP TJA11xx PHY

maintainers:
  - Andrew Lunn <andrew@lunn.ch>
  - Florian Fainelli <f.fainelli@gmail.com>
  - Heiner Kallweit <hkallweit1@gmail.com>

description:
  Bindings for NXP TJA11xx automotive PHYs

properties:
  compatible:
    enum:
      - ethernet-phy-id0180.dc40
      - ethernet-phy-id0180.dc41
      - ethernet-phy-id0180.dc48
      - ethernet-phy-id0180.dd00
      - ethernet-phy-id0180.dd01
      - ethernet-phy-id0180.dd02
      - ethernet-phy-id0180.dc80
      - ethernet-phy-id0180.dc82
      - ethernet-phy-id001b.b010
      - ethernet-phy-id001b.b013
      - ethernet-phy-id001b.b030
      - ethernet-phy-id001b.b031

allOf:
  - $ref: ethernet-phy.yaml#
  - if:
      properties:
        compatible:
          contains:
            enum:
              - ethernet-phy-id0180.dc40
              - ethernet-phy-id0180.dc41
              - ethernet-phy-id0180.dc48
              - ethernet-phy-id0180.dd00
              - ethernet-phy-id0180.dd01
              - ethernet-phy-id0180.dd02

    then:
      properties:
        nxp,rmii-refclk-in:
          type: boolean
          description: |
            The REF_CLK is provided for both transmitted and received data
            in RMII mode. This clock signal is provided by the PHY and is
            typically derived from an external 25MHz crystal. Alternatively,
            a 50MHz clock signal generated by an external oscillator can be
            connected to pin REF_CLK. A third option is to connect a 25MHz
            clock to pin CLK_IN_OUT. So, the REF_CLK should be configured
            as input or output according to the actual circuit connection.
            If present, indicates that the REF_CLK will be configured as
            interface reference clock input when RMII mode enabled.
            If not present, the REF_CLK will be configured as interface
            reference clock output when RMII mode enabled.
            Only supported on TJA1100 and TJA1101.

  - if:
      properties:
        compatible:
          contains:
            enum:
              - ethernet-phy-id001b.b010
              - ethernet-phy-id001b.b013
              - ethernet-phy-id001b.b030
              - ethernet-phy-id001b.b031

    then:
      properties:
        nxp,rmii-refclk-out:
          type: boolean
          description: Enable 50MHz RMII reference clock output on REF_CLK pin.

patternProperties:
  "^ethernet-phy@[0-9a-f]+$":
    type: object
    additionalProperties: false
    description: |
      Some packages have multiple PHYs. Secondary PHY should be defines as
      subnode of the first (parent) PHY.

    properties:
      reg:
        minimum: 0
        maximum: 31
        description:
          The ID number for the child PHY. Should be +1 of parent PHY.

    required:
      - reg

unevaluatedProperties: false

examples:
  - |
    mdio {
        #address-cells = <1>;
        #size-cells = <0>;

        tja1101_phy0: ethernet-phy@4 {
            compatible = "ethernet-phy-id0180.dc40";
            reg = <0x4>;
            nxp,rmii-refclk-in;
        };
    };
  - |
    mdio {
        #address-cells = <1>;
        #size-cells = <0>;

        tja1102_phy0: ethernet-phy@4 {
            reg = <0x4>;
            #address-cells = <1>;
            #size-cells = <0>;

            tja1102_phy1: ethernet-phy@5 {
                reg = <0x5>;
            };
        };
    };
```

## Documentation/devicetree/bindings/net/opencores-ethoc.txt
```
* OpenCores MAC 10/100 Mbps

Required properties:
- compatible: Should be "opencores,ethoc".
- reg: two memory regions (address and length),
  first region is for the device registers and descriptor rings,
  second is for the device packet memory.
- interrupts: interrupt for the device.

Optional properties:
- clocks: phandle to refer to the clk used as per
  Documentation/devicetree/bindings/clock/clock-bindings.txt

Examples:

	enet0: ethoc@fd030000 {
		compatible = "opencores,ethoc";
		reg = <0xfd030000 0x4000 0xfd800000 0x4000>;
		interrupts = <1>;
		local-mac-address = [00 50 c2 13 6f 00];
		clocks = <&osc>;
        };
```

## Documentation/devicetree/bindings/net/oxnas-dwmac.txt
```
* Oxford Semiconductor OXNAS DWMAC Ethernet controller

The device inherits all the properties of the dwmac/stmmac devices
described in the file stmmac.txt in the current directory with the
following changes.

Required properties on all platforms:

- compatible:	For the OX820 SoC, it should be :
		- "oxsemi,ox820-dwmac" to select glue
		- "snps,dwmac-3.512" to select IP version.

- clocks: Should contain phandles to the following clocks
- clock-names:	Should contain the following:
		- "stmmaceth" for the host clock - see stmmac.txt
		- "gmac" for the peripheral gate clock

- oxsemi,sys-ctrl: a phandle to the system controller syscon node

Example :

etha: ethernet@40400000 {
	compatible = "oxsemi,ox820-dwmac", "snps,dwmac-3.512";
	reg = <0x40400000 0x2000>;
	interrupts = <GIC_SPI 8 IRQ_TYPE_LEVEL_HIGH>,
		     <GIC_SPI 17 IRQ_TYPE_LEVEL_HIGH>;
	interrupt-names = "macirq", "eth_wake_irq";
	mac-address = [000000000000]; /* Filled in by U-Boot */
	phy-mode = "rgmii";

	clocks = <&stdclk CLK_820_ETHA>, <&gmacclk>;
	clock-names = "gmac", "stmmaceth";
	resets = <&reset RESET_MAC>;

	/* Regmap for sys registers */
	oxsemi,sys-ctrl = <&sys>;

	status = "disabled";
};
```

## Documentation/devicetree/bindings/net/pcs/fsl,lynx-pcs.yaml
```yaml
# SPDX-License-Identifier: GPL-2.0-only OR BSD-2-Clause
%YAML 1.2
---
$id: http://devicetree.org/schemas/net/pcs/fsl,lynx-pcs.yaml#
$schema: http://devicetree.org/meta-schemas/core.yaml#

title: NXP Lynx PCS

maintainers:
  - Ioana Ciornei <ioana.ciornei@nxp.com>

description: |
  NXP Lynx 10G and 28G SerDes have Ethernet PCS devices which can be used as
  protocol controllers. They are accessible over the Ethernet interface's MDIO
  bus.

properties:
  compatible:
    const: fsl,lynx-pcs

  reg:
    maxItems: 1

required:
  - compatible
  - reg

additionalProperties: false

examples:
  - |
    mdio-bus {
      #address-cells = <1>;
      #size-cells = <0>;

      qsgmii_pcs1: ethernet-pcs@1 {
        compatible = "fsl,lynx-pcs";
        reg = <1>;
      };
    };
```
