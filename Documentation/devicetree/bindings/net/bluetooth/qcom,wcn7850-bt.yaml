## Documentation/devicetree/bindings/net/calxeda-xgmac.yaml
```yaml
# SPDX-License-Identifier: (GPL-2.0-only OR BSD-2-Clause)
%YAML 1.2
---
$id: http://devicetree.org/schemas/net/calxeda-xgmac.yaml#
$schema: http://devicetree.org/meta-schemas/core.yaml#

title: Calxeda Highbank 10Gb XGMAC Ethernet controller

description: |
  The Calxeda XGMAC Ethernet controllers are directly connected to the
  internal machine "network fabric", which is set up, initialised and
  managed by the firmware. So there are no PHY properties in this
  binding. Switches in the fabric take care of routing and mapping the
  traffic to external network ports.

maintainers:
  - Andre Przywara <andre.przywara@arm.com>

properties:
  compatible:
    const: calxeda,hb-xgmac

  reg:
    maxItems: 1

  interrupts:
    description: |
      Can point to at most 3 xgmac interrupts. The 1st one is the main
      interrupt, the 2nd one is used for power management. The optional
      3rd one is the low power state interrupt.
    minItems: 2
    maxItems: 3

  dma-coherent: true

required:
  - compatible
  - reg
  - interrupts

additionalProperties: false

examples:
  - |
    ethernet@fff50000 {
        compatible = "calxeda,hb-xgmac";
        reg = <0xfff50000 0x1000>;
        interrupts = <0 77 4>, <0 78 4>, <0 79 4>;
    };
```
