## Documentation/devicetree/bindings/net/bluetooth/qcom,wcn7850-bt.yaml
```yaml
# SPDX-License-Identifier: (GPL-2.0 OR BSD-2-Clause)
%YAML 1.2
---
$id: http://devicetree.org/schemas/net/bluetooth/qcom,wcn7850-bt.yaml#
$schema: http://devicetree.org/meta-schemas/core.yaml#

title: Qualcomm WCN7850 Bluetooth

maintainers:
  - Bartosz Golaszewski <brgl@bgdev.pl>
  - Balakrishna Godavarthi <quic_bgodavar@quicinc.com>
  - Rocky Liao <quic_rjliao@quicinc.com>

properties:
  compatible:
    enum:
      - qcom,wcn7850-bt

  enable-gpios:
    maxItems: 1
    deprecated: true

  swctrl-gpios:
    maxItems: 1
    description: gpio specifier is used to find status
                 of clock supply to SoC
    deprecated: true

  vddaon-supply:
    description: VDD_AON supply regulator handle

  vdddig-supply:
    description: VDD_DIG supply regulator handle
    deprecated: true

  vddio-supply:
    description: VDD_IO supply regulator handle
    deprecated: true

  vddrfa0p8-supply:
    description: VDD_RFA_0P8 supply regulator handle

  vddrfa1p2-supply:
    description: VDD_RFA_1P2 supply regulator handle

  vddrfa1p8-supply:
    description: VDD_RFA_1P8 supply regulator handle

  vddrfa1p9-supply:
    description: VDD_RFA_1P9 supply regulator handle
    deprecated: true

  vddrfacmn-supply:
    description: VDD_RFA_CMN supply regulator handle

  vddwlcx-supply:
    description: VDD_WLCX supply regulator handle

  vddwlmx-supply:
    description: VDD_WLMX supply regulator handle

required:
  - compatible
  - vddrfacmn-supply
  - vddaon-supply
  - vddwlcx-supply
  - vddwlmx-supply
  - vddrfa0p8-supply
  - vddrfa1p2-supply
  - vddrfa1p8-supply

allOf:
  - $ref: bluetooth-controller.yaml#
  - $ref: qcom,bluetooth-common.yaml
  - $ref: /schemas/serial/serial-peripheral-props.yaml#

unevaluatedProperties: false

examples:
  - |
    serial {
        bluetooth {
            compatible = "qcom,wcn7850-bt";

            max-speed = <3200000>;
            vddaon-supply = <&vreg_pmu_aon_0p59>;
            vddrfa0p8-supply = <&vreg_pmu_rfa_0p8>;
            vddrfa1p2-supply = <&vreg_pmu_rfa_1p2>;
            vddrfa1p8-supply = <&vreg_pmu_rfa_1p8>;
            vddrfacmn-supply = <&vreg_pmu_rfa_cmn>;
            vddwlcx-supply = <&vreg_pmu_wlcx_0p8>;
            vddwlmx-supply = <&vreg_pmu_wlmx_0p85>;
        };
    };
```

## Documentation/devicetree/bindings/net/bluetooth/qualcomm-bluetooth.yaml
```yaml
# SPDX-License-Identifier: (GPL-2.0 OR BSD-2-Clause)
%YAML 1.2
---
$id: http://devicetree.org/schemas/net/bluetooth/qualcomm-bluetooth.yaml#
$schema: http://devicetree.org/meta-schemas/core.yaml#

title: Qualcomm Bluetooth Chips

maintainers:
  - Balakrishna Godavarthi <quic_bgodavar@quicinc.com>
  - Rocky Liao <quic_rjliao@quicinc.com>

description:
  This binding describes Qualcomm UART-attached bluetooth chips.

properties:
  compatible:
    enum:
      - qcom,wcn6750-bt
      - qcom,wcn6855-bt
      - qcom,wcn7850-bt

  enable-gpios:
    maxItems: 1
    description: gpio specifier used to enable chip

  swctrl-gpios:
    maxItems: 1
    description: gpio specifier is used to find status
                 of clock supply to SoC

  vddio-supply:
    description: VDD_IO supply regulator handle

  vddaon-supply:
    description: VDD_AON supply regulator handle

  vdddig-supply:
    description: VDD_DIG supply regulator handle

  vddbtcmx-supply:
    description: VDD_BT_CMX supply regulator handle

  vddbtcxmx-supply:
    description: VDD_BT_CXMX supply regulator handle

  vddrfacmn-supply:
    description: VDD_RFA_CMN supply regulator handle

  vddrfa0p8-supply:
    description: VDD_RFA_0P8 supply regulator handle

  vddrfa1p7-supply:
    description: VDD_RFA_1P7 supply regulator handle

  vddrfa1p8-supply:
    description: VDD_RFA_1P8 supply regulator handle

  vddrfa1p2-supply:
    description: VDD_RFA_1P2 supply regulator handle

  vddrfa1p9-supply:
    description: VDD_RFA_1P9 supply regulator handle

  vddrfa2p2-supply:
    description: VDD_RFA_2P2 supply regulator handle

  vddasd-supply:
    description: VDD_ASD supply regulator handle

  vddwlcx-supply:
    description: VDD_WLCX supply regulator handle

  vddwlmx-supply:
    description: VDD_WLMX supply regulator handle

  max-speed: true

  firmware-name:
    minItems: 1
    items:
      - description: specify the name of nvm firmware to load
      - description: specify the name of rampatch firmware to load

  local-bd-address: true

  qcom,local-bd-address-broken:
    type: boolean
    description:
      boot firmware is incorrectly passing the address in big-endian order

required:
  - compatible

additionalProperties: false

allOf:
  - $ref: bluetooth-controller.yaml#
  - $ref: /schemas/serial/serial-peripheral-props.yaml#

  - if:
      properties:
        compatible:
          contains:
            enum:
              - qcom,wcn6750-bt
    then:
      required:
        - vddaon-supply
        - vddrfacmn-supply
        - vddrfa0p8-supply
        - vddrfa1p7-supply
        - vddrfa1p2-supply
  - if:
      properties:
        compatible:
          contains:
            enum:
              - qcom,wcn6855-bt
    then:
      required:
        - vddrfacmn-supply
        - vddaon-supply
        - vddwlcx-supply
        - vddwlmx-supply
        - vddbtcmx-supply
        - vddrfa0p8-supply
        - vddrfa1p2-supply
        - vddrfa1p8-supply
  - if:
      properties:
        compatible:
          contains:
            enum:
              - qcom,wcn7850-bt
    then:
      required:
        - vddrfacmn-supply
        - vddaon-supply
        - vddwlcx-supply
        - vddwlmx-supply
        - vddrfa0p8-supply
        - vddrfa1p2-supply
        - vddrfa1p8-supply

examples:
  - |
    #include <dt-bindings/gpio/gpio.h>
    serial {

        bluetooth {
            compatible = "qcom,wcn6750-bt";
            pinctrl-names = "default";
            pinctrl-0 = <&bt_en_default>;
            enable-gpios = <&tlmm 85 GPIO_ACTIVE_HIGH>;
            swctrl-gpios = <&tlmm 86 GPIO_ACTIVE_HIGH>;
            vddio-supply = <&vreg_l19b_1p8>;
            vddaon-supply = <&vreg_s7b_0p9>;
            vddbtcxmx-supply = <&vreg_s7b_0p9>;
            vddrfacmn-supply = <&vreg_s7b_0p9>;
            vddrfa0p8-supply = <&vreg_s7b_0p9>;
            vddrfa1p7-supply = <&vreg_s1b_1p8>;
            vddrfa1p2-supply = <&vreg_s8b_1p2>;
            vddrfa2p2-supply = <&vreg_s1c_2p2>;
            vddasd-supply = <&vreg_l11c_2p8>;
            max-speed = <3200000>;
            firmware-name = "msnv11.bin";
        };
    };
```

## Documentation/devicetree/bindings/net/brcm,amac.txt
```
Broadcom AMAC Ethernet Controller Device Tree Bindings
-------------------------------------------------------------

Required properties:
 - compatible:	"brcm,amac"
		"brcm,nsp-amac"
		"brcm,ns2-amac"
 - reg:		Address and length of the register set for the device. It
		contains the information of registers in the same order as
		described by reg-names
 - reg-names:	Names of the registers.
		"amac_base":	Address and length of the GMAC registers
		"idm_base":	Address and length of the GMAC IDM registers
				(required for NSP and Northstar2)
		"nicpm_base":	Address and length of the NIC Port Manager
				registers (required for Northstar2)
 - interrupts:	Interrupt number

Optional properties:
- mac-address:	See ethernet.txt file in the same directory

Examples:

amac0: ethernet@18022000 {
	compatible = "brcm,nsp-amac";
	reg = <0x18022000 0x1000>,
	      <0x18110000 0x1000>;
	reg-names = "amac_base", "idm_base";
	interrupts = <GIC_SPI 147 IRQ_TYPE_LEVEL_HIGH>;
	status = "disabled";
};
```

## Documentation/devicetree/bindings/net/brcm,amac.yaml
```yaml
# SPDX-License-Identifier: GPL-2.0-only OR BSD-2-Clause
%YAML 1.2
---
$id: http://devicetree.org/schemas/net/brcm,amac.yaml#
$schema: http://devicetree.org/meta-schemas/core.yaml#

title: Broadcom AMAC Ethernet Controller

maintainers:
  - Florian Fainelli <f.fainelli@gmail.com>

allOf:
  - $ref: ethernet-controller.yaml#
  - if:
      properties:
        compatible:
          contains:
            enum:
              - brcm,amac
    then:
      properties:
        reg:
          maxItems: 2
        reg-names:
          maxItems: 2

  - if:
      properties:
        compatible:
          contains:
            enum:
              - brcm,nsp-amac
    then:
      properties:
        reg:
          minItems: 2
          maxItems: 2
        reg-names:
          minItems: 2
          maxItems: 2

  - if:
      properties:
        compatible:
          contains:
            enum:
              - brcm,ns2-amac
    then:
      properties:
        reg:
          minItems: 3
        reg-names:
          minItems: 3

properties:
  compatible:
    enum:
      - brcm,amac
      - brcm,nsp-amac
      - brcm,ns2-amac

  interrupts:
    maxItems: 1

  reg:
    minItems: 1
    maxItems: 3

  reg-names:
    minItems: 1
    items:
      - const: amac_base
      - const: idm_base
      - const: nicpm_base

unevaluatedProperties: false

examples:
  - |
   #include <dt-bindings/interrupt-controller/arm-gic.h>

   amac0: ethernet@18022000 {
      compatible = "brcm,nsp-amac";
      reg = <0x18022000 0x1000>,
            <0x18110000 0x1000>;
      reg-names = "amac_base", "idm_base";
      interrupts = <GIC_SPI 147 IRQ_TYPE_LEVEL_HIGH>;
   };
```

## Documentation/devicetree/bindings/net/brcm,asp-v2.0.yaml
```yaml
# SPDX-License-Identifier: (GPL-2.0-only OR BSD-2-Clause)
%YAML 1.2
---
$id: http://devicetree.org/schemas/net/brcm,asp-v2.0.yaml#
$schema: http://devicetree.org/meta-schemas/core.yaml#

title: Broadcom ASP 2.0 Ethernet controller

maintainers:
  - Justin Chen <justin.chen@broadcom.com>
  - Florian Fainelli <florian.fainelli@broadcom.com>

description: Broadcom Ethernet controller first introduced with 72165

properties:
  compatible:
    oneOf:
      - items:
          - enum:
              - brcm,bcm74165-asp
          - const: brcm,asp-v2.1
      - items:
          - enum:
              - brcm,bcm72165-asp
          - const: brcm,asp-v2.0

  "#address-cells":
    const: 1
  "#size-cells":
    const: 1

  reg:
    maxItems: 1

  ranges: true

  interrupts:
    minItems: 1
    items:
      - description: RX/TX interrupt
      - description: Port 0 Wake-on-LAN
      - description: Port 1 Wake-on-LAN

  clocks:
    maxItems: 1

  ethernet-ports:
    type: object
    properties:
      "#address-cells":
        const: 1
      "#size-cells":
        const: 0

    patternProperties:
      "^port@[0-9a-f]+$":
        type: object

        $ref: ethernet-controller.yaml#

        unevaluatedProperties: false

        properties:
          reg:
            maxItems: 1
            description: Port number

          brcm,channel:
            $ref: /schemas/types.yaml#/definitions/uint32
            description: |
              ASP Channel Number

              The depacketizer channel that consumes packets from
              the unimac/port.

        required:
          - reg
          - brcm,channel

    additionalProperties: false

patternProperties:
  "^mdio@[0-9a-f]+$":
    type: object
    $ref: brcm,unimac-mdio.yaml

    description:
      ASP internal UniMAC MDIO bus

required:
  - compatible
  - reg
  - interrupts
  - clocks
  - ranges

additionalProperties: false

examples:
  - |
    #include <dt-bindings/interrupt-controller/irq.h>
    #include <dt-bindings/interrupt-controller/arm-gic.h>

    ethernet@9c00000 {
        compatible = "brcm,bcm72165-asp", "brcm,asp-v2.0";
        reg = <0x9c00000 0x1fff14>;
        interrupts = <GIC_SPI 51 IRQ_TYPE_LEVEL_HIGH>;
        ranges = <0x0 0x9c00000 0x1fff14>;
        clocks = <&scmi 14>;
        #address-cells = <1>;
        #size-cells = <1>;

        mdio@c614 {
            compatible = "brcm,asp-v2.0-mdio";
            reg = <0xc614 0x8>;
            reg-names = "mdio";
            #address-cells = <1>;
            #size-cells = <0>;

            phy0: ethernet-phy@1 {
                reg = <1>;
            };
       };

        mdio@ce14 {
            compatible = "brcm,asp-v2.0-mdio";
            reg = <0xce14 0x8>;
            reg-names = "mdio";
            #address-cells = <1>;
            #size-cells = <0>;

            phy1: ethernet-phy@1 {
                reg = <1>;
            };
        };

        ethernet-ports {
            #address-cells = <1>;
            #size-cells = <0>;

            port@0 {
                reg = <0>;
                brcm,channel = <8>;
                phy-mode = "rgmii";
                phy-handle = <&phy0>;
            };

            port@1 {
                reg = <1>;
                brcm,channel = <9>;
                phy-mode = "rgmii";
                phy-handle = <&phy1>;
            };
        };
    };
```

## Documentation/devicetree/bindings/net/brcm,bcm4908-enet.yaml
```yaml
# SPDX-License-Identifier: GPL-2.0-only OR BSD-2-Clause
%YAML 1.2
---
$id: http://devicetree.org/schemas/net/brcm,bcm4908-enet.yaml#
$schema: http://devicetree.org/meta-schemas/core.yaml#

title: Broadcom BCM4908 Ethernet controller

description: Broadcom's Ethernet controller integrated into BCM4908 family SoCs

maintainers:
  - Rafał Miłecki <rafal@milecki.pl>

allOf:
  - $ref: ethernet-controller.yaml#

properties:
  compatible:
    const: brcm,bcm4908-enet

  reg:
    maxItems: 1

  interrupts:
    description: RX interrupt

  interrupt-names:
    const: rx

required:
  - reg
  - interrupts
  - interrupt-names

additionalProperties: false

examples:
  - |
    #include <dt-bindings/interrupt-controller/irq.h>
    #include <dt-bindings/interrupt-controller/arm-gic.h>

    ethernet@80002000 {
        compatible = "brcm,bcm4908-enet";
        reg = <0x80002000 0x1000>;

        interrupts = <GIC_SPI 86 IRQ_TYPE_LEVEL_HIGH>;
        interrupt-names = "rx";
    };
```

## Documentation/devicetree/bindings/net/brcm,bcm6368-mdio-mux.yaml
```yaml
# SPDX-License-Identifier: GPL-2.0-only OR BSD-2-Clause
%YAML 1.2
---
$id: http://devicetree.org/schemas/net/brcm,bcm6368-mdio-mux.yaml#
$schema: http://devicetree.org/meta-schemas/core.yaml#

title: Broadcom BCM6368 MDIO bus multiplexer

maintainers:
  - Álvaro Fernández Rojas <noltari@gmail.com>

description:
  This MDIO bus multiplexer defines buses that could be internal as well as
  external to SoCs. When child bus is selected, one needs to select these two
  properties as well to generate desired MDIO transaction on appropriate bus.

allOf:
  - $ref: mdio-mux.yaml#

properties:
  compatible:
    const: brcm,bcm6368-mdio-mux

  reg:
    maxItems: 1

required:
  - compatible
  - reg

unevaluatedProperties: false

examples:
  - |
    mdio0: mdio@10e000b0 {
      #address-cells = <1>;
      #size-cells = <0>;
      compatible = "brcm,bcm6368-mdio-mux";
      reg = <0x10e000b0 0x6>;

      mdio_int: mdio@0 {
        #address-cells = <1>;
        #size-cells = <0>;
        reg = <0>;
      };

      mdio_ext: mdio@1 {
        #address-cells = <1>;
        #size-cells = <0>;
        reg = <1>;
      };
    };
```
