## Documentation/devicetree/bindings/net/brcm,bcm7445-switch-v4.0.txt
```
* Broadcom Starfighter 2 integrated switch

See dsa/brcm,bcm7445-switch-v4.0.yaml for the documentation.

*Deprecated* binding required properties:

- dsa,mii-bus: phandle to the MDIO bus controller, see dsa/dsa.txt
- dsa,ethernet: phandle to the CPU network interface controller, see dsa/dsa.txt
- #address-cells: must be 2, see dsa/dsa.txt

Example using the old DSA DeviceTree binding:

switch_top@f0b00000 {
	compatible = "simple-bus";
	#size-cells = <1>;
	#address-cells = <1>;
	ranges = <0 0xf0b00000 0x40804>;

	ethernet_switch@0 {
		compatible = "brcm,bcm7445-switch-v4.0";
		#size-cells = <0>;
		#address-cells = <2>;
		reg = <0x0 0x40000
			0x40000 0x110
			0x40340 0x30
			0x40380 0x30
			0x40400 0x34
			0x40600 0x208>;
		interrupts = <0 0x18 0
				0 0x19 0>;
		brcm,num-gphy = <1>;
		brcm,num-rgmii-ports = <2>;
		brcm,fcb-pause-override;
		brcm,acb-packets-inflight;

		...
		switch@0 {
			reg = <0 0>;
			#size-cells = <0>;
			#address-cells = <1>;

			port@0 {
				label = "gphy";
				reg = <0>;
				brcm,use-bcm-hdr;
			};
			...
		};
	};
};
```

## Documentation/devicetree/bindings/net/brcm,bcmgenet.txt
```
* Broadcom BCM7xxx Ethernet Controller (GENET)

Required properties:
- compatible: should contain one of "brcm,genet-v1", "brcm,genet-v2",
  "brcm,genet-v3", "brcm,genet-v4", "brcm,genet-v5".
- reg: address and length of the register set for the device
- interrupts and/or interrupts-extended: must be two cells, the first cell
  is the general purpose interrupt line, while the second cell is the
  interrupt for the ring RX and TX queues operating in ring mode.  An
  optional third interrupt cell for Wake-on-LAN can be specified.
  See Documentation/devicetree/bindings/interrupt-controller/interrupts.txt
  for information on the property specifics.
- phy-mode: see ethernet.txt file in the same directory
- #address-cells: should be 1
- #size-cells: should be 1

Optional properties:
- clocks: When provided, must be two phandles to the functional clocks nodes
  of the GENET block. The first phandle is the main GENET clock used during
  normal operation, while the second phandle is the Wake-on-LAN clock.
- clock-names: When provided, names of the functional clock phandles, first
  name should be "enet" and second should be "enet-wol".

- phy-handle: See ethernet.txt file in the same directory; used to describe
  configurations where a PHY (internal or external) is used.

- fixed-link: When the GENET interface is connected to a MoCA hardware block or
  when operating in a RGMII to RGMII type of connection, or when the MDIO bus is
  voluntarily disabled, this property should be used to describe the "fixed link".
  See Documentation/devicetree/bindings/net/fixed-link.txt for information on
  the property specifics

Required child nodes:

- mdio bus node: this node should always be present regardless of the PHY
  configuration of the GENET instance

MDIO bus node required properties:

- compatible: should contain one of "brcm,genet-mdio-v1", "brcm,genet-mdio-v2"
  "brcm,genet-mdio-v3", "brcm,genet-mdio-v4", "brcm,genet-mdio-v5", the version
  has to match the parent node compatible property (e.g: brcm,genet-v4 pairs
  with brcm,genet-mdio-v4)
- reg: address and length relative to the parent node base register address
- #address-cells: address cell for MDIO bus addressing, should be 1
- #size-cells: size of the cells for MDIO bus addressing, should be 0

Ethernet PHY node properties:

See Documentation/devicetree/bindings/net/phy.txt for the list of required and
optional properties.

Internal Gigabit PHY example:

ethernet@f0b60000 {
	phy-mode = "internal";
	phy-handle = <&phy1>;
	mac-address = [ 00 10 18 36 23 1a ];
	compatible = "brcm,genet-v4";
	#address-cells = <0x1>;
	#size-cells = <0x1>;
	reg = <0xf0b60000 0xfc4c>;
	interrupts = <0x0 0x14 0x0>, <0x0 0x15 0x0>;

	mdio@e14 {
		compatible = "brcm,genet-mdio-v4";
		#address-cells = <0x1>;
		#size-cells = <0x0>;
		reg = <0xe14 0x8>;

		phy1: ethernet-phy@1 {
			max-speed = <1000>;
			reg = <0x1>;
			compatible = "ethernet-phy-ieee802.3-c22";
		};
	};
};

MoCA interface / MAC to MAC example:

ethernet@f0b80000 {
	phy-mode = "moca";
	fixed-link = <1 0 1000 0 0>;
	mac-address = [ 00 10 18 36 24 1a ];
	compatible = "brcm,genet-v4";
	#address-cells = <0x1>;
	#size-cells = <0x1>;
	reg = <0xf0b80000 0xfc4c>;
	interrupts = <0x0 0x16 0x0>, <0x0 0x17 0x0>;

	mdio@e14 {
		compatible = "brcm,genet-mdio-v4";
		#address-cells = <0x1>;
		#size-cells = <0x0>;
		reg = <0xe14 0x8>;
	};
};


External MDIO-connected Gigabit PHY/switch:

ethernet@f0ba0000 {
	phy-mode = "rgmii";
	phy-handle = <&phy0>;
	mac-address = [ 00 10 18 36 26 1a ];
	compatible = "brcm,genet-v4";
	#address-cells = <0x1>;
	#size-cells = <0x1>;
	reg = <0xf0ba0000 0xfc4c>;
	interrupts = <0x0 0x18 0x0>, <0x0 0x19 0x0>;

	mdio@0e14 {
		compatible = "brcm,genet-mdio-v4";
		#address-cells = <0x1>;
		#size-cells = <0x0>;
		reg = <0xe14 0x8>;

		phy0: ethernet-phy@0 {
			max-speed = <1000>;
			reg = <0x0>;
			compatible = "ethernet-phy-ieee802.3-c22";
		};
	};
};
```

## Documentation/devicetree/bindings/net/brcm,bcmgenet.yaml
```yaml
# SPDX-License-Identifier: GPL-2.0-only OR BSD-2-Clause
%YAML 1.2
---
$id: http://devicetree.org/schemas/net/brcm,bcmgenet.yaml#
$schema: http://devicetree.org/meta-schemas/core.yaml#

title: Broadcom BCM7xxx Ethernet Controller (GENET) binding

maintainers:
  - Doug Berger <opendmb@gmail.com>
  - Florian Fainelli <f.fainelli@gmail.com>

properties:
  compatible:
    enum:
      - brcm,genet-v1
      - brcm,genet-v2
      - brcm,genet-v3
      - brcm,genet-v4
      - brcm,genet-v5
      - brcm,bcm2711-genet-v5
      - brcm,bcm7712-genet-v5

  reg:
    maxItems: 1

  interrupts:
    minItems: 2
    items:
      - description: general purpose interrupt line
      - description: RX and TX rings interrupt line
      - description: Wake-on-LAN interrupt line


  clocks:
    minItems: 1
    items:
      - description: main clock
      - description: EEE clock
      - description: Wake-on-LAN clock

  clock-names:
    minItems: 1
    items:
      - const: enet
      - const: enet-eee
      - const: enet-wol

  "#address-cells":
    const: 1

  "#size-cells":
    const: 1

patternProperties:
  "^mdio@[0-9a-f]+$":
    type: object
    $ref: "brcm,unimac-mdio.yaml"

    description:
      GENET internal UniMAC MDIO bus

required:
  - reg
  - interrupts
  - phy-mode
  - "#address-cells"
  - "#size-cells"

allOf:
  - $ref: ethernet-controller.yaml

unevaluatedProperties: false

examples:
  #include <dt-bindings/interrupt-controller/arm-gic.h>

  - |
    ethernet@f0b60000 {
        phy-mode = "internal";
        phy-handle = <&phy1>;
        mac-address = [ 00 10 18 36 23 1a ];
        compatible = "brcm,genet-v4";
        reg = <0xf0b60000 0xfc4c>;
        interrupts = <0x0 0x14 0x0>, <0x0 0x15 0x0>;
        #address-cells = <1>;
        #size-cells = <1>;

        mdio0: mdio@e14 {
           compatible = "brcm,genet-mdio-v4";
           #address-cells = <1>;
           #size-cells = <0>;
           reg = <0xe14 0x8>;

           phy1: ethernet-phy@1 {
                max-speed = <1000>;
                reg = <1>;
                compatible = "ethernet-phy-ieee802.3-c22";
           };
        };
    };

  - |
    ethernet@f0b80000 {
        phy-mode = "moca";
        fixed-link = <1 0 1000 0 0>;
        mac-address = [ 00 10 18 36 24 1a ];
        compatible = "brcm,genet-v4";
        #address-cells = <1>;
        #size-cells = <1>;
        reg = <0xf0b80000 0xfc4c>;
        interrupts = <0x0 0x16 0x0>, <0x0 0x17 0x0>;

        mdio1: mdio@e14 {
           compatible = "brcm,genet-mdio-v4";
           #address-cells = <1>;
           #size-cells = <0>;
           reg = <0xe14 0x8>;
        };
    };

  - |
    ethernet@f0ba0000 {
        phy-mode = "rgmii";
        phy-handle = <&phy0>;
        mac-address = [ 00 10 18 36 26 1a ];
        compatible = "brcm,genet-v4";
        #address-cells = <1>;
        #size-cells = <1>;
        reg = <0xf0ba0000 0xfc4c>;
        interrupts = <0x0 0x18 0x0>, <0x0 0x19 0x0>;

        mdio2: mdio@e14 {
           compatible = "brcm,genet-mdio-v4";
           #address-cells = <1>;
           #size-cells = <0>;
           reg = <0xe14 0x8>;

           phy0: ethernet-phy@0 {
                max-speed = <1000>;
                reg = <0>;
                compatible = "ethernet-phy-ieee802.3-c22";
           };
        };
    };
```

## Documentation/devicetree/bindings/net/brcm,bgmac-nsp.txt
```
Broadcom GMAC Ethernet Controller Device Tree Bindings
-------------------------------------------------------------

Required properties:
 - compatible:	"brcm,bgmac-nsp"
 - reg:		Address and length of the GMAC registers,
		Address and length of the GMAC IDM registers
 - reg-names:	Names of the registers.  Must have both "gmac_base" and
		"idm_base"
 - interrupts:	Interrupt number

Optional properties:
- mac-address:	See ethernet.txt file in the same directory

Examples:

gmac0: ethernet@18022000 {
	compatible = "brcm,bgmac-nsp";
	reg = <0x18022000 0x1000>,
	      <0x18110000 0x1000>;
	reg-names = "gmac_base", "idm_base";
	interrupts = <GIC_SPI 147 IRQ_TYPE_LEVEL_HIGH>;
	status = "disabled";
};
```

## Documentation/devicetree/bindings/net/brcm,iproc-mdio.txt
```
* Broadcom iProc MDIO bus controller

Required properties:
- compatible: should be "brcm,iproc-mdio"
- reg: address and length of the register set for the MDIO interface
- #size-cells: must be 1
- #address-cells: must be 0

Child yesdes of this MDIO bus controller yesde are standard Ethernet PHY device
yesdes as described in Documentation/devicetree/bindings/net/phy.txt

Example:

mdio@18002000 {
	compatible = "brcm,iproc-mdio";
	reg = <0x18002000 0x8>;
	#size-cells = <1>;
	#address-cells = <0>;

	enet-gphy@0 {
		reg = <0>;
	};
};
```

## Documentation/devicetree/bindings/net/brcm,iproc-mdio.yaml
```yaml
# SPDX-License-Identifier: GPL-2.0-only OR BSD-2-Clause
%YAML 1.2
---
$id: http://devicetree.org/schemas/net/brcm,iproc-mdio.yaml#
$schema: http://devicetree.org/meta-schemas/core.yaml#

title: Broadcom iProc MDIO bus controller

maintainers:
  - Rafał Miłecki <rafal@milecki.pl>

allOf:
  - $ref: mdio.yaml#

properties:
  compatible:
    const: brcm,iproc-mdio

  reg:
    maxItems: 1

unevaluatedProperties: false

required:
  - reg

examples:
  - |
    mdio@18002000 {
        compatible = "brcm,iproc-mdio";
        reg = <0x18002000 0x8>;
        #address-cells = <1>;
        #size-cells = <0>;

        ethernet-phy@0 {
            reg = <0>;
        };
    };
```

## Documentation/devicetree/bindings/net/brcm,mdio-mux-iproc.txt
```
Properties for an MDIO bus multiplexer found in Broadcom iProc based SoCs.

This MDIO bus multiplexer defines buses that could be internal as well as
external to SoCs and could accept MDIO transaction compatible to C-22 or
C-45 Clause. When child bus is selected, one needs to select these two
properties as well to generate desired MDIO transaction on appropriate bus.

Required properties in addition to the generic multiplexer properties:

MDIO multiplexer node:
- compatible: brcm,mdio-mux-iproc.

Every non-ethernet PHY requires a compatible so that it could be probed based
on this compatible string.

Optional properties:
- clocks: phandle of the core clock which drives the mdio block.

Additional information regarding generic multiplexer properties can be found
at- Documentation/devicetree/bindings/net/mdio-mux.txt


for example:
		mdio_mux_iproc: mdio-mux@66020000 {
			compatible = "brcm,mdio-mux-iproc";
			reg = <0x66020000 0x250>;
			#address-cells = <1>;
			#size-cells = <0>;

			mdio@0 {
				reg = <0x0>;
				#address-cells = <1>;
				#size-cells = <0>;

				pci_phy0: pci-phy@0 {
					compatible = "brcm,ns2-pcie-phy";
					reg = <0x0>;
					#phy-cells = <0>;
				};
			};

			mdio@7 {
				reg = <0x7>;
				#address-cells = <1>;
				#size-cells = <0>;

				pci_phy1: pci-phy@0 {
					compatible = "brcm,ns2-pcie-phy";
					reg = <0x0>;
					#phy-cells = <0>;
				};
			};
			mdio@10 {
				reg = <0x10>;
				#address-cells = <1>;
				#size-cells = <0>;

				gphy0: eth-phy@10 {
					reg = <0x10>;
				};
			};
		};
```

## Documentation/devicetree/bindings/net/brcm,mdio-mux-iproc.yaml
```yaml
# SPDX-License-Identifier: (GPL-2.0-only OR BSD-2-Clause)
%YAML 1.2
---
$id: http://devicetree.org/schemas/net/brcm,mdio-mux-iproc.yaml#
$schema: http://devicetree.org/meta-schemas/core.yaml#

title: MDIO bus multiplexer found in Broadcom iProc based SoCs.

maintainers:
  - Florian Fainelli <f.fainelli@gmail.com>

description:
  This MDIO bus multiplexer defines buses that could be internal as well as
  external to SoCs and could accept MDIO transaction compatible to C-22 or
  C-45 Clause. When child bus is selected, one needs to select these two
  properties as well to generate desired MDIO transaction on appropriate bus.

allOf:
  - $ref: /schemas/net/mdio-mux.yaml#

properties:
  compatible:
    const: brcm,mdio-mux-iproc

  reg:
    maxItems: 1

  clocks:
    maxItems: 1
    description: core clock driving the MDIO block


required:
  - compatible
  - reg

unevaluatedProperties: false

examples:
  - |
    mdio-mux@66020000 {
        compatible = "brcm,mdio-mux-iproc";
        reg = <0x66020000 0x250>;
        #address-cells = <1>;
        #size-cells = <0>;

        mdio@0 {
            reg = <0x0>;
            #address-cells = <1>;
            #size-cells = <0>;

            pci-phy@0 {
                compatible = "brcm,ns2-pcie-phy";
                reg = <0x0>;
                #phy-cells = <0>;
            };
        };

        mdio@7 {
            reg = <0x7>;
            #address-cells = <1>;
            #size-cells = <0>;

            pci-phy@0 {
                compatible = "brcm,ns2-pcie-phy";
                reg = <0x0>;
                #phy-cells = <0>;
            };
        };

        mdio@10 {
            reg = <0x10>;
            #address-cells = <1>;
            #size-cells = <0>;

            eth-phy@10 {
                reg = <0x10>;
            };
        };
    };
```

## Documentation/devicetree/bindings/net/brcm,systemport.txt
```
* Broadcom BCM7xxx Ethernet Systemport Controller (SYSTEMPORT)

Required properties:
- compatible: should be one of:
	      "brcm,systemport-v1.00"
	      "brcm,systemportlite-v1.00" or
	      "brcm,systemport"
- reg: address and length of the register set for the device.
- interrupts: interrupts for the device, first cell must be for the rx
  interrupts, and the second cell should be for the transmit queues. An
  optional third interrupt cell for Wake-on-LAN can be specified
- local-mac-address: Ethernet MAC address (48 bits) of this adapter
- phy-mode: Should be a string describing the PHY interface to the
  Ethernet switch/PHY, see Documentation/devicetree/bindings/net/ethernet.txt
- fixed-link: see Documentation/devicetree/bindings/net/fixed-link.txt for
  the property specific details

Optional properties:
- systemport,num-tier2-arb: number of tier 2 arbiters, an integer
- systemport,num-tier1-arb: number of tier 1 arbiters, an integer
- systemport,num-txq: number of HW transmit queues, an integer
- systemport,num-rxq: number of HW receive queues, an integer
- clocks: When provided, must be two phandles to the functional clocks nodes of
  the SYSTEMPORT block. The first phandle is the main SYSTEMPORT clock used
  during normal operation, while the second phandle is the Wake-on-LAN clock.
- clock-names: When provided, names of the functional clock phandles, first
  name should be "sw_sysport" and second should be "sw_sysportwol".

Example:
ethernet@f04a0000 {
	compatible = "brcm,systemport-v1.00";
	reg = <0xf04a0000 0x4650>;
	local-mac-address = [ 00 11 22 33 44 55 ];
	fixed-link = <0 1 1000 0 0>;
	phy-mode = "gmii";
	interrupts = <0x0 0x16 0x0>,
		<0x0 0x17 0x0>;
};
```
