## Documentation/devicetree/bindings/net/brcm,systemport.yaml
```yaml
# SPDX-License-Identifier: GPL-2.0-only OR BSD-2-Clause
%YAML 1.2
---
$id: http://devicetree.org/schemas/net/brcm,systemport.yaml#
$schema: http://devicetree.org/meta-schemas/core.yaml#

title: Broadcom BCM7xxx Ethernet Systemport Controller (SYSTEMPORT)

maintainers:
  - Florian Fainelli <f.fainelli@gmail.com>

properties:
  compatible:
    enum:
      - brcm,systemport-v1.00
      - brcm,systemportlite-v1.00
      - brcm,systemport

  reg:
    maxItems: 1

  interrupts:
    minItems: 2
    items:
      - description: interrupt line for RX queues
      - description: interrupt line for TX queues
      - description: interrupt line for Wake-on-LAN

  clocks:
    items:
      - description: main clock
      - description: Wake-on-LAN clock

  clock-names:
    items:
      - const: sw_sysport
      - const: sw_sysportwol

  systemport,num-tier2-arb:
    $ref: /schemas/types.yaml#/definitions/uint32
    description:
      Number of tier 2 arbiters

  systemport,num-tier1-arb:
    $ref: /schemas/types.yaml#/definitions/uint32
    description:
      Number of tier 2 arbiters

  systemport,num-txq:
    $ref: /schemas/types.yaml#/definitions/uint32
    minimum: 1
    maximum: 32
    description:
      Number of HW transmit queues

  systemport,num-rxq:
    $ref: /schemas/types.yaml#/definitions/uint32
    minimum: 1
    maximum: 32
    description:
      Number of HW receive queues

required:
  - reg
  - interrupts
  - phy-mode

allOf:
  - $ref: ethernet-controller.yaml#

unevaluatedProperties: false

examples:
  - |
    ethernet@f04a0000 {
        compatible = "brcm,systemport-v1.00";
        reg = <0xf04a0000 0x4650>;
        local-mac-address = [ 00 11 22 33 44 55 ];
        phy-mode = "gmii";
        interrupts = <0x0 0x16 0x0>,
                     <0x0 0x17 0x0>;
        fixed-link {
            speed = <1000>;
            full-duplex;
        };
    };
```

## Documentation/devicetree/bindings/net/brcm,unimac-mdio.txt
```
* Broadcom UniMAC MDIO bus controller

Required properties:
- compatible: should one from "brcm,genet-mdio-v1", "brcm,genet-mdio-v2",
  "brcm,genet-mdio-v3", "brcm,genet-mdio-v4", "brcm,genet-mdio-v5" or
  "brcm,unimac-mdio"
- reg: address and length of the register set for the device, first one is the
  base register, and the second one is optional and for indirect accesses to
  larger than 16-bits MDIO transactions
- reg-names: name(s) of the register must be "mdio" and optional "mdio_indir_rw"
- #size-cells: must be 1
- #address-cells: must be 0

Optional properties:
- interrupts: must be one if the interrupt is shared with the Ethernet MAC or
  Ethernet switch this MDIO block is integrated from, or must be two, if there
  are two separate interrupts, first one must be "mdio done" and second must be
  for "mdio error"
- interrupt-names: must be "mdio_done_error" when there is a share interrupt fed
  to this hardware block, or must be "mdio_done" for the first interrupt and
  "mdio_error" for the second when there are separate interrupts
- clocks: A reference to the clock supplying the MDIO bus controller
- clock-frequency: the MDIO bus clock that must be output by the MDIO bus
  hardware, if absent, the default hardware values are used

Child nodes of this MDIO bus controller node are standard Ethernet PHY device
nodes as described in Documentation/devicetree/bindings/net/phy.txt

Example:

mdio@403c0 {
	compatible = "brcm,unimac-mdio";
	reg = <0x403c0 0x8 0x40300 0x18>;
	reg-names = "mdio", "mdio_indir_rw";
	#size-cells = <1>;
	#address-cells = <0>;

	...
	phy@0 {
		compatible = "ethernet-phy-ieee802.3-c22";
		reg = <0>;
	};
};
```

## Documentation/devicetree/bindings/net/brcm,unimac-mdio.yaml
```yaml
# SPDX-License-Identifier: GPL-2.0-only OR BSD-2-Clause
%YAML 1.2
---
$id: http://devicetree.org/schemas/net/brcm,unimac-mdio.yaml#
$schema: http://devicetree.org/meta-schemas/core.yaml#

title: Broadcom UniMAC MDIO bus controller

maintainers:
  - Doug Berger <opendmb@gmail.com>
  - Florian Fainelli <f.fainelli@gmail.com>
  - Rafał Miłecki <rafal@milecki.pl>

allOf:
  - $ref: mdio.yaml#

properties:
  compatible:
    enum:
      - brcm,genet-mdio-v1
      - brcm,genet-mdio-v2
      - brcm,genet-mdio-v3
      - brcm,genet-mdio-v4
      - brcm,genet-mdio-v5
      - brcm,asp-v2.0-mdio
      - brcm,asp-v2.1-mdio
      - brcm,asp-v2.2-mdio
      - brcm,unimac-mdio
      - brcm,bcm6846-mdio

  reg:
    minItems: 1
    items:
      - description: base register
      - description: indirect accesses to larger than 16-bits MDIO transactions

  reg-names:
    minItems: 1
    items:
      - const: mdio
      - const: mdio_indir_rw

  interrupts:
    oneOf:
      - description: >
          Interrupt shared with the Ethernet MAC or Ethernet switch this MDIO
          block is integrated from
      - items:
          - description: |
              "mdio done" interrupt
          - description: |
              "mdio error" interrupt

  interrupt-names:
    oneOf:
      - const: mdio_done_error
      - items:
          - const: mdio_done
          - const: mdio_error

  clocks:
    description: A reference to the clock supplying the MDIO bus controller

  clock-frequency:
    description: >
      The MDIO bus clock that must be output by the MDIO bus hardware, if
      absent, the default hardware values are used

unevaluatedProperties: false

required:
  - reg
  - '#address-cells'
  - '#size-cells'

examples:
  - |
    mdio@403c0 {
        compatible = "brcm,unimac-mdio";
        reg = <0x403c0 0x8>, <0x40300 0x18>;
        reg-names = "mdio", "mdio_indir_rw";
        #address-cells = <1>;
        #size-cells = <0>;

        ethernet-phy@0 {
            compatible = "ethernet-phy-ieee802.3-c22";
            reg = <0>;
        };
    };
```

## Documentation/devicetree/bindings/net/broadcom-bcm87xx.txt
```
The Broadcom BCM87XX devices are a family of 10G Ethernet PHYs.  They
have these bindings in addition to the standard PHY bindings.

Compatible: Should contain "broadcom,bcm8706" or "broadcom,bcm8727" and
            "ethernet-phy-ieee802.3-c45"

Optional Properties:

- broadcom,c45-reg-init : one of more sets of 4 cells.  The first cell
  is the MDIO Manageable Device (MMD) address, the second a register
  address within the MMD, the third cell contains a mask to be ANDed
  with the existing register value, and the fourth cell is ORed with
  he result to yield the new register value.  If the third cell has a
  value of zero, no read of the existing value is performed.

Example:

	ethernet-phy@5 {
		reg = <5>;
		compatible = "broadcom,bcm8706", "ethernet-phy-ieee802.3-c45";
		interrupt-parent = <&gpio>;
		interrupts = <12 8>; /* Pin 12, active low */
		/*
		 * Set PMD Digital Control Register for
		 * GPIO[1] Tx/Rx
		 * GPIO[0] R64 Sync Acquired
		 */
		broadcom,c45-reg-init = <1 0xc808 0xff8f 0x70>;
	};
```

## Documentation/devicetree/bindings/net/broadcom-bluetooth.txt
```
Broadcom Bluetooth Chips
---------------------

This documents the binding structure and common properties for serial
attached Broadcom devices.

Serial attached Broadcom devices shall be a child node of the host UART
device the slave device is attached to.

Required properties:

 - compatible: should contain one of the following:
   * "brcm,bcm20702a1"
   * "brcm,bcm4329-bt"
   * "brcm,bcm4330-bt"
   * "brcm,bcm43438-bt"
   * "brcm,bcm4345c5"
   * "brcm,bcm43540-bt"
   * "brcm,bcm4335a0"

Optional properties:

 - max-speed: see Documentation/devicetree/bindings/serial/serial.yaml
 - shutdown-gpios: GPIO specifier, used to enable the BT module
 - device-wakeup-gpios: GPIO specifier, used to wakeup the controller
 - host-wakeup-gpios: GPIO specifier, used to wakeup the host processor.
                      deprecated, replaced by interrupts and
                      "host-wakeup" interrupt-names
 - clocks: 1 or 2 clocks as defined in clock-names below, in that order
 - clock-names: names for clock inputs, matching the clocks given
   - "extclk": deprecated, replaced by "txco"
   - "txco": external reference clock (not a standalone crystal)
   - "lpo": external low power 32.768 kHz clock
 - vbat-supply: phandle to regulator supply for VBAT
 - vddio-supply: phandle to regulator supply for VDDIO
 - brcm,bt-pcm-int-params: configure PCM parameters via a 5-byte array
    - sco-routing: 0 = PCM, 1 = Transport, 2 = Codec, 3 = I2S
    - pcm-interface-rate: 128KBps, 256KBps, 512KBps, 1024KBps, 2048KBps
    - pcm-frame-type: short, long
    - pcm-sync-mode: slave, master
    - pcm-clock-mode: slave, master
 - interrupts: must be one, used to wakeup the host processor
 - interrupt-names: must be "host-wakeup"

Example:

&uart2 {
       pinctrl-names = "default";
       pinctrl-0 = <&uart2_pins>;

       bluetooth {
               compatible = "brcm,bcm43438-bt";
               max-speed = <921600>;
               brcm,bt-pcm-int-params = [01 02 00 01 01];
       };
};
```

## Documentation/devicetree/bindings/net/broadcom-bluetooth.yaml
```yaml
# SPDX-License-Identifier: (GPL-2.0 OR BSD-2-Clause)
%YAML 1.2
---
$id: http://devicetree.org/schemas/net/broadcom-bluetooth.yaml#
$schema: http://devicetree.org/meta-schemas/core.yaml#

title: Broadcom Bluetooth Chips

maintainers:
  - Linus Walleij <linus.walleij@linaro.org>

description:
  This binding describes Broadcom UART-attached bluetooth chips.

properties:
  compatible:
    enum:
      - brcm,bcm20702a1
      - brcm,bcm4329-bt
      - brcm,bcm4330-bt
      - brcm,bcm4334-bt
      - brcm,bcm43430a0-bt
      - brcm,bcm43430a1-bt
      - brcm,bcm43438-bt
      - brcm,bcm4345c5
      - brcm,bcm43540-bt
      - brcm,bcm4335a0
      - brcm,bcm4349-bt
      - cypress,cyw4373a0-bt
      - infineon,cyw55572-bt

  shutdown-gpios:
    maxItems: 1
    description: GPIO specifier for the line BT_REG_ON used to
      power on the BT module

  reset-gpios:
    maxItems: 1
    description: GPIO specifier for the line BT_RST_N used to
      reset the BT module. This should be marked as
      GPIO_ACTIVE_LOW.

  device-wakeup-gpios:
    maxItems: 1
    description: GPIO specifier for the line BT_WAKE used to
      wakeup the controller. This is using the BT_GPIO_0
      pin on the chip when in use.

  host-wakeup-gpios:
    maxItems: 1
    deprecated: true
    description: GPIO specifier for the line HOST_WAKE used
      to wakeup the host processor. This is using he BT_GPIO_1
      pin on the chip when in use. This is deprecated and replaced
      by interrupts and "host-wakeup" interrupt-names

  clocks:
    minItems: 1
    maxItems: 2
    description: 1 or 2 clocks as defined in clock-names below,
      in that order

  clock-names:
    description: Names of the 1 to 2 supplied clocks
    oneOf:
      - const: extclk
        deprecated: true
        description: Deprecated in favor of txco

      - const: txco
        description: >
          external reference clock (not a standalone crystal)

      - const: lpo
        description: >
          external low power 32.768 kHz clock

      - items:
          - const: txco
          - const: lpo

  vbat-supply:
    description: phandle to regulator supply for VBAT

  vddio-supply:
    description: phandle to regulator supply for VDDIO

  brcm,bt-pcm-int-params:
    $ref: /schemas/types.yaml#/definitions/uint8-array
    minItems: 5
    maxItems: 5
    description: |-
      configure PCM parameters via a 5-byte array:
       sco-routing: 0 = PCM, 1 = Transport, 2 = Codec, 3 = I2S
       pcm-interface-rate: 128KBps, 256KBps, 512KBps, 1024KBps, 2048KBps
       pcm-frame-type: short, long
       pcm-sync-mode: slave, master
       pcm-clock-mode: slave, master

  brcm,requires-autobaud-mode:
    type: boolean
    description:
      Set this property if autobaud mode is required. Autobaud mode is required
      if the device's initial baud rate in normal mode is not supported by the
      host or if the device requires autobaud mode startup before loading FW.

  interrupts:
    items:
      - description: Handle to the line HOST_WAKE used to wake
          up the host processor. This uses the BT_GPIO_1 pin on
          the chip when in use.

  interrupt-names:
    items:
      - const: host-wakeup

  max-speed: true
  current-speed: true

required:
  - compatible

dependencies:
  brcm,requires-autobaud-mode: [ shutdown-gpios ]

if:
  not:
    properties:
      compatible:
        contains:
          enum:
            - brcm,bcm20702a1
            - brcm,bcm4329-bt
            - brcm,bcm4330-bt
then:
  properties:
    reset-gpios: false

additionalProperties: false

examples:
  - |
    #include <dt-bindings/gpio/gpio.h>
    #include <dt-bindings/interrupt-controller/irq.h>

    uart {
        uart-has-rtscts;

        bluetooth {
            compatible = "brcm,bcm4330-bt";
            max-speed = <921600>;
            brcm,bt-pcm-int-params = [01 02 00 01 01];
            shutdown-gpios = <&gpio 30 GPIO_ACTIVE_HIGH>;
            device-wakeup-gpios = <&gpio 7 GPIO_ACTIVE_HIGH>;
            reset-gpios = <&gpio 9 GPIO_ACTIVE_LOW>;
            interrupt-parent = <&gpio>;
            interrupts = <8 IRQ_TYPE_EDGE_FALLING>;
        };
    };
```

## Documentation/devicetree/bindings/net/btusb.txt
```
Generic Bluetooth controller over USB (btusb driver)
---------------------------------------------------

Required properties:

  - compatible : should comply with the format "usbVID,PID" specified in
		 Documentation/devicetree/bindings/usb/usb-device.yaml
		 At the time of writing, the only OF supported devices
		 (more may be added later) are:

		  "usb1286,204e" (Marvell 8997)
		  "usbcf3,e300" (Qualcomm QCA6174A)
		  "usb4ca,301a" (Qualcomm QCA6174A (Lite-On))


Also, vendors that use btusb may have device additional properties, e.g:
Documentation/devicetree/bindings/net/marvell-bt-8xxx.txt

Optional properties:

  - interrupt-names: (see below)
  - interrupts : The interrupt specified by the name "wakeup" is the interrupt
		 that shall be used for out-of-band wake-on-bt. Driver will
		 request this interrupt for wakeup. During system suspend, the
		 irq will be enabled so that the bluetooth chip can wakeup host
		 platform out of band. During system resume, the irq will be
		 disabled to make sure unnecessary interrupt is not received.

Example:

Following example uses irq pin number 3 of gpio0 for out of band wake-on-bt:

&usb_host1_ehci {
    #address-cells = <1>;
    #size-cells = <0>;

    mvl_bt1: bt@1 {
	compatible = "usb1286,204e";
	reg = <1>;
	interrupt-parent = <&gpio0>;
	interrupt-names = "wakeup";
	interrupts = <3 IRQ_TYPE_LEVEL_LOW>;
    };
};
```

## Documentation/devicetree/bindings/net/calxeda-xgmac.txt
```
* Calxeda Highbank 10Gb XGMAC Ethernet

Required properties:
- compatible : Should be "calxeda,hb-xgmac"
- reg : Address and length of the register set for the device
- interrupts : Should contain 3 xgmac interrupts. The 1st is main interrupt.
  The 2nd is pwr mgt interrupt. The 3rd is low power state interrupt.

Example:

ethernet@fff50000 {
        compatible = "calxeda,hb-xgmac";
        reg = <0xfff50000 0x1000>;
        interrupts = <0 77 4  0 78 4  0 79 4>;
};
```
