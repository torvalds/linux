## Documentation/devicetree/bindings/net/fsl,gianfar.yaml
```yaml
# SPDX-License-Identifier: GPL-2.0
%YAML 1.2
---
$id: http://devicetree.org/schemas/net/fsl,gianfar.yaml#
$schema: http://devicetree.org/meta-schemas/core.yaml#

title: Freescale Three-Speed Ethernet Controller (TSEC), "Gianfar"

maintainers:
  - J. Neuschäfer <j.ne@posteo.net>

# This is needed to distinguish gianfar.yaml and gianfar-mdio.yaml, because
# both use compatible = "gianfar" (with different device_type values)
select:
  oneOf:
    - properties:
        compatible:
          contains:
            const: gianfar
        device_type:
          const: network
      required:
        - device_type

    - properties:
        compatible:
          const: fsl,etsec2

  required:
    - compatible

properties:
  compatible:
    enum:
      - gianfar
      - fsl,etsec2

  device_type:
    const: network

  model:
    enum:
      - FEC
      - TSEC
      - eTSEC

  reg:
    maxItems: 1

  ranges: true

  "#address-cells":
    enum: [ 1, 2 ]

  "#size-cells":
    enum: [ 1, 2 ]

  cell-index:
    $ref: /schemas/types.yaml#/definitions/uint32

  interrupts:
    minItems: 1
    items:
      - description: Transmit interrupt or single combined interrupt
      - description: Receive interrupt
      - description: Error interrupt

  dma-coherent: true

  fsl,magic-packet:
    type: boolean
    description:
      If present, indicates that the hardware supports waking up via magic packet.

  fsl,wake-on-filer:
    type: boolean
    description:
      If present, indicates that the hardware supports waking up by Filer
      General Purpose Interrupt (FGPI) asserted on the Rx int line. This is
      an advanced power management capability allowing certain packet types
      (user) defined by filer rules to wake up the system.

  bd-stash:
    type: boolean
    description:
      If present, indicates that the hardware supports stashing buffer
      descriptors in the L2.

  rx-stash-len:
    $ref: /schemas/types.yaml#/definitions/uint32
    description:
      Denotes the number of bytes of a received buffer to stash in the L2.

  rx-stash-idx:
    $ref: /schemas/types.yaml#/definitions/uint32
    description:
      Denotes the index of the first byte from the received buffer to stash in
      the L2.

  fsl,num_rx_queues:
    $ref: /schemas/types.yaml#/definitions/uint32
    description: Number of receive queues
    const: 8

  fsl,num_tx_queues:
    $ref: /schemas/types.yaml#/definitions/uint32
    description: Number of transmit queues
    const: 8

  tbi-handle:
    $ref: /schemas/types.yaml#/definitions/phandle
    description: Reference (phandle) to the TBI node

required:
  - compatible
  - model

patternProperties:
  "^mdio@[0-9a-f]+$":
    $ref: /schemas/net/fsl,gianfar-mdio.yaml#

allOf:
  - $ref: ethernet-controller.yaml#

  # eTSEC2 controller nodes have "queue group" subnodes and don't need a "reg"
  # property.
  - if:
      properties:
        compatible:
          contains:
            const: fsl,etsec2
    then:
      patternProperties:
        "^queue-group@[0-9a-f]+$":
          type: object

          properties:
            reg:
              maxItems: 1

            interrupts:
              items:
                - description: Transmit interrupt
                - description: Receive interrupt
                - description: Error interrupt

          required:
            - reg
            - interrupts

          additionalProperties: false
    else:
      required:
        - reg

  # TSEC and eTSEC devices require three interrupts
  - if:
      properties:
        model:
          contains:
            enum: [ TSEC, eTSEC ]
    then:
      properties:
        interrupts:
          items:
            - description: Transmit interrupt
            - description: Receive interrupt
            - description: Error interrupt



unevaluatedProperties: false

examples:
  - |
    ethernet@24000 {
        device_type = "network";
        model = "TSEC";
        compatible = "gianfar";
        reg = <0x24000 0x1000>;
        local-mac-address = [ 00 00 00 00 00 00 ];
        interrupts = <29 2>, <30 2>, <34 2>;
        interrupt-parent = <&mpic>;
        phy-handle = <&phy0>;
    };

  - |
    #include <dt-bindings/interrupt-controller/irq.h>

    ethernet@24000 {
        compatible = "gianfar";
        reg = <0x24000 0x1000>;
        ranges = <0x0 0x24000 0x1000>;
        #address-cells = <1>;
        #size-cells = <1>;
        cell-index = <0>;
        device_type = "network";
        model = "eTSEC";
        local-mac-address = [ 00 00 00 00 00 00 ];
        interrupts = <32 IRQ_TYPE_LEVEL_LOW>,
                     <33 IRQ_TYPE_LEVEL_LOW>,
                     <34 IRQ_TYPE_LEVEL_LOW>;
        interrupt-parent = <&ipic>;

        mdio@520 {
            #address-cells = <1>;
            #size-cells = <0>;
            compatible = "fsl,gianfar-mdio";
            reg = <0x520 0x20>;
        };
    };

  - |
    #include <dt-bindings/interrupt-controller/irq.h>
    #include <dt-bindings/interrupt-controller/arm-gic.h>

    bus {
        #address-cells = <2>;
        #size-cells = <2>;

        ethernet {
            compatible = "fsl,etsec2";
            ranges;
            device_type = "network";
            #address-cells = <2>;
            #size-cells = <2>;
            interrupt-parent = <&gic>;
            model = "eTSEC";
            fsl,magic-packet;
            dma-coherent;

            queue-group@2d10000 {
                reg = <0x0 0x2d10000 0x0 0x1000>;
                interrupts = <GIC_SPI 144 IRQ_TYPE_LEVEL_HIGH>,
                             <GIC_SPI 145 IRQ_TYPE_LEVEL_HIGH>,
                             <GIC_SPI 146 IRQ_TYPE_LEVEL_HIGH>;
            };

            queue-group@2d14000  {
                reg = <0x0 0x2d14000 0x0 0x1000>;
                interrupts = <GIC_SPI 147 IRQ_TYPE_LEVEL_HIGH>,
                             <GIC_SPI 148 IRQ_TYPE_LEVEL_HIGH>,
                             <GIC_SPI 149 IRQ_TYPE_LEVEL_HIGH>;
            };
        };
    };

...
```

## Documentation/devicetree/bindings/net/fsl,qoriq-mc-dpmac.yaml
```yaml
# SPDX-License-Identifier: (GPL-2.0-only OR BSD-2-Clause)
%YAML 1.2
---
$id: http://devicetree.org/schemas/net/fsl,qoriq-mc-dpmac.yaml#
$schema: http://devicetree.org/meta-schemas/core.yaml#

title: DPAA2 MAC

maintainers:
  - Ioana Ciornei <ioana.ciornei@nxp.com>

description:
  This binding represents the DPAA2 MAC objects found on the fsl-mc bus and
  located under the 'dpmacs' node for the fsl-mc bus DTS node.

allOf:
  - $ref: ethernet-controller.yaml#

properties:
  compatible:
    const: fsl,qoriq-mc-dpmac

  reg:
    maxItems: 1
    description: The DPMAC number

  phy-handle: true

  phy-connection-type: true

  phy-mode: true

  pcs-handle:
    maxItems: 1
    description:
      A reference to a node representing a PCS PHY device found on
      the internal MDIO bus.

  managed: true

required:
  - reg

additionalProperties: false

examples:
  - |
    dpmacs {
      #address-cells = <1>;
      #size-cells = <0>;

      ethernet@4 {
        compatible = "fsl,qoriq-mc-dpmac";
        reg = <0x4>;
        phy-handle = <&mdio1_phy6>;
        phy-connection-type = "qsgmii";
        managed = "in-band-status";
        pcs-handle = <&pcs3_1>;
      };
    };
```

## Documentation/devicetree/bindings/net/fsl-enetc.txt
```
* ENETC ethernet device tree bindings

Depending on board design and ENETC port type (internal or
external) there are two supported link modes specified by
below device tree bindings.

Required properties:

- reg		: Specifies PCIe Device Number and Function
		  Number of the ENETC endpoint device, according
		  to parent node bindings.
- compatible	: Should be "fsl,enetc".

1. The ENETC external port is connected to a MDIO configurable phy

1.1. Using the local ENETC Port MDIO interface

In this case, the ENETC node should include a "mdio" sub-node
that in turn should contain the "ethernet-phy" node describing the
external phy.  Below properties are required, their bindings
already defined in Documentation/devicetree/bindings/net/ethernet.txt or
Documentation/devicetree/bindings/net/phy.txt.

Required:

- phy-handle		: Phandle to a PHY on the MDIO bus.
			  Defined in ethernet.txt.

- phy-connection-type	: Defined in ethernet.txt.

- mdio			: "mdio" node, defined in mdio.txt.

- ethernet-phy		: "ethernet-phy" node, defined in phy.txt.

Example:

	ethernet@0,0 {
		compatible = "fsl,enetc";
		reg = <0x000000 0 0 0 0>;
		phy-handle = <&sgmii_phy0>;
		phy-connection-type = "sgmii";

		mdio {
			#address-cells = <1>;
			#size-cells = <0>;
			sgmii_phy0: ethernet-phy@2 {
				reg = <0x2>;
			};
		};
	};

1.2. Using the central MDIO PCIe endpoint device

In this case, the mdio node should be defined as another PCIe
endpoint node, at the same level with the ENETC port nodes.

Required properties:

- reg		: Specifies PCIe Device Number and Function
		  Number of the ENETC endpoint device, according
		  to parent node bindings.
- compatible	: Should be "fsl,enetc-mdio".

The remaining required mdio bus properties are standard, their bindings
already defined in Documentation/devicetree/bindings/net/mdio.txt.

Example:

	ethernet@0,0 {
		compatible = "fsl,enetc";
		reg = <0x000000 0 0 0 0>;
		phy-handle = <&sgmii_phy0>;
		phy-connection-type = "sgmii";
	};

	mdio@0,3 {
		compatible = "fsl,enetc-mdio";
		reg = <0x000300 0 0 0 0>;
		#address-cells = <1>;
		#size-cells = <0>;
		sgmii_phy0: ethernet-phy@2 {
			reg = <0x2>;
		};
	};

2. The ENETC port is an internal port or has a fixed-link external
connection

In this case, the ENETC port node defines a fixed link connection,
as specified by Documentation/devicetree/bindings/net/fixed-link.txt.

Required:

- fixed-link	: "fixed-link" node, defined in "fixed-link.txt".

Example:
	ethernet@0,2 {
		compatible = "fsl,enetc";
		reg = <0x000200 0 0 0 0>;
		fixed-link {
			speed = <1000>;
			full-duplex;
		};
	};

* Integrated Endpoint Register Block bindings

Optionally, the fsl_enetc driver can probe on the Integrated Endpoint Register
Block, which preconfigures the FIFO limits for the ENETC ports. This is a node
with the following properties:

- reg		: Specifies the address in the SoC memory space.
- compatible	: Must be "fsl,ls1028a-enetc-ierb".

Example:
	ierb@1f0800000 {
		compatible = "fsl,ls1028a-enetc-ierb";
		reg = <0x01 0xf0800000 0x0 0x10000>;
	};
```

## Documentation/devicetree/bindings/net/fsl-fec.txt
```
* Freescale Fast Ethernet Controller (FEC)

Required properties:
- compatible : Should be "fsl,<soc>-fec"
- reg : Address and length of the register set for the device
- interrupts : Should contain fec interrupt
- phy-mode : See ethernet.txt file in the same directory

Optional properties:
- phy-reset-gpios : Should specify the gpio for phy reset
- phy-reset-duration : Reset duration in milliseconds.  Should present
  only if property "phy-reset-gpios" is available.  Missing the property
  will have the duration be 1 millisecond.  Numbers greater than 1000 are
  invalid and 1 millisecond will be used instead.
- phy-reset-active-high : If present then the reset sequence using the GPIO
  specified in the "phy-reset-gpios" property is reversed (H=reset state,
  L=operation state).
- phy-reset-post-delay : Post reset delay in milliseconds. If present then
  a delay of phy-reset-post-delay milliseconds will be observed after the
  phy-reset-gpios has been toggled. Can be omitted thus no delay is
  observed. Delay is in range of 1ms to 1000ms. Other delays are invalid.
- phy-supply : regulator that powers the Ethernet PHY.
- phy-handle : phandle to the PHY device connected to this device.
- fixed-link : Assume a fixed link. See fixed-link.txt in the same directory.
  Use instead of phy-handle.
- fsl,num-tx-queues : The property is valid for enet-avb IP, which supports
  hw multi queues. Should specify the tx queue number, otherwise set tx queue
  number to 1.
- fsl,num-rx-queues : The property is valid for enet-avb IP, which supports
  hw multi queues. Should specify the rx queue number, otherwise set rx queue
  number to 1.
- fsl,magic-packet : If present, indicates that the hardware supports waking
  up via magic packet.
- fsl,err006687-workaround-present: If present indicates that the system has
  the hardware workaround for ERR006687 applied and does not need a software
  workaround.
 -interrupt-names:  names of the interrupts listed in interrupts property in
  the same order. The defaults if not specified are
  __Number of interrupts__   __Default__
	1			"int0"
	2			"int0", "pps"
	3			"int0", "int1", "int2"
	4			"int0", "int1", "int2", "pps"
  The order may be changed as long as they correspond to the interrupts
  property. Currently, only i.mx7 uses "int1" and "int2". They correspond to
  tx/rx queues 1 and 2. "int0" will be used for queue 0 and ENET_MII interrupts.
  For imx6sx, "int0" handles all 3 queues and ENET_MII. "pps" is for the pulse
  per second interrupt associated with 1588 precision time protocol(PTP).


Optional subnodes:
- mdio : specifies the mdio bus in the FEC, used as a container for phy nodes
  according to phy.txt in the same directory

Example:

ethernet@83fec000 {
	compatible = "fsl,imx51-fec", "fsl,imx27-fec";
	reg = <0x83fec000 0x4000>;
	interrupts = <87>;
	phy-mode = "mii";
	phy-reset-gpios = <&gpio2 14 GPIO_ACTIVE_LOW>; /* GPIO2_14 */
	local-mac-address = [00 04 9F 01 1B B9];
	phy-supply = <&reg_fec_supply>;
};

Example with phy specified:

ethernet@83fec000 {
	compatible = "fsl,imx51-fec", "fsl,imx27-fec";
	reg = <0x83fec000 0x4000>;
	interrupts = <87>;
	phy-mode = "mii";
	phy-reset-gpios = <&gpio2 14 GPIO_ACTIVE_LOW>; /* GPIO2_14 */
	local-mac-address = [00 04 9F 01 1B B9];
	phy-supply = <&reg_fec_supply>;
	phy-handle = <&ethphy>;
	mdio {
		ethphy: ethernet-phy@6 {
			compatible = "ethernet-phy-ieee802.3-c22";
			reg = <6>;
			max-speed = <100>;
		};
	};
};
```
