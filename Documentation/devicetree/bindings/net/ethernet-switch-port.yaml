## Documentation/devicetree/bindings/net/ethernet-switch-port.yaml
```yaml
# SPDX-License-Identifier: (GPL-2.0-only OR BSD-2-Clause)
%YAML 1.2
---
$id: http://devicetree.org/schemas/net/ethernet-switch-port.yaml#
$schema: http://devicetree.org/meta-schemas/core.yaml#

title: Generic Ethernet Switch Port

maintainers:
  - Andrew Lunn <andrew@lunn.ch>
  - Florian Fainelli <f.fainelli@gmail.com>
  - Vladimir Oltean <olteanv@gmail.com>

description:
  An Ethernet switch port is a component of a switch that manages one MAC, and
  can pass Ethernet frames.

$ref: ethernet-controller.yaml#

properties:
  reg:
    description: Port number

additionalProperties: true

...
```

## Documentation/devicetree/bindings/net/ethernet-switch.yaml
```yaml
# SPDX-License-Identifier: (GPL-2.0-only OR BSD-2-Clause)
%YAML 1.2
---
$id: http://devicetree.org/schemas/net/ethernet-switch.yaml#
$schema: http://devicetree.org/meta-schemas/core.yaml#

title: Generic Ethernet Switch

maintainers:
  - Andrew Lunn <andrew@lunn.ch>
  - Florian Fainelli <f.fainelli@gmail.com>
  - Vladimir Oltean <olteanv@gmail.com>

description:
  Ethernet switches are multi-port Ethernet controllers. Each port has
  its own number and is represented as its own Ethernet controller.
  The minimum required functionality is to pass packets to software.
  They may or may not be able to forward packets automonously between
  ports.

select: false

properties:
  $nodename:
    pattern: "^(ethernet-)?switch(@.*)?$"

patternProperties:
  "^(ethernet-)?ports$":
    type: object
    unevaluatedProperties: false

    properties:
      '#address-cells':
        const: 1
      '#size-cells':
        const: 0

    patternProperties:
      "^(ethernet-)?port@[0-9]+$":
        type: object
        description: Ethernet switch ports

oneOf:
  - required:
      - ports
  - required:
      - ethernet-ports

additionalProperties: true

$defs:
  base:
    description: An ethernet switch without any extra port properties
    $ref: '#/'

    patternProperties:
      "^(ethernet-)?port@[0-9]+$":
        description: Ethernet switch ports
        $ref: ethernet-switch-port.yaml#
        unevaluatedProperties: false

...
```

## Documentation/devicetree/bindings/net/ethernet.txt
```
The following properties are common to the Ethernet controllers:

- local-mac-address: array of 6 bytes, specifies the MAC address that was
  assigned to the network device;
- mac-address: array of 6 bytes, specifies the MAC address that was last used by
  the boot program; should be used in cases where the MAC address assigned to
  the device by the boot program is different from the "local-mac-address"
  property;
- max-speed: number, specifies maximum speed in Mbit/s supported by the device;
- max-frame-size: number, maximum transfer unit (IEEE defined MTU), rather than
  the maximum frame size (there's contradiction in the Devicetree
  Specification).
- phy-mode: string, operation mode of the PHY interface. This is now a de-facto
  standard property; supported values are:
  * "internal"
  * "mii"
  * "gmii"
  * "sgmii"
  * "qsgmii"
  * "tbi"
  * "rev-mii"
  * "rmii"
  * "rgmii" (RX and TX delays are added by the MAC when required)
  * "rgmii-id" (RGMII with internal RX and TX delays provided by the PHY, the
     MAC should not add the RX or TX delays in this case)
  * "rgmii-rxid" (RGMII with internal RX delay provided by the PHY, the MAC
     should not add an RX delay in this case)
  * "rgmii-txid" (RGMII with internal TX delay provided by the PHY, the MAC
     should not add an TX delay in this case)
  * "rtbi"
  * "smii"
  * "xgmii"
  * "trgmii"
  * "2000base-x",
  * "2500base-x",
  * "rxaui"
  * "xaui"
  * "10gbase-kr" (10GBASE-KR, XFI, SFI)
- phy-connection-type: the same as "phy-mode" property but described in the
  Devicetree Specification;
- phy-handle: phandle, specifies a reference to a node representing a PHY
  device; this property is described in the Devicetree Specification and so
  preferred;
- phy: the same as "phy-handle" property, not recommended for new bindings.
- phy-device: the same as "phy-handle" property, not recommended for new
  bindings.
- rx-fifo-depth: the size of the controller's receive fifo in bytes. This
  is used for components that can have configurable receive fifo sizes,
  and is useful for determining certain configuration settings such as
  flow control thresholds.
- tx-fifo-depth: the size of the controller's transmit fifo in bytes. This
  is used for components that can have configurable fifo sizes.
- managed: string, specifies the PHY management type. Supported values are:
  "auto", "in-band-status". "auto" is the default, it usess MDIO for
  management if fixed-link is not specified.

Child nodes of the Ethernet controller are typically the individual PHY devices
connected via the MDIO bus (sometimes the MDIO bus controller is separate).
They are described in the phy.txt file in this same directory.
For non-MDIO PHY management see fixed-link.txt.
```

## Documentation/devicetree/bindings/net/ezchip_enet.txt
```
* EZchip NPS Management Ethernet port driver

Required properties:
- compatible: Should be "ezchip,nps-mgt-enet"
- reg: Address and length of the register set for the device
- interrupts: Should contain the ENET interrupt

Examples:

	ethernet@f0003000 {
		compatible = "ezchip,nps-mgt-enet";
		reg = <0xf0003000 0x44>;
		interrupts = <7>;
		mac-address = [ 00 11 22 33 44 55 ];
	};
```

## Documentation/devicetree/bindings/net/faraday,ftgmac100.yaml
```yaml
# SPDX-License-Identifier: GPL-2.0
%YAML 1.2
---
$id: http://devicetree.org/schemas/net/faraday,ftgmac100.yaml#
$schema: http://devicetree.org/meta-schemas/core.yaml#

title: Faraday Technology FTGMAC100 gigabit ethernet controller

allOf:
  - $ref: ethernet-controller.yaml#

maintainers:
  - Po-Yu Chuang <ratbert@faraday-tech.com>

properties:
  compatible:
    oneOf:
      - const: faraday,ftgmac100
      - items:
          - enum:
              - aspeed,ast2400-mac
              - aspeed,ast2500-mac
              - aspeed,ast2600-mac
          - const: faraday,ftgmac100

  reg:
    maxItems: 1

  interrupts:
    maxItems: 1

  clocks:
    minItems: 1
    items:
      - description: MAC IP clock
      - description: RMII RCLK gate for AST2500/2600

  clock-names:
    minItems: 1
    items:
      - const: MACCLK
      - const: RCLK

  phy-mode:
    enum:
      - rgmii
      - rgmii-id
      - rgmii-rxid
      - rgmii-txid
      - rmii

  phy-handle: true

  use-ncsi:
    description:
      Use the NC-SI stack instead of an MDIO PHY. Currently assumes
      rmii (100bT) but kept as a separate property in case NC-SI grows support
      for a gigabit link.
    type: boolean

  no-hw-checksum:
    description:
      Used to disable HW checksum support. Here for backward
      compatibility as the driver now should have correct defaults based on
      the SoC.
    type: boolean
    deprecated: true

  mdio:
    $ref: /schemas/net/mdio.yaml#

required:
  - compatible
  - reg
  - interrupts

unevaluatedProperties: false

examples:
  - |
    ethernet@1e660000 {
        compatible = "aspeed,ast2500-mac", "faraday,ftgmac100";
        reg = <0x1e660000 0x180>;
        interrupts = <2>;
        use-ncsi;
    };

    ethernet@1e680000 {
        compatible = "aspeed,ast2500-mac", "faraday,ftgmac100";
        reg = <0x1e680000 0x180>;
        interrupts = <2>;

        phy-handle = <&phy>;
        phy-mode = "rgmii";

        mdio {
            #address-cells = <1>;
            #size-cells = <0>;

            phy: ethernet-phy@1 {
                compatible = "ethernet-phy-ieee802.3-c22";
                reg = <1>;
            };
        };
    };
```

## Documentation/devicetree/bindings/net/fsl,cpm-enet.yaml
```yaml
# SPDX-License-Identifier: (GPL-2.0-only OR BSD-2-Clause)
%YAML 1.2
---
$id: http://devicetree.org/schemas/net/fsl,cpm-enet.yaml#
$schema: http://devicetree.org/meta-schemas/core.yaml#

title: Network for cpm enet

maintainers:
  - Frank Li <Frank.Li@nxp.com>

properties:
  compatible:
    oneOf:
      - enum:
          - fsl,cpm1-scc-enet
          - fsl,cpm2-scc-enet
          - fsl,cpm1-fec-enet
          - fsl,cpm2-fcc-enet
          - fsl,qe-enet
      - items:
          - enum:
              - fsl,mpc8272-fcc-enet
          - const: fsl,cpm2-fcc-enet

  reg:
    minItems: 1
    maxItems: 3

  interrupts:
    maxItems: 1

  fsl,cpm-command:
    $ref: /schemas/types.yaml#/definitions/uint32
    description: cpm command

required:
  - compatible
  - reg
  - interrupts

allOf:
  - $ref: ethernet-controller.yaml

unevaluatedProperties: false

examples:
  - |
    ethernet@11300 {
        compatible = "fsl,mpc8272-fcc-enet",
                     "fsl,cpm2-fcc-enet";
        reg = <0x11300 0x20 0x8400 0x100 0x11390 1>;
        local-mac-address = [ 00 00 00 00 00 00 ];
        interrupts = <20 8>;
        interrupt-parent = <&pic>;
        phy-handle = <&phy0>;
        fsl,cpm-command = <0x12000300>;
    };
```

## Documentation/devicetree/bindings/net/fsl,cpm-mdio.yaml
```yaml
# SPDX-License-Identifier: (GPL-2.0-only OR BSD-2-Clause)
%YAML 1.2
---
$id: http://devicetree.org/schemas/net/fsl,cpm-mdio.yaml#
$schema: http://devicetree.org/meta-schemas/core.yaml#

title: Freescale CPM MDIO Device

maintainers:
  - Frank Li <Frank.Li@nxp.com>

properties:
  compatible:
    oneOf:
      - enum:
          - fsl,pq1-fec-mdio
          - fsl,cpm2-mdio-bitbang
      - items:
          - const: fsl,mpc8272ads-mdio-bitbang
          - const: fsl,mpc8272-mdio-bitbang
          - const: fsl,cpm2-mdio-bitbang

  reg:
    maxItems: 1

  fsl,mdio-pin:
    $ref: /schemas/types.yaml#/definitions/uint32
    description: pin of port C controlling mdio data

  fsl,mdc-pin:
    $ref: /schemas/types.yaml#/definitions/uint32
    description: pin of port C controlling mdio clock

required:
  - compatible
  - reg

allOf:
  - $ref: mdio.yaml#

unevaluatedProperties: false

examples:
  - |
    mdio@10d40 {
        compatible = "fsl,mpc8272ads-mdio-bitbang",
                     "fsl,mpc8272-mdio-bitbang",
                     "fsl,cpm2-mdio-bitbang";
        reg = <0x10d40 0x14>;
        #address-cells = <1>;
        #size-cells = <0>;
        fsl,mdio-pin = <12>;
        fsl,mdc-pin = <13>;
    };
```

## Documentation/devicetree/bindings/net/fsl,enetc-ierb.yaml
```yaml
# SPDX-License-Identifier: (GPL-2.0-only OR BSD-2-Clause)
%YAML 1.2
---
$id: http://devicetree.org/schemas/net/fsl,enetc-ierb.yaml#
$schema: http://devicetree.org/meta-schemas/core.yaml#

title: Integrated Endpoint Register Block

description:
  The fsl_enetc driver can probe on the Integrated Endpoint Register Block,
  which preconfigures the FIFO limits for the ENETC ports.

maintainers:
  - Frank Li <Frank.Li@nxp.com>
  - Vladimir Oltean <vladimir.oltean@nxp.com>
  - Wei Fang <wei.fang@nxp.com>
  - Claudiu Manoil <claudiu.manoil@nxp.com>

properties:
  compatible:
    enum:
      - fsl,ls1028a-enetc-ierb

  reg:
    maxItems: 1

required:
  - compatible
  - reg

additionalProperties: false

examples:
  - |
    endpoint-config@f0800000 {
        compatible = "fsl,ls1028a-enetc-ierb";
        reg = <0xf0800000 0x10000>;
    };
```

## Documentation/devicetree/bindings/net/fsl,enetc-mdio.yaml
```yaml
# SPDX-License-Identifier: (GPL-2.0-only OR BSD-2-Clause)
%YAML 1.2
---
$id: http://devicetree.org/schemas/net/fsl,enetc-mdio.yaml#
$schema: http://devicetree.org/meta-schemas/core.yaml#

title: ENETC external MDIO PCIe endpoint device

description:
  NETC provides an external master MDIO interface (EMDIO) for managing external
  devices (PHYs). EMDIO supports both Clause 22 and 45 protocols. And the EMDIO
  provides a means for different software modules to share a single set of MDIO
  signals to access their PHYs.

maintainers:
  - Frank Li <Frank.Li@nxp.com>
  - Vladimir Oltean <vladimir.oltean@nxp.com>
  - Wei Fang <wei.fang@nxp.com>
  - Claudiu Manoil <claudiu.manoil@nxp.com>

properties:
  compatible:
    oneOf:
      - items:
          - enum:
              - pci1957,ee01
          - const: fsl,enetc-mdio
      - items:
          - const: pci1131,ee00

  reg:
    maxItems: 1

required:
  - compatible
  - reg

allOf:
  - $ref: mdio.yaml
  - $ref: /schemas/pci/pci-device.yaml

unevaluatedProperties: false

examples:
  - |
    pcie{
        #address-cells = <3>;
        #size-cells = <2>;

        mdio@0,3 {
            compatible = "pci1957,ee01", "fsl,enetc-mdio";
            reg = <0x000300 0 0 0 0>;
            #address-cells = <1>;
            #size-cells = <0>;

            ethernet-phy@2 {
                reg = <0x2>;
            };
        };
    };
```

## Documentation/devicetree/bindings/net/fsl,enetc.yaml
```yaml
# SPDX-License-Identifier: (GPL-2.0-only OR BSD-2-Clause)
%YAML 1.2
---
$id: http://devicetree.org/schemas/net/fsl,enetc.yaml#
$schema: http://devicetree.org/meta-schemas/core.yaml#

title: The NIC functionality of NXP NETC

description:
  The NIC functionality in NETC is known as EtherNET Controller (ENETC). ENETC
  supports virtualization/isolation based on PCIe Single Root IO Virtualization
  (SR-IOV), advanced QoS with 8 traffic classes and 4 drop resilience levels,
  and a full range of TSN standards and NIC offload capabilities

maintainers:
  - Frank Li <Frank.Li@nxp.com>
  - Vladimir Oltean <vladimir.oltean@nxp.com>
  - Wei Fang <wei.fang@nxp.com>
  - Claudiu Manoil <claudiu.manoil@nxp.com>

properties:
  compatible:
    oneOf:
      - items:
          - enum:
              - pci1957,e100
          - const: fsl,enetc
      - enum:
          - pci1131,e101

  reg:
    maxItems: 1

  clocks:
    items:
      - description: MAC transmit/receive reference clock

  clock-names:
    items:
      - const: ref

  mdio:
    $ref: mdio.yaml
    unevaluatedProperties: false
    description: Optional child node for ENETC instance, otherwise use NETC EMDIO.

required:
  - compatible
  - reg

allOf:
  - $ref: /schemas/pci/pci-device.yaml
  - $ref: ethernet-controller.yaml
  - if:
      not:
        properties:
          compatible:
            contains:
              enum:
                - pci1131,e101
    then:
      properties:
        clocks: false
        clock-names: false

unevaluatedProperties: false

examples:
  - |
    pcie {
        #address-cells = <3>;
        #size-cells = <2>;

        ethernet@0,0 {
            compatible = "pci1957,e100", "fsl,enetc";
            reg = <0x000000 0 0 0 0>;
            phy-handle = <&sgmii_phy0>;
            phy-connection-type = "sgmii";

            mdio {
                #address-cells = <1>;
                #size-cells = <0>;
                phy@2 {
                    reg = <0x2>;
                };
            };
        };
    };
```
