## Documentation/devicetree/bindings/nvec/nvidia,nvec.txt
```
NVIDIA compliant embedded controller

Required properties:
- compatible : should be "nvidia,nvec".
- reg : the iomem of the i2c slave controller
- interrupts : the interrupt line of the i2c slave controller
- clock-frequency : the frequency of the i2c bus
- gpios : the gpio used for ec request
- slave-addr: the i2c address of the slave controller
- clocks : Must contain an entry for each entry in clock-names.
  See ../clocks/clock-bindings.txt for details.
- clock-names : Must include the following entries:
  Tegra20/Tegra30:
  - div-clk
  - fast-clk
  Tegra114:
  - div-clk
- resets : Must contain an entry for each entry in reset-names.
  See ../reset/reset.txt for details.
- reset-names : Must include the following entries:
  - i2c
```

## Documentation/devicetree/bindings/nvme/apple,nvme-ans.yaml
```yaml
# SPDX-License-Identifier: GPL-2.0 OR BSD-2-Clause
%YAML 1.2
---
$id: http://devicetree.org/schemas/nvme/apple,nvme-ans.yaml#
$schema: http://devicetree.org/meta-schemas/core.yaml#

title: Apple ANS NVM Express host controller

maintainers:
  - Sven Peter <sven@svenpeter.dev>

properties:
  compatible:
    items:
      - enum:
          - apple,t8103-nvme-ans2
          - apple,t6000-nvme-ans2
      - const: apple,nvme-ans2

  reg:
    items:
      - description: NVMe and NVMMU registers
      - description: ANS2 co-processor control registers

  reg-names:
    items:
      - const: nvme
      - const: ans

  resets:
    maxItems: 1

  power-domains:
    # two domains for t8103, three for t6000
    minItems: 2
    items:
      - description: power domain for the NVMe controller.
      - description: power domain for the first PCIe bus connecting the NVMe
          controller to the storage modules.
      - description: optional power domain for the second PCIe bus
          connecting the NVMe controller to the storage modules.

  power-domain-names:
    minItems: 2
    items:
      - const: ans
      - const: apcie0
      - const: apcie1

  mboxes:
    maxItems: 1
    description: Mailbox of the ANS2 co-processor

  interrupts:
    maxItems: 1

  apple,sart:
    maxItems: 1
    $ref: /schemas/types.yaml#/definitions/phandle
    description: |
      Reference to the SART address filter.

      The SART address filter is documented in iommu/apple,sart.yaml.

if:
  properties:
    compatible:
      contains:
        const: apple,t8103-nvme-ans2
then:
  properties:
    power-domains:
      maxItems: 2
    power-domain-names:
      maxItems: 2
else:
  properties:
    power-domains:
      minItems: 3
    power-domain-names:
      minItems: 3

required:
  - compatible
  - reg
  - reg-names
  - resets
  - power-domains
  - power-domain-names
  - mboxes
  - interrupts
  - apple,sart

additionalProperties: false

examples:
  - |
    #include <dt-bindings/interrupt-controller/apple-aic.h>
    #include <dt-bindings/interrupt-controller/irq.h>

    nvme@7bcc0000 {
      compatible = "apple,t8103-nvme-ans2", "apple,nvme-ans2";
      reg = <0x7bcc0000 0x40000>, <0x77400000 0x4000>;
      reg-names = "nvme", "ans";
      interrupts = <AIC_IRQ 590 IRQ_TYPE_LEVEL_HIGH>;
      mboxes = <&ans>;
      apple,sart = <&sart>;
      power-domains = <&ps_ans2>, <&ps_apcie_st>;
      power-domain-names = "ans", "apcie0";
      resets = <&ps_ans2>;
    };
```

## Documentation/devicetree/bindings/nvmem/airoha,an8855-efuse.yaml
```yaml
# SPDX-License-Identifier: (GPL-2.0 OR BSD-2-Clause)
%YAML 1.2
---
$id: http://devicetree.org/schemas/nvmem/airoha,an8855-efuse.yaml#
$schema: http://devicetree.org/meta-schemas/core.yaml#

title: Airoha AN8855 Switch EFUSE

maintainers:
  - Christian Marangi <ansuelsmth@gmail.com>

description:
  Airoha AN8855 EFUSE used to calibrate internal PHYs and store additional
  configuration info.

$ref: nvmem.yaml#

properties:
  compatible:
    const: airoha,an8855-efuse

  '#nvmem-cell-cells':
    const: 0

required:
  - compatible
  - '#nvmem-cell-cells'

unevaluatedProperties: false

examples:
  - |
    efuse {
        compatible = "airoha,an8855-efuse";

        #nvmem-cell-cells = <0>;

        nvmem-layout {
            compatible = "fixed-layout";
            #address-cells = <1>;
            #size-cells = <1>;

            shift_sel_port0_tx_a: shift-sel-port0-tx-a@c {
               reg = <0xc 0x4>;
            };

            shift_sel_port0_tx_b: shift-sel-port0-tx-b@10 {
                reg = <0x10 0x4>;
            };

            shift_sel_port0_tx_c: shift-sel-port0-tx-c@14 {
                reg = <0x14 0x4>;
            };

            shift_sel_port0_tx_d: shift-sel-port0-tx-d@18 {
               reg = <0x18 0x4>;
            };

            shift_sel_port1_tx_a: shift-sel-port1-tx-a@1c {
               reg = <0x1c 0x4>;
            };

            shift_sel_port1_tx_b: shift-sel-port1-tx-b@20 {
               reg = <0x20 0x4>;
            };

            shift_sel_port1_tx_c: shift-sel-port1-tx-c@24 {
               reg = <0x24 0x4>;
            };

            shift_sel_port1_tx_d: shift-sel-port1-tx-d@28 {
               reg = <0x28 0x4>;
            };

            shift_sel_port2_tx_a: shift-sel-port2-tx-a@2c {
                reg = <0x2c 0x4>;
            };

            shift_sel_port2_tx_b: shift-sel-port2-tx-b@30 {
                reg = <0x30 0x4>;
            };

            shift_sel_port2_tx_c: shift-sel-port2-tx-c@34 {
                reg = <0x34 0x4>;
            };

            shift_sel_port2_tx_d: shift-sel-port2-tx-d@38 {
                reg = <0x38 0x4>;
            };

            shift_sel_port3_tx_a: shift-sel-port3-tx-a@4c {
                reg = <0x4c 0x4>;
            };

            shift_sel_port3_tx_b: shift-sel-port3-tx-b@50 {
                reg = <0x50 0x4>;
            };

            shift_sel_port3_tx_c: shift-sel-port3-tx-c@54 {
               reg = <0x54 0x4>;
            };

            shift_sel_port3_tx_d: shift-sel-port3-tx-d@58 {
               reg = <0x58 0x4>;
            };

            shift_sel_port4_tx_a: shift-sel-port4-tx-a@5c {
                reg = <0x5c 0x4>;
            };

            shift_sel_port4_tx_b: shift-sel-port4-tx-b@60 {
                reg = <0x60 0x4>;
            };

            shift_sel_port4_tx_c: shift-sel-port4-tx-c@64 {
                reg = <0x64 0x4>;
            };

            shift_sel_port4_tx_d: shift-sel-port4-tx-d@68 {
                reg = <0x68 0x4>;
            };
        };
    };
```
