## Documentation/devicetree/bindings/net/wireless/silabs,wfx.yaml
```yaml
# SPDX-License-Identifier: (GPL-2.0-only OR BSD-2-Clause)
# Copyright (c) 2020, Silicon Laboratories, Inc.
%YAML 1.2
---
$id: http://devicetree.org/schemas/net/wireless/silabs,wfx.yaml#
$schema: http://devicetree.org/meta-schemas/core.yaml#

title: Silicon Labs WFxxx

maintainers:
  - Jérôme Pouiller <jerome.pouiller@silabs.com>

description: >
  Support for the Wifi chip WFxxx from Silicon Labs. Currently, the only device
  from the WFxxx series is the WF200 described here:
     https://www.silabs.com/documents/public/data-sheets/wf200-datasheet.pdf

  The WF200 can be connected via SPI or via SDIO.

  For SDIO:

    Declaring the WFxxx chip in device tree is mandatory (usually, the VID/PID is
    sufficient for the SDIO devices).

    It is recommended to declare a mmc-pwrseq on SDIO host above WFx. Without
    it, you may encounter issues during reboot. The mmc-pwrseq should be
    compatible with mmc-pwrseq-simple. Please consult
    Documentation/devicetree/bindings/mmc/mmc-pwrseq-simple.yaml for more
    information.

properties:
  compatible:
    items:
      - enum:
          - prt,prtt1c-wfm200 # Protonic PRTT1C Board
          - silabs,brd4001a # WGM160P Evaluation Board
          - silabs,brd8022a # WF200 Evaluation Board
          - silabs,brd8023a # WFM200 Evaluation Board
      - const: silabs,wf200 # Chip alone without antenna

  reg:
    description:
      When used on SDIO bus, <reg> must be set to 1. When used on SPI bus, it is
      the chip select address of the device as defined in the SPI devices
      bindings.
    maxItems: 1

  interrupts:
    description: The interrupt line. Should be IRQ_TYPE_EDGE_RISING. When SPI is
      used, this property is required. When SDIO is used, the "in-band"
      interrupt provided by the SDIO bus is used unless an interrupt is defined
      in the Device Tree.
    maxItems: 1

  reset-gpios:
    description: (SPI only) Phandle of gpio that will be used to reset chip
      during probe. Without this property, you may encounter issues with warm
      boot.

      For SDIO, the reset gpio should declared using a mmc-pwrseq.
    maxItems: 1

  wakeup-gpios:
    description: Phandle of gpio that will be used to wake-up chip. Without this
      property, driver will disable most of power saving features.
    maxItems: 1

  silabs,antenna-config-file:
    $ref: /schemas/types.yaml#/definitions/string
    description: Use an alternative file for antenna configuration (aka
      "Platform Data Set" in Silabs jargon). Default depends of "compatible"
      string. For "silabs,wf200", the default is 'wf200.pds'.

  local-mac-address: true

  mac-address: true

required:
  - compatible
  - reg

allOf:
  - $ref: /schemas/spi/spi-peripheral-props.yaml#

unevaluatedProperties: false

examples:
  - |
    #include <dt-bindings/gpio/gpio.h>
    #include <dt-bindings/interrupt-controller/irq.h>

    spi {
        #address-cells = <1>;
        #size-cells = <0>;

        wifi@0 {
            compatible = "silabs,brd8022a", "silabs,wf200";
            pinctrl-names = "default";
            pinctrl-0 = <&wfx_irq &wfx_gpios>;
            reg = <0>;
            interrupts-extended = <&gpio 16 IRQ_TYPE_EDGE_RISING>;
            wakeup-gpios = <&gpio 12 GPIO_ACTIVE_HIGH>;
            reset-gpios = <&gpio 13 GPIO_ACTIVE_LOW>;
            spi-max-frequency = <42000000>;
        };
    };

  - |
    #include <dt-bindings/gpio/gpio.h>
    #include <dt-bindings/interrupt-controller/irq.h>

    wfx_pwrseq: wfx_pwrseq {
        compatible = "mmc-pwrseq-simple";
        pinctrl-names = "default";
        pinctrl-0 = <&wfx_reset>;
        reset-gpios = <&gpio 13 GPIO_ACTIVE_LOW>;
    };

    mmc {
        mmc-pwrseq = <&wfx_pwrseq>;
        #address-cells = <1>;
        #size-cells = <0>;

        wifi@1 {
            compatible = "silabs,brd8022a", "silabs,wf200";
            pinctrl-names = "default";
            pinctrl-0 = <&wfx_wakeup>;
            reg = <1>;
            wakeup-gpios = <&gpio 12 GPIO_ACTIVE_HIGH>;
        };
    };
...
```

## Documentation/devicetree/bindings/net/wireless/st,stlc4560.yaml
```yaml
# SPDX-License-Identifier: (GPL-2.0-only OR BSD-2-Clause)
%YAML 1.2
---
$id: http://devicetree.org/schemas/net/wireless/st,stlc4560.yaml#
$schema: http://devicetree.org/meta-schemas/core.yaml#

title: ST/Intersil/Conexant stlc45xx/p54spi/cx3110x SPI wireless device

maintainers:
  - Christian Lamparter <chunkeey@gmail.com>

description:
  The SPI variant of the Intersil Prism54 wireless device was sold
  under a variety of names, including Conexant CX3110x and
  ST Microelectronics STLC5460.

allOf:
  - $ref: ieee80211.yaml#
  - $ref: /schemas/spi/spi-peripheral-props.yaml#

properties:
  compatible:
    oneOf:
      - const: st,stlc4560
      - items:
          - enum:
              - cnxt,3110x
              - isil,p54spi
              - st,stlc4550
          - const: st,stlc4560

  reg:
    maxItems: 1

  interrupts:
    maxItems: 1

  powerdown-gpios:
    maxItems: 1

required:
  - compatible
  - reg
  - interrupts

unevaluatedProperties: false

examples:
  - |
    spi {
        #address-cells = <1>;
        #size-cells = <0>;

        wifi@0 {
            compatible = "st,stlc4560";
            reg = <0>;
            spi-max-frequency = <48000000>;
            interrupts-extended = <&gpio 23>;
            powerdown-gpios = <&gpio 1>;
        };
    };
```

## Documentation/devicetree/bindings/net/wireless/ti,wl1251.txt
```
* Texas Instruments wl1251 wireless lan controller

The wl1251 chip can be connected via SPI or via SDIO. This
document describes the binding for the SPI connected chip.

Required properties:
- compatible :        Should be "ti,wl1251"
- reg :               Chip select address of device
- spi-max-frequency : Maximum SPI clocking speed of device in Hz
- interrupts :        Should contain interrupt line
- vio-supply :        phandle to regulator providing VIO
- ti,power-gpio :     GPIO connected to chip's PMEN pin

Optional properties:
- ti,wl1251-has-eeprom : boolean, the wl1251 has an eeprom connected, which
                         provides configuration data (calibration, MAC, ...)
- Please consult Documentation/devicetree/bindings/spi/spi-bus.txt
  for optional SPI connection related properties,

Examples:

&spi1 {
	wl1251@0 {
		compatible = "ti,wl1251";

		reg = <0>;
		spi-max-frequency = <48000000>;
		spi-cpol;
		spi-cpha;

		interrupt-parent = <&gpio2>;
		interrupts = <10 IRQ_TYPE_NONE>; /* gpio line 42 */

		vio-supply = <&vio>;
		ti,power-gpio = <&gpio3 23 GPIO_ACTIVE_HIGH>; /* 87 */
	};
};
```

## Documentation/devicetree/bindings/net/wireless/ti,wlcore,spi.txt
```
* Texas Instruments wl12xx/wl18xx wireless lan controller

The wl12xx/wl18xx chips can be connected via SPI or via SDIO. This
document describes the binding for the SPI connected chip.

Required properties:
- compatible :          Should be one of the following:
    * "ti,wl1271"
    * "ti,wl1273"
    * "ti,wl1281"
    * "ti,wl1283"
    * "ti,wl1801"
    * "ti,wl1805"
    * "ti,wl1807"
    * "ti,wl1831"
    * "ti,wl1835"
    * "ti,wl1837"
- reg :                 Chip select address of device
- spi-max-frequency :   Maximum SPI clocking speed of device in Hz
- interrupt-parent, interrupts :
                        Should contain parameters for 1 interrupt line.
                        Interrupt parameters: parent, line number, type.
- vwlan-supply :        Point the node of the regulator that powers/enable the
                        wl12xx/wl18xx chip

Optional properties:
- ref-clock-frequency : Reference clock frequency (should be set for wl12xx)
- clock-xtal :          boolean, clock is generated from XTAL

- Please consult Documentation/devicetree/bindings/spi/spi-bus.txt
  for optional SPI connection related properties,

Examples:

For wl12xx family:
&spi1 {
	wlcore: wlcore@1 {
		compatible = "ti,wl1271";
		reg = <1>;
		spi-max-frequency = <48000000>;
		interrupt-parent = <&gpio3>;
		interrupts = <8 IRQ_TYPE_LEVEL_HIGH>;
		vwlan-supply = <&vwlan_fixed>;
		clock-xtal;
		ref-clock-frequency = <38400000>;
	};
};

For wl18xx family:
&spi0 {
	wlcore: wlcore@0 {
		compatible = "ti,wl1835";
		reg = <0>;
		spi-max-frequency = <48000000>;
		interrupt-parent = <&gpio0>;
		interrupts = <27 IRQ_TYPE_EDGE_RISING>;
		vwlan-supply = <&vwlan_fixed>;
	};
};
```

## Documentation/devicetree/bindings/net/wireless/ti,wlcore.txt
```
TI Wilink 6/7/8 (wl12xx/wl18xx) SDIO devices

This node provides properties for controlling the wilink wireless device. The
node is expected to be specified as a child node to the SDIO controller that
connects the device to the system.

Required properties:
 - compatible: should be one of the following:
    * "ti,wl1271"
    * "ti,wl1273"
    * "ti,wl1281"
    * "ti,wl1283"
    * "ti,wl1801"
    * "ti,wl1805"
    * "ti,wl1807"
    * "ti,wl1831"
    * "ti,wl1835"
    * "ti,wl1837"
 - interrupts : specifies attributes for the out-of-band interrupt.

Optional properties:
 - interrupt-parent : the phandle for the interrupt controller to which the
	device interrupts are connected.
 - ref-clock-frequency : ref clock frequency in Hz
 - tcxo-clock-frequency : tcxo clock frequency in Hz

Note: the *-clock-frequency properties assume internal clocks. In case of external
clock, new bindings (for parsing the clock nodes) have to be added.

Example:

&mmc3 {
	status = "okay";
	vmmc-supply = <&wlan_en_reg>;
	bus-width = <4>;
	cap-power-off-card;
	keep-power-in-suspend;

	#address-cells = <1>;
	#size-cells = <0>;
	wlcore: wlcore@2 {
		compatible = "ti,wl1835";
		reg = <2>;
		interrupt-parent = <&gpio0>;
		interrupts = <19 IRQ_TYPE_LEVEL_HIGH>;
	};
};
```

## Documentation/devicetree/bindings/net/wireless/ti,wlcore.yaml
```yaml
# SPDX-License-Identifier: (GPL-2.0-only OR BSD-2-Clause)
%YAML 1.2
---
$id: http://devicetree.org/schemas/net/wireless/ti,wlcore.yaml#
$schema: http://devicetree.org/meta-schemas/core.yaml#

title: Texas Instruments Wilink 6/7/8 (wl12xx/wl18xx) Wireless LAN Controller

maintainers:
  - Tony Lindgren <tony@atomide.com>

description:
  The wl12xx/wl18xx chips can be connected via SPI or via SDIO.
  Note that the *-clock-frequency properties assume internal clocks.  In case
  of external clocks, new bindings (for parsing the clock nodes) have to be
  added.

properties:
  compatible:
    enum:
      - ti,wl1271
      - ti,wl1273
      - ti,wl1281
      - ti,wl1283
      - ti,wl1285
      - ti,wl1801
      - ti,wl1805
      - ti,wl1807
      - ti,wl1831
      - ti,wl1835
      - ti,wl1837

  reg:
    maxItems: 1
    description:
      This is required when connected via SPI, and optional when connected via
      SDIO.

  spi-max-frequency: true

  interrupts:
    minItems: 1
    maxItems: 2

  interrupt-names:
    items:
      - const: irq
      - const: wakeup

  vwlan-supply:
    description:
      Points to the node of the regulator that powers/enable the wl12xx/wl18xx
      chip.  This is required when connected via SPI.


  ref-clock-frequency:
    $ref: /schemas/types.yaml#/definitions/uint32
    description: Reference clock frequency.

  tcxo-clock-frequency:
    $ref: /schemas/types.yaml#/definitions/uint32
    description: TCXO clock frequency.

  clock-xtal:
    $ref: /schemas/types.yaml#/definitions/flag
    description: Indicates that the clock is generated from XTAL.

required:
  - compatible
  - interrupts

if:
  properties:
    compatible:
      contains:
        enum:
          - ti,wl1271
          - ti,wl1273
          - ti,wl1281
          - ti,wl1283
then:
  required:
    - ref-clock-frequency

additionalProperties: false

examples:
  - |
    #include <dt-bindings/interrupt-controller/irq.h>

    // For wl12xx family:
    spi1 {
            #address-cells = <1>;
            #size-cells = <0>;

            wlcore1: wlcore@1 {
                    compatible = "ti,wl1271";
                    reg = <1>;
                    spi-max-frequency = <48000000>;
                    interrupts = <8 IRQ_TYPE_LEVEL_HIGH>;
                    vwlan-supply = <&vwlan_fixed>;
                    clock-xtal;
                    ref-clock-frequency = <38400000>;
            };
    };

    // For wl18xx family:
    spi2 {
            #address-cells = <1>;
            #size-cells = <0>;

            wlcore2: wlcore@0 {
                    compatible = "ti,wl1835";
                    reg = <0>;
                    spi-max-frequency = <48000000>;
                    interrupts = <27 IRQ_TYPE_EDGE_RISING>;
                    vwlan-supply = <&vwlan_fixed>;
            };
    };

    // SDIO example:
    mmc3 {
            vmmc-supply = <&wlan_en_reg>;
            bus-width = <4>;
            cap-power-off-card;
            keep-power-in-suspend;

            #address-cells = <1>;
            #size-cells = <0>;

            wlcore3: wlcore@2 {
                    compatible = "ti,wl1835";
                    reg = <2>;
                    interrupts = <19 IRQ_TYPE_LEVEL_HIGH>;
            };
    };
```

## Documentation/devicetree/bindings/net/wireless/wireless-controller.yaml
```yaml
# SPDX-License-Identifier: (GPL-2.0-only OR BSD-2-Clause)
%YAML 1.2
---
$id: http://devicetree.org/schemas/net/wireless/wireless-controller.yaml#
$schema: http://devicetree.org/meta-schemas/core.yaml#

title: Wireless Controller Common Properties

maintainers:
  - Lorenzo Bianconi <lorenzo@kernel.org>

properties:
  $nodename:
    pattern: "^wifi(@.*)?$"

allOf:
  - $ref: ieee80211.yaml#
  - $ref: /schemas/net/network-class.yaml#

additionalProperties: true

...
```

## Documentation/devicetree/bindings/net/wiznet,w5x00.txt
```
* Wiznet w5x00

This is a standalone 10/100 MBit Ethernet controller with SPI interface.

For each device connected to a SPI bus, define a child node within
the SPI master node.

Required properties:
- compatible: Should be one of the following strings:
	      "wiznet,w5100"
	      "wiznet,w5200"
	      "wiznet,w5500"
- reg: Specify the SPI chip select the chip is wired to.
- interrupts: Specify the interrupt index within the interrupt controller (referred
              to above in interrupt-parent) and interrupt type. w5x00 natively
              generates falling edge interrupts, however, additional board logic
              might invert the signal.
- pinctrl-names: List of assigned state names, see pinctrl binding documentation.
- pinctrl-0: List of phandles to configure the GPIO pin used as interrupt line,
             see also generic and your platform specific pinctrl binding
             documentation.

Optional properties:
- spi-max-frequency: Maximum frequency of the SPI bus when accessing the w5500.
  According to the w5500 datasheet, the chip allows a maximum of 80 MHz, however,
  board designs may need to limit this value.
- local-mac-address: See ethernet.txt in the same directory.


Example (for Raspberry Pi with pin control stuff for GPIO irq):

&spi {
	ethernet@0: w5500@0 {
		compatible = "wiznet,w5500";
		reg = <0>;
		pinctrl-names = "default";
		pinctrl-0 = <&eth1_pins>;
		interrupt-parent = <&gpio>;
		interrupts = <25 IRQ_TYPE_EDGE_FALLING>;
		spi-max-frequency = <30000000>;
	};
};

&gpio {
	eth1_pins: eth1_pins {
		brcm,pins = <25>;
		brcm,function = <0>; /* in */
		brcm,pull = <0>; /* none */
	};
};
```
