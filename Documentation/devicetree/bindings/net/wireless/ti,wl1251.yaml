## Documentation/devicetree/bindings/pinctrl/ambarella,cv75-pinctrl.yaml
```yaml
# SPDX-License-Identifier: GPL-2.0-only OR BSD-2-Clause
%YAML 1.2
---
$id: http://devicetree.org/schemas/pinctrl/ambarella,cv75-pinctrl.yaml#
$schema: http://devicetree.org/meta-schemas/core.yaml#

title: Ambarella CV75 Pin Controller

maintainers:
  - Long Zhao <longzhao@ambarella.com>

description:
  The Ambarella CV75 pin controller configures pin multiplexing, bias and
  drive strength for the main GPIO banks. Pin groups and their mux settings
  are defined by the pin controller driver and selected by function and group
  names.

allOf:
  - $ref: pinctrl.yaml#

properties:
  compatible:
    const: ambarella,cv75-pinctrl

  reg:
    maxItems: 1
    description: IOMUX registers

  ambarella,drive-strength-syscon:
    $ref: /schemas/types.yaml#/definitions/phandle
    description: RCT syscon containing the drive-strength registers.

  ambarella,pull-syscon:
    $ref: /schemas/types.yaml#/definitions/phandle
    description: Secure scratchpad syscon containing the pull registers.

patternProperties:
  "^[a-z0-9-]+-pins$":
    type: object
    allOf:
      - $ref: pinmux-node.yaml#
      - $ref: pincfg-node.yaml#
    additionalProperties: false

    properties:
      function:
        enum:
          - can0
          - can1
          - dmic0
          - enet0
          - hsync0
          - hsync1
          - i2c0
          - i2c1
          - i2c2
          - i2c3
          - i2cs
          - i2s0
          - i2s1
          - ir
          - pwm0
          - pwm1
          - pwm2
          - pwm3
          - pwm4
          - pwm5
          - pwm6
          - pwm7
          - pwm8
          - pwm9
          - pwm10
          - pwm11
          - sdmmc0
          - sdmmc1
          - snand
          - spi0
          - spi1
          - spi2
          - spi3
          - spi_slave
          - spinor
          - uart0
          - uart1
          - uart2
          - uart3
          - uart4
          - vin_master_sync
          - vsync0
          - vsync1
          - vsync2
          - vsync3
          - wdt

      groups:
        items:
          enum:
            - can0
            - can1
            - dmic0
            - enet_2nd_ref_clk_a
            - enet_2nd_ref_clk_b
            - enet_ext_osc_clk
            - enet0_ptp_pps_o
            - hsync0
            - hsync1
            - i2c0_a
            - i2c0_b
            - i2c1_a
            - i2c1_b
            - i2c2
            - i2c3_a
            - i2c3_b
            - i2c3_c
            - i2cs_a
            - i2cs_b
            - i2cs_c
            - i2cs_d
            - i2s0
            - i2s1
            - ir
            - pwm0
            - pwm1
            - pwm2
            - pwm3
            - pwm4_a
            - pwm4_b
            - pwm5_a
            - pwm5_b
            - pwm6_a
            - pwm6_b
            - pwm7_a
            - pwm7_b
            - pwm8_a
            - pwm8_b
            - pwm9_a
            - pwm9_b
            - pwm10_a
            - pwm10_b
            - pwm11_a
            - pwm11_b
            - rgmii0
            - rmii0
            - sdmmc0_1bit
            - sdmmc0_4bit
            - sdmmc0_cd
            - sdmmc0_hs_sel
            - sdmmc0_reset
            - sdmmc0_wp
            - sdmmc1_1bit
            - sdmmc1_4bit
            - sdmmc1_cd
            - sdmmc1_hs_sel
            - sdmmc1_reset
            - sdmmc1_wp
            - snand
            - spi0
            - spi1
            - spi2
            - spi3_a
            - spi3_b
            - spi3_c
            - spi_slave_a
            - spi_slave_b
            - spi_slave_c
            - spi_slave_d
            - spi_slave_e
            - spinor
            - uart0
            - uart1
            - uart1_flow
            - uart2_a
            - uart2_b
            - uart2_c
            - uart2_flow_a
            - uart2_flow_b
            - uart3_a
            - uart3_b
            - uart3_flow_a
            - uart3_flow_b
            - uart4_a
            - uart4_b
            - uart4_flow_a
            - uart4_flow_b
            - vin_master_sync_a
            - vin_master_sync_b
            - vin_master_sync_c
            - vin_master_sync_d
            - vin_master_sync_e
            - vsync0
            - vsync1
            - vsync2
            - vsync3
            - wdt_a
            - wdt_b
            - wdt_c
            - wdt_d
            - wdt_e
            - wdt_f
        minItems: 1
        maxItems: 6
        uniqueItems: true

      bias-disable: true
      bias-pull-down: true
      bias-pull-up: true

      drive-strength:
        enum: [3, 4, 5, 6, 7, 8, 9, 12]

    required:
      - function
      - groups

required:
  - compatible
  - reg
  - ambarella,drive-strength-syscon
  - ambarella,pull-syscon

unevaluatedProperties: false

examples:
  - |
    pinctrl: pinctrl@e4010000 {
        compatible = "ambarella,cv75-pinctrl";
        reg = <0xe4010000 0x1000>;
        ambarella,drive-strength-syscon = <&rct>;
        ambarella,pull-syscon = <&scratchpad>;

        uart0-pins {
            function = "uart0";
            groups = "uart0";
            bias-disable;
            drive-strength = <8>;
        };
    };
```

## Documentation/devicetree/bindings/pinctrl/brcm,nsp-gpio.yaml
```yaml
# SPDX-License-Identifier: (GPL-2.0-only OR BSD-2-Clause)
%YAML 1.2
---
$id: http://devicetree.org/schemas/pinctrl/brcm,nsp-gpio.yaml#
$schema: http://devicetree.org/meta-schemas/core.yaml#

title: Broadcom Northstar Plus (NSP) GPIO/PINCONF Controller

maintainers:
  - Ray Jui <rjui@broadcom.com>
  - Scott Branden <sbranden@broadcom.com>

description: |
  The chipCommonA GPIO block also provides generic pin configuration for the
  pins it controls: bias, pull up/down, slew rate and drive strength. Pin
  configuration is described in '-pins' child nodes, referenced through the
  standard pinctrl-0/pinctrl-names properties. Child nodes named '*-hog' are
  treated as GPIO hogs.

properties:
  compatible:
    const: brcm,nsp-gpio-a

  reg:
    items:
      - description: GPIO base registers
      - description: IO control registers

  "#gpio-cells":
    const: 2
    description: |
      The first cell is the GPIO pin number (within the controller's pin
      space) and the second cell is used for the following:
      bit[0]: polarity (0 for active high and 1 for active low)

  gpio-controller: true

  ngpios:
    description: Number of GPIOs supported (58x25 supports 32 and 58x23 supports 24)
    maximum: 32

  interrupts:
    maxItems: 1

  "#interrupt-cells":
    const: 2

  interrupt-controller: true

  gpio-ranges: true

  gpio-line-names: true

required:
  - compatible
  - reg
  - "#gpio-cells"
  - gpio-controller
  - ngpios

dependencies:
  interrupt-controller: ['#interrupt-cells']

patternProperties:
  '-pins$':
    type: object
    $ref: pincfg-node.yaml#

    properties:
      pins:
        $ref: /schemas/types.yaml#/definitions/string-array
        items:
          pattern: '^gpio-'

      bias-disable: true
      bias-pull-up: true
      bias-pull-down: true

      drive-strength:
        $ref: /schemas/types.yaml#/definitions/uint32
        enum: [ 2, 4, 6, 8, 10, 12, 14, 16 ]

      slew-rate:
        description: 0 disables and 1 enables slew rate control
        enum: [ 0, 1 ]

    required:
      - pins

    additionalProperties: false

  '-hog(-[0-9]+)?$':
    type: object
    required:
      - gpio-hog

additionalProperties: false

examples:
  - |
    #include <dt-bindings/interrupt-controller/arm-gic.h>

    gpio@18000020 {
        compatible = "brcm,nsp-gpio-a";
        reg = <0x18000020 0x100>,
              <0x1803f1c4 0x1c>;
        #gpio-cells = <2>;
        gpio-controller;
        ngpios = <32>;
        gpio-ranges = <&pinctrl 0 0 31>;
        interrupt-controller;
        #interrupt-cells = <2>;
        interrupts = <GIC_SPI 85 IRQ_TYPE_LEVEL_HIGH>;

        pinctrl-names = "default";
        pinctrl-0 = <&led_pins>;

        led_pins: led-pins {
            pins = "gpio-1";
            bias-pull-up;
            drive-strength = <16>;
        };

        /* GPIO hog */
        pwr-hog {
            gpio-hog;
            gpios = <3 1>;
            output-high;
        };
    };
```

## Documentation/devicetree/bindings/pinctrl/econet,en7528-pinctrl.yaml
```yaml
# SPDX-License-Identifier: (GPL-2.0 OR BSD-2-Clause)
%YAML 1.2
---
$id: http://devicetree.org/schemas/pinctrl/econet,en7528-pinctrl.yaml#
$schema: http://devicetree.org/meta-schemas/core.yaml#

title: EcoNet EN7528 Pin Controller

maintainers:
  - Lorenzo Bianconi <lorenzo@kernel.org>

description:
  The EcoNet EN7528 pin controller is used to control SoC pins. It shares the
  IP with the Airoha pin controllers, but its IOMUX and pin configuration
  registers have a different layout.

properties:
  compatible:
    const: econet,en7528-pinctrl

  airoha,chip-scu:
    description: phandle to the chip SCU syscon
    $ref: /schemas/types.yaml#/definitions/phandle

  interrupts:
    maxItems: 1

  gpio-controller: true

  '#gpio-cells':
    const: 2

  gpio-ranges:
    maxItems: 1

  interrupt-controller: true

  '#interrupt-cells':
    const: 2

patternProperties:
  '-pins$':
    type: object

    patternProperties:
      '^mux(-|$)':
        type: object

        description:
          pinmux configuration nodes.

        $ref: /schemas/pinctrl/pinmux-node.yaml

        properties:
          function:
            description:
              A string containing the name of the function to mux to the group.
            enum: [gpio, jtag, pcie_reset, pcm, pcm_spi, phy1_led0,
                   phy1_led1, phy2_led0, phy2_led1, phy3_led0, phy3_led1,
                   phy4_led0, phy4_led1, pnand, pon, pwm, sipo, spi, uart]

          groups:
            description:
              An array of strings. Each string contains the name of a group.
            items:
              enum: [pon, sipo, sipo_rclk, uart2, uart2_cts_rts, uart3,
                     ejtag, pcm1, pcm2, spi_quad, spi_cs1, pcm_spi,
                     pcm_spi_int, pcm_spi_rst, pcm_spi_cs1, pcm_spi_cs2,
                     pcm_spi_cs3, pcm_spi_cs4, pcm_spi_cs5, pcm_spi_cs6,
                     pcm_spi_cs7, pnand, gpio0, gpio1, gpio2, gpio3, gpio4,
                     gpio5, gpio6, gpio7, gpio8, gpio9, gpio10, gpio11,
                     gpio12, gpio13, gpio14, gpio15, gpio16, gpio17,
                     gpio18, gpio19, gpio20, gpio21, gpio22, gpio23,
                     gpio24, gpio25, gpio26, gpio27, gpio28, gpio29,
                     gpio30, gpio31, gpio32, gpio33, gpio34, gpio35,
                     gpio36, gpio37, gpio38, gpio39, gpio40, gpio41,
                     pcie_reset0, pcie_reset1]

        required:
          - function
          - groups

        additionalProperties: false

      '^conf(-|$)':
        type: object

        description:
          pinconf configuration nodes.

        $ref: /schemas/pinctrl/pincfg-node.yaml

        properties:
          pins:
            description:
              An array of strings. Each string contains the name of a pin.
            items:
              enum: [gpio0, gpio1, gpio2, gpio3, gpio4, gpio5, gpio6,
                     gpio7, gpio8, gpio9, gpio10, gpio11, gpio12, gpio13,
                     gpio14, gpio15, gpio16, gpio17, gpio18, gpio19,
                     gpio20, gpio21, gpio22, gpio23, gpio24, gpio25,
                     gpio26, gpio27, gpio28, gpio29, gpio30, gpio31,
                     gpio32, gpio33, gpio34, gpio35, gpio36, gpio37,
                     gpio38, gpio39, pcie_reset0, pcie_reset1, i2c_sda,
                     i2c_scl, uart_txd, uart_rxd, spi_cs0, spi_clk,
                     spi_mosi, spi_miso]
            minItems: 1
            maxItems: 50

          bias-disable: true

          bias-pull-up: true

          bias-pull-down: true

          input-enable: true

          output-enable: true

          output-low: true

          output-high: true

          drive-strength:
            description:
              Selects the drive strength for the pin, in mA.
            enum: [2, 4]

        required:
          - pins

        additionalProperties: false

    additionalProperties: false

required:
  - compatible
  - airoha,chip-scu
  - interrupts
  - gpio-controller
  - gpio-ranges
  - "#gpio-cells"
  - interrupt-controller
  - "#interrupt-cells"

allOf:
  - $ref: pinctrl.yaml#

additionalProperties: false

examples:
  - |
    #include <dt-bindings/interrupt-controller/mips-gic.h>
    #include <dt-bindings/interrupt-controller/irq.h>

    pinctrl {
      compatible = "econet,en7528-pinctrl";

      airoha,chip-scu = <&chip_scu>;

      interrupt-parent = <&gic>;
      interrupts = <GIC_SHARED 10 IRQ_TYPE_LEVEL_HIGH>;

      gpio-controller;
      #gpio-cells = <2>;

      interrupt-controller;
      #interrupt-cells = <2>;

      gpio-ranges = <&pinctrl 0 0 42>;

      uart2-pins {
        mux {
          function = "uart";
          groups = "uart2";
        };

        conf {
          pins = "gpio28", "gpio29";
          bias-pull-up;
        };
      };

      pwm-pins {
        mux {
          function = "pwm";
          groups = "gpio30";
        };
      };
    };
```
