## Documentation/devicetree/bindings/pinctrl/mediatek,mt6858-pinctrl.yaml
```yaml
# SPDX-License-Identifier: (GPL-2.0-only OR BSD-2-Clause)
%YAML 1.2
---
$id: http://devicetree.org/schemas/pinctrl/mediatek,mt6858-pinctrl.yaml#
$schema: http://devicetree.org/meta-schemas/core.yaml#

title: MediaTek MT6858 Pin Controller

maintainers:
  - Nikolai Burov <nikolai.burov@jolla.com>

description:
  The MediaTek's MT6858 Pin controller is used to control SoC pins.

properties:
  compatible:
    const: mediatek,mt6858-pinctrl

  reg:
    items:
      - description: gpio base
      - description: lm group IO
      - description: rb group IO
      - description: bm2 group IO
      - description: bm group IO
      - description: bm1 group IO
      - description: lt group IO
      - description: lt1 group IO
      - description: rt group IO
      - description: rt1 group IO
      - description: eint south group IO
      - description: eint west group IO
      - description: eint east group IO
      - description: eint center group IO

  reg-names:
    items:
      - const: base
      - const: lm
      - const: rb
      - const: bm2
      - const: bm
      - const: bm1
      - const: lt
      - const: lt1
      - const: rt
      - const: rt1
      - const: eint0
      - const: eint1
      - const: eint2
      - const: eint3

  interrupts:
    maxItems: 1

  interrupt-controller: true

  '#interrupt-cells':
    const: 2

  gpio-controller: true

  '#gpio-cells':
    const: 2

  gpio-ranges:
    maxItems: 1

  gpio-line-names: true

# PIN CONFIGURATION NODES
patternProperties:
  '-pins$':
    type: object
    additionalProperties: false

    patternProperties:
      '^pins':
        type: object
        $ref: /schemas/pinctrl/pincfg-node.yaml
        additionalProperties: false
        description:
          A pinctrl node should contain at least one subnodes representing the
          pinctrl groups available on the machine. Each subnode will list the
          pins it needs, and how they should be configured, with regard to muxer
          configuration, pullups, drive strength, input enable/disable and input
          schmitt.

        properties:
          pinmux:
            description:
              Integer array, represents gpio pin number and mux setting.
              Supported pin number and mux varies for different SoCs, and are
              defined as macros in arch/arm64/boot/dts/mediatek/mt6858-pinfunc.h
              for this SoC.

          drive-strength:
            enum: [2, 4, 6, 8, 10, 12, 14, 16]

          bias-pull-down:
            oneOf:
              - type: boolean
                description: normal pull down.
              - enum: [100, 101, 102, 103]
                description: PUPD/R1/R0 pull down type. See MTK_PUPD_SET_R1R0_
                  defines in dt-bindings/pinctrl/mt65xx.h.
              - enum: [200, 201, 202, 203]
                description: RSEL pull down type. See MTK_PULL_SET_RSEL_ defines
                  in dt-bindings/pinctrl/mt65xx.h.

          bias-pull-up:
            oneOf:
              - type: boolean
                description: normal pull up.
              - enum: [100, 101, 102, 103]
                description: PUPD/R1/R0 pull up type. See MTK_PUPD_SET_R1R0_
                  defines in dt-bindings/pinctrl/mt65xx.h.
              - enum: [200, 201, 202, 203]
                description: RSEL pull up type. See MTK_PULL_SET_RSEL_ defines
                  in dt-bindings/pinctrl/mt65xx.h.

          bias-disable: true

          output-high: true

          output-low: true

          input-enable: true

          input-disable: true

          input-schmitt-enable: true

          input-schmitt-disable: true

        required:
          - pinmux

required:
  - compatible
  - reg
  - interrupts
  - interrupt-controller
  - '#interrupt-cells'
  - gpio-controller
  - '#gpio-cells'
  - gpio-ranges

additionalProperties: false

examples:
  - |
    #include <dt-bindings/pinctrl/mt65xx.h>
    #include <dt-bindings/interrupt-controller/arm-gic.h>
    #define PINMUX_GPIO149__FUNC_SCL5 (MTK_PIN_NO(149) | 1)
    #define PINMUX_GPIO150__FUNC_SDA5 (MTK_PIN_NO(150) | 1)

    pio: pinctrl@10005000 {
        compatible = "mediatek,mt6858-pinctrl";
        reg = <0x10005000 0x1000>,
              <0x11b20000 0x1000>,
              <0x11c10000 0x1000>,
              <0x11d10000 0x1000>,
              <0x11d30000 0x1000>,
              <0x11d40000 0x1000>,
              <0x11e20000 0x1000>,
              <0x11e30000 0x1000>,
              <0x11ed0000 0x1000>,
              <0x11ee0000 0x1000>,
              <0x11b00000 0x1000>,
              <0x11e60000 0x1000>,
              <0x11e80000 0x1000>,
              <0x1c01e000 0x1000>;
        reg-names = "base", "lm", "rb", "bm2", "bm", "bm1", "lt", "lt1",
                    "rt", "rt1", "eint0", "eint1", "eint2", "eint3";
        gpio-controller;
        #gpio-cells = <2>;
        gpio-ranges = <&pio 0 0 197>;
        interrupt-controller;
        interrupts = <GIC_SPI 239 IRQ_TYPE_LEVEL_HIGH 0>;
        #interrupt-cells = <2>;

        i2c5-pins {
            pins {
                pinmux = <PINMUX_GPIO149__FUNC_SCL5>,
                         <PINMUX_GPIO150__FUNC_SDA5>;
                bias-disable;
            };
        };
    };
```

## Documentation/devicetree/bindings/pinctrl/microchip,pic32mzda-pinctrl.yaml
```yaml
# SPDX-License-Identifier: (GPL-2.0-only OR BSD-2-Clause)
%YAML 1.2
---
$id: http://devicetree.org/schemas/pinctrl/microchip,pic32mzda-pinctrl.yaml#
$schema: http://devicetree.org/meta-schemas/core.yaml#

title: Microchip PIC32 Pin Controller

maintainers:
  - Linus Walleij <linusw@kernel.org>

description:
  PIC32 pin configuration node is a node of a group of pins which can be used
  for a specific device or function. This node represents configurations of
  pins, optional function, and optional mux related configuration.

properties:
  compatible:
    const: microchip,pic32mzda-pinctrl

  reg:
    maxItems: 1

  clocks:
    maxItems: 1

$defs:
  pin-node:
    type: object
    allOf:
      - $ref: /schemas/pinctrl/pincfg-node.yaml#
      - $ref: /schemas/pinctrl/pinmux-node.yaml#

    properties:
      pins:
        description: List of pins to which the configuration applies.
        items:
          type: string
        minItems: 1

      function: true

      bias-pull-up: true
      bias-pull-down: true
      input-enable: true
      output-low: true
      output-high: true

      microchip,digital:
        description: Enable digital I/O.
        type: boolean

      microchip,analog:
        description: Enable analog I/O.
        type: boolean

    required:
      - pins

    unevaluatedProperties: false

additionalProperties:
  oneOf:
    - additionalProperties:
        $ref: '#/$defs/pin-node'
    - $ref: '#/$defs/pin-node'

required:
  - compatible
  - reg
  - clocks

examples:
  - |
    #include <dt-bindings/clock/microchip,pic32-clock.h>
    #include <dt-bindings/interrupt-controller/irq.h>

    pic32_pinctrl: pinctrl@1f801400 {
        compatible = "microchip,pic32mzda-pinctrl";
        reg = <0x1f801400 0x400>;
        clocks = <&rootclk PB1CLK>;

        pinctrl_uart2: pinctrl_uart2 {
            uart2-tx {
                pins = "G9";
                function = "U2TX";
                microchip,digital;
                output-low;
            };

            uart2-rx {
                pins = "B0";
                function = "U2RX";
                microchip,digital;
                input-enable;
            };
        };
    };

    uart2: serial@1f822200 {
        compatible = "microchip,pic32mzda-uart";
        reg = <0x1f822200 0x50>;
        interrupts = <145 IRQ_TYPE_LEVEL_HIGH>,
                     <146 IRQ_TYPE_LEVEL_HIGH>,
                     <147 IRQ_TYPE_LEVEL_HIGH>;
        clocks = <&rootclk PB2CLK>;
        pinctrl-names = "default";
        pinctrl-0 = <&pinctrl_uart2>;
    };
```

## Documentation/devicetree/bindings/pinctrl/qcom,hawi-lpass-lpi-pinctrl.yaml
```yaml
# SPDX-License-Identifier: (GPL-2.0-only OR BSD-2-Clause)
%YAML 1.2
---
$id: http://devicetree.org/schemas/pinctrl/qcom,hawi-lpass-lpi-pinctrl.yaml#
$schema: http://devicetree.org/meta-schemas/core.yaml#

title: Qualcomm Hawi SoC LPASS LPI TLMM

maintainers:
  - Krzysztof Kozlowski <krzk@kernel.org>
  - Srinivas Kandagatla <srinivas.kandagatla@oss.qualcomm.com>
  - Prasad Kumpatla <prasad.kumpatla@oss.qualcomm.com>

description:
  Top Level Mode Multiplexer pin controller in the Low Power Audio SubSystem
  (LPASS) Low Power Island (LPI) of Qualcomm Hawi SoC.

properties:
  compatible:
    const: qcom,hawi-lpass-lpi-pinctrl

  reg:
    items:
      - description: LPASS LPI TLMM Control and Status registers

  clocks:
    items:
      - description: LPASS LPR(Low Power Resource) voting clock
      - description: LPASS Audio voting clock

  clock-names:
    items:
      - const: lpr
      - const: audio

patternProperties:
  "-state$":
    oneOf:
      - $ref: "#/$defs/qcom-hawi-lpass-state"
      - patternProperties:
          "-pins$":
            $ref: "#/$defs/qcom-hawi-lpass-state"
        additionalProperties: false

$defs:
  qcom-hawi-lpass-state:
    type: object
    description:
      Pinctrl node's client devices use subnodes for desired pin configuration.
      Client device subnodes use below standard properties.
    $ref: qcom,lpass-lpi-common.yaml#/$defs/qcom-tlmm-state
    unevaluatedProperties: false

    properties:
      pins:
        description:
          List of gpio pins affected by the properties specified in this
          subnode.
        items:
          pattern: "^gpio([0-9]|1[0-9]|2[0-2])$"

      function:
        enum: [dmic1_clk, dmic1_data, dmic2_clk, dmic2_data, dmic3_clk,
               dmic3_data, dmic4_clk, dmic4_data, ext_mclk1_a, ext_mclk1_b,
               ext_mclk1_c, ext_mclk1_d, ext_mclk1_e, gpio, i2s0_clk,
               i2s0_data, i2s0_ws, i2s1_clk, i2s1_data, i2s1_ws, i2s2_clk,
               i2s2_data, i2s2_ws, i2s3_clk, i2s3_data, i2s3_ws,
               lpass_lpi_dbg_clk, qca_swr_clk, qca_swr_data, slimbus_clk,
               slimbus_data, swr_rx_clk, swr_rx_data, swr_tx_clk, swr_tx_clk1,
               swr_tx_data, va_i2s0_clk, va_i2s0_data, va_i2s0_ws,
               wsa2_swr_clk, wsa2_swr_data, wsa_swr_clk, wsa_swr_data]
        description:
          Specify the alternative function to be configured for the specified
          pins.

allOf:
  - $ref: qcom,lpass-lpi-common.yaml#

required:
  - compatible
  - reg
  - clocks
  - clock-names

unevaluatedProperties: false

examples:
  - |
    #include <dt-bindings/sound/qcom,q6dsp-lpass-ports.h>

    lpass_tlmm: pinctrl@7f60000 {
        compatible = "qcom,hawi-lpass-lpi-pinctrl";
        reg = <0x07f60000 0x20000>;

        clocks = <&q6prmcc LPASS_HW_LPR_VOTE LPASS_CLK_ATTRIBUTE_COUPLE_NO>,
                 <&q6prmcc LPASS_HW_DCODEC_VOTE LPASS_CLK_ATTRIBUTE_COUPLE_NO>;
        clock-names = "lpr", "audio";

        gpio-controller;
        #gpio-cells = <2>;
        gpio-ranges = <&lpass_tlmm 0 0 23>;

        tx-swr-sleep-clk-state {
            pins = "gpio0";
            function = "swr_tx_clk";
            drive-strength = <2>;
            bias-pull-down;
        };
    };
```

## Documentation/devicetree/bindings/pinctrl/qcom,kuno-tlmm.yaml
```yaml
# SPDX-License-Identifier: (GPL-2.0-only OR BSD-2-Clause)
%YAML 1.2
---
$id: http://devicetree.org/schemas/pinctrl/qcom,kuno-tlmm.yaml#
$schema: http://devicetree.org/meta-schemas/core.yaml#

title: Qualcomm Technologies, Inc. Kuno TLMM block

maintainers:
  - Hardeep Sharma <hardeep.sharma@oss.qualcomm.com>

description:
  Top Level Mode Multiplexer pin controller in Qualcomm Kuno SoC.

allOf:
  - $ref: /schemas/pinctrl/qcom,tlmm-common.yaml#

properties:
  compatible:
    const: qcom,kuno-tlmm

  reg:
    maxItems: 1

  interrupts:
    maxItems: 1

  gpio-reserved-ranges:
    minItems: 1
    maxItems: 55

  gpio-line-names:
    maxItems: 110

patternProperties:
  "-state$":
    oneOf:
      - $ref: "#/$defs/qcom-kuno-tlmm-state"
      - patternProperties:
          "-pins$":
            $ref: "#/$defs/qcom-kuno-tlmm-state"
        additionalProperties: false

$defs:
  qcom-kuno-tlmm-state:
    type: object
    description:
      Pinctrl node's client devices use subnodes for desired pin configuration.
      Client device subnodes use below standard properties.
    $ref: qcom,tlmm-common.yaml#/$defs/qcom-tlmm-state
    unevaluatedProperties: false

    properties:
      pins:
        description:
          List of gpio pins affected by the properties specified in this
          subnode.
        items:
          pattern: "^gpio([0-9]|[1-9][0-9]|10[0-9])$"
        minItems: 1
        maxItems: 36

      function:
        description:
          Specify the alternative function to be configured for the specified
          pins.
        enum: [ gpio, audio_ref_clk, coex_uart, ebi2_lcd_a,
                ebi2_lcd_cs, ebi2_lcd_reset, ebi2_lcd_te, emac_mdc, emac_mdio,
                emac_pps_in, emac_ptp_aux, emac_ptp_pps, gcc_gp1_clk,
                gcc_gp2_clk, gcc_gp3_clk, mi2s0_data0, mi2s0_data1, mi2s0_sck,
                mi2s0_ws, mi2s1_data0, mi2s1_data1, mi2s1_sck, mi2s1_ws,
                mi2s_mclk, nav_gpio, pci_e_rst,
                pcie_clkreq_n, pll_bist_sync, pll_clk_aux, qdss_cti_trig0,
                qdss_cti_trig1, qdss_cti_trig1_mire, qdss_gpio_traceclk,
                qdss_gpio_tracectl,
                qup0_se0, qup0_se1, qup0_se2, qup0_se3_mira, qup0_se3_mirb,
                qup0_se4, sdc4_clk, sdc4_cmd,
                sdc4_data, sdc4_tb_trig, sgmii_phy_intr, spmi_coex_clk,
                spmi_coex_data, spmi_vgi_hwevent, uim1_clk, uim1_data,
                uim1_present, uim1_reset, usb2phy_ac_en ]

    required:
      - pins

required:
  - compatible
  - reg

unevaluatedProperties: false

examples:
  - |
    #include <dt-bindings/interrupt-controller/arm-gic.h>

    tlmm: pinctrl@f000000 {
        compatible = "qcom,kuno-tlmm";
        reg = <0x0f000000 0x400000>;
        interrupts = <GIC_SPI 212 IRQ_TYPE_LEVEL_HIGH>;
        gpio-controller;
        #gpio-cells = <2>;
        gpio-ranges = <&tlmm 0 0 110>;
        interrupt-controller;
        #interrupt-cells = <2>;

        spmi-state {
            pins = "gpio78", "gpio79";
            function = "spmi_vgi_hwevent";
        };
    };
...
```
