## Documentation/devicetree/bindings/phy/aspeed,ast2700-usb3-phy.yaml
```yaml
# SPDX-License-Identifier: (GPL-2.0-only OR BSD-2-Clause)
%YAML 1.2
---
$id: http://devicetree.org/schemas/phy/aspeed,ast2700-usb3-phy.yaml#
$schema: http://devicetree.org/meta-schemas/core.yaml#

title: ASPEED AST2700 USB 3.2 PHY

maintainers:
  - Ryan Chen <ryan_chen@aspeedtech.com>

properties:
  compatible:
    const: aspeed,ast2700-usb3-phy

  reg:
    maxItems: 1

  clocks:
    maxItems: 1

  resets:
    maxItems: 1

  '#phy-cells':
    const: 0

required:
  - compatible
  - reg
  - clocks
  - resets
  - '#phy-cells'

additionalProperties: false

examples:
  - |
    #include <dt-bindings/clock/aspeed,ast2700-scu.h>
    #include <dt-bindings/reset/aspeed,ast2700-scu.h>

    usb-phy@12010000 {
        compatible = "aspeed,ast2700-usb3-phy";
        reg = <0x12010000 0xc0>;
        clocks = <&syscon0 SCU0_CLK_GATE_PORTAUSB2CLK>;
        resets = <&syscon0 SCU0_RESET_PORTA_PHY3>;
        #phy-cells = <0>;
    };
```

## Documentation/devicetree/bindings/phy/mediatek,mt8195-dp-phy.yaml
```yaml
# SPDX-License-Identifier: (GPL-2.0-only OR BSD-2-Clause)
%YAML 1.2
---
$id: http://devicetree.org/schemas/phy/mediatek,mt8195-dp-phy.yaml#
$schema: http://devicetree.org/meta-schemas/core.yaml#

title: MediaTek SoC DisplayPort Transmitter PHY

maintainers:
  - AngeloGioacchino Del Regno <angelogioacchino.delregno@collabora.com>

properties:
  compatible:
    enum:
      - mediatek,mt8195-dp-phy
      - mediatek,mt8196-edp-phy

  reg:
    maxItems: 1

  "#phy-cells":
    const: 0

  nvmem-cells:
    description: PHY calibrations from eFuse for optimal EYE signal pattern
    items:
      - description: PHY-Global Reference Bias trim
      - description: PHY-Global AUX Transmitter clock impedance adjustment
      - description: Lane 0 Transmitter impedance selection (P-MOSFET)
      - description: Lane 0 Transmitter impedance selection (N-MOSFET)
      - description: Lane 1 Transmitter impedance selection (P-MOSFET)
      - description: Lane 1 Transmitter impedance selection (N-MOSFET)
      - description: Lane 2 Transmitter impedance selection (P-MOSFET)
      - description: Lane 2 Transmitter impedance selection (N-MOSFET)
      - description: Lane 3 Transmitter impedance selection (P-MOSFET)
      - description: Lane 3 Transmitter impedance selection (N-MOSFET)

  nvmem-cell-names:
    items:
      - const: rbias-trim
      - const: impedance-txclk
      - const: impedance-lane0p
      - const: impedance-lane0n
      - const: impedance-lane1p
      - const: impedance-lane1n
      - const: impedance-lane2p
      - const: impedance-lane2n
      - const: impedance-lane3p
      - const: impedance-lane3n

  power-domains:
    maxItems: 1

required:
  - compatible
  - reg
  - "#phy-cells"

additionalProperties: false

examples:
  - |
    phy@1c500000 {
        compatible = "mediatek,mt8195-dp-phy";
        reg = <0x1c500000 0x2000>;
        #phy-cells = <0>;
        nvmem-cells = <&edp_glb_bias_trim>, <&edp_clktx_impsel>,
                      <&edp_imp_ln0_pmos>, <&edp_imp_ln0_nmos>,
                      <&edp_imp_ln1_pmos>, <&edp_imp_ln1_nmos>,
                      <&edp_imp_ln2_pmos>, <&edp_imp_ln2_nmos>,
                      <&edp_imp_ln3_pmos>, <&edp_imp_ln3_nmos>;
        nvmem-cell-names = "rbias-trim", "impedance-txclk",
                           "impedance-lane0p", "impedance-lane0n",
                           "impedance-lane1p", "impedance-lane1n",
                           "impedance-lane2p", "impedance-lane2n",
                           "impedance-lane3p", "impedance-lane3n";
    };
```

## Documentation/devicetree/bindings/phy/mediatek,mt8196-pcie-sphy.yaml
```yaml
# SPDX-License-Identifier: (GPL-2.0 OR BSD-2-Clause)
%YAML 1.2
---
$id: http://devicetree.org/schemas/phy/mediatek,mt8196-pcie-sphy.yaml#
$schema: http://devicetree.org/meta-schemas/core.yaml#

title: MediaTek PCI-Express Gen4 S-PHY

maintainers:
  - AngeloGioacchino Del Regno <angelogioacchino.delregno@collabora.com>

description:
  The MediaTek PCI-Express Gen4 S-PHY is capable of data serialization
  and de-serialization with 8, 10, 128 or 130 bits (16GT/s) encoding
  and decoding, has analog buffers, elastic buffers and mechanisms for
  receiver detection.
  This PHY supports link rates of 2.5, 5.0, 8.0 and 16.0 GT/s per-lane
  in both Root Complex (RC) and End Point (EP) modes, depending on the
  chosen port.
  The Digital PHY (PHYD) part adheres to the Intel PIPE (PHY Interface
  for the PCIe) specification.

properties:
  compatible:
    const: mediatek,mt8196-pcie-sphy

  reg:
    items:
      - description: System Interface (SIF) registers
      - description: Clock Management (CKM) registers

  reg-names:
    items:
      - const: sif
      - const: ckm

  "#phy-cells":
    const: 0

  nvmem-cells:
    items:
      - description: Internal resistor selection of TX Bias Current
      - description: XTP Bias V2V voltage calibration
      - description: S-PLL CKTX Impedance Selection (P-MOSFET side)
      - description: S-PLL CKTX Impedance Selection (N-MOSFET side)
      - description: S-PLL CKTX Intermediate Transition Impedance
      - description: RX Front-End Return Loss Continuous Time Linear EQ
      - description: RX Front-End Return Loss Variable Gain Amplifier
      - description: RX Front-End Return Loss Decision Feedback EQ
      - description: RX Impedance Selection
      - description: TX Impedance Selection (P-MOSFET side)
      - description: TX Impedance Selection (N-MOSFET side)
      - description: TX Lane 0 Switch Resistance (RSWn)
      - description: TX Lane 1 Switch Resistance (RSWn)
      - description: eFuse calibration table version

  nvmem-cell-names:
    items:
      - const: int-r
      - const: xtp-vtrim
      - const: cktx-pmos
      - const: cktx-nmos
      - const: cktx-r-mid
      - const: rxfe-lanes-rl-ctle
      - const: rxfe-lanes-rl-vga
      - const: rxfe-lanes-rl-dfe
      - const: rx-lanes-imp
      - const: tx-lanes-pmos
      - const: tx-lanes-nmos
      - const: tx-ln0-rswn
      - const: tx-ln1-rswn
      - const: cal-version

  power-domains:
    maxItems: 1

required:
  - compatible
  - reg
  - reg-names
  - "#phy-cells"

additionalProperties: false

examples:
  - |
    phy@16900000 {
        compatible = "mediatek,mt8196-pcie-sphy";
        reg = <0x16900000 0x10000>, <0x16920000 0x10000>;
        reg-names = "sif", "ckm";
        power-domains = <&spm 10>;
        #phy-cells = <0>;
    };
```

## Documentation/devicetree/bindings/phy/nvidia,tegra264-mphy.yaml
```yaml
# SPDX-License-Identifier: GPL-2.0-only OR BSD-2-Clause
%YAML 1.2
---
$id: http://devicetree.org/schemas/phy/nvidia,tegra264-mphy.yaml#
$schema: http://devicetree.org/meta-schemas/core.yaml#

title: NVIDIA Tegra264 MIPI M-PHY

maintainers:
  - Kartik Rajput <kkartik@nvidia.com>
  - Thierry Reding <treding@nvidia.com>

properties:
  compatible:
    const: nvidia,tegra264-mphy

  reg:
    items:
      - description: Lane 0 register window
      - description: Lane 1 register window

  reg-names:
    items:
      - const: l0
      - const: l1

  clocks:
    maxItems: 11

  clock-names:
    items:
      - const: pll
      - const: tx-ref
      - const: l0-tx-sym
      - const: l0-tx-ls
      - const: l0-tx-hs
      - const: l0-tx-fifo
      - const: l0-rx-sym
      - const: l0-rx-ana
      - const: l0-rx-ls
      - const: l0-rx-hs
      - const: l1-rx-ana

  resets:
    maxItems: 5

  reset-names:
    items:
      - const: clk-ctl
      - const: l0-rx
      - const: l0-tx
      - const: l1-rx
      - const: l1-tx

  '#phy-cells':
    description: |
      The cell selects one M-PHY lane direction. Valid values are defined in
      <dt-bindings/phy/nvidia,tegra264-mphy.h>: TEGRA_MPHY_L0_TX, TEGRA_MPHY_L0_RX,
      TEGRA_MPHY_L1_TX and TEGRA_MPHY_L1_RX.
    const: 1

required:
  - compatible
  - reg
  - reg-names
  - clocks
  - clock-names
  - resets
  - reset-names
  - '#phy-cells'

additionalProperties: false

examples:
  - |
    #include <dt-bindings/clock/nvidia,tegra264.h>
    #include <dt-bindings/reset/nvidia,tegra264.h>
    #include <dt-bindings/phy/nvidia,tegra264-mphy.h>

    mphy: phy@b910000 {
        compatible = "nvidia,tegra264-mphy";
        reg = <0xb910000 0x10000>,
              <0xb920000 0x10000>;
        reg-names = "l0", "l1";
        clocks = <&bpmp TEGRA264_CLK_MPHY_CORE_PLL_FIXED>,
                 <&bpmp TEGRA264_CLK_MPHY_TX_1MHZ_REF>,
                 <&bpmp TEGRA264_CLK_MPHY_L0_TX_SYMB>,
                 <&bpmp TEGRA264_CLK_MPHY_L0_TX_LS_3XBIT>,
                 <&bpmp TEGRA264_CLK_MPHY_L0_TX_HS_SYMB_DIV>,
                 <&bpmp TEGRA264_CLK_MPHY_L0_UPHY_TX_FIFO>,
                 <&bpmp TEGRA264_CLK_MPHY_L0_RX_SYMB>,
                 <&bpmp TEGRA264_CLK_MPHY_L0_RX_ANA>,
                 <&bpmp TEGRA264_CLK_MPHY_L0_RX_LS_BIT>,
                 <&bpmp TEGRA264_CLK_MPHY_L0_RX_HS_SYMB_DIV>,
                 <&bpmp TEGRA264_CLK_MPHY_L1_RX_ANA>;
        clock-names = "pll", "tx-ref",
                      "l0-tx-sym", "l0-tx-ls", "l0-tx-hs", "l0-tx-fifo",
                      "l0-rx-sym", "l0-rx-ana", "l0-rx-ls", "l0-rx-hs",
                      "l1-rx-ana";
        resets = <&bpmp TEGRA264_RESET_MPHY_CLK_CTL>,
                 <&bpmp TEGRA264_RESET_MPHY_L0_RX>,
                 <&bpmp TEGRA264_RESET_MPHY_L0_TX>,
                 <&bpmp TEGRA264_RESET_MPHY_L1_RX>,
                 <&bpmp TEGRA264_RESET_MPHY_L1_TX>;
        reset-names = "clk-ctl", "l0-rx", "l0-tx", "l1-rx", "l1-tx";
        #phy-cells = <1>;
    };
...
```

## Documentation/devicetree/bindings/phy/qcom,x1e80100-csi2-phy.yaml
```yaml
# SPDX-License-Identifier: (GPL-2.0 OR BSD-2-Clause)
%YAML 1.2
---
$id: http://devicetree.org/schemas/phy/qcom,x1e80100-csi2-phy.yaml#
$schema: http://devicetree.org/meta-schemas/core.yaml#

title: Qualcomm X1E80100 SoC CSI2 PHY

maintainers:
  - Bryan O'Donoghue <bod@kernel.org>

description:
  Qualcomm MIPI CSI2 C-PHY/D-PHY combination PHY. Connects MIPI CSI2 sensors
  to Qualcomm's Camera CSI Decoder. The PHY supports both C-PHY and D-PHY
  modes.

properties:
  compatible:
    oneOf:
      - const: qcom,x1e80100-csi2-phy
      - items:
          - const: qcom,glymur-csi2-phy
          - const: qcom,x1e80100-csi2-phy

  reg:
    maxItems: 1

  clocks:
    maxItems: 3

  clock-names:
    items:
      - const: core
      - const: timer
      - const: ahb

  interrupts:
    maxItems: 1

  operating-points-v2: true

  opp-table:
    type: object

  power-domains:
    items:
      - description: Titan Top GDSC - Titan ISP Block, Global Distributed Switch Controller.
      - description: MMCX voltage rail
      - description: MXC or MXA voltage rail

  power-domain-names:
    items:
      - const: top
      - const: mmcx
      - const: mx

  vdda-0p9-supply:
    description: Phandle to a 0.9V regulator supply to a PHY.

  vdda-1p2-supply:
    description: Phandle to 1.2V regulator supply to a PHY.

  ports:
    $ref: /schemas/graph.yaml#/properties/ports

    properties:
      port@0:
        $ref: /schemas/graph.yaml#/$defs/port-base
        description:
          Sensor input. Always present. A single sensor is described by a
          single endpoint with one to four data lanes, numbered 1-4. The
          clock lane is position 0.

          DPHY split mode, where two independent sensors share the PHY, is
          described by two endpoints. endpoint@0 uses data lanes 1 or 1-2,
          clock lane position 0; endpoint@1 uses data lane 3, clock lane
          position 4.

        unevaluatedProperties: false

        patternProperties:
          "^endpoint(@[01])?$":
            $ref: /schemas/media/video-interfaces.yaml#
            unevaluatedProperties: false
            properties:
              bus-type:
                enum:
                  - 1 # MEDIA_BUS_TYPE_CSI2_CPHY
                  - 4 # MEDIA_BUS_TYPE_CSI2_DPHY
                default: 4

              data-lanes:
                minItems: 1
                maxItems: 4
                items:
                  minimum: 1
                  maximum: 4
                description:
                  Data lane positions following this endpoint's clock
                  lane. Positions are a per-port logical numbering, not
                  package pad or ball positions.

            required:
              - data-lanes
              - remote-endpoint

        allOf:
          - if:
              required:
                - endpoint@1
            then:
              properties:
                endpoint@0:
                  properties:
                    data-lanes:
                      maxItems: 2
                      items:
                        maximum: 2
                endpoint@1:
                  properties:
                    data-lanes:
                      items:
                        - const: 3
              required:
                - endpoint@0

      port@1:
        $ref: /schemas/graph.yaml#/properties/port
        description: Output to the CAMSS CSID controller.

    required:
      - port@0
      - port@1

required:
  - compatible
  - reg
  - clocks
  - clock-names
  - interrupts
  - operating-points-v2
  - power-domains
  - power-domain-names
  - vdda-0p9-supply
  - vdda-1p2-supply
  - ports

additionalProperties: false

examples:
  - |
    #include <dt-bindings/clock/qcom,x1e80100-camcc.h>
    #include <dt-bindings/clock/qcom,x1e80100-gcc.h>
    #include <dt-bindings/interrupt-controller/arm-gic.h>
    #include <dt-bindings/media/video-interfaces.h>
    #include <dt-bindings/power/qcom,rpmhpd.h>

    phy@ace4000 {
        compatible = "qcom,x1e80100-csi2-phy";
        reg = <0x0ace4000 0x2000>;

        clocks = <&camcc CAM_CC_CSIPHY0_CLK>,
                 <&camcc CAM_CC_CSI0PHYTIMER_CLK>,
                 <&camcc CAM_CC_CORE_AHB_CLK>;
        clock-names = "core",
                      "timer",
                      "ahb";

        interrupts = <GIC_SPI 477 IRQ_TYPE_EDGE_RISING>;

        operating-points-v2 = <&csiphy_opp_table>;

        power-domains = <&camcc CAM_CC_TITAN_TOP_GDSC>,
                        <&rpmhpd RPMHPD_MMCX>,
                        <&rpmhpd RPMHPD_MX>;
        power-domain-names = "top",
                             "mmcx",
                             "mx";

        vdda-0p9-supply = <&vreg_l2c_0p9>;
        vdda-1p2-supply = <&vreg_l1c_1p2>;

        ports {
            #address-cells = <1>;
            #size-cells = <0>;

            port@0 {
                reg = <0>;
                csiphy0_in: endpoint {
                    bus-type = <MEDIA_BUS_TYPE_CSI2_DPHY>;
                    data-lanes = <1 2 3 4>;
                    remote-endpoint = <&sensor_out>;
                };
            };

            port@1 {
                reg = <1>;
                csiphy0_out: endpoint {
                    remote-endpoint = <&csid_in>;
                };
            };
        };

        csiphy_opp_table: opp-table {
            compatible = "operating-points-v2";

            opp-300000000 {
                opp-hz = /bits/ 64 <300000000>;
                required-opps = <&rpmhpd_opp_low_svs_d1>,
                                <&rpmhpd_opp_low_svs_d1>;
            };
        };
    };
```
