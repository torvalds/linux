## Documentation/devicetree/bindings/net/wireless/ti,wl1251.yaml
```yaml
# SPDX-License-Identifier: (GPL-2.0-only OR BSD-2-Clause)
%YAML 1.2
---
$id: http://devicetree.org/schemas/net/wireless/ti,wl1251.yaml#
$schema: http://devicetree.org/meta-schemas/core.yaml#

title: Texas Instruments WL1251 Wireless LAN Controller

maintainers:
  - Eduard Bostina <egbostina@gmail.com>

properties:
  compatible:
    const: ti,wl1251

  reg:
    maxItems: 1

  interrupts:
    maxItems: 1

  vio-supply:
    description:
      Phandle to the regulator providing VIO. Required when connected via SPI.

  ti,power-gpio:
    maxItems: 1
    description:
      GPIO connected to chip's PMEN pin if operated in SPI mode.

  ti,wl1251-has-eeprom:
    type: boolean
    description:
      The wl1251 has an EEPROM connected, which provides configuration
      data (calibration, MAC, ...).

  clocks:
    maxItems: 1

  spi-max-frequency: true
  spi-cpol: true
  spi-cpha: true

required:
  - compatible
  - reg
  - interrupts

allOf:
  - $ref: /schemas/spi/spi-peripheral-props.yaml#

unevaluatedProperties: false

examples:
  - |
    #include <dt-bindings/interrupt-controller/irq.h>
    #include <dt-bindings/gpio/gpio.h>
    spi {
        #address-cells = <1>;
        #size-cells = <0>;
        wifi@0 {
            compatible = "ti,wl1251";
            reg = <0>;
            spi-max-frequency = <48000000>;
            spi-cpol;
            spi-cpha;
            interrupt-parent = <&gpio2>;
            interrupts = <10 IRQ_TYPE_NONE>;
            vio-supply = <&vio>;
            ti,power-gpio = <&gpio3 23 GPIO_ACTIVE_HIGH>;
        };
    };
  - |
    #include <dt-bindings/interrupt-controller/irq.h>
    mmc {
        #address-cells = <1>;
        #size-cells = <0>;
        wifi@1 {
            compatible = "ti,wl1251";
            reg = <1>;
            interrupt-parent = <&gpio1>;
            interrupts = <21 IRQ_TYPE_LEVEL_HIGH>;
            ti,wl1251-has-eeprom;
        };
    };
```

## Documentation/devicetree/bindings/net/wiznet,w5100.yaml
```yaml
# SPDX-License-Identifier: (GPL-2.0-only OR BSD-2-Clause)
%YAML 1.2
---
$id: http://devicetree.org/schemas/net/wiznet,w5100.yaml#
$schema: http://devicetree.org/meta-schemas/core.yaml#

title: Wiznet w5100/w5200/w5500 SPI Ethernet Controller

maintainers:
  - Arthur Crepin Leblond <arthur@marmottus.net>

description: |
  This is a standalone 10/100 MBit Ethernet controller with SPI interface.

properties:
  compatible:
    enum:
      - wiznet,w5100
      - wiznet,w5200
      - wiznet,w5500

  interrupts:
    minItems: 1
    description:
      The main interrupt (INT pin) is mandatory on all devices. The w5500
      additionally supports an optional second interrupt for link status changes
      (LINKLED pin). If it is not specified, link state changes will not be
      reported.
    items:
      - description: Main interrupt (INT pin on the device).
      - description:
          Optional interrupt for link status changes (LINKLED pin on w5500).

  reg:
    maxItems: 1

  spi-max-frequency:
    description:
      According to the datasheets, w5500 and w5200 allow a maximum of 80 MHz
      while w5100 is reported by users to allow a maximum of 14 MHz. However,
      board designs may need to limit this value.
    maximum: 80000000

required:
  - compatible
  - reg
  - interrupts

allOf:
  - $ref: /schemas/net/ethernet-controller.yaml#
  - $ref: /schemas/spi/spi-peripheral-props.yaml#
  - if:
      not:
        properties:
          compatible:
            contains:
              enum:
                - wiznet,w5500
    then:
      properties:
        interrupts:
          maxItems: 1

unevaluatedProperties: false

examples:
  - |
    /* Example (for Raspberry Pi with pin control stuff for GPIO irq) */

    #include <dt-bindings/interrupt-controller/irq.h>

    spi {
        #address-cells = <1>;
        #size-cells = <0>;

        ethernet@0 {
            compatible = "wiznet,w5500";
            reg = <0>;
            interrupt-parent = <&gpio>;
            interrupts = <25 IRQ_TYPE_LEVEL_LOW>,
                         <24 IRQ_TYPE_EDGE_BOTH>;
            local-mac-address = [ a0 b0 c0 d0 e0 f0 ];
            pinctrl-0 = <&eth1_pins>;
            pinctrl-names = "default";
            spi-max-frequency = <30000000>;
        };
    };
...
```

## Documentation/devicetree/bindings/net/x-powers,acx00-ephy-package.yaml
```yaml
# SPDX-License-Identifier: (GPL-2.0-only OR BSD-2-Clause)
%YAML 1.2
---
$id: http://devicetree.org/schemas/net/x-powers,acx00-ephy-package.yaml#
$schema: http://devicetree.org/meta-schemas/core.yaml#

title: X-Powers AC200 and AC300 Ethernet PHY packages

maintainers:
  - James Hilliard <james.hilliard1@gmail.com>

description:
  The AC200 and AC300 contain compatible Fast Ethernet PHY blocks which report
  the same Clause 22 PHY ID and use the same link-side register layout. The
  package control paths differ. AC200 package control registers are accessed
  through the companion IC's I2C register interface, while AC300 control
  registers occupy a second Clause 22 address fixed at 16 plus the link PHY
  address.

  Systems with a known package use the corresponding AC200 or AC300 compatible.
  Systems which can contain either package use the ACx00 compatible and a
  packed NVMEM configuration field to select the backend at runtime.

  The link PHY cannot report its ID until the package control sequence has
  completed, so its child node supplies the documented PHY ID. The package and
  child use the same base address. The AC200 driver programs that address into
  the package, while the AC300 driver derives its control address from it.

properties:
  compatible:
    enum:
      - x-powers,ac200-ephy-package
      - x-powers,ac300-ephy-package
      - x-powers,acx00-ephy-package

  reg:
    maximum: 31

  clocks:
    maxItems: 1
    description: AC300 input clock, running at 24, 25, or 27 MHz

  vcc-supply:
    description:
      3.3 V package supply. This is connected to EPHY_VCC on AC200 and VCC1
      on AC300.

  nvmem-cells:
    maxItems: 1
    description:
      Packed little-endian EPHY configuration value, with the least-significant
      byte first. Bits 3 through 0 contain the analog calibration code, bits 7
      through 4 are reserved, bit 8 selects AC300 when set and AC200 when clear,
      and bit 9 requests the AC300 low-calibration tuning sequence. Bits 15
      through 10 are reserved.

      AC300 and selectable ACx00 packages require the full configuration
      field, including bits 8 and 9 even when their values are zero, returned
      as two bytes. A fixed AC200 package may provide a one-byte calibration
      value or a two-byte configuration with bit 8 clear, or omit the cell
      and use its internal eFuse calibration copy.

  nvmem-cell-names:
    const: configuration

  x-powers,ac200:
    $ref: /schemas/types.yaml#/definitions/phandle
    description:
      Phandle to the AC200 companion IC described by the x-powers,ac200 MFD
      binding. Its I2C interface provides access to the package control
      registers used to power and configure the Ethernet PHY.

  x-powers,xmii-rx-clock-inverted:
    type: boolean
    description:
      Invert the xMII receive clock inside the PHY. This is required by some
      SoC integrations, including the Allwinner H6 AC200 connection.

patternProperties:
  ^ethernet-phy@[a-f0-9]+$:
    $ref: ethernet-phy.yaml#
    properties:
      compatible:
        const: ethernet-phy-id0044.1400
    required:
      - compatible
    unevaluatedProperties: false

required:
  - compatible
  - vcc-supply

dependentRequired:
  nvmem-cells: [ nvmem-cell-names ]

allOf:
  - $ref: ethernet-phy-package.yaml#
  - if:
      properties:
        compatible:
          const: x-powers,ac200-ephy-package
    then:
      properties:
        clocks: false
      required:
        - x-powers,ac200
  - if:
      properties:
        compatible:
          const: x-powers,ac300-ephy-package
    then:
      properties:
        x-powers,ac200: false
      required:
        - clocks
        - nvmem-cells
        - nvmem-cell-names
  - if:
      properties:
        compatible:
          const: x-powers,acx00-ephy-package
    then:
      required:
        - clocks
        - nvmem-cells
        - nvmem-cell-names
        - x-powers,ac200
  - if:
      properties:
        compatible:
          enum:
            - x-powers,ac300-ephy-package
            - x-powers,acx00-ephy-package
    then:
      properties:
        reg:
          maximum: 7
      patternProperties:
        ^ethernet-phy@[a-f0-9]+$:
          properties:
            reg:
              maximum: 7

unevaluatedProperties: false

examples:
  - |
    mdio {
        #address-cells = <1>;
        #size-cells = <0>;

        ethernet-phy-package@0 {
            compatible = "x-powers,acx00-ephy-package";
            reg = <0>;
            #address-cells = <1>;
            #size-cells = <0>;
            clocks = <&pwm 5>;
            vcc-supply = <&reg_3v3>;
            nvmem-cells = <&ephy_configuration>;
            nvmem-cell-names = "configuration";
            x-powers,ac200 = <&ac200>;

            ethernet-phy@0 {
                compatible = "ethernet-phy-id0044.1400";
                reg = <0>;
            };
        };
    };

...
```
