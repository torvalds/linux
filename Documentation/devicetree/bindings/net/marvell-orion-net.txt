## Documentation/devicetree/bindings/net/mediatek,star-emac.yaml
```yaml
# SPDX-License-Identifier: (GPL-2.0-only OR BSD-2-Clause)
%YAML 1.2
---
$id: http://devicetree.org/schemas/net/mediatek,star-emac.yaml#
$schema: http://devicetree.org/meta-schemas/core.yaml#

title: MediaTek STAR Ethernet MAC Controller

maintainers:
  - Bartosz Golaszewski <bgolaszewski@baylibre.com>

description:
  This Ethernet MAC is used on the MT8* family of SoCs from MediaTek.
  It's compliant with 802.3 standards and supports half- and full-duplex
  modes with flow-control as well as CRC offloading and VLAN tags.

allOf:
  - $ref: ethernet-controller.yaml#

properties:
  compatible:
    enum:
      - mediatek,mt8516-eth
      - mediatek,mt8518-eth
      - mediatek,mt8175-eth
      - mediatek,mt8365-eth

  reg:
    maxItems: 1

  interrupts:
    maxItems: 1

  clocks:
    minItems: 3
    maxItems: 3

  clock-names:
    additionalItems: false
    items:
      - const: core
      - const: reg
      - const: trans

  mediatek,pericfg:
    $ref: /schemas/types.yaml#/definitions/phandle
    description:
      Phandle to the device containing the PERICFG register range. This is used
      to control the MII mode.

  mediatek,rmii-rxc:
    type: boolean
    description:
      If present, indicates that the RMII reference clock, which is from external
      PHYs, is connected to RXC pin. Otherwise, is connected to TXC pin.

  mediatek,rxc-inverse:
    type: boolean
    description:
      If present, indicates that clock on RXC pad will be inversed.

  mediatek,txc-inverse:
    type: boolean
    description:
      If present, indicates that clock on TXC pad will be inversed.

  mdio:
    $ref: mdio.yaml#
    unevaluatedProperties: false

required:
  - compatible
  - reg
  - interrupts
  - clocks
  - clock-names
  - mediatek,pericfg
  - phy-handle

unevaluatedProperties: false

examples:
  - |
    #include <dt-bindings/interrupt-controller/arm-gic.h>
    #include <dt-bindings/clock/mt8516-clk.h>

    ethernet: ethernet@11180000 {
        compatible = "mediatek,mt8516-eth";
        reg = <0x11180000 0x1000>;
        mediatek,pericfg = <&pericfg>;
        interrupts = <GIC_SPI 111 IRQ_TYPE_LEVEL_LOW>;
        clocks = <&topckgen CLK_TOP_RG_ETH>,
                 <&topckgen CLK_TOP_66M_ETH>,
                 <&topckgen CLK_TOP_133M_ETH>;
        clock-names = "core", "reg", "trans";
        phy-handle = <&eth_phy>;
        phy-mode = "rmii";

        mdio {
            #address-cells = <1>;
            #size-cells = <0>;

            eth_phy: ethernet-phy@0 {
                reg = <0>;
            };
        };
    };
```

## Documentation/devicetree/bindings/net/mediatek-bluetooth.txt
```
MediaTek SoC built-in Bluetooth Devices
==================================

This device is a serial attached device to BTIF device and thus it must be a
child node of the serial node with BTIF. The dt-bindings details for BTIF
device can be known via Documentation/devicetree/bindings/serial/8250.txt.

Required properties:

- compatible:	Must be
		  "mediatek,mt7622-bluetooth": for MT7622 SoC
- clocks:	Should be the clock specifiers corresponding to the entry in
		clock-names property.
- clock-names:	Should contain "ref" entries.
- power-domains: Phandle to the power domain that the device is part of

Example:

	btif: serial@1100c000 {
		compatible = "mediatek,mt7622-btif",
			     "mediatek,mtk-btif";
		reg = <0 0x1100c000 0 0x1000>;
		interrupts = <GIC_SPI 90 IRQ_TYPE_LEVEL_LOW>;
		clocks = <&pericfg CLK_PERI_BTIF_PD>;
		clock-names = "main";
		reg-shift = <2>;
		reg-io-width = <4>;

		bluetooth {
			compatible = "mediatek,mt7622-bluetooth";
			power-domains = <&scpsys MT7622_POWER_DOMAIN_WB>;
			clocks = <&clk25m>;
			clock-names = "ref";
		};
	};

MediaTek UART based Bluetooth Devices
==================================

This device is a serial attached device to UART device and thus it must be a
child node of the serial node with UART.

Please refer to the following documents for generic properties:

	Documentation/devicetree/bindings/serial/slave-device.txt

Required properties:

- compatible:	Must be
		  "mediatek,mt7663u-bluetooth": for MT7663U device
		  "mediatek,mt7668u-bluetooth": for MT7668U device
- vcc-supply:	Main voltage regulator
- pinctrl-names: Should be "default", "runtime"
- pinctrl-0: Should contain UART RXD low when the device is powered up to
	     enter proper bootstrap mode.
- pinctrl-1: Should contain UART mode pin ctrl

Optional properties:

- reset-gpios:	GPIO used to reset the device whose initial state keeps low,
		if the GPIO is missing, then board-level design should be
		guaranteed.
- current-speed:  Current baud rate of the device whose defaults to 921600

Example:

	uart1_pins_boot: uart1-default {
		pins-dat {
			pinmux = <MT7623_PIN_81_URXD1_FUNC_GPIO81>;
			output-low;
		};
	};

	uart1_pins_runtime: uart1-runtime {
		pins-dat {
			pinmux = <MT7623_PIN_81_URXD1_FUNC_URXD1>,
				 <MT7623_PIN_82_UTXD1_FUNC_UTXD1>;
		};
	};

	uart1: serial@11003000 {
		compatible = "mediatek,mt7623-uart",
			     "mediatek,mt6577-uart";
		reg = <0 0x11003000 0 0x400>;
		interrupts = <GIC_SPI 52 IRQ_TYPE_LEVEL_LOW>;
		clocks = <&pericfg CLK_PERI_UART1_SEL>,
			 <&pericfg CLK_PERI_UART1>;
		clock-names = "baud", "bus";

		bluetooth {
			compatible = "mediatek,mt7663u-bluetooth";
			vcc-supply = <&reg_5v>;
			reset-gpios = <&pio 24 GPIO_ACTIVE_LOW>;
			pinctrl-names = "default", "runtime";
			pinctrl-0 = <&uart1_pins_boot>;
			pinctrl-1 = <&uart1_pins_runtime>;
			current-speed = <921600>;
		};
	};
```

## Documentation/devicetree/bindings/net/mediatek-dwmac.txt
```
MediaTek DWMAC glue layer controller

This file documents platform glue layer for stmmac.
Please see stmmac.txt for the other unchanged properties.

The device node has following properties.

Required properties:
- compatible:  Should be "mediatek,mt2712-gmac" for MT2712 SoC
- reg:  Address and length of the register set for the device
- interrupts:  Should contain the MAC interrupts
- interrupt-names: Should contain a list of interrupt names corresponding to
	the interrupts in the interrupts property, if available.
	Should be "macirq" for the main MAC IRQ
- clocks: Must contain a phandle for each entry in clock-names.
- clock-names: The name of the clock listed in the clocks property. These are
	"axi", "apb", "mac_main", "ptp_ref" for MT2712 SoC
- mac-address: See ethernet.txt in the same directory
- phy-mode: See ethernet.txt in the same directory
- mediatek,pericfg: A phandle to the syscon node that control ethernet
	interface and timing delay.

Optional properties:
- mediatek,tx-delay-ps: TX clock delay macro value. Default is 0.
	It should be defined for RGMII/MII interface.
- mediatek,rx-delay-ps: RX clock delay macro value. Default is 0.
	It should be defined for RGMII/MII/RMII interface.
Both delay properties need to be a multiple of 170 for RGMII interface,
or will round down. Range 0~31*170.
Both delay properties need to be a multiple of 550 for MII/RMII interface,
or will round down. Range 0~31*550.

- mediatek,rmii-rxc: boolean property, if present indicates that the RMII
	reference clock, which is from external PHYs, is connected to RXC pin
	on MT2712 SoC.
	Otherwise, is connected to TXC pin.
- mediatek,txc-inverse: boolean property, if present indicates that
	1. tx clock will be inversed in MII/RGMII case,
	2. tx clock inside MAC will be inversed relative to reference clock
	   which is from external PHYs in RMII case, and it rarely happen.
- mediatek,rxc-inverse: boolean property, if present indicates that
	1. rx clock will be inversed in MII/RGMII case.
	2. reference clock will be inversed when arrived at MAC in RMII case.
- assigned-clocks: mac_main and ptp_ref clocks
- assigned-clock-parents: parent clocks of the assigned clocks

Example:
	eth: ethernet@1101c000 {
		compatible = "mediatek,mt2712-gmac";
		reg = <0 0x1101c000 0 0x1300>;
		interrupts = <GIC_SPI 237 IRQ_TYPE_LEVEL_LOW>;
		interrupt-names = "macirq";
		phy-mode ="rgmii";
		mac-address = [00 55 7b b5 7d f7];
		clock-names = "axi",
			      "apb",
			      "mac_main",
			      "ptp_ref",
			      "ptp_top";
		clocks = <&pericfg CLK_PERI_GMAC>,
			 <&pericfg CLK_PERI_GMAC_PCLK>,
			 <&topckgen CLK_TOP_ETHER_125M_SEL>,
			 <&topckgen CLK_TOP_ETHER_50M_SEL>;
		assigned-clocks = <&topckgen CLK_TOP_ETHER_125M_SEL>,
				  <&topckgen CLK_TOP_ETHER_50M_SEL>;
		assigned-clock-parents = <&topckgen CLK_TOP_ETHERPLL_125M>,
					 <&topckgen CLK_TOP_APLL1_D3>;
		mediatek,pericfg = <&pericfg>;
		mediatek,tx-delay-ps = <1530>;
		mediatek,rx-delay-ps = <1530>;
		mediatek,rmii-rxc;
		mediatek,txc-inverse;
		mediatek,rxc-inverse;
		snps,txpbl = <32>;
		snps,rxpbl = <32>;
		snps,reset-gpio = <&pio 87 GPIO_ACTIVE_LOW>;
		snps,reset-active-low;
	};
```
