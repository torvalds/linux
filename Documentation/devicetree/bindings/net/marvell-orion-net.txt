## Documentation/devicetree/bindings/net/marvell-orion-net.txt
```
Marvell Orion/Discovery ethernet controller
=============================================

The Marvell Discovery ethernet controller can be found on Marvell Orion SoCs
(Kirkwood, Dove, Orion5x, and Discovery Innovation) and as part of Marvell
Discovery system controller chips (mv64[345]60).

The Discovery ethernet controller is described with two levels of nodes. The
first level describes the ethernet controller itself and the second level
describes up to 3 ethernet port nodes within that controller. The reason for
the multiple levels is that the port registers are interleaved within a single
set of controller registers. Each port node describes port-specific properties.

Note: The above separation is only true for Discovery system controllers.
For Orion SoCs we stick to the separation, although there each controller has
only one port associated. Multiple ports are implemented as multiple single-port
controllers. As Kirkwood has some issues with proper initialization after reset,
an extra compatible string is added for it.

* Ethernet controller node

Required controller properties:
 - #address-cells: shall be 1.
 - #size-cells: shall be 0.
 - compatible: shall be one of "marvell,orion-eth", "marvell,kirkwood-eth".
 - reg: address and length of the controller registers.

Optional controller properties:
 - clocks: phandle reference to the controller clock.
 - marvell,tx-checksum-limit: max tx packet size for hardware checksum.

* Ethernet port node

Required port properties:
 - compatible: shall be one of "marvell,orion-eth-port",
      "marvell,kirkwood-eth-port".
 - reg: port number relative to ethernet controller, shall be 0, 1, or 2.
 - interrupts: port interrupt.
 - local-mac-address: See ethernet.txt file in the same directory.

Optional port properties:
 - marvell,tx-queue-size: size of the transmit ring buffer.
 - marvell,tx-sram-addr: address of transmit descriptor buffer located in SRAM.
 - marvell,tx-sram-size: size of transmit descriptor buffer located in SRAM.
 - marvell,rx-queue-size: size of the receive ring buffer.
 - marvell,rx-sram-addr: address of receive descriptor buffer located in SRAM.
 - marvell,rx-sram-size: size of receive descriptor buffer located in SRAM.

and

 - phy-handle: See ethernet.txt file in the same directory.

or

 - speed: port speed if no PHY connected.
 - duplex: port mode if no PHY connected.

* Node example:

mdio-bus {
	...
	ethphy: ethernet-phy@8 {
		...
	};
};

eth: ethernet-controller@72000 {
	compatible = "marvell,orion-eth";
	#address-cells = <1>;
	#size-cells = <0>;
	reg = <0x72000 0x2000>;
	clocks = <&gate_clk 2>;
	marvell,tx-checksum-limit = <1600>;

	ethernet@0 {
		compatible = "marvell,orion-eth-port";
		reg = <0>;
		interrupts = <29>;
		phy-handle = <&ethphy>;
		local-mac-address = [00 00 00 00 00 00];
	};
};
```

## Documentation/devicetree/bindings/net/marvell-pp2.txt
```
* Marvell Armada 375 Ethernet Controller (PPv2.1)
  Marvell Armada 7K/8K Ethernet Controller (PPv2.2)

Required properties:

- compatible: should be one of:
    "marvell,armada-375-pp2"
    "marvell,armada-7k-pp2"
- reg: addresses and length of the register sets for the device.
  For "marvell,armada-375-pp2", must contain the following register
  sets:
	- common controller registers
	- LMS registers
	- one register area per Ethernet port
  For "marvell,armada-7k-pp2", must contain the following register
  sets:
	- packet processor registers
	- networking interfaces registers

- clocks: pointers to the reference clocks for this device, consequently:
	- main controller clock (for both armada-375-pp2 and armada-7k-pp2)
	- GOP clock (for both armada-375-pp2 and armada-7k-pp2)
	- MG clock (only for armada-7k-pp2)
	- MG Core clock (only for armada-7k-pp2)
	- AXI clock (only for armada-7k-pp2)
- clock-names: names of used clocks, must be "pp_clk", "gop_clk", "mg_clk",
  "mg_core_clk" and "axi_clk" (the 3 latter only for armada-7k-pp2).

The ethernet ports are represented by subnodes. At least one port is
required.

Required properties (port):

- interrupts: interrupt(s) for the port
- port-id: ID of the port from the MAC point of view
- gop-port-id: only for marvell,armada-7k-pp2, ID of the port from the
  GOP (Group Of Ports) point of view. This ID is used to index the
  per-port registers in the second register area.
- phy-mode: See ethernet.txt file in the same directory

Optional properties (port):

- marvell,loopback: port is loopback mode
- phy: a phandle to a phy node defining the PHY address (as the reg
  property, a single integer).
- interrupt-names: if more than a single interrupt for is given, must be the
                   name associated to the interrupts listed. Valid names are:
                   "hifX", with X in [0..8], and "link". The names "tx-cpu0",
                   "tx-cpu1", "tx-cpu2", "tx-cpu3" and "rx-shared" are supported
                   for backward compatibility but shouldn't be used for new
                   additions.
- marvell,system-controller: a phandle to the system controller.

Example for marvell,armada-375-pp2:

ethernet@f0000 {
	compatible = "marvell,armada-375-pp2";
	reg = <0xf0000 0xa000>,
	      <0xc0000 0x3060>,
	      <0xc4000 0x100>,
	      <0xc5000 0x100>;
	clocks = <&gateclk 3>, <&gateclk 19>;
	clock-names = "pp_clk", "gop_clk";

	eth0: eth0@c4000 {
		interrupts = <GIC_SPI 37 IRQ_TYPE_LEVEL_HIGH>;
		port-id = <0>;
		phy = <&phy0>;
		phy-mode = "gmii";
	};

	eth1: eth1@c5000 {
		interrupts = <GIC_SPI 41 IRQ_TYPE_LEVEL_HIGH>;
		port-id = <1>;
		phy = <&phy3>;
		phy-mode = "gmii";
	};
};

Example for marvell,armada-7k-pp2:

cpm_ethernet: ethernet@0 {
	compatible = "marvell,armada-7k-pp22";
	reg = <0x0 0x100000>, <0x129000 0xb000>;
	clocks = <&cpm_syscon0 1 3>, <&cpm_syscon0 1 9>,
		 <&cpm_syscon0 1 5>, <&cpm_syscon0 1 6>, <&cpm_syscon0 1 18>;
	clock-names = "pp_clk", "gop_clk", "mg_clk", "mg_core_clk", "axi_clk";

	eth0: eth0 {
		interrupts = <ICU_GRP_NSR 39 IRQ_TYPE_LEVEL_HIGH>,
			     <ICU_GRP_NSR 43 IRQ_TYPE_LEVEL_HIGH>,
			     <ICU_GRP_NSR 47 IRQ_TYPE_LEVEL_HIGH>,
			     <ICU_GRP_NSR 51 IRQ_TYPE_LEVEL_HIGH>,
			     <ICU_GRP_NSR 55 IRQ_TYPE_LEVEL_HIGH>,
			     <ICU_GRP_NSR 59 IRQ_TYPE_LEVEL_HIGH>,
			     <ICU_GRP_NSR 63 IRQ_TYPE_LEVEL_HIGH>,
			     <ICU_GRP_NSR 67 IRQ_TYPE_LEVEL_HIGH>,
			     <ICU_GRP_NSR 71 IRQ_TYPE_LEVEL_HIGH>,
			     <ICU_GRP_NSR 129 IRQ_TYPE_LEVEL_HIGH>;
		interrupt-names = "hif0", "hif1", "hif2", "hif3", "hif4",
				  "hif5", "hif6", "hif7", "hif8", "link";
		port-id = <0>;
		gop-port-id = <0>;
	};

	eth1: eth1 {
		interrupts = <ICU_GRP_NSR 40 IRQ_TYPE_LEVEL_HIGH>,
			     <ICU_GRP_NSR 44 IRQ_TYPE_LEVEL_HIGH>,
			     <ICU_GRP_NSR 48 IRQ_TYPE_LEVEL_HIGH>,
			     <ICU_GRP_NSR 52 IRQ_TYPE_LEVEL_HIGH>,
			     <ICU_GRP_NSR 56 IRQ_TYPE_LEVEL_HIGH>,
			     <ICU_GRP_NSR 60 IRQ_TYPE_LEVEL_HIGH>,
			     <ICU_GRP_NSR 64 IRQ_TYPE_LEVEL_HIGH>,
			     <ICU_GRP_NSR 68 IRQ_TYPE_LEVEL_HIGH>,
			     <ICU_GRP_NSR 72 IRQ_TYPE_LEVEL_HIGH>,
			     <ICU_GRP_NSR 128 IRQ_TYPE_LEVEL_HIGH>;
		interrupt-names = "hif0", "hif1", "hif2", "hif3", "hif4",
				  "hif5", "hif6", "hif7", "hif8", "link";
		port-id = <1>;
		gop-port-id = <2>;
	};

	eth2: eth2 {
		interrupts = <ICU_GRP_NSR 41 IRQ_TYPE_LEVEL_HIGH>,
			     <ICU_GRP_NSR 45 IRQ_TYPE_LEVEL_HIGH>,
			     <ICU_GRP_NSR 49 IRQ_TYPE_LEVEL_HIGH>,
			     <ICU_GRP_NSR 53 IRQ_TYPE_LEVEL_HIGH>,
			     <ICU_GRP_NSR 57 IRQ_TYPE_LEVEL_HIGH>,
			     <ICU_GRP_NSR 61 IRQ_TYPE_LEVEL_HIGH>,
			     <ICU_GRP_NSR 65 IRQ_TYPE_LEVEL_HIGH>,
			     <ICU_GRP_NSR 69 IRQ_TYPE_LEVEL_HIGH>,
			     <ICU_GRP_NSR 73 IRQ_TYPE_LEVEL_HIGH>,
			     <ICU_GRP_NSR 127 IRQ_TYPE_LEVEL_HIGH>;
		interrupt-names = "hif0", "hif1", "hif2", "hif3", "hif4",
				  "hif5", "hif6", "hif7", "hif8", "link";
		port-id = <2>;
		gop-port-id = <3>;
	};
};
```

## Documentation/devicetree/bindings/net/marvell-pxa168.txt
```
* Marvell PXA168 Ethernet Controller

Required properties:
- compatible: should be "marvell,pxa168-eth".
- reg: address and length of the register set for the device.
- interrupts: interrupt for the device.
- clocks: pointer to the clock for the device.

Optional properties:
- port-id: Ethernet port number. Should be '0','1' or '2'.
- #address-cells: must be 1 when using sub-nodes.
- #size-cells: must be 0 when using sub-nodes.
- phy-handle: see ethernet.txt file in the same directory.

The MAC address will be determined using the optional properties
defined in ethernet.txt.

Sub-nodes:
Each PHY can be represented as a sub-node. This is not mandatory.

Sub-nodes required properties:
- reg: the MDIO address of the PHY.

Example:

	eth0: ethernet@f7b90000 {
		compatible = "marvell,pxa168-eth";
		reg = <0xf7b90000 0x10000>;
		clocks = <&chip CLKID_GETH0>;
		interrupts = <GIC_SPI 24 IRQ_TYPE_LEVEL_HIGH>;
		#address-cells = <1>;
		#size-cells = <0>;
		phy-handle = <&ethphy0>;

		ethphy0: ethernet-phy@0 {
			reg = <0>;
		};
	};
```

## Documentation/devicetree/bindings/net/maxim,ds26522.txt
```
* Maxim (Dallas) DS26522 Dual T1/E1/J1 Transceiver

Required properties:
- compatible: Should contain "maxim,ds26522".
- reg: SPI CS.
- spi-max-frequency: SPI clock.

Example:
	slic@1 {
		compatible = "maxim,ds26522";
		reg = <1>;
		spi-max-frequency = <2000000>; /* input clock */
	};
```

## Documentation/devicetree/bindings/net/maxim,ds26522.yaml
```yaml
# SPDX-License-Identifier: (GPL-2.0-only OR BSD-2-Clause)
%YAML 1.2
---
$id: http://devicetree.org/schemas/net/maxim,ds26522.yaml#
$schema: http://devicetree.org/meta-schemas/core.yaml#

title: Maxim (Dallas) DS26522 Dual T1/E1/J1 Transceiver

maintainers:
  - Frank Li <Frank.Li@nxp.com>

properties:
  compatible:
    items:
      - const: maxim,ds26522

  reg:
    maxItems: 1

required:
  - compatible
  - reg

allOf:
  - $ref: /schemas/spi/spi-peripheral-props.yaml

unevaluatedProperties: false

examples:
  - |
    spi {
        #address-cells = <1>;
        #size-cells = <0>;

        transceiver@1 {
            compatible = "maxim,ds26522";
            reg = <1>;
            spi-max-frequency = <2000000>; /* input clock */
        };
    };
```

## Documentation/devicetree/bindings/net/maxlinear,gpy2xx.yaml
```yaml
# SPDX-License-Identifier: GPL-2.0-only OR BSD-2-Clause
%YAML 1.2
---
$id: http://devicetree.org/schemas/net/maxlinear,gpy2xx.yaml#
$schema: http://devicetree.org/meta-schemas/core.yaml#

title: MaxLinear GPY2xx PHY

maintainers:
  - Andrew Lunn <andrew@lunn.ch>
  - Michael Walle <michael@walle.cc>

allOf:
  - $ref: ethernet-phy.yaml#

properties:
  maxlinear,use-broken-interrupts:
    description: |
      Interrupts are broken on some GPY2xx PHYs in that they keep the
      interrupt line asserted for a random amount of time even after the
      interrupt status register is cleared. Thus it is blocking the
      interrupt line which is usually bad for shared lines. By default,
      interrupts are disabled for this PHY and polling mode is used. If one
      can live with the consequences, this property can be used to enable
      interrupt handling.

      Affected PHYs (as far as known) are GPY215B and GPY215C.
    type: boolean

dependencies:
  maxlinear,use-broken-interrupts: [ interrupts ]

unevaluatedProperties: false

examples:
  - |
    ethernet {
        #address-cells = <1>;
        #size-cells = <0>;

        ethernet-phy@0 {
            reg = <0>;
            interrupts-extended = <&intc 0>;
            maxlinear,use-broken-interrupts;
        };
    };

...
```

## Documentation/devicetree/bindings/net/mctp-i2c-controller.yaml
```yaml
# SPDX-License-Identifier: (GPL-2.0-only OR BSD-2-Clause)
%YAML 1.2
---
$id: http://devicetree.org/schemas/net/mctp-i2c-controller.yaml#
$schema: http://devicetree.org/meta-schemas/core.yaml#

title: MCTP I2C transport

maintainers:
  - Matt Johnston <matt@codeconstruct.com.au>

description: |
  An mctp-i2c-controller defines a local MCTP endpoint on an I2C controller.
  MCTP I2C is specified by DMTF DSP0237.

  An mctp-i2c-controller must be attached to an I2C adapter which supports
  slave functionality. I2C busses (either directly or as subordinate mux
  busses) are attached to the mctp-i2c-controller with a 'mctp-controller'
  property on each used bus. Each mctp-controller I2C bus will be presented
  to the host system as a separate MCTP I2C instance.

properties:
  compatible:
    const: mctp-i2c-controller

  reg:
    minimum: 0x40000000
    maximum: 0x4000007f
    description: |
      7 bit I2C address of the local endpoint.
      I2C_OWN_SLAVE_ADDRESS (1<<30) flag must be set.

additionalProperties: false

required:
  - compatible
  - reg

examples:
  - |
    // Basic case of a single I2C bus
    #include <dt-bindings/i2c/i2c.h>

    i2c {
      #address-cells = <1>;
      #size-cells = <0>;
      mctp-controller;

      mctp@30 {
        compatible = "mctp-i2c-controller";
        reg = <(0x30 | I2C_OWN_SLAVE_ADDRESS)>;
      };
    };

  - |
    // Mux topology with multiple MCTP-handling busses under
    // a single mctp-i2c-controller.
    // i2c1 and i2c6 can have MCTP devices, i2c5 does not.
    #include <dt-bindings/i2c/i2c.h>

    i2c1: i2c {
      #address-cells = <1>;
      #size-cells = <0>;
      mctp-controller;

      mctp@50 {
        compatible = "mctp-i2c-controller";
        reg = <(0x50 | I2C_OWN_SLAVE_ADDRESS)>;
      };
    };

    i2c-mux {
      #address-cells = <1>;
      #size-cells = <0>;
      i2c-parent = <&i2c1>;

      i2c5: i2c@0 {
        #address-cells = <1>;
        #size-cells = <0>;
        reg = <0>;
        eeprom@33 {
          reg = <0x33>;
        };
      };

      i2c6: i2c@1 {
        #address-cells = <1>;
        #size-cells = <0>;
        reg = <1>;
        mctp-controller;
      };
    };
```

## Documentation/devicetree/bindings/net/mdio-gpio.txt
```
MDIO on GPIOs

Currently defined compatibles:
- virtual,gpio-mdio
- microchip,mdio-smi0

MDC and MDIO lines connected to GPIO controllers are listed in the
gpios property as described in section VIII.1 in the following order:

MDC, MDIO.

Note: Each gpio-mdio bus should have an alias correctly numbered in "aliases"
node.

Example:

aliases {
	mdio-gpio0 = &mdio0;
};

mdio0: mdio {
	compatible = "virtual,mdio-gpio";
	#address-cells = <1>;
	#size-cells = <0>;
	gpios = <&qe_pio_a 11
		 &qe_pio_c 6>;
};
```

## Documentation/devicetree/bindings/net/mdio-gpio.yaml
```yaml
# SPDX-License-Identifier: (GPL-2.0-only OR BSD-2-Clause)
%YAML 1.2
---
$id: http://devicetree.org/schemas/net/mdio-gpio.yaml#
$schema: http://devicetree.org/meta-schemas/core.yaml#

title: MDIO on GPIOs

maintainers:
  - Andrew Lunn <andrew@lunn.ch>
  - Heiner Kallweit <hkallweit1@gmail.com>
  - Russell King <linux@armlinux.org.uk>

allOf:
  - $ref: mdio.yaml#

properties:
  compatible:
    enum:
      - virtual,mdio-gpio
      - microchip,mdio-smi0

  "#address-cells":
    const: 1

  "#size-cells":
    const: 0

  gpios:
    minItems: 2
    items:
      - description: MDC
      - description: MDIO
      - description: MDO

# Note: Each gpio-mdio bus should have an alias correctly numbered in "aliases"
# node.
additionalProperties:
  type: object

examples:
  - |
    aliases {
        mdio-gpio0 = &mdio0;
    };

    mdio0: mdio {
      compatible = "virtual,mdio-gpio";
      #address-cells = <1>;
      #size-cells = <0>;
      gpios = <&qe_pio_a 11>,
              <&qe_pio_c 6>;
      ethphy0: ethernet-phy@0 {
        reg = <0>;
      };
    };
...
```
