## Documentation/devicetree/bindings/net/intel,dwmac-plat.yaml
```yaml
# SPDX-License-Identifier: (GPL-2.0-only OR BSD-2-Clause)
%YAML 1.2
---
$id: http://devicetree.org/schemas/net/intel,dwmac-plat.yaml#
$schema: http://devicetree.org/meta-schemas/core.yaml#

title: Intel DWMAC glue layer Device Tree Bindings

maintainers:
  - Vineetha G. Jaya Kumaran <vineetha.g.jaya.kumaran@intel.com>

select:
  properties:
    compatible:
      contains:
        enum:
          - intel,keembay-dwmac
  required:
    - compatible

allOf:
  - $ref: "snps,dwmac.yaml#"

properties:
  compatible:
    oneOf:
      - items:
          - enum:
              - intel,keembay-dwmac
          - const: snps,dwmac-4.10a

  clocks:
    items:
      - description: GMAC main clock
      - description: PTP reference clock
      - description: Tx clock

  clock-names:
    items:
      - const: stmmaceth
      - const: ptp_ref
      - const: tx_clk

required:
  - compatible
  - clocks
  - clock-names

unevaluatedProperties: false

examples:
# FIXME: Remove defines and include the correct header file
# once it is available in mainline.
  - |
    #include <dt-bindings/interrupt-controller/arm-gic.h>
    #include <dt-bindings/interrupt-controller/irq.h>
    #define MOVISOC_KMB_PSS_GBE
    #define MOVISOC_KMB_PSS_AUX_GBE_PTP
    #define MOVISOC_KMB_PSS_AUX_GBE_TX

    stmmac_axi_setup: stmmac-axi-config {
        snps,lpi_en;
        snps,wr_osr_lmt = <0x0>;
        snps,rd_osr_lmt = <0x2>;
        snps,blen = <0 0 0 0 16 8 4>;
    };

    mtl_rx_setup: rx-queues-config {
        snps,rx-queues-to-use = <2>;
        snps,rx-sched-sp;
        queue0 {
            snps,dcb-algorithm;
            snps,map-to-dma-channel = <0x0>;
            snps,priority = <0x0>;
        };

        queue1 {
            snps,dcb-algorithm;
            snps,map-to-dma-channel = <0x1>;
            snps,priority = <0x1>;
        };
    };

    mtl_tx_setup: tx-queues-config {
        snps,tx-queues-to-use = <2>;
        snps,tx-sched-wrr;
        queue0 {
           snps,weight = <0x10>;
           snps,dcb-algorithm;
           snps,priority = <0x0>;
        };

        queue1 {
            snps,weight = <0x10>;
            snps,dcb-algorithm;
            snps,priority = <0x1>;
        };
    };

    gmac0: ethernet@3a000000 {
        compatible = "intel,keembay-dwmac", "snps,dwmac-4.10a";
        interrupts = <GIC_SPI 119 IRQ_TYPE_LEVEL_HIGH>;
        interrupt-names = "macirq";
        reg = <0x3a000000 0x8000>;
        snps,perfect-filter-entries = <128>;
        phy-handle = <&eth_phy0>;
        phy-mode = "rgmii";
        rx-fifo-depth = <4096>;
        tx-fifo-depth = <4096>;
        clock-names = "stmmaceth", "ptp_ref", "tx_clk";
        clocks = <&scmi_clk MOVISOC_KMB_PSS_GBE>,
                 <&scmi_clk MOVISOC_KMB_PSS_AUX_GBE_PTP>,
                 <&scmi_clk MOVISOC_KMB_PSS_AUX_GBE_TX>;
        snps,pbl = <0x4>;
        snps,axi-config = <&stmmac_axi_setup>;
        snps,mtl-rx-config = <&mtl_rx_setup>;
        snps,mtl-tx-config = <&mtl_tx_setup>;
        snps,tso;

        mdio {
            #address-cells = <1>;
            #size-cells = <0>;
            compatible = "snps,dwmac-mdio";

            ethernet-phy@0 {
                reg = <0>;
            };
        };
    };

...
```

## Documentation/devicetree/bindings/net/intel,ixp46x-ptp-timer.yaml
```yaml
# SPDX-License-Identifier: (GPL-2.0 OR BSD-2-Clause)
# Copyright 2018 Linaro Ltd.
%YAML 1.2
---
$id: http://devicetree.org/schemas/net/intel,ixp46x-ptp-timer.yaml#
$schema: http://devicetree.org/meta-schemas/core.yaml#

title: Intel IXP46x PTP Timer (TSYNC)

maintainers:
  - Linus Walleij <linus.walleij@linaro.org>

description: |
  The Intel IXP46x PTP timer is known in the manual as IEEE1588 Hardware
  Assist and Time Synchronization Hardware Assist TSYNC provides a PTP
  timer. It exists in the Intel IXP45x and IXP46x XScale SoCs.

properties:
  compatible:
    const: intel,ixp46x-ptp-timer

  reg:
    maxItems: 1

  interrupts:
    items:
      - description: Interrupt to trigger master mode snapshot from the
          PRP timer, usually a GPIO interrupt.
      - description: Interrupt to trigger slave mode snapshot from the
          PRP timer, usually a GPIO interrupt.

  interrupt-names:
    items:
      - const: master
      - const: slave

required:
  - compatible
  - reg
  - interrupts
  - interrupt-names

additionalProperties: false

examples:
  - |
    #include <dt-bindings/interrupt-controller/irq.h>
    ptp-timer@c8010000 {
        compatible = "intel,ixp46x-ptp-timer";
        reg = <0xc8010000 0x1000>;
        interrupt-parent = <&gpio0>;
        interrupts = <8 IRQ_TYPE_EDGE_FALLING>, <7 IRQ_TYPE_EDGE_FALLING>;
        interrupt-names = "master", "slave";
    };
```

## Documentation/devicetree/bindings/net/intel,ixp4xx-ethernet.yaml
```yaml
# SPDX-License-Identifier: (GPL-2.0 OR BSD-2-Clause)
# Copyright 2018 Linaro Ltd.
%YAML 1.2
---
$id: "http://devicetree.org/schemas/net/intel,ixp4xx-ethernet.yaml#"
$schema: "http://devicetree.org/meta-schemas/core.yaml#"

title: Intel IXP4xx ethernet

allOf:
  - $ref: "ethernet-controller.yaml#"

maintainers:
  - Linus Walleij <linus.walleij@linaro.org>

description: |
  The Intel IXP4xx ethernet makes use of the IXP4xx NPE (Network
  Processing Engine) and the IXP4xx Queue Manager to process
  the ethernet frames. It can optionally contain an MDIO bus to
  talk to PHYs.

properties:
  compatible:
    const: intel,ixp4xx-ethernet

  reg:
    maxItems: 1
    description: Ethernet MMIO address range

  queue-rx:
    $ref: '/schemas/types.yaml#/definitions/phandle-array'
    maxItems: 1
    description: phandle to the RX queue on the NPE

  queue-txready:
    $ref: '/schemas/types.yaml#/definitions/phandle-array'
    maxItems: 1
    description: phandle to the TX READY queue on the NPE

  phy-mode: true

  phy-handle: true

  intel,npe-handle:
    $ref: '/schemas/types.yaml#/definitions/phandle-array'
    maxItems: 1
    description: phandle to the NPE this ethernet instance is using
      and the instance to use in the second cell

  mdio:
    type: object
    $ref: "mdio.yaml#"
    description: optional node for embedded MDIO controller

required:
  - compatible
  - reg
  - queue-rx
  - queue-txready
  - intel,npe-handle

additionalProperties: false

examples:
  - |
    npe: npe@c8006000 {
      compatible = "intel,ixp4xx-network-processing-engine";
      reg = <0xc8006000 0x1000>, <0xc8007000 0x1000>, <0xc8008000 0x1000>;
    };

    ethernet@c8009000 {
      compatible = "intel,ixp4xx-ethernet";
      reg = <0xc8009000 0x1000>;
      status = "disabled";
      queue-rx = <&qmgr 4>;
      queue-txready = <&qmgr 21>;
      intel,npe-handle = <&npe 1>;
      phy-mode = "rgmii";
      phy-handle = <&phy1>;
    };

    ethernet@c800c000 {
      compatible = "intel,ixp4xx-ethernet";
      reg = <0xc800c000 0x1000>;
      status = "disabled";
      queue-rx = <&qmgr 3>;
      queue-txready = <&qmgr 20>;
      intel,npe-handle = <&npe 2>;
      phy-mode = "rgmii";
      phy-handle = <&phy2>;

      mdio {
        #address-cells = <1>;
        #size-cells = <0>;
        phy1: ethernet-phy@1 {
          reg = <1>;
        };
        phy2: ethernet-phy@2 {
          reg = <2>;
        };
      };
    };
```

## Documentation/devicetree/bindings/net/intel,ixp4xx-hss.yaml
```yaml
# SPDX-License-Identifier: (GPL-2.0 OR BSD-2-Clause)
# Copyright 2021 Linaro Ltd.
%YAML 1.2
---
$id: http://devicetree.org/schemas/net/intel,ixp4xx-hss.yaml#
$schema: http://devicetree.org/meta-schemas/core.yaml#

title: Intel IXP4xx V.35 WAN High Speed Serial Link (HSS)

maintainers:
  - Linus Walleij <linus.walleij@linaro.org>

description: |
  The Intel IXP4xx HSS makes use of the IXP4xx NPE (Network
  Processing Engine) and the IXP4xx Queue Manager to process
  V.35 Wideband Modem (WAN) links.

properties:
  compatible:
    const: intel,ixp4xx-hss

  reg:
    maxItems: 1
    description: The HSS instance

  intel,npe-handle:
    $ref: /schemas/types.yaml#/definitions/phandle-array
    items:
      items:
        - description: phandle to the NPE this HSS instance is using
        - description: the NPE instance number
    description: phandle to the NPE this HSS instance is using
      and the instance to use in the second cell

  intel,queue-chl-rxtrig:
    $ref: /schemas/types.yaml#/definitions/phandle-array
    items:
      - items:
          - description: phandle to the RX trigger queue on the NPE
          - description: the queue instance number
    description: phandle to the RX trigger queue on the NPE

  intel,queue-chl-txready:
    $ref: /schemas/types.yaml#/definitions/phandle-array
    items:
      - items:
          - description: phandle to the TX ready queue on the NPE
          - description: the queue instance number
    description: phandle to the TX ready queue on the NPE

  intel,queue-pkt-rx:
    $ref: /schemas/types.yaml#/definitions/phandle-array
    items:
      - items:
          - description: phandle to the RX queue on the NPE
          - description: the queue instance number
    description: phandle to the packet RX queue on the NPE

  intel,queue-pkt-tx:
    $ref: /schemas/types.yaml#/definitions/phandle-array
    maxItems: 4
    items:
      items:
        - description: phandle to the TX queue on the NPE
        - description: the queue instance number
    description: phandle to the packet TX0, TX1, TX2 and TX3 queues on the NPE

  intel,queue-pkt-rxfree:
    $ref: /schemas/types.yaml#/definitions/phandle-array
    maxItems: 4
    items:
      items:
        - description: phandle to the RXFREE queue on the NPE
        - description: the queue instance number
    description: phandle to the packet RXFREE0, RXFREE1, RXFREE2 and
      RXFREE3 queues on the NPE

  intel,queue-pkt-txdone:
    $ref: /schemas/types.yaml#/definitions/phandle-array
    items:
      - items:
          - description: phandle to the TXDONE queue on the NPE
          - description: the queue instance number
    description: phandle to the packet TXDONE queue on the NPE

  cts-gpios:
    maxItems: 1
    description: Clear To Send (CTS) GPIO line

  rts-gpios:
    maxItems: 1
    description: Ready To Send (RTS) GPIO line

  dcd-gpios:
    maxItems: 1
    description: Data Carrier Detect (DCD) GPIO line

  dtr-gpios:
    maxItems: 1
    description: Data Terminal Ready (DTR) GPIO line

  clk-internal-gpios:
    maxItems: 1
    description: Clock internal GPIO line, driving this high will make the HSS
      use internal clocking as opposed to external clocking

required:
  - compatible
  - reg
  - intel,npe-handle
  - intel,queue-chl-rxtrig
  - intel,queue-chl-txready
  - intel,queue-pkt-rx
  - intel,queue-pkt-tx
  - intel,queue-pkt-rxfree
  - intel,queue-pkt-txdone
  - cts-gpios
  - rts-gpios
  - dcd-gpios
  - dtr-gpios
  - clk-internal-gpios

additionalProperties: false
```

## Documentation/devicetree/bindings/net/ipq806x-dwmac.txt
```
* IPQ806x DWMAC Ethernet controller

The device inherits all the properties of the dwmac/stmmac devices
described in the file net/stmmac.txt with the following changes.

Required properties:

- compatible: should be "qcom,ipq806x-gmac" along with "snps,dwmac"
	      and any applicable more detailed version number
	      described in net/stmmac.txt

- qcom,nss-common: should contain a phandle to a syscon device mapping the
		   nss-common registers.

- qcom,qsgmii-csr: should contain a phandle to a syscon device mapping the
		   qsgmii-csr registers.

Example:

	gmac: ethernet@37000000 {
		device_type = "network";
		compatible = "qcom,ipq806x-gmac";
		reg = <0x37000000 0x200000>;
		interrupts = <GIC_SPI 220 IRQ_TYPE_LEVEL_HIGH>;
		interrupt-names = "macirq";

		qcom,nss-common = <&nss_common>;
		qcom,qsgmii-csr = <&qsgmii_csr>;

		clocks = <&gcc GMAC_CORE1_CLK>;
		clock-names = "stmmaceth";

		resets = <&gcc GMAC_CORE1_RESET>;
		reset-names = "stmmaceth";
	};
```
