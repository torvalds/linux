## Documentation/devicetree/bindings/net/gpmc-eth.txt
```
Device tree bindings for Ethernet chip connected to TI GPMC

Besides being used to interface with external memory devices, the
General-Purpose Memory Controller can be used to connect Pseudo-SRAM devices
such as ethernet controllers to processors using the TI GPMC as a data bus.

Ethernet controllers connected to TI GPMC are represented as child nodes of
the GPMC controller with an "ethernet" name.

All timing relevant properties as well as generic GPMC child properties are
explained in a separate documents. Please refer to
Documentation/devicetree/bindings/memory-controllers/omap-gpmc.txt

For the properties relevant to the ethernet controller connected to the GPMC
refer to the binding documentation of the device. For example, the documentation
for the SMSC 911x is Documentation/devicetree/bindings/net/smsc,lan9115.yaml

Child nodes need to specify the GPMC bus address width using the "bank-width"
property but is possible that an ethernet controller also has a property to
specify the I/O registers address width. Even when the GPMC has a maximum 16-bit
address width, it supports devices with 32-bit word registers.
For example with an SMSC LAN911x/912x controller connected to the TI GPMC on an
OMAP2+ board, "bank-width = <2>;" and "reg-io-width = <4>;".

Required properties:
- bank-width: 		Address width of the device in bytes. GPMC supports 8-bit
			and 16-bit devices and so must be either 1 or 2 bytes.
- compatible:		Compatible string property for the ethernet child device.
- gpmc,cs-on-ns:	Chip-select assertion time
- gpmc,cs-rd-off-ns:	Chip-select de-assertion time for reads
- gpmc,cs-wr-off-ns:	Chip-select de-assertion time for writes
- gpmc,oe-on-ns:	Output-enable assertion time
- gpmc,oe-off-ns:	Output-enable de-assertion time
- gpmc,we-on-ns:	Write-enable assertion time
- gpmc,we-off-ns:	Write-enable de-assertion time
- gpmc,access-ns:	Start cycle to first data capture (read access)
- gpmc,rd-cycle-ns:	Total read cycle time
- gpmc,wr-cycle-ns:	Total write cycle time
- reg:			Chip-select, base address (relative to chip-select)
			and size of the memory mapped for the device.
			Note that base address will be typically 0 as this
			is the start of the chip-select.

Optional properties:
- gpmc,XXX		Additional GPMC timings and settings parameters. See
			Documentation/devicetree/bindings/memory-controllers/omap-gpmc.txt

Example:

gpmc: gpmc@6e000000 {
	compatible = "ti,omap3430-gpmc";
	ti,hwmods = "gpmc";
	reg = <0x6e000000 0x1000>;
	interrupts = <20>;
	gpmc,num-cs = <8>;
	gpmc,num-waitpins = <4>;
	#address-cells = <2>;
	#size-cells = <1>;

	ranges = <5 0 0x2c000000 0x1000000>;

	ethernet@5,0 {
		compatible = "smsc,lan9221", "smsc,lan9115";
		reg = <5 0 0xff>;
		bank-width = <2>;

		gpmc,mux-add-data;
		gpmc,cs-on-ns = <0>;
		gpmc,cs-rd-off-ns = <186>;
		gpmc,cs-wr-off-ns = <186>;
		gpmc,adv-on-ns = <12>;
		gpmc,adv-rd-off-ns = <48>;
		gpmc,adv-wr-off-ns = <48>;
		gpmc,oe-on-ns = <54>;
		gpmc,oe-off-ns = <168>;
		gpmc,we-on-ns = <54>;
		gpmc,we-off-ns = <168>;
		gpmc,rd-cycle-ns = <186>;
		gpmc,wr-cycle-ns = <186>;
		gpmc,access-ns = <114>;
		gpmc,page-burst-access-ns = <6>;
		gpmc,bus-turnaround-ns = <12>;
		gpmc,cycle2cycle-delay-ns = <18>;
		gpmc,wr-data-mux-bus-ns = <90>;
		gpmc,wr-access-ns = <186>;
		gpmc,cycle2cycle-samecsen;
		gpmc,cycle2cycle-diffcsen;

		interrupt-parent = <&gpio6>;
		interrupts = <16>;
		vmmc-supply = <&vddvario>;
		vmmc_aux-supply = <&vdd33a>;
		reg-io-width = <4>;

		smsc,save-mac-address;
	};
};
```

## Documentation/devicetree/bindings/net/hisilicon-femac-mdio.txt
```
Hisilicon Fast Ethernet MDIO Controller interface

Required properties:
- compatible: should be "hisilicon,hisi-femac-mdio".
- reg: address and length of the register set for the device.
- clocks: A phandle to the reference clock for this device.

- PHY subnode: inherits from phy binding [1]
[1] Documentation/devicetree/bindings/net/phy.txt

Example:
mdio: mdio@10091100 {
	compatible = "hisilicon,hisi-femac-mdio";
	reg = <0x10091100 0x10>;
	clocks = <&crg HI3516CV300_MDIO_CLK>;
	#address-cells = <1>;
	#size-cells = <0>;

	phy0: phy@1 {
		reg = <1>;
	};
};
```

## Documentation/devicetree/bindings/net/hisilicon-femac.txt
```
Hisilicon Fast Ethernet MAC controller

Required properties:
- compatible: should contain one of the following version strings:
	* "hisilicon,hisi-femac-v1"
	* "hisilicon,hisi-femac-v2"
	and the soc string "hisilicon,hi3516cv300-femac".
- reg: specifies base physical address(s) and size of the device registers.
  The first region is the MAC core register base and size.
  The second region is the global MAC control register.
- interrupts: should contain the MAC interrupt.
- clocks: A phandle to the MAC main clock.
- resets: should contain the phandle to the MAC reset signal(required) and
	the PHY reset signal(optional).
- reset-names: should contain the reset signal name "mac"(required)
	and "phy"(optional).
- phy-mode: see ethernet.txt [1].
- phy-handle: see ethernet.txt [1].
- hisilicon,phy-reset-delays-us: triplet of delays if PHY reset signal given.
	The 1st cell is reset pre-delay in micro seconds.
	The 2nd cell is reset pulse in micro seconds.
	The 3rd cell is reset post-delay in micro seconds.

The MAC address will be determined using the optional properties
defined in ethernet.txt[1].

[1] Documentation/devicetree/bindings/net/ethernet.txt

Example:
	hisi_femac: ethernet@10090000 {
		compatible = "hisilicon,hi3516cv300-femac","hisilicon,hisi-femac-v2";
		reg = <0x10090000 0x1000>,<0x10091300 0x200>;
		interrupts = <12>;
		clocks = <&crg HI3518EV200_ETH_CLK>;
		resets = <&crg 0xec 0>,<&crg 0xec 3>;
		reset-names = "mac","phy";
		mac-address = [00 00 00 00 00 00];
		phy-mode = "mii";
		phy-handle = <&phy0>;
		hisilicon,phy-reset-delays-us = <10000 20000 20000>;
	};
```

## Documentation/devicetree/bindings/net/hisilicon-hip04-net.txt
```
Hisilicon hip04 Ethernet Controller

* Ethernet controller node

Required properties:
- compatible: should be "hisilicon,hip04-mac".
- reg: address and length of the register set for the device.
- interrupts: interrupt for the device.
- port-handle: <phandle port channel>
	phandle, specifies a reference to the syscon ppe node
	port, port number connected to the controller
	channel, recv channel start from channel * number (RX_DESC_NUM)
	group, field in the pkg desc, in general, it is the same as the port.
- phy-mode: see ethernet.txt [1].

Optional properties:
- phy-handle: see ethernet.txt [1].

[1] Documentation/devicetree/bindings/net/ethernet.txt


* MDIO bus node:

Required properties:

- compatible: should be "hisilicon,mdio".
- Inherits from MDIO bus node binding [2]
[2] Documentation/devicetree/bindings/net/phy.txt

Example:
	mdio {
		compatible = "hisilicon,mdio";
		reg = <0x28f1000 0x1000>;
		#address-cells = <1>;
		#size-cells = <0>;

		phy0: ethernet-phy@0 {
			compatible = "ethernet-phy-ieee802.3-c22";
			reg = <0>;
			marvell,reg-init = <18 0x14 0 0x8001>;
		};

		phy1: ethernet-phy@1 {
			compatible = "ethernet-phy-ieee802.3-c22";
			reg = <1>;
			marvell,reg-init = <18 0x14 0 0x8001>;
		};
	};

	ppe: ppe@28c0000 {
		compatible = "hisilicon,hip04-ppe", "syscon";
		reg = <0x28c0000 0x10000>;
	};

	fe: ethernet@28b0000 {
		compatible = "hisilicon,hip04-mac";
		reg = <0x28b0000 0x10000>;
		interrupts = <0 413 4>;
		phy-mode = "mii";
		port-handle = <&ppe 31 0 31>;
	};

	ge0: ethernet@2800000 {
		compatible = "hisilicon,hip04-mac";
		reg = <0x2800000 0x10000>;
		interrupts = <0 402 4>;
		phy-mode = "sgmii";
		port-handle = <&ppe 0 1 0>;
		phy-handle = <&phy0>;
	};

	ge8: ethernet@2880000 {
		compatible = "hisilicon,hip04-mac";
		reg = <0x2880000 0x10000>;
		interrupts = <0 410 4>;
		phy-mode = "sgmii";
		port-handle = <&ppe 8 2 8>;
		phy-handle = <&phy1>;
	};
```

## Documentation/devicetree/bindings/net/hisilicon-hix5hd2-gmac.txt
```
Hisilicon hix5hd2 gmac controller

Required properties:
- compatible: should contain one of the following SoC strings:
	* "hisilicon,hix5hd2-gmac"
	* "hisilicon,hi3798cv200-gmac"
	* "hisilicon,hi3516a-gmac"
	and one of the following version string:
	* "hisilicon,hisi-gmac-v1"
	* "hisilicon,hisi-gmac-v2"
  The version v1 includes SoCs hix5hd2.
  The version v2 includes SoCs hi3798cv200, hi3516a.
- reg: specifies base physical address(s) and size of the device registers.
  The first region is the MAC register base and size.
  The second region is external interface control register.
- interrupts: should contain the MAC interrupt.
- #address-cells: must be <1>.
- #size-cells: must be <0>.
- phy-mode: see ethernet.txt [1].
- phy-handle: see ethernet.txt [1].
- clocks: clock phandle and specifier pair.
- clock-names: contain the clock name "mac_core"(required) and "mac_ifc"(optional).
- resets: should contain the phandle to the MAC core reset signal(optional),
	the MAC interface reset signal(optional)
	and the PHY reset signal(optional).
- reset-names: contain the reset signal name "mac_core"(optional),
	"mac_ifc"(optional) and "phy"(optional).
- hisilicon,phy-reset-delays-us: triplet of delays if PHY reset signal given.
	The 1st cell is reset pre-delay in micro seconds.
	The 2nd cell is reset pulse in micro seconds.
	The 3rd cell is reset post-delay in micro seconds.

The MAC address will be determined using the properties defined in
ethernet.txt[1].

- PHY subnode: inherits from phy binding [2]

[1] Documentation/devicetree/bindings/net/ethernet.txt
[2] Documentation/devicetree/bindings/net/phy.txt

Example:
	gmac0: ethernet@f9840000 {
		compatible = "hisilicon,hi3798cv200-gmac", "hisilicon,hisi-gmac-v2";
		reg = <0xf9840000 0x1000>,<0xf984300c 0x4>;
		interrupts = <0 71 4>;
		#address-cells = <1>;
		#size-cells = <0>;
		phy-mode = "rgmii";
		phy-handle = <&phy2>;
		mac-address = [00 00 00 00 00 00];
		clocks = <&crg HISTB_ETH0_MAC_CLK>, <&crg HISTB_ETH0_MACIF_CLK>;
		clock-names = "mac_core", "mac_ifc";
		resets = <&crg 0xcc 8>, <&crg 0xcc 10>, <&crg 0xcc 12>;
		reset-names = "mac_core", "mac_ifc", "phy";
		hisilicon,phy-reset-delays-us = <10000 10000 30000>;

		phy2: ethernet-phy@2 {
			reg = <2>;
		};
	};
```

## Documentation/devicetree/bindings/net/hisilicon-hns-dsaf.txt
```
Hisilicon DSA Fabric device controller

Required properties:
- compatible: should be "hisilicon,hns-dsaf-v1" or "hisilicon,hns-dsaf-v2".
  "hisilicon,hns-dsaf-v1" is for hip05.
  "hisilicon,hns-dsaf-v2" is for Hi1610 and Hi1612.
- mode: dsa fabric mode string. only support one of dsaf modes like these:
		"2port-64vf",
		"6port-16rss",
		"6port-16vf",
		"single-port".
- interrupt-parent: the interrupt parent of this device.
- interrupts: should contain the DSA Fabric and rcb interrupt.
- reg: specifies base physical address(es) and size of the device registers.
  The first region is external interface control register base and size(optional,
  only used when subctrl-syscon does not exist). It is recommended using
  subctrl-syscon rather than this address.
  The second region is SerDes base register and size(optional, only used when
  serdes-syscon in port node does not exist). It is recommended using
  serdes-syscon rather than this address.
  The third region is the PPE register base and size.
  The fourth region is dsa fabric base register and size. It is not required for
  single-port mode.
- reg-names: may be ppe-base and(or) dsaf-base. It is used to find the
  corresponding reg's index.

- phy-handle: phy handle of physical port, 0 if not any phy device. It is optional
  attribute. If port node exists, phy-handle in each port node will be used.
  see ethernet.txt [1].
- subctrl-syscon: is syscon handle for external interface control register.
- reset-field-offset: is offset of reset field. Its value depends on the hardware
  user manual.
- buf-size: rx buffer size, should be 16-1024.
- desc-num: number of description in TX and RX queue, should be 512, 1024, 2048 or 4096.

- port: subnodes of dsaf. A dsaf node may contain several port nodes(Depending
  on mode of dsaf). Port node contain some attributes listed below:
- reg: is physical port index in one dsaf.
- phy-handle: phy handle of physical port. It is not required if there isn't
  phy device. see ethernet.txt [1].
- serdes-syscon: is syscon handle for SerDes register.
- cpld-syscon: is syscon handle + register offset pair for cpld register. It is
  not required if there isn't cpld device.
- port-rst-offset: is offset of reset field for each port in dsaf. Its value
  depends on the hardware user manual.
- port-mode-offset: is offset of port mode field for each port in dsaf. Its
  value depends on the hardware user manual.

[1] Documentation/devicetree/bindings/net/phy.txt

Example:

dsaf0: dsa@c7000000 {
	compatible = "hisilicon,hns-dsaf-v1";
	mode = "6port-16rss";
	interrupt-parent = <&mbigen_dsa>;
	reg = <0x0 0xc5000000 0x0 0x890000
	       0x0 0xc7000000 0x0 0x60000>;
	reg-names = "ppe-base", "dsaf-base";
	subctrl-syscon = <&subctrl>;
	reset-field-offset = 0;
	interrupts = <131 4>,<132 4>, <133 4>,<134 4>,
		     <135 4>,<136 4>, <137 4>,<138 4>,
		     <139 4>,<140 4>, <141 4>,<142 4>,
		     <143 4>,<144 4>, <145 4>,<146 4>,
		     <147 4>,<148 4>, <384 1>,<385 1>,
		     <386 1>,<387 1>, <388 1>,<389 1>,
		     <390 1>,<391 1>,
	buf-size = <4096>;
	desc-num = <1024>;
	dma-coherent;

	port@0 {
		reg = 0;
		phy-handle = <&phy0>;
		serdes-syscon = <&serdes>;
	};

	port@1 {
                reg = 1;
                serdes-syscon = <&serdes>;
        };
};
```

## Documentation/devicetree/bindings/net/hisilicon-hns-mdio.txt
```
Hisilicon MDIO bus controller

Properties:
- compatible: can be one of:
	"hisilicon,hns-mdio"
	"hisilicon,mdio"
  "hisilicon,hns-mdio" is recommended to be used for hip05 and later SOCs,
  while "hisilicon,mdio" is optional for backwards compatibility only on
  hip04 Soc.
- reg: The base address of the MDIO bus controller register bank.
- #address-cells: Must be <1>.
- #size-cells: Must be <0>.  MDIO addresses have no size component.

Typically an MDIO bus might have several children.

Example:
         mdio@803c0000 {
                   #address-cells = <1>;
                   #size-cells = <0>;
                   compatible = "hisilicon,hns-mdio","hisilicon,mdio";
                   reg = <0x0 0x803c0000 0x0 0x10000>;

                   ethernet-phy@0 {
                            ...
                            reg = <0>;
                   };
         };
```
