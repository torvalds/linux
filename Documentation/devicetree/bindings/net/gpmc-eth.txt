## Documentation/devicetree/bindings/net/hisilicon-hns-nic.txt
```
Hisilicon Network Subsystem NIC controller

Required properties:
- compatible: "hisilicon,hns-nic-v1" or "hisilicon,hns-nic-v2".
  "hisilicon,hns-nic-v1" is for hip05.
  "hisilicon,hns-nic-v2" is for Hi1610 and Hi1612.
- ae-handle: accelerator engine handle for hns,
  specifies a reference to the associating hardware driver node.
  see Documentation/devicetree/bindings/net/hisilicon-hns-dsaf.txt
- port-id: is the index of port provided by DSAF (the accelerator). DSAF can
  connect to 8 PHYs. Port 0 to 1 are both used for administration purpose. They
  are called debug ports.

  The remaining 6 PHYs are taken according to the mode of DSAF.

  In NIC mode of DSAF, all 6 PHYs are taken as ethernet ports to the CPU. The
  port-id can be 2 to 7. Here is the diagram:
            +-----+---------------+
            |            CPU      |
            +-+-+-+---+-+-+-+-+-+-+
              | |     | | | | | |
             debug       service
             port         port
             (0,1)       (2-7)

  In Switch mode of DSAF, all 6 PHYs are taken as physical ports connect to a
  LAN Switch while the CPU side assume itself have one single NIC connect to
  this switch. In this case, the port-id will be 2 only.
            +-----+---------------+
            |            CPU      |
            +-+-+-+---+-+-+-+-+-+-+
              | |   service| port(2)
             debug   +------------+
             port    |   switch   |
             (0,1)   +-+-+-+-+-+-++
                       | | | | | |
                      external port

  This attribute is remained for compatible purpose. It is not recommended to
  use it in new code.

- port-idx-in-ae: is the index of port provided by AE.
  In NIC mode of DSAF, all 6 PHYs of service DSAF are taken as ethernet ports
  to the CPU. The port-idx-in-ae can be 0 to 5. Here is the diagram:
            +-----+---------------+
            |            CPU      |
            +-+-+-+---+-+-+-+-+-+-+
              |    |   | | | | | |
           debug debug   service
           port  port     port
           (0)   (0)     (0-5)

  In Switch mode of DSAF, all 6 PHYs of service DSAF are taken as physical
  ports connected to a LAN Switch while the CPU side assume itself have one
  single NIC connected to this switch. In this case, the port-idx-in-ae
  will be 0 only.
            +-----+-----+------+------+
            |                CPU      |
            +-+-+-+-+-+-+-+-+-+-+-+-+-+
              |    |     service| port(0)
            debug debug  +------------+
            port  port   |   switch   |
            (0)   (0)    +-+-+-+-+-+-++
                          | | | | | |
                         external port

- local-mac-address: mac addr of the ethernet interface

Example:

	ethernet@0{
		compatible = "hisilicon,hns-nic-v1";
		ae-handle = <&dsaf0>;
		port-idx-in-ae = <0>;
		local-mac-address = [a2 14 e4 4b 56 76];
	};
```

## Documentation/devicetree/bindings/net/icplus-ip101ag.txt
```
IC Plus Corp. IP101A / IP101G Ethernet PHYs

There are different models of the IP101G Ethernet PHY:
- IP101GR (32-pin QFN package)
- IP101G (die only, no package)
- IP101GA (48-pin LQFP package)

There are different models of the IP101A Ethernet PHY (which is the
predecessor of the IP101G):
- IP101A (48-pin LQFP package)
- IP101AH (48-pin LQFP package)

Optional properties for the IP101GR (32-pin QFN package):

- icplus,select-rx-error:
  pin 21 ("RXER/INTR_32") will output the receive error status.
  interrupts are not routed outside the PHY in this mode.
- icplus,select-interrupt:
  pin 21 ("RXER/INTR_32") will output the interrupt signal.
```

## Documentation/devicetree/bindings/net/idt,3243x-emac.yaml
```yaml
# SPDX-License-Identifier: GPL-2.0-only OR BSD-2-Clause
%YAML 1.2
---
$id: http://devicetree.org/schemas/net/idt,3243x-emac.yaml#
$schema: http://devicetree.org/meta-schemas/core.yaml#

title: IDT 79rc3243x Ethernet controller

description: Ethernet controller integrated into IDT 79RC3243x family SoCs

maintainers:
  - Thomas Bogendoerfer <tsbogend@alpha.franken.de>

allOf:
  - $ref: ethernet-controller.yaml#

properties:
  compatible:
    const: idt,3243x-emac

  reg:
    maxItems: 3

  reg-names:
    items:
      - const: emac
      - const: dma_rx
      - const: dma_tx

  interrupts:
    items:
      - description: RX interrupt
      - description: TX interrupt

  interrupt-names:
    items:
      - const: rx
      - const: tx

  clocks:
    maxItems: 1

  clock-names:
    items:
      - const: mdioclk

required:
  - compatible
  - reg
  - reg-names
  - interrupts
  - interrupt-names

additionalProperties: false

examples:
  - |

    ethernet@60000 {
        compatible = "idt,3243x-emac";

        reg = <0x60000 0x10000>,
              <0x40000 0x14>,
              <0x40014 0x14>;
        reg-names = "emac", "dma_rx", "dma_tx";

        interrupt-parent = <&rcpic3>;
        interrupts = <0>, <1>;
        interrupt-names = "rx", "tx";

        clocks = <&iclk>;
        clock-names = "mdioclk";
    };
```

## Documentation/devicetree/bindings/net/ieee802154/adf7242.txt
```
* ADF7242 IEEE 802.15.4 *

Required properties:
  - compatible:		should be "adi,adf7242", "adi,adf7241"
  - spi-max-frequency:	maximal bus speed (12.5 MHz)
  - reg:		the chipselect index
  - interrupts:		the interrupt generated by the device via pin IRQ1.
			IRQ_TYPE_LEVEL_HIGH (4) or IRQ_TYPE_EDGE_FALLING (1)

Example:

	adf7242@0 {
		compatible = "adi,adf7242";
		spi-max-frequency = <10000000>;
		reg = <0>;
		interrupts = <98 IRQ_TYPE_LEVEL_HIGH>;
		interrupt-parent = <&gpio3>;
	};
```

## Documentation/devicetree/bindings/net/ieee802154/at86rf230.txt
```
* AT86RF230 IEEE 802.15.4 *

Required properties:
  - compatible:		should be "atmel,at86rf230", "atmel,at86rf231",
			"atmel,at86rf233" or "atmel,at86rf212"
  - spi-max-frequency:	maximal bus speed, should be set to 7500000 depends
			sync or async operation mode
  - reg:		the chipselect index
  - interrupts:		the interrupt generated by the device. Non high-level
			can occur deadlocks while handling isr.

Optional properties:
  - reset-gpio:		GPIO spec for the rstn pin
  - sleep-gpio:		GPIO spec for the slp_tr pin
  - xtal-trim:		u8 value for fine tuning the internal capacitance
			arrays of xtal pins: 0 = +0 pF, 0xf = +4.5 pF

Example:

	at86rf231@0 {
		compatible = "atmel,at86rf231";
		spi-max-frequency = <7500000>;
		reg = <0>;
		interrupts = <19 4>;
		interrupt-parent = <&gpio3>;
		xtal-trim = /bits/ 8 <0x06>;
	};
```

## Documentation/devicetree/bindings/net/ieee802154/atmel,at86rf233.yaml
```yaml
# SPDX-License-Identifier: (GPL-2.0-only OR BSD-2-Clause)
%YAML 1.2
---
$id: http://devicetree.org/schemas/net/ieee802154/atmel,at86rf233.yaml#
$schema: http://devicetree.org/meta-schemas/core.yaml#

title: AT86RF230 IEEE 802.15.4

maintainers:
  - Frank Li <Frank.Li@nxp.com>

properties:
  compatible:
    enum:
      - atmel,at86rf212
      - atmel,at86rf230
      - atmel,at86rf231
      - atmel,at86rf233

  reg:
    maxItems: 1

  interrupts:
    maxItems: 1

  reset-gpio:
    maxItems: 1

  sleep-gpio:
    maxItems: 1

  spi-max-frequency:
    maximum: 7500000

  xtal-trim:
    $ref: /schemas/types.yaml#/definitions/uint8
    maximum: 0xf
    description: |
      Fine tuning the internal capacitance arrays of xtal pins:
        0 = +0 pF, 0xf = +4.5 pF

required:
  - compatible
  - reg
  - interrupts

allOf:
  - $ref: /schemas/spi/spi-peripheral-props.yaml#

unevaluatedProperties: false

examples:
  - |
    spi {
        #address-cells = <1>;
        #size-cells = <0>;

        zigbee@0 {
            compatible = "atmel,at86rf231";
            reg = <0>;
            spi-max-frequency = <7500000>;
            interrupts = <19 4>;
            interrupt-parent = <&gpio3>;
            xtal-trim = /bits/ 8 <0x06>;
        };
    };
```

## Documentation/devicetree/bindings/net/ieee802154/ca8210.txt
```
* CA8210 IEEE 802.15.4 *

Required properties:
	- compatible:           Should be "cascoda,ca8210"
	- reg:                  Controlling chip select
	- spi-max-frequency:    Maximum clock speed, should be *less than*
	                        4000000
	- spi-cpol:             Requires inverted clock polarity
	- reset-gpio:           GPIO attached to reset
	- irq-gpio:             GPIO attached to IRQ
Optional properties:
	- extclock-enable:      Include for the ca8210 to route its 16MHz clock
	                        to an output
	- extclock-freq:        Frequency in Hz of the external clock
	- extclock-gpio:        GPIO of the ca8210 to output the clock on

Example:
	ca8210@0 {
		compatible = "cascoda,ca8210";
		reg = <0>;
		spi-max-frequency = <3000000>;
		spi-cpol;
		reset-gpio = <&gpio1 1 GPIO_ACTIVE_LOW>;
		irq-gpio = <&gpio1 2 GPIO_ACTIVE_HIGH>;
		extclock-enable;
		extclock-freq = 16000000;
		extclock-gpio = 2;
	};
```

## Documentation/devicetree/bindings/net/ieee802154/cc2520.txt
```
*CC2520 IEEE 802.15.4 Compatible Radio*

Required properties:
	- compatible: 		should be "ti,cc2520"
	- spi-max-frequency:	maximal bus speed (8000000), should be set to 4000000 depends
				sync or async operation mode
	- reg:			the chipselect index
	- pinctrl-0: 		pin control group to be used for this controller.
	- pinctrl-names: 	must contain a "default" entry.
	- fifo-gpio:		GPIO spec for the FIFO pin
	- fifop-gpio:		GPIO spec for the FIFOP pin
	- sfd-gpio:		GPIO spec for the SFD pin
	- cca-gpio:		GPIO spec for the CCA pin
	- vreg-gpio:		GPIO spec for the VREG pin
	- reset-gpio:		GPIO spec for the RESET pin
Optional properties:
	- amplified:		include if the CC2520 is connected to a CC2591 amplifier

Example:
	cc2520@0 {
		compatible = "ti,cc2520";
		reg = <0>;
		spi-max-frequency = <4000000>;
		amplified;
		pinctrl-names = "default";
		pinctrl-0 = <&cc2520_cape_pins>;
		fifo-gpio = <&gpio1 18 0>;
		fifop-gpio = <&gpio1 19 0>;
		sfd-gpio = <&gpio1 13 0>;
		cca-gpio = <&gpio1 16 0>;
		vreg-gpio = <&gpio0 31 0>;
		reset-gpio = <&gpio1 12 0>;
	};
```

## Documentation/devicetree/bindings/net/ieee802154/mcr20a.txt
```
* MCR20A IEEE 802.15.4 *

Required properties:
  - compatible:		should be "nxp,mcr20a"
  - spi-max-frequency:	maximal bus speed, should be set to a frequency
			lower than 9000000 depends sync or async operation mode
  - reg:		the chipselect index
  - interrupts:		the interrupt generated by the device. Non high-level
			can occur deadlocks while handling isr.

Optional properties:
  - rst_b-gpio:		GPIO spec for the RST_B pin

Example:

	mcr20a@0 {
		compatible = "nxp,mcr20a";
		spi-max-frequency = <9000000>;
		reg = <0>;
		interrupts = <17 2>;
		interrupt-parent = <&gpio>;
		rst_b-gpio = <&gpio 27 1>
	};
```

## Documentation/devicetree/bindings/net/ieee802154/mrf24j40.txt
```
* MRF24J40 IEEE 802.15.4 *

Required properties:
  - compatible:		should be "microchip,mrf24j40", "microchip,mrf24j40ma",
			or "microchip,mrf24j40mc" depends on your transceiver
			board
  - spi-max-frequency:	maximal bus speed, should be set something under or equal
			10000000
  - reg:		the chipselect index
  - interrupts:		the interrupt generated by the device.

Example:

	mrf24j40ma@0 {
		compatible = "microchip,mrf24j40ma";
		spi-max-frequency = <8500000>;
		reg = <0>;
		interrupts = <19 8>;
		interrupt-parent = <&gpio3>;
	};
```

## Documentation/devicetree/bindings/net/imx-dwmac.txt
```
IMX8 glue layer controller, NXP imx8 families support Synopsys MAC 5.10a IP.

This file documents platform glue layer for IMX.
Please see stmmac.txt for the other unchanged properties.

The device node has following properties.

Required properties:
- compatible:  Should be "nxp,imx8mp-dwmac-eqos" to select glue layer
	       and "snps,dwmac-5.10a" to select IP version.
- clocks: Must contain a phandle for each entry in clock-names.
- clock-names: Should be "stmmaceth" for the host clock.
	       Should be "pclk" for the MAC apb clock.
	       Should be "ptp_ref" for the MAC timer clock.
	       Should be "tx" for the MAC RGMII TX clock:
	       Should be "mem" for EQOS MEM clock.
		- "mem" clock is required for imx8dxl platform.
		- "mem" clock is not required for imx8mp platform.
- interrupt-names: Should contain a list of interrupt names corresponding to
		   the interrupts in the interrupts property, if available.
		   Should be "macirq" for the main MAC IRQ
		   Should be "eth_wake_irq" for the IT which wake up system
- intf_mode: Should be phandle/offset pair. The phandle to the syscon node which
	     encompases the GPR register, and the offset of the GPR register.
		- required for imx8mp platform.
		- is optional for imx8dxl platform.

Optional properties:
- intf_mode: is optional for imx8dxl platform.
- snps,rmii_refclk_ext: to select RMII reference clock from external.

Example:
	eqos: ethernet@30bf0000 {
		compatible = "nxp,imx8mp-dwmac-eqos", "snps,dwmac-5.10a";
		reg = <0x30bf0000 0x10000>;
		interrupts = <GIC_SPI 134 IRQ_TYPE_LEVEL_HIGH>,
			     <GIC_SPI 135 IRQ_TYPE_LEVEL_HIGH>;
		interrupt-names = "eth_wake_irq", "macirq";
		clocks = <&clk IMX8MP_CLK_ENET_QOS_ROOT>,
			 <&clk IMX8MP_CLK_QOS_ENET_ROOT>,
			 <&clk IMX8MP_CLK_ENET_QOS_TIMER>,
			 <&clk IMX8MP_CLK_ENET_QOS>;
		clock-names = "stmmaceth", "pclk", "ptp_ref", "tx";
		assigned-clocks = <&clk IMX8MP_CLK_ENET_AXI>,
				  <&clk IMX8MP_CLK_ENET_QOS_TIMER>,
				  <&clk IMX8MP_CLK_ENET_QOS>;
		assigned-clock-parents = <&clk IMX8MP_SYS_PLL1_266M>,
					 <&clk IMX8MP_SYS_PLL2_100M>,
					 <&clk IMX8MP_SYS_PLL2_125M>;
		assigned-clock-rates = <0>, <100000000>, <125000000>;
		nvmem-cells = <&eth_mac0>;
		nvmem-cell-names = "mac-address";
		nvmem_macaddr_swap;
		intf_mode = <&gpr 0x4>;
		status = "disabled";
	};
```

## Documentation/devicetree/bindings/net/ingenic,mac.yaml
```yaml
# SPDX-License-Identifier: (GPL-2.0-only OR BSD-2-Clause)
%YAML 1.2
---
$id: http://devicetree.org/schemas/net/ingenic,mac.yaml#
$schema: http://devicetree.org/meta-schemas/core.yaml#

title: MAC in Ingenic SoCs

maintainers:
  - 周琰杰 (Zhou Yanjie) <zhouyanjie@wanyeetech.com>

description:
  The Ethernet Media Access Controller in Ingenic SoCs.

properties:
  compatible:
    enum:
      - ingenic,jz4775-mac
      - ingenic,x1000-mac
      - ingenic,x1600-mac
      - ingenic,x1830-mac
      - ingenic,x2000-mac

  reg:
    maxItems: 1

  interrupts:
    maxItems: 1

  interrupt-names:
    const: macirq

  clocks:
    maxItems: 1

  clock-names:
    const: stmmaceth

  mode-reg:
    $ref: /schemas/types.yaml#/definitions/phandle
    description: An extra syscon register that control ethernet interface and timing delay

  rx-clk-delay-ps:
    description: RGMII receive clock delay defined in pico seconds

  tx-clk-delay-ps:
    description: RGMII transmit clock delay defined in pico seconds

required:
  - compatible
  - reg
  - interrupts
  - interrupt-names
  - clocks
  - clock-names
  - mode-reg

additionalProperties: false

examples:
  - |
    #include <dt-bindings/clock/ingenic,x1000-cgu.h>

    mac: ethernet@134b0000 {
        compatible = "ingenic,x1000-mac";
        reg = <0x134b0000 0x2000>;

        interrupt-parent = <&intc>;
        interrupts = <55>;
        interrupt-names = "macirq";

        clocks = <&cgu X1000_CLK_MAC>;
        clock-names = "stmmaceth";

        mode-reg = <&mac_phy_ctrl>;
    };
...
```
