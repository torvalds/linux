## Documentation/devicetree/bindings/net/loongson,ls1c-emac.yaml
```yaml
# SPDX-License-Identifier: (GPL-2.0-only OR BSD-2-Clause)
%YAML 1.2
---
$id: http://devicetree.org/schemas/net/loongson,ls1c-emac.yaml#
$schema: http://devicetree.org/meta-schemas/core.yaml#

title: Loongson-1C Ethernet MAC Controller

maintainers:
  - Keguang Zhang <keguang.zhang@gmail.com>

description: |
  Loongson-1C Ethernet MAC Controller is based on
  Synopsys DesignWare MAC (version 3.50a).

  Main features
  - 10/100Mbps
  - Full-duplex operation (IEEE 802.3x flow control automatic transmission)
  - Half-duplex operation (CSMA/CD Protocol and back-pressure support)
  - IEEE 802.1Q VLAN tag detection for reception frames
  - MII interface
  - RMII interface

select:
  properties:
    compatible:
      contains:
        enum:
          - loongson,ls1c-emac
  required:
    - compatible

properties:
  compatible:
    items:
      - enum:
          - loongson,ls1c-emac
      - const: snps,dwmac-3.50a

  reg:
    maxItems: 1

  clocks:
    maxItems: 1

  clock-names:
    items:
      - const: stmmaceth

  interrupts:
    maxItems: 1

  interrupt-names:
    items:
      - const: macirq

  loongson,ls1-syscon:
    $ref: /schemas/types.yaml#/definitions/phandle
    description:
      Phandle to the syscon containing some extra configurations
      including PHY interface mode.

  phy-mode:
    enum:
      - mii
      - rmii

required:
  - compatible
  - reg
  - clocks
  - clock-names
  - interrupts
  - interrupt-names
  - loongson,ls1-syscon

allOf:
  - $ref: snps,dwmac.yaml#

unevaluatedProperties: false

examples:
  - |
    #include <dt-bindings/clock/loongson,ls1x-clk.h>
    #include <dt-bindings/interrupt-controller/irq.h>

    emac: ethernet@1fe10000 {
        compatible = "loongson,ls1c-emac", "snps,dwmac-3.50a";
        reg = <0x1fe10000 0x10000>;

        clocks = <&clkc LS1X_CLKID_AHB>;
        clock-names = "stmmaceth";

        interrupt-parent = <&intc1>;
        interrupts = <2 IRQ_TYPE_LEVEL_HIGH>;
        interrupt-names = "macirq";

        loongson,ls1-syscon = <&syscon>;

        phy-handle = <&phy0>;
        phy-mode = "mii";
        snps,pbl = <1>;

        mdio {
            #address-cells = <1>;
            #size-cells = <0>;
            compatible = "snps,dwmac-mdio";

            phy0: ethernet-phy@13 {
                reg = <0x13>;
            };
        };
    };
```

## Documentation/devicetree/bindings/net/lpc-eth.txt
```
* NXP LPC32xx SoC Ethernet Controller

Required properties:
- compatible: Should be "nxp,lpc-eth"
- reg: Address and length of the register set for the device
- interrupts: Should contain ethernet controller interrupt

Optional properties:
- phy-mode: See ethernet.txt file in the same directory. If the property is
  absent, "rmii" is assumed.
- use-iram: Use LPC32xx internal SRAM (IRAM) for DMA buffering

Example:

	mac: ethernet@31060000 {
		compatible = "nxp,lpc-eth";
		reg = <0x31060000 0x1000>;
		interrupt-parent = <&mic>;
		interrupts = <29 0>;

		phy-mode = "rmii";
		use-iram;
	};
```

## Documentation/devicetree/bindings/net/macb.txt
```
* Cadence MACB/GEM Ethernet controller

Required properties:
- compatible: Should be "cdns,[<chip>-]{macb|gem}"
  Use "cdns,at91rm9200-emac" Atmel at91rm9200 SoC.
  Use "cdns,at91sam9260-macb" for Atmel at91sam9 SoCs.
  Use "cdns,sam9x60-macb" for Microchip sam9x60 SoC.
  Use "cdns,np4-macb" for NP4 SoC devices.
  Use "cdns,at32ap7000-macb" for other 10/100 usage or use the generic form: "cdns,macb".
  Use "atmel,sama5d2-gem" for the GEM IP (10/100) available on Atmel sama5d2 SoCs.
  Use "atmel,sama5d3-macb" for the 10/100Mbit IP available on Atmel sama5d3 SoCs.
  Use "atmel,sama5d3-gem" for the Gigabit IP available on Atmel sama5d3 SoCs.
  Use "atmel,sama5d4-gem" for the GEM IP (10/100) available on Atmel sama5d4 SoCs.
  Use "cdns,zynq-gem" Xilinx Zynq-7xxx SoC.
  Use "cdns,zynqmp-gem" for Zynq Ultrascale+ MPSoC.
  Use "sifive,fu540-c000-gem" for SiFive FU540-C000 SoC.
  Use "microchip,sama7g5-emac" for Microchip SAMA7G5 ethernet interface.
  Use "microchip,sama7g5-gem" for Microchip SAMA7G5 gigabit ethernet interface.
  Or the generic form: "cdns,emac".
- reg: Address and length of the register set for the device
	For "sifive,fu540-c000-gem", second range is required to specify the
	address and length of the registers for GEMGXL Management block.
- interrupts: Should contain macb interrupt
- phy-mode: See ethernet.txt file in the same directory.
- clock-names: Tuple listing input clock names.
	Required elements: 'pclk', 'hclk'
	Optional elements: 'tx_clk'
	Optional elements: 'rx_clk' applies to cdns,zynqmp-gem
	Optional elements: 'tsu_clk'
- clocks: Phandles to input clocks.

The MAC address will be determined using the optional properties
defined in ethernet.txt.

Optional properties for PHY child node:
- reset-gpios : Should specify the gpio for phy reset
- magic-packet : If present, indicates that the hardware supports waking
  up via magic packet.
- phy-handle : see ethernet.txt file in the same directory

Examples:

	macb0: ethernet@fffc4000 {
		compatible = "cdns,at32ap7000-macb";
		reg = <0xfffc4000 0x4000>;
		interrupts = <21>;
		phy-mode = "rmii";
		local-mac-address = [3a 0e 03 04 05 06];
		clock-names = "pclk", "hclk", "tx_clk";
		clocks = <&clkc 30>, <&clkc 30>, <&clkc 13>;
		ethernet-phy@1 {
			reg = <0x1>;
			reset-gpios = <&pioE 6 1>;
		};
	};
```

## Documentation/devicetree/bindings/net/marvell,aquantia.yaml
```yaml
# SPDX-License-Identifier: (GPL-2.0-only OR BSD-2-Clause)
%YAML 1.2
---
$id: http://devicetree.org/schemas/net/marvell,aquantia.yaml#
$schema: http://devicetree.org/meta-schemas/core.yaml#

title: Marvell Aquantia Ethernet PHY

maintainers:
  - Christian Marangi <ansuelsmth@gmail.com>

description: |
  Marvell Aquantia Ethernet PHY require a firmware to be loaded to actually
  work.

  This can be done and is implemented by OEM in 3 different way:
    - Attached SPI flash directly to the PHY with the firmware. The PHY
      will self load the firmware in the presence of this configuration.
    - Read from a dedicated partition on system NAND declared in an
      NVMEM cell, and loaded to the PHY using its mailbox interface.
    - Manually provided firmware loaded from a file in the filesystem.

allOf:
  - $ref: ethernet-phy.yaml#

select:
  properties:
    compatible:
      contains:
        enum:
          - ethernet-phy-id03a1.b445
          - ethernet-phy-id03a1.b460
          - ethernet-phy-id03a1.b4a2
          - ethernet-phy-id03a1.b4d0
          - ethernet-phy-id03a1.b4e0
          - ethernet-phy-id03a1.b5c2
          - ethernet-phy-id03a1.b4b0
          - ethernet-phy-id03a1.b662
          - ethernet-phy-id03a1.b712
          - ethernet-phy-id31c3.1c12
  required:
    - compatible

properties:
  reg:
    maxItems: 1

  firmware-name:
    description: specify the name of PHY firmware to load

  marvell,mdi-cfg-order:
    $ref: /schemas/types.yaml#/definitions/uint32
    enum: [0, 1]
    description:
      force normal (0) or reverse (1) order of MDI pairs, overriding MDI_CFG bootstrap pin.

  nvmem-cells:
    description: phandle to the firmware nvmem cell
    maxItems: 1

  nvmem-cell-names:
    const: firmware

required:
  - compatible
  - reg

unevaluatedProperties: false

examples:
  - |
    mdio {
        #address-cells = <1>;
        #size-cells = <0>;

        ethernet-phy@0 {
            compatible = "ethernet-phy-id31c3.1c12",
                         "ethernet-phy-ieee802.3-c45";

            reg = <0>;
            firmware-name = "AQR-G4_v5.4.C-AQR_CIG_WF-1945_0x8_ID44776_VER1630.cld";
        };

        ethernet-phy@1 {
            compatible = "ethernet-phy-id31c3.1c12",
                         "ethernet-phy-ieee802.3-c45";

            reg = <1>;
            nvmem-cells = <&aqr_fw>;
            nvmem-cell-names = "firmware";
        };
    };

    flash {
        compatible = "jedec,spi-nor";
        #address-cells = <1>;
        #size-cells = <1>;

        partitions {
            compatible = "fixed-partitions";
            #address-cells = <1>;
            #size-cells = <1>;

            /* ... */

            partition@650000 {
                compatible = "nvmem-cells";
                label = "0:ethphyfw";
                reg = <0x650000 0x80000>;
                read-only;
                #address-cells = <1>;
                #size-cells = <1>;

                aqr_fw: aqr_fw@0 {
                    reg = <0x0 0x5f42a>;
                };
            };

            /* ... */

        };
    };
```

## Documentation/devicetree/bindings/net/marvell,armada-370-neta.yaml
```yaml
# SPDX-License-Identifier: (GPL-2.0-only OR BSD-2-Clause)
%YAML 1.2
---
$id: http://devicetree.org/schemas/net/marvell,armada-370-neta.yaml#
$schema: http://devicetree.org/meta-schemas/core.yaml#

title: Marvell Armada 370/XP/3700/AC5 Ethernet Controller (NETA)

maintainers:
  - Marcin Wojtas <marcin.s.wojtas@gmail.com>

allOf:
  - $ref: /schemas/net/ethernet-controller.yaml#

properties:
  compatible:
    enum:
      - marvell,armada-370-neta
      - marvell,armada-xp-neta
      - marvell,armada-3700-neta
      - marvell,armada-ac5-neta

  reg:
    maxItems: 1

  interrupts:
    maxItems: 1

  clocks:
    minItems: 1
    maxItems: 2

  clock-names:
    minItems: 1
    items:
      - const: core
      - const: bus

  phys:
    maxItems: 1

  tx-csum-limit:
    description: Maximum MTU in bytes for Tx checksum offload; default is 1600 for
      armada-370-neta and 9800 for others.
    $ref: /schemas/types.yaml#/definitions/uint32

  buffer-manager:
    description: Phandle to hardware buffer manager.
    $ref: /schemas/types.yaml#/definitions/phandle

  bm,pool-long:
    description: Pool ID for packets larger than the short threshold.
    $ref: /schemas/types.yaml#/definitions/uint32

  bm,pool-short:
    description: Pool ID for packets smaller than the long threshold.
    $ref: /schemas/types.yaml#/definitions/uint32

required:
  - compatible
  - reg
  - clocks

unevaluatedProperties: false

examples:
  - |
    ethernet@70000 {
        compatible = "marvell,armada-370-neta";
        reg = <0x70000 0x2500>;
        interrupts = <8>;
        clocks = <&gate_clk 4>;
        tx-csum-limit = <9800>;
        phy = <&phy0>;
        phy-mode = "rgmii-id";
        buffer-manager = <&bm>;
        bm,pool-long = <0>;
        bm,pool-short = <1>;
    };
```

## Documentation/devicetree/bindings/net/marvell,armada-380-neta-bm.yaml
```yaml
# SPDX-License-Identifier: (GPL-2.0-only OR BSD-2-Clause)
%YAML 1.2
---
$id: http://devicetree.org/schemas/net/marvell,armada-380-neta-bm.yaml#
$schema: http://devicetree.org/meta-schemas/core.yaml#

title: Marvell Armada 380/XP Buffer Manager (BM)

maintainers:
  - Marcin Wojtas <marcin.s.wojtas@gmail.com>

description:
  In order to see how to hook the BM to a given ethernet port, please refer to
  Documentation/devicetree/bindings/net/marvell,armada-370-neta.yaml.

properties:
  compatible:
    const: marvell,armada-380-neta-bm

  reg:
    maxItems: 1

  clocks:
    maxItems: 1

  internal-mem:
    description: Phandle to internal SRAM region
    $ref: /schemas/types.yaml#/definitions/phandle

patternProperties:
  "^pool[0-3],capacity$":
    description:
      size of external buffer pointers' ring maintained in DRAM for pool 0-3
    $ref: /schemas/types.yaml#/definitions/uint32
    minimum: 128
    maximum: 16352

  "^pool[0-3],pkt-size$":
    description:
      maximum packet size for a short buffer pool entry (pool 0-3)
    $ref: /schemas/types.yaml#/definitions/uint32

required:
  - compatible
  - reg
  - clocks
  - internal-mem

additionalProperties: false

examples:
  - |
    bm@c8000 {
        compatible = "marvell,armada-380-neta-bm";
        reg = <0xc8000 0xac>;
        clocks = <&gateclk 13>;
        internal-mem = <&bm_bppi>;
        pool2,capacity = <4096>;
        pool1,pkt-size = <512>;
    };
```

## Documentation/devicetree/bindings/net/marvell,dfx-server.yaml
```yaml
# SPDX-License-Identifier: GPL-2.0-only OR BSD-2-Clause
%YAML 1.2
---
$id: http://devicetree.org/schemas/net/marvell,dfx-server.yaml#
$schema: http://devicetree.org/meta-schemas/core.yaml#

title: Marvell Prestera DFX server

maintainers:
  - Miquel Raynal <miquel.raynal@bootlin.com>

select:
  properties:
    compatible:
      contains:
        const: marvell,dfx-server
  required:
    - compatible

properties:
  compatible:
    items:
      - const: marvell,dfx-server
      - const: simple-bus

  reg:
    maxItems: 1

  ranges: true

  '#address-cells':
    const: 1

  '#size-cells':
    const: 1

required:
  - compatible
  - reg
  - ranges

# The DFX server may expose clocks described as subnodes
additionalProperties:
  type: object

examples:
  - |

    #define MBUS_ID(target,attributes) (((target) << 24) | ((attributes) << 16))
    bus@0 {
        reg = <0 0>;
        #address-cells = <2>;
        #size-cells = <1>;

        dfx-bus@ac000000 {
            compatible = "marvell,dfx-server", "simple-bus";
            #address-cells = <1>;
            #size-cells = <1>;
            ranges = <0 MBUS_ID(0x08, 0x00) 0 0x100000>;
            reg = <MBUS_ID(0x08, 0x00) 0 0x100000>;
        };
    };
```

## Documentation/devicetree/bindings/net/marvell,mvusb.yaml
```yaml
# SPDX-License-Identifier: GPL-2.0
%YAML 1.2
---
$id: http://devicetree.org/schemas/net/marvell,mvusb.yaml#
$schema: http://devicetree.org/meta-schemas/core.yaml#

title: Marvell USB to MDIO Controller

maintainers:
  - Tobias Waldekranz <tobias@waldekranz.com>

description: |+
  This controller is mounted on development boards for Marvell's Link Street
  family of Ethernet switches. It allows you to configure the switch's registers
  using the standard MDIO interface.

  Since the device is connected over USB, there is no strict requirement of
  having a device tree representation of the device. But in order to use it with
  the mv88e6xxx driver, you need a device tree node in which to place the switch
  definition.

allOf:
  - $ref: "mdio.yaml#"

properties:
  compatible:
    const: usb1286,1fa4
  reg:
    maxItems: 1
    description: The USB port number on the host controller

required:
  - compatible
  - reg
  - "#address-cells"
  - "#size-cells"

examples:
  - |
    /* USB host controller */
    usb {
            #address-cells = <1>;
            #size-cells = <0>;

            mdio@1 {
                    compatible = "usb1286,1fa4";
                    reg = <1>;
                    #address-cells = <1>;
                    #size-cells = <0>;

                    switch@0 {
                            compatible = "marvell,mv88e6190";
                            reg = <0x0>;

                            ports {
                                    /* Port definitions */
                            };

                            mdio {
                                    /* PHY definitions */
                            };
                    };
            };
    };
```
