## Documentation/devicetree/bindings/net/marvell-armada-370-neta.txt
```
* Marvell Armada 370 / Armada XP / Armada 3700 Ethernet Controller (NETA)

Required properties:
- compatible: could be one of the following:
	"marvell,armada-370-neta"
	"marvell,armada-xp-neta"
	"marvell,armada-3700-neta"
	"marvell,armada-ac5-neta"
- reg: address and length of the register set for the device.
- interrupts: interrupt for the device
- phy: See ethernet.txt file in the same directory.
- phy-mode: See ethernet.txt file in the same directory
- clocks: List of clocks for this device. At least one clock is
  mandatory for the core clock. If several clocks are given, then the
  clock-names property must be used to identify them.

Optional properties:
- tx-csum-limit: maximum mtu supported by port that allow TX checksum.
  Value is presented in bytes. If not used, by default 1600B is set for
  "marvell,armada-370-neta" and 9800B for others.
- clock-names: List of names corresponding to clocks property; shall be
  "core" for core clock and "bus" for the optional bus clock.
- phys: comphy for the ethernet port, see ../phy/phy-bindings.txt

Optional properties (valid only for Armada XP/38x):

- buffer-manager: a phandle to a buffer manager node. Please refer to
  Documentation/devicetree/bindings/net/marvell-neta-bm.txt
- bm,pool-long: ID of a pool, that will accept all packets of a size
  higher than 'short' pool's threshold (if set) and up to MTU value.
  Obligatory, when the port is supposed to use hardware
  buffer management.
- bm,pool-short: ID of a pool, that will be used for accepting
  packets of a size lower than given threshold. If not set, the port
  will use a single 'long' pool for all packets, as defined above.

Example:

ethernet@70000 {
	compatible = "marvell,armada-370-neta";
	reg = <0x70000 0x2500>;
	interrupts = <8>;
	clocks = <&gate_clk 4>;
	tx-csum-limit = <9800>
	phy = <&phy0>;
	phy-mode = "rgmii-id";
	buffer-manager = <&bm>;
	bm,pool-long = <0>;
	bm,pool-short = <1>;
};
```

## Documentation/devicetree/bindings/net/marvell-bluetooth.txt
```
Marvell Bluetooth Chips
-----------------------

This documents the binding structure and common properties for serial
attached Marvell Bluetooth devices. The following chips are included in
this binding:

* Marvell 88W8897 Bluetooth devices

Required properties:
 - compatible: should be:
    "mrvl,88w8897"

Optional properties:
None so far

Example:

&serial0 {
	compatible = "ns16550a";
	...
	bluetooth {
		compatible = "mrvl,88w8897";
	};
};
```

## Documentation/devicetree/bindings/net/marvell-bluetooth.yaml
```yaml
# SPDX-License-Identifier: (GPL-2.0 OR BSD-2-Clause)
%YAML 1.2
---
$id: http://devicetree.org/schemas/net/marvell-bluetooth.yaml#
$schema: http://devicetree.org/meta-schemas/core.yaml#

title: Marvell Bluetooth chips

description: |
  This documents the binding structure and common properties for serial
  attached Marvell Bluetooth devices.

maintainers:
  - Rob Herring <robh@kernel.org>

properties:
  compatible:
    enum:
      - mrvl,88w8897
      - mrvl,88w8997

  max-speed:
    description: see Documentation/devicetree/bindings/serial/serial.yaml

required:
  - compatible

allOf:
  - if:
      properties:
        compatible:
          contains:
            const: mrvl,88w8997
    then:
      properties:
        max-speed: true
    else:
      properties:
        max-speed: false

additionalProperties: false

examples:
  - |
    serial {
      bluetooth {
        compatible = "mrvl,88w8897";
      };
    };
```

## Documentation/devicetree/bindings/net/marvell-bt-8xxx.txt
```
Marvell 8897/8997 (sd8897/sd8997) bluetooth devices (SDIO or USB based)
------
The 8997 devices supports multiple interfaces. When used on SDIO interfaces,
the btmrvl driver is used and when used on USB interface, the btusb driver is
used.

Required properties:

  - compatible : should be one of the following:
	* "marvell,sd8897-bt" (for SDIO)
	* "marvell,sd8997-bt" (for SDIO)
	* "usb1286,204e"      (for USB)

Optional properties:

  - marvell,cal-data: Calibration data downloaded to the device during
		      initialization. This is an array of 28 values(u8).
		      This is only applicable to SDIO devices.

  - marvell,wakeup-pin: It represents wakeup pin number of the bluetooth chip.
		        firmware will use the pin to wakeup host system (u16).
  - marvell,wakeup-gap-ms: wakeup gap represents wakeup latency of the host
		      platform. The value will be configured to firmware. This
		      is needed to work chip's sleep feature as expected (u16).
  - interrupt-parent: phandle of the parent interrupt controller
  - interrupt-names: Used only for USB based devices (See below)
  - interrupts : specifies the interrupt pin number to the cpu. For SDIO, the
		 driver will use the first interrupt specified in the interrupt
		 array. For USB based devices, the driver will use the interrupt
		 named "wakeup" from the interrupt-names and interrupt arrays.
		 The driver will request an irq based on this interrupt number.
		 During system suspend, the irq will be enabled so that the
		 bluetooth chip can wakeup host platform under certain
		 conditions. During system resume, the irq will be disabled
		 to make sure unnecessary interrupt is not received.

Example:

IRQ pin 119 is used as system wakeup source interrupt.
wakeup pin 13 and gap 100ms are configured so that firmware can wakeup host
using this device side pin and wakeup latency.

Example for SDIO device follows (calibration data is also available in
below example).

&mmc3 {
	status = "okay";
	vmmc-supply = <&wlan_en_reg>;
	bus-width = <4>;
	cap-power-off-card;
	keep-power-in-suspend;

	#address-cells = <1>;
	#size-cells = <0>;
	btmrvl: bluetooth@2 {
		compatible = "marvell,sd8897-bt";
		reg = <2>;
		interrupt-parent = <&pio>;
		interrupts = <119 IRQ_TYPE_LEVEL_LOW>;

		marvell,cal-data = /bits/ 8 <
			0x37 0x01 0x1c 0x00 0xff 0xff 0xff 0xff 0x01 0x7f 0x04 0x02
			0x00 0x00 0xba 0xce 0xc0 0xc6 0x2d 0x00 0x00 0x00 0x00 0x00
			0x00 0x00 0xf0 0x00>;
		marvell,wakeup-pin = /bits/ 16 <0x0d>;
		marvell,wakeup-gap-ms = /bits/ 16 <0x64>;
	};
};

Example for USB device:

&usb_host1_ohci {
    status = "okay";
    #address-cells = <1>;
    #size-cells = <0>;

    mvl_bt1: bt@1 {
	compatible = "usb1286,204e";
	reg = <1>;
	interrupt-parent = <&gpio0>;
	interrupt-names = "wakeup";
	interrupts = <119 IRQ_TYPE_LEVEL_LOW>;
	marvell,wakeup-pin = /bits/ 16 <0x0d>;
	marvell,wakeup-gap-ms = /bits/ 16 <0x64>;
    };
};
```

## Documentation/devicetree/bindings/net/marvell-bt-sd8xxx.txt
```
Marvell 8897/8997 (sd8897/sd8997) bluetooth SDIO devices
------

Required properties:

  - compatible : should be one of the following:
	* "marvell,sd8897-bt"
	* "marvell,sd8997-bt"

Optional properties:

  - marvell,cal-data: Calibration data downloaded to the device during
		      initialization. This is an array of 28 values(u8).

  - marvell,wakeup-pin: It represents wakeup pin number of the bluetooth chip.
		        firmware will use the pin to wakeup host system.
  - marvell,wakeup-gap-ms: wakeup gap represents wakeup latency of the host
		      platform. The value will be configured to firmware. This
		      is needed to work chip's sleep feature as expected.
  - interrupt-parent: phandle of the parent interrupt controller
  - interrupts : interrupt pin number to the cpu. Driver will request an irq based
		 on this interrupt number. During system suspend, the irq will be
		 enabled so that the bluetooth chip can wakeup host platform under
		 certain condition. During system resume, the irq will be disabled
		 to make sure unnecessary interrupt is not received.

Example:

IRQ pin 119 is used as system wakeup source interrupt.
wakeup pin 13 and gap 100ms are configured so that firmware can wakeup host
using this device side pin and wakeup latency.
calibration data is also available in below example.

&mmc3 {
	status = "okay";
	vmmc-supply = <&wlan_en_reg>;
	bus-width = <4>;
	cap-power-off-card;
	keep-power-in-suspend;

	#address-cells = <1>;
	#size-cells = <0>;
	btmrvl: bluetooth@2 {
		compatible = "marvell,sd8897-bt";
		reg = <2>;
		interrupt-parent = <&pio>;
		interrupts = <119 IRQ_TYPE_LEVEL_LOW>;

		marvell,cal-data = /bits/ 8 <
			0x37 0x01 0x1c 0x00 0xff 0xff 0xff 0xff 0x01 0x7f 0x04 0x02
			0x00 0x00 0xba 0xce 0xc0 0xc6 0x2d 0x00 0x00 0x00 0x00 0x00
			0x00 0x00 0xf0 0x00>;
		marvell,wakeup-pin = <0x0d>;
		marvell,wakeup-gap-ms = <0x64>;
	};
};
```

## Documentation/devicetree/bindings/net/marvell-neta-bm.txt
```
* Marvell Armada 380/XP Buffer Manager driver (BM)

Required properties:

- compatible: should be "marvell,armada-380-neta-bm".
- reg: address and length of the register set for the device.
- clocks: a pointer to the reference clock for this device.
- internal-mem: a phandle to BM internal SRAM definition.

Optional properties (port):

- pool<0 : 3>,capacity: size of external buffer pointers' ring maintained
  in DRAM. Can be set for each pool (id 0 : 3) separately. The value has
  to be chosen between 128 and 16352 and it also has to be aligned to 32.
  Otherwise the driver would adjust a given number or choose default if
  not set.
- pool<0 : 3>,pkt-size: maximum size of a packet accepted by a given buffer
  pointers' pool (id 0 : 3). It will be taken into consideration only when pool
  type is 'short'. For 'long' ones it would be overridden by port's MTU.
  If not set a driver will choose a default value.

In order to see how to hook the BM to a given ethernet port, please
refer to Documentation/devicetree/bindings/net/marvell-armada-370-neta.txt.

Example:

- main node:

bm: bm@c8000 {
	compatible = "marvell,armada-380-neta-bm";
	reg = <0xc8000 0xac>;
	clocks = <&gateclk 13>;
	internal-mem = <&bm_bppi>;
	pool2,capacity = <4096>;
	pool1,pkt-size = <512>;
};

- internal SRAM node:

bm_bppi: bm-bppi {
	compatible = "mmio-sram";
	reg = <MBUS_ID(0x0c, 0x04) 0 0x100000>;
	ranges = <0 MBUS_ID(0x0c, 0x04) 0 0x100000>;
	#address-cells = <1>;
	#size-cells = <1>;
	clocks = <&gateclk 13>;
};
```

## Documentation/devicetree/bindings/net/marvell-orion-mdio.txt
```
* Marvell MDIO Ethernet Controller interface

The Ethernet controllers of the Marvel Kirkwood, Dove, Orion5x,
MV78xx0, Armada 370, Armada XP, Armada 7k and Armada 8k have an
identical unit that provides an interface with the MDIO bus.
Additionally, Armada 7k and Armada 8k has a second unit which
provides an interface with the xMDIO bus. This driver handles
these interfaces.

Required properties:
- compatible: "marvell,orion-mdio" or "marvell,xmdio"
- reg: address and length of the MDIO registers.  When an interrupt is
  not present, the length is the size of the SMI register (4 bytes)
  otherwise it must be 0x84 bytes to cover the interrupt control
  registers.

Optional properties:
- interrupts: interrupt line number for the SMI error/done interrupt
- clocks: phandle for up to three required clocks for the MDIO instance

The child nodes of the MDIO driver are the individual PHY devices
connected to this MDIO bus. They must have a "reg" property given the
PHY address on the MDIO bus.

Example at the SoC level without an interrupt property:

mdio {
	#address-cells = <1>;
	#size-cells = <0>;
	compatible = "marvell,orion-mdio";
	reg = <0xd0072004 0x4>;
};

Example with an interrupt property:

mdio {
	#address-cells = <1>;
	#size-cells = <0>;
	compatible = "marvell,orion-mdio";
	reg = <0xd0072004 0x84>;
	interrupts = <30>;
};

And at the board level:

mdio {
	phy0: ethernet-phy@0 {
		reg = <0>;
	};

	phy1: ethernet-phy@1 {
		reg = <1>;
	};
}
```
