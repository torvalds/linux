## Documentation/devicetree/bindings/hwmon/adi,adm1275.yaml
```yaml
# SPDX-License-Identifier: (GPL-2.0 OR BSD-2-Clause)
%YAML 1.2
---
$id: http://devicetree.org/schemas/hwmon/adi,adm1275.yaml#
$schema: http://devicetree.org/meta-schemas/core.yaml#

title: Analog Devices ADM1075/ADM127x/ADM1281/ADM129x digital power monitors

maintainers:
  - Krzysztof Kozlowski <krzk@kernel.org>

description: |
  The ADM1293 and ADM1294 are high accuracy integrated digital power monitors
  that offer digital current, voltage, and power monitoring using an on-chip,
  12-bit analog-to-digital converter (ADC), communicated through a PMBus
  compliant I2C interface.

  Datasheets:
    https://www.analog.com/en/products/adm1294.html

  The SQ24905C is also a Hot-swap controller compatibility to the ADM1278,
  the PMBUS_MFR_MODEL is MC09C

  Datasheets:
    https://www.silergy.com/
    download/downloadFile?id=5669&type=product&ftype=note

  The BD12780 and BD12780A are hot-swap controllers from ROHM. They are
  functionally compatible with the ADM1278. The main difference between
  the BD12780A and the BD12780 is amount of configurable I2C addresses.

  Datasheets:
    https://fscdn.rohm.com/en/products/databook/datasheet/ic/power/power_switch/bd12780muv-lb-e.pdf
    https://fscdn.rohm.com/en/products/databook/datasheet/ic/power/power_switch/bd12780amuv-lb-e.pdf

  The BD12790 is a ROHM hot-swap controller, functionally similar to the
  ADM1272.

properties:
  compatible:
    oneOf:
      - enum:
          - adi,adm1075
          - adi,adm1272
          - adi,adm1273
          - adi,adm1275
          - adi,adm1276
          - adi,adm1278
          - adi,adm1281
          - adi,adm1293
          - adi,adm1294
          - rohm,bd12780
          - rohm,bd12790
          - silergy,mc09c

      # Require BD12780 as a fall-back for BD12780A.
      - items:
          - const: rohm,bd12780a
          - const: rohm,bd12780

  reg:
    maxItems: 1

  adi,volt-curr-sample-average:
    description: |
      Number of samples to be used to report voltage and current values.
    $ref: /schemas/types.yaml#/definitions/uint32
    enum: [1, 2, 4, 8, 16, 32, 64, 128]

  adi,power-sample-average:
    description: |
      Number of samples to be used to report power values.
    $ref: /schemas/types.yaml#/definitions/uint32
    enum: [1, 2, 4, 8, 16, 32, 64, 128]

allOf:
  - $ref: hwmon-common.yaml#
  - if:
      properties:
        compatible:
          contains:
            enum:
              - adi,adm1075
              - adi,adm1276
    then:
      properties:
        adi,volt-curr-sample-average:
          default: 128
        adi,power-sample-average: false

  - if:
      properties:
        compatible:
          contains:
            enum:
              - adi,adm1275
    then:
      properties:
        adi,volt-curr-sample-average:
          default: 16
        adi,power-sample-average: false

  - if:
      properties:
        compatible:
          contains:
            enum:
              - adi,adm1272
              - adi,adm1273
              - rohm,bd12790
    then:
      properties:
        adi,volt-curr-sample-average:
          default: 128
        adi,power-sample-average:
          default: 128

  - if:
      properties:
        compatible:
          contains:
            enum:
              - adi,adm1278
              - adi,adm1281
              - adi,adm1293
              - adi,adm1294
              - rohm,bd12780
              - silergy,mc09c
    then:
      properties:
        adi,volt-curr-sample-average:
          default: 128
        adi,power-sample-average:
          default: 1

required:
  - compatible
  - reg

unevaluatedProperties: false

examples:
  - |
    i2c {
        #address-cells = <1>;
        #size-cells = <0>;

        power-sensor@10 {
            compatible = "adi,adm1272";
            reg = <0x10>;
            shunt-resistor-micro-ohms = <500>;
            adi,volt-curr-sample-average = <128>;
            adi,power-sample-average = <128>;
        };
    };
```

## Documentation/devicetree/bindings/hwmon/adi,axi-fan-control.yaml
```yaml
# SPDX-License-Identifier: (GPL-2.0-only OR BSD-2-Clause)
# Copyright 2019 Analog Devices Inc.
%YAML 1.2
---
$id: http://devicetree.org/schemas/hwmon/adi,axi-fan-control.yaml#
$schema: http://devicetree.org/meta-schemas/core.yaml#

title: Analog Devices AXI FAN Control Device Tree Bindings

maintainers:
  - Nuno Sá <nuno.sa@analog.com>

description: |+
  Bindings for the Analog Devices AXI FAN Control driver. Spefications of the
  core can be found in:

  https://wiki.analog.com/resources/fpga/docs/axi_fan_control

properties:
  compatible:
    enum:
        - adi,axi-fan-control-1.00.a

  reg:
    maxItems: 1

  clocks:
    maxItems: 1

  interrupts:
    maxItems: 1

  pulses-per-revolution:
    description:
      Value specifying the number of pulses per revolution of the controlled
      FAN.
    allOf:
      - $ref: /schemas/types.yaml#/definitions/uint32
    enum: [1, 2, 4]

required:
  - compatible
  - reg
  - clocks
  - interrupts
  - pulses-per-revolution

examples:
  - |
    fpga_axi: fpga-axi {
            #address-cells = <0x2>;
            #size-cells = <0x1>;

            axi_fan_control: axi-fan-control@80000000 {
                    compatible = "adi,axi-fan-control-1.00.a";
                    reg = <0x0 0x80000000 0x10000>;
                    clocks = <&clk 71>;
                    interrupts = <0 110 0>;
                    pulses-per-revolution = <2>;
            };
    };
...
```

## Documentation/devicetree/bindings/hwmon/adi,ltc2945.yaml
```yaml
# SPDX-License-Identifier: (GPL-2.0-only OR BSD-2-Clause)
%YAML 1.2
---
$id: http://devicetree.org/schemas/hwmon/adi,ltc2945.yaml#
$schema: http://devicetree.org/meta-schemas/core.yaml#

title: Analog Devices LTC2945 wide range i2c power monitor

maintainers:
  - Guenter Roeck <linux@roeck-us.net>

description: |
  Analog Devices LTC2945 wide range i2c power monitor over I2C.

  https://www.analog.com/media/en/technical-documentation/data-sheets/LTC2945.pdf

properties:
  compatible:
    enum:
      - adi,ltc2945

  reg:
    maxItems: 1

  shunt-resistor-micro-ohms:
    description:
      Shunt resistor value in micro-Ohms
    default: 1000

required:
  - compatible
  - reg

allOf:
  - $ref: hwmon-common.yaml#

unevaluatedProperties: false

examples:
  - |
    i2c {
        #address-cells = <1>;
        #size-cells = <0>;

        power-monitor@6e {
            compatible = "adi,ltc2945";
            reg = <0x6e>;
            /* 10 milli-Ohm shunt resistor */
            shunt-resistor-micro-ohms = <10000>;
        };
    };
...
```

## Documentation/devicetree/bindings/hwmon/adi,ltc2947.yaml
```yaml
# SPDX-License-Identifier: (GPL-2.0-only OR BSD-2-Clause)
%YAML 1.2
---
$id: http://devicetree.org/schemas/hwmon/adi,ltc2947.yaml#
$schema: http://devicetree.org/meta-schemas/core.yaml#

title: Analog Devices LTC2947 high precision power and energy monitor

maintainers:
  - Nuno Sá <nuno.sa@analog.com>

description: |
  Analog Devices LTC2947 high precision power and energy monitor over SPI or I2C.

  https://www.analog.com/media/en/technical-documentation/data-sheets/LTC2947.pdf

properties:
  compatible:
    enum:
      - adi,ltc2947

  reg:
    maxItems: 1

  clocks:
    description:
      The LTC2947 uses either a trimmed internal oscillator or an external clock
      as the time base for determining the integration period to represent time,
      charge and energy. When an external clock is used, this property must be
      set accordingly.
    maxItems: 1

  adi,accumulator-ctl-pol:
    description:
      This property controls the polarity of current that is accumulated to
      calculate charge and energy so that, they can be only accumulated for
      positive current for example. Since there are two sets of registers for
      the accumulated values, this entry can also have two items which sets
      energy1/charge1 and energy2/charger2 respectively. Check table 12 of the
      datasheet for more information on the supported options.
    allOf:
      - $ref: /schemas/types.yaml#/definitions/uint32-array
      - minItems: 2
        maxItems: 2
        items:
          enum: [0, 1, 2, 3]
          default: 0

  adi,accumulation-deadband-microamp:
    description:
      This property controls the Accumulation Dead band which allows to set the
      level of current below which no accumulation takes place.
    allOf:
      - $ref: /schemas/types.yaml#/definitions/uint32
    maximum: 255
    default: 0

  adi,gpio-out-pol:
    description:
      This property controls the GPIO polarity. Setting it to one makes the GPIO
      active high, setting it to zero makets it active low. When this property
      is present, the GPIO is automatically configured as output and set to
      control a fan as a function of measured temperature.
    allOf:
      - $ref: /schemas/types.yaml#/definitions/uint32
    enum: [0, 1]
    default: 0

  adi,gpio-in-accum:
    description:
      When set, this property sets the GPIO as input. It is then used to control
      the accumulation of charge, energy and time. This function can be
      enabled/configured separately for each of the two sets of accumulation
      registers. Check table 13 of the datasheet for more information on the
      supported options. This property cannot be used together with
      adi,gpio-out-pol.
    allOf:
      - $ref: /schemas/types.yaml#/definitions/uint32-array
      - minItems: 2
        maxItems: 2
        items:
          enum: [0, 1, 2]
          default: 0

required:
  - compatible
  - reg


examples:
  - |
    spi {
           #address-cells = <1>;
           #size-cells = <0>;

           ltc2947_spi: ltc2947@0 {
                   compatible = "adi,ltc2947";
                   reg = <0>;
                   /* accumulation takes place always for energ1/charge1. */
                   /* accumulation only on positive current for energy2/charge2. */
                   adi,accumulator-ctl-pol = <0 1>;
           };
    };
...
```

## Documentation/devicetree/bindings/hwmon/adi,ltc2991.yaml
```yaml
# SPDX-License-Identifier: (GPL-2.0 OR BSD-2-Clause)
%YAML 1.2
---

$id: http://devicetree.org/schemas/hwmon/adi,ltc2991.yaml#
$schema: http://devicetree.org/meta-schemas/core.yaml#

title: Analog Devices LTC2991 Octal I2C Voltage, Current and Temperature Monitor

maintainers:
  - Antoniu Miclaus <antoniu.miclaus@analog.com>

description: |
  The LTC2991 is used to monitor system temperatures, voltages and currents.
  Through the I2C serial interface, the eight monitors can individually measure
  supply voltages and can be paired for differential measurements of current
  sense resistors or temperature sensing transistors.

  Datasheet:
    https://www.analog.com/en/products/ltc2991.html

properties:
  compatible:
    const: adi,ltc2991

  reg:
    maxItems: 1

  '#address-cells':
    const: 1

  '#size-cells':
    const: 0

  vcc-supply: true

patternProperties:
  "^channel@[0-3]$":
    type: object
    description:
      Represents the differential/temperature channels.

    properties:
      reg:
        description:
          The channel number. LTC2991 can monitor 4 currents/temperatures.
        items:
          minimum: 0
          maximum: 3

      shunt-resistor-micro-ohms:
        description:
          The value of curent sense resistor in micro ohms. Pin configuration is
          set for differential input pair.

      adi,temperature-enable:
        description:
          Enables temperature readings. Pin configuration is set for remote
          diode temperature measurement.
        type: boolean

    required:
      - reg

    allOf:
      - if:
          required:
            - shunt-resistor-micro-ohms
        then:
          properties:
            adi,temperature-enable: false

    additionalProperties: false

required:
  - compatible
  - reg
  - vcc-supply

additionalProperties: false

examples:
  - |
    i2c {
        #address-cells = <1>;
        #size-cells = <0>;

        hwmon@48 {
            compatible = "adi,ltc2991";
            reg = <0x48>;
            vcc-supply = <&vcc>;
        };
    };
  - |
    i2c {
        #address-cells = <1>;
        #size-cells = <0>;

        hwmon@48 {
            #address-cells = <1>;
            #size-cells = <0>;

            compatible = "adi,ltc2991";
            reg = <0x48>;
            vcc-supply = <&vcc>;

            channel@0 {
                    reg = <0x0>;
                    shunt-resistor-micro-ohms = <100000>;
            };

            channel@1 {
                    reg = <0x1>;
                    shunt-resistor-micro-ohms = <100000>;
            };

            channel@2 {
                    reg = <0x2>;
                    adi,temperature-enable;
            };

            channel@3 {
                    reg = <0x3>;
                    adi,temperature-enable;
            };
        };
    };
...
```

## Documentation/devicetree/bindings/hwmon/adi,ltc2992.yaml
```yaml
# SPDX-License-Identifier: (GPL-2.0-only OR BSD-2-Clause)
%YAML 1.2
---
$id: http://devicetree.org/schemas/hwmon/adi,ltc2992.yaml#
$schema: http://devicetree.org/meta-schemas/core.yaml#

title: Linear Technology 2992 Power Monitor

maintainers:
  - Alexandru Tachici <alexandru.tachici@analog.com>

description: |
  Linear Technology 2992 Dual Wide Range Power Monitor
  https://www.analog.com/media/en/technical-documentation/data-sheets/ltc2992.pdf

properties:
  compatible:
    enum:
      - adi,ltc2992

  reg:
    maxItems: 1

  '#address-cells':
    const: 1

  '#size-cells':
    const: 0

  avcc-supply: true

patternProperties:
  "^channel@([0-1])$":
    type: object
    description: |
      Represents the two supplies to be monitored.

    properties:
      reg:
        description: |
          The channel number. LTC2992 can monitor two supplies.
        items:
          minimum: 0
          maximum: 1

      shunt-resistor-micro-ohms:
        description:
          The value of curent sense resistor in microohms.

required:
  - compatible
  - reg

additionalProperties: false

examples:
  - |
    i2c {
        #address-cells = <1>;
        #size-cells = <0>;

        ltc2992@6f {
            #address-cells = <1>;
            #size-cells = <0>;

            compatible = "adi,ltc2992";
            reg = <0x6f>;

            channel@0 {
                reg = <0x0>;
                shunt-resistor-micro-ohms = <10000>;
            };

            channel@1 {
                reg = <0x1>;
                shunt-resistor-micro-ohms = <10000>;
            };
        };
    };
...
```
