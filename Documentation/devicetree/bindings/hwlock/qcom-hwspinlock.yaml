## Documentation/devicetree/bindings/hwmon/adi,max31827.yaml
```yaml
# SPDX-License-Identifier: (GPL-2.0-only OR BSD-2-Clause)
%YAML 1.2
---
$id: http://devicetree.org/schemas/hwmon/adi,max31827.yaml#
$schema: http://devicetree.org/meta-schemas/core.yaml#

title: Analog Devices MAX31827, MAX31828, MAX31829 Low-Power Temperature Switch

maintainers:
  - Daniel Matyas <daniel.matyas@analog.com>

description: |
  Analog Devices MAX31827, MAX31828, MAX31829 Low-Power Temperature Switch with
  I2C Interface
  https://www.analog.com/media/en/technical-documentation/data-sheets/MAX31827-MAX31829.pdf

properties:
  compatible:
    oneOf:
      - const: adi,max31827
      - items:
          - enum:
              - adi,max31828
              - adi,max31829
          - const: adi,max31827

  reg:
    maxItems: 1

  vref-supply:
    description:
      Must have values in the interval (1.6V; 3.6V) in order for the device to
      function correctly.

  adi,comp-int:
    description:
      If present interrupt mode is used. If not present comparator mode is used
      (default).
    type: boolean

  adi,alarm-pol:
    description:
      Sets the alarms active state.
            - 0 = active low
            - 1 = active high
    $ref: /schemas/types.yaml#/definitions/uint32
    enum: [0, 1]

  adi,fault-q:
    description:
      Select how many consecutive temperature faults must occur before
      overtemperature or undertemperature faults are indicated in the
      corresponding status bits.
    $ref: /schemas/types.yaml#/definitions/uint32
    enum: [1, 2, 4, 8]

  adi,timeout-enable:
    description:
      Enables timeout. Bus timeout resets the I2C-compatible interface when SCL
      is low for more than 30ms (nominal).
    type: boolean

allOf:
  - if:
      properties:
        compatible:
          contains:
            const: adi,max31829

    then:
      properties:
        adi,alarm-pol:
          default: 1

    else:
      properties:
        adi,alarm-pol:
          default: 0

  - if:
      properties:
        compatible:
          contains:
            const: adi,max31827

    then:
      properties:
        adi,fault-q:
          default: 1

    else:
      properties:
        adi,fault-q:
          default: 4


required:
  - compatible
  - reg
  - vref-supply

additionalProperties: false

examples:
  - |
    i2c {
        #address-cells = <1>;
        #size-cells = <0>;

        temperature-sensor@42 {
            compatible = "adi,max31827";
            reg = <0x42>;
            vref-supply = <&reg_vdd>;
            adi,comp-int;
            adi,alarm-pol = <0>;
            adi,fault-q = <1>;
            adi,timeout-enable;
        };
    };
...
```

## Documentation/devicetree/bindings/hwmon/adm1275.txt
```
adm1275 properties

Required properties:
- compatible: Must be one of the supported compatible strings:
	- "adi,adm1075" for adm1075
	- "adi,adm1272" for adm1272
	- "adi,adm1275" for adm1275
	- "adi,adm1276" for adm1276
	- "adi,adm1278" for adm1278
	- "adi,adm1293" for adm1293
	- "adi,adm1294" for adm1294
- reg: I2C address

Optional properties:

- shunt-resistor-micro-ohms
	Shunt resistor value in micro-Ohm

Example:

adm1272@10 {
	compatible = "adi,adm1272";
	reg = <0x10>;
	shunt-resistor-micro-ohms = <500>;
};
```

## Documentation/devicetree/bindings/hwmon/ads1015.txt
```
ADS1015 (I2C)

This device is a 12-bit A-D converter with 4 inputs.

The inputs can be used single ended or in certain differential combinations.

For configuration all possible combinations are mapped to 8 channels:
  0: Voltage over AIN0 and AIN1.
  1: Voltage over AIN0 and AIN3.
  2: Voltage over AIN1 and AIN3.
  3: Voltage over AIN2 and AIN3.
  4: Voltage over AIN0 and GND.
  5: Voltage over AIN1 and GND.
  6: Voltage over AIN2 and GND.
  7: Voltage over AIN3 and GND.

Each channel can be configured individually:
 - pga is the programmable gain amplifier (values are full scale)
    0: +/- 6.144 V
    1: +/- 4.096 V
    2: +/- 2.048 V (default)
    3: +/- 1.024 V
    4: +/- 0.512 V
    5: +/- 0.256 V
 - data_rate in samples per second
    0: 128
    1: 250
    2: 490
    3: 920
    4: 1600 (default)
    5: 2400
    6: 3300

1) The /ads1015 node

  Required properties:

   - compatible : must be "ti,ads1015"
   - reg : I2C bus address of the device
   - #address-cells : must be <1>
   - #size-cells : must be <0>

  The node contains child nodes for each channel that the platform uses.

  Example ADS1015 node:

    ads1015@49 {
	    compatible = "ti,ads1015";
	    reg = <0x49>;
	    #address-cells = <1>;
	    #size-cells = <0>;

	    [ child node definitions... ]
    }

2) channel nodes

  Required properties:

   - reg : the channel number

  Optional properties:

   - ti,gain : the programmable gain amplifier setting
   - ti,datarate : the converter data rate

  Example ADS1015 channel node:

    channel@4 {
	    reg = <4>;
	    ti,gain = <3>;
	    ti,datarate = <5>;
    };
```
