## Documentation/devicetree/bindings/hwlock/qcom-hwspinlock.yaml
```yaml
# SPDX-License-Identifier: (GPL-2.0-only OR BSD-2-Clause)
%YAML 1.2
---
$id: http://devicetree.org/schemas/hwlock/qcom-hwspinlock.yaml#
$schema: http://devicetree.org/meta-schemas/core.yaml#

title: Qualcomm Hardware Mutex Block

maintainers:
  - Bjorn Andersson <bjorn.andersson@linaro.org>

description:
  The hardware block provides mutexes utilized between different processors on
  the SoC as part of the communication protocol used by these processors.

properties:
  compatible:
    oneOf:
      - enum:
          - qcom,sfpb-mutex
          - qcom,tcsr-mutex
      - items:
          - enum:
              - qcom,apq8084-tcsr-mutex
              - qcom,ipq6018-tcsr-mutex
              - qcom,msm8226-tcsr-mutex
              - qcom,msm8994-tcsr-mutex
          - const: qcom,tcsr-mutex
      - items:
          - enum:
              - qcom,msm8974-tcsr-mutex
          - const: qcom,tcsr-mutex
          - const: syscon

  reg:
    maxItems: 1

  '#hwlock-cells':
    const: 1

required:
  - compatible
  - reg
  - '#hwlock-cells'

additionalProperties: false

examples:
  - |
    hwlock@1f40000 {
        compatible = "qcom,tcsr-mutex";
        reg = <0x01f40000 0x40000>;
        #hwlock-cells = <1>;
    };
...
```

## Documentation/devicetree/bindings/hwlock/rockchip-hwspinlock.txt
```
Rockchip HW Spinlock Device Binding
===================================

Required properties :
- compatible : shall contain only one of the following:
	"rockchip,hwspinlock"

- reg : the register address of hwspinlock

- #hwlock-cells : hwlock users only use the hwlock id to represent a specific
	hwlock, so the number of cells should be <1> here.

Please look at the generic hwlock binding for usage information for consumers,
"Documentation/devicetree/bindings/hwlock/hwlock.txt"

Example of hwlock provider:
	hwlock: hwspinlock@ff040000 {
		compatible = "rockchip,hwspinlock";
		reg = <0 0xff040000 0 0x10000>;
		#hwlock-cells = <1>;
	};

Example of hwlock users:
	node {
		...
		hwlocks = <&hwlock 0>;
		...
	};
```

## Documentation/devicetree/bindings/hwlock/sirf,hwspinlock.txt
```
SIRF Hardware spinlock device Binding
-----------------------------------------------

Required properties :
- compatible : shall contain only one of the following:
	"sirf,hwspinlock"

- reg : the register address of hwspinlock

- #hwlock-cells : hwlock users only use the hwlock id to represent a specific
	hwlock, so the number of cells should be <1> here.

Please look at the generic hwlock binding for usage information for consumers,
"Documentation/devicetree/bindings/hwlock/hwlock.txt"

Example of hwlock provider:
	hwlock {
		compatible = "sirf,hwspinlock";
		reg = <0x13240000 0x00010000>;
		#hwlock-cells = <1>;
	};

Example of hwlock users:
	node {
		...
		hwlocks = <&hwlock 2>;
		...
	};
```

## Documentation/devicetree/bindings/hwlock/sprd,hwspinlock-r3p0.yaml
```yaml
# SPDX-License-Identifier: GPL-2.0-only OR BSD-2-Clause
%YAML 1.2
---
$id: http://devicetree.org/schemas/hwlock/sprd,hwspinlock-r3p0.yaml#
$schema: http://devicetree.org/meta-schemas/core.yaml#

title: Spreadtrum hardware spinlock

maintainers:
  - Orson Zhai <orsonzhai@gmail.com>
  - Baolin Wang <baolin.wang7@gmail.com>
  - Chunyan Zhang <zhang.lyra@gmail.com>

properties:
  compatible:
    const: sprd,hwspinlock-r3p0

  reg:
    maxItems: 1

  clocks:
    maxItems: 1

  clock-names:
    const: enable

  '#hwlock-cells':
    const: 1

required:
  - compatible
  - reg
  - clocks
  - clock-names
  - '#hwlock-cells'

additionalProperties: false

examples:
  - |
    #include <dt-bindings/clock/sprd,sc9860-clk.h>

    hwlock@40500000 {
      compatible = "sprd,hwspinlock-r3p0";
      reg = <0x40500000 0x1000>;
      clocks = <&aon_gate CLK_SPLK_EB>;
      clock-names = "enable";
      #hwlock-cells = <1>;
    };
...
```

## Documentation/devicetree/bindings/hwlock/sprd-hwspinlock.txt
```
SPRD Hardware Spinlock Device Binding
-------------------------------------

Required properties :
- compatible : should be "sprd,hwspinlock-r3p0".
- reg : the register address of hwspinlock.
- #hwlock-cells : hwlock users only use the hwlock id to represent a specific
	hwlock, so the number of cells should be <1> here.
- clock-names : Must contain "enable".
- clocks : Must contain a phandle entry for the clock in clock-names, see the
	common clock bindings.

Please look at the generic hwlock binding for usage information for consumers,
"Documentation/devicetree/bindings/hwlock/hwlock.txt"

Example of hwlock provider:
	hwspinlock@40500000 {
		compatible  = "sprd,hwspinlock-r3p0";
		reg = <0 0x40500000 0 0x1000>;
		#hwlock-cells = <1>;
		clock-names = "enable";
		clocks = <&clk_aon_apb_gates0 22>;
	};
```

## Documentation/devicetree/bindings/hwlock/st,stm32-hwspinlock.txt
```
STM32 Hardware Spinlock Device Binding
-------------------------------------

Required properties :
- compatible : should be "st,stm32-hwspinlock".
- reg : the register address of hwspinlock.
- #hwlock-cells : hwlock users only use the hwlock id to represent a specific
	hwlock, so the number of cells should be <1> here.
- clock-names : Must contain "hsem".
- clocks : Must contain a phandle entry for the clock in clock-names, see the
	common clock bindings.

Please look at the generic hwlock binding for usage information for consumers,
"Documentation/devicetree/bindings/hwlock/hwlock.txt"

Example of hwlock provider:
	hwspinlock@4c000000 {
		compatible = "st,stm32-hwspinlock";
		#hwlock-cells = <1>;
		reg = <0x4c000000 0x400>;
		clocks = <&rcc HSEM>;
		clock-names = "hsem";
	};
```

## Documentation/devicetree/bindings/hwlock/st,stm32-hwspinlock.yaml
```yaml
# SPDX-License-Identifier: (GPL-2.0-only OR BSD-2-Clause)
%YAML 1.2
---
$id: http://devicetree.org/schemas/hwlock/st,stm32-hwspinlock.yaml#
$schema: http://devicetree.org/meta-schemas/core.yaml#

title: STMicroelectronics STM32 Hardware Spinlock

maintainers:
  - Fabien Dessenne <fabien.dessenne@foss.st.com>

properties:
  "#hwlock-cells":
    const: 1

  compatible:
    const: st,stm32-hwspinlock

  reg:
    maxItems: 1

  clocks:
    maxItems: 1

  clock-names:
    items:
      - const: hsem

required:
  - "#hwlock-cells"
  - compatible
  - reg
  - clocks
  - clock-names

additionalProperties: false

examples:
  - |
    #include <dt-bindings/clock/stm32mp1-clks.h>
    hwspinlock@4c000000 {
        compatible = "st,stm32-hwspinlock";
        #hwlock-cells = <1>;
        reg = <0x4c000000 0x400>;
        clocks = <&rcc HSEM>;
        clock-names = "hsem";
    };

...
```

## Documentation/devicetree/bindings/hwlock/ti,omap-hwspinlock.yaml
```yaml
# SPDX-License-Identifier: (GPL-2.0-only OR BSD-2-Clause)
%YAML 1.2
---
$id: http://devicetree.org/schemas/hwlock/ti,omap-hwspinlock.yaml#
$schema: http://devicetree.org/meta-schemas/core.yaml#

title: TI HwSpinlock for OMAP and K3 based SoCs

maintainers:
  - Suman Anna <s-anna@ti.com>

properties:
  compatible:
    enum:
      - ti,omap4-hwspinlock  # for OMAP44xx, OMAP54xx, AM33xx, AM43xx, DRA7xx SoCs
      - ti,am64-hwspinlock   # for K3 AM64x SoCs
      - ti,am654-hwspinlock  # for K3 AM65x, J721E and J7200 SoCs

  reg:
    maxItems: 1

  "#hwlock-cells":
    const: 1
    description: |
      The OMAP hwspinlock users will use a 0-indexed relative hwlock number as
      the argument specifier value for requesting a specific hwspinlock within
      a hwspinlock bank.

      Please look at the generic hwlock binding for usage information for
      consumers, "Documentation/devicetree/bindings/hwlock/hwlock.txt"

required:
  - compatible
  - reg
  - "#hwlock-cells"

additionalProperties: false

examples:

  - |
    spinlock@4a0f6000 {
        compatible = "ti,omap4-hwspinlock";
        reg = <0x4a0f6000 0x1000>;
        #hwlock-cells = <1>;
    };
```

## Documentation/devicetree/bindings/hwmon/ad741x.txt
```
* AD7416/AD7417/AD7418 Temperature Sensor Device Tree Bindings

Required properties:
- compatible: one of
		"adi,ad7416"
		"adi,ad7417"
		"adi,ad7418"
- reg: I2C address

Example:

hwmon@28 {
	compatible = "adi,ad7418";
	reg = <0x28>;
};
```

## Documentation/devicetree/bindings/hwmon/adc128d818.txt
```
TI ADC128D818 ADC System Monitor With Temperature Sensor
--------------------------------------------------------

Operation modes:

 - Mode 0:  7 single-ended voltage readings (IN0-IN6),
            1 temperature reading (internal)
 - Mode 1:  8 single-ended voltage readings (IN0-IN7),
            no temperature
 - Mode 2:  4 pseudo-differential voltage readings
              (IN0-IN1, IN3-IN2, IN4-IN5, IN7-IN6),
            1 temperature reading (internal)
 - Mode 3:  4 single-ended voltage readings (IN0-IN3),
            2 pseudo-differential voltage readings
              (IN4-IN5, IN7-IN6),
            1 temperature reading (internal)

If no operation mode is configured via device tree, the driver keeps the
currently active chip operation mode (default is mode 0).


Required node properties:

 - compatible:  must be set to "ti,adc128d818"
 - reg:         I2C address of the device

Optional node properties:

 - ti,mode:     Operation mode (see above).


Example (operation mode 2):

	adc128d818@1d {
		compatible = "ti,adc128d818";
		reg = <0x1d>;
		ti,mode = <2>;
	};
```

## Documentation/devicetree/bindings/hwmon/adi,ad741x.yaml
```yaml
# SPDX-License-Identifier: (GPL-2.0 OR BSD-2-Clause)
%YAML 1.2
---
$id: http://devicetree.org/schemas/hwmon/adi,ad741x.yaml#
$schema: http://devicetree.org/meta-schemas/core.yaml#

title: Analog Devices AD7416/AD7417/AD7418 temperature sensors

maintainers:
  - Krzysztof Kozlowski <krzk@kernel.org>

properties:
  compatible:
    enum:
      - adi,ad7416
      - adi,ad7417
      - adi,ad7418

  reg:
    maxItems: 1

required:
  - compatible
  - reg

additionalProperties: false

examples:
  - |
    i2c {
        #address-cells = <1>;
        #size-cells = <0>;

        temperature-sensor@28 {
            compatible = "adi,ad7418";
            reg = <0x28>;
        };
    };
```

## Documentation/devicetree/bindings/hwmon/adi,adm1177.yaml
```yaml
# SPDX-License-Identifier: (GPL-2.0-only OR BSD-2-Clause)
%YAML 1.2
---
$id: http://devicetree.org/schemas/hwmon/adi,adm1177.yaml#
$schema: http://devicetree.org/meta-schemas/core.yaml#

title: Analog Devices ADM1177 Hot Swap Controller and Digital Power Monitor

maintainers:
  - Michael Hennerich <michael.hennerich@analog.com>

description: |
  Analog Devices ADM1177 Hot Swap Controller and Digital Power Monitor
  https://www.analog.com/media/en/technical-documentation/data-sheets/ADM1177.pdf

properties:
  compatible:
    enum:
      - adi,adm1177

  reg:
    maxItems: 1

  avcc-supply:
    description:
      Phandle to the Avcc power supply

  shunt-resistor-micro-ohms:
    description:
      The value of current sense resistor in microohms. If not provided,
      the current reading and overcurrent alert is disabled.

  adi,shutdown-threshold-microamp:
    description:
      Specifies the current level at which an over current alert occurs.
      If not provided, the overcurrent alert is configured to max ADC range
      based on shunt-resistor-micro-ohms.

  adi,vrange-high-enable:
    description:
      Specifies which internal voltage divider to be used. A 1 selects
      a 7:2 voltage divider while a 0 selects a 14:1 voltage divider.
    type: boolean

required:
  - compatible
  - reg

additionalProperties: false

examples:
  - |
    #include <dt-bindings/gpio/gpio.h>
    #include <dt-bindings/interrupt-controller/irq.h>
    i2c {
        #address-cells = <1>;
        #size-cells = <0>;

        pwmon@5a {
            compatible = "adi,adm1177";
            reg = <0x5a>;
            shunt-resistor-micro-ohms = <50000>; /* 50 mOhm */
            adi,shutdown-threshold-microamp = <1059000>; /* 1.059 A */
            adi,vrange-high-enable;
        };
    };
...
```

## Documentation/devicetree/bindings/hwmon/adi,adm1266.yaml
```yaml
# SPDX-License-Identifier: (GPL-2.0-only OR BSD-2-Clause)
%YAML 1.2
---
$id: http://devicetree.org/schemas/hwmon/adi,adm1266.yaml#
$schema: http://devicetree.org/meta-schemas/core.yaml#

title: Analog Devices ADM1266 Cascadable Super Sequencer with Margin
  Control and Fault Recording

maintainers:
  - Alexandru Tachici <alexandru.tachici@analog.com>

description: |
  Analog Devices ADM1266 Cascadable Super Sequencer with Margin
  Control and Fault Recording.
  https://www.analog.com/media/en/technical-documentation/data-sheets/ADM1266.pdf

properties:
  compatible:
    enum:
      - adi,adm1266

  reg:
    description: |
      I2C address of slave device.
    items:
      minimum: 0x40
      maximum: 0x4F

  avcc-supply:
    description: |
      Phandle to the Avcc power supply.

required:
  - compatible
  - reg

additionalProperties: false

examples:
  - |
    i2c0 {
        #address-cells = <1>;
        #size-cells = <0>;

        adm1266@40 {
                compatible = "adi,adm1266";
                reg = <0x40>;
        };
    };
...
```
