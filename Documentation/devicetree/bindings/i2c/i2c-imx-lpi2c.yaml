## Documentation/devicetree/bindings/i2c/i2c-mt65xx.yaml
```yaml
# SPDX-License-Identifier: (GPL-2.0-only OR BSD-2-Clause)
%YAML 1.2
---
$id: http://devicetree.org/schemas/i2c/i2c-mt65xx.yaml#
$schema: http://devicetree.org/meta-schemas/core.yaml#

title: MediaTek I2C controller

description:
  This driver interfaces with the native I2C controller present in
  various MediaTek SoCs.

allOf:
  - $ref: /schemas/i2c/i2c-controller.yaml#

maintainers:
  - Qii Wang <qii.wang@mediatek.com>

properties:
  compatible:
    oneOf:
      - const: mediatek,mt2712-i2c
      - const: mediatek,mt6577-i2c
      - const: mediatek,mt6589-i2c
      - const: mediatek,mt7622-i2c
      - const: mediatek,mt7981-i2c
      - const: mediatek,mt7986-i2c
      - const: mediatek,mt8168-i2c
      - const: mediatek,mt8173-i2c
      - const: mediatek,mt8183-i2c
      - const: mediatek,mt8186-i2c
      - const: mediatek,mt8188-i2c
      - const: mediatek,mt8192-i2c
      - items:
          - enum:
              - mediatek,mt7629-i2c
              - mediatek,mt8516-i2c
          - const: mediatek,mt2712-i2c
      - items:
          - enum:
              - mediatek,mt2701-i2c
              - mediatek,mt6797-i2c
              - mediatek,mt7623-i2c
          - const: mediatek,mt6577-i2c
      - items:
          - enum:
              - mediatek,mt8365-i2c
          - const: mediatek,mt8168-i2c
      - items:
          - enum:
              - mediatek,mt6795-i2c
          - const: mediatek,mt8173-i2c
      - items:
          - enum:
              - mediatek,mt6878-i2c
              - mediatek,mt6991-i2c
              - mediatek,mt8196-i2c
          - const: mediatek,mt8188-i2c
      - items:
          - enum:
              - mediatek,mt6893-i2c
              - mediatek,mt8195-i2c
          - const: mediatek,mt8192-i2c

  reg:
    items:
      - description: Physical base address
      - description: DMA base address

  interrupts:
    maxItems: 1

  clocks:
    minItems: 2
    items:
      - description: Main clock for I2C bus
      - description: Clock for I2C via DMA
      - description: Bus arbitrator clock
      - description: Clock for I2C from PMIC

  clock-names:
    minItems: 2
    items:
      - const: main
      - const: dma
      - const: arb
      - const: pmic

  clock-div:
    $ref: /schemas/types.yaml#/definitions/uint32
    description: Frequency divider of clock source in I2C module

  clock-frequency:
    default: 100000
    description:
      SCL frequency to use (in Hz). If omitted, 100kHz is used.

  mediatek,have-pmic:
    description: Platform controls I2C from PMIC side
    type: boolean

  mediatek,use-push-pull:
    description: Use push-pull mode I/O config
    type: boolean

  vbus-supply:
    description: Phandle to the regulator providing power to SCL/SDA

required:
  - compatible
  - reg
  - clocks
  - clock-names
  - clock-div
  - interrupts

unevaluatedProperties: false

examples:
  - |
    #include <dt-bindings/interrupt-controller/arm-gic.h>
    #include <dt-bindings/interrupt-controller/irq.h>

    i2c0: i2c@1100d000 {
      compatible = "mediatek,mt6577-i2c";
      reg = <0x1100d000 0x70>, <0x11000300 0x80>;
      interrupts = <GIC_SPI 44 IRQ_TYPE_LEVEL_LOW>;
      clocks = <&i2c0_ck>, <&ap_dma_ck>;
      clock-names = "main", "dma";
      clock-div = <16>;
      clock-frequency = <400000>;
      mediatek,have-pmic;

      #address-cells = <1>;
      #size-cells = <0>;
    };
```

## Documentation/devicetree/bindings/i2c/i2c-mt7621.txt
```
MediaTek MT7621/MT7628 I2C master controller

Required properties:

- compatible: Should be one of the following:
  - "mediatek,mt7621-i2c": for MT7621/MT7628/MT7688 platforms
- #address-cells: should be 1.
- #size-cells: should be 0.
- reg: Address and length of the register set for the device
- resets: phandle to the reset controller asserting this device in
          reset
  See ../reset/reset.txt for details.

Optional properties :

Example:

i2c: i2c@900 {
	compatible = "mediatek,mt7621-i2c";
	reg = <0x900 0x100>;
	#address-cells = <1>;
	#size-cells = <0>;
	resets = <&rstctrl 16>;
	reset-names = "i2c";
};
```

## Documentation/devicetree/bindings/i2c/i2c-mtk.txt
```
* MediaTek's I2C controller

The MediaTek's I2C controller is used to interface with I2C devices.

Required properties:
  - compatible: value should be either of the following.
      "mediatek,mt2701-i2c", "mediatek,mt6577-i2c": for MediaTek MT2701
      "mediatek,mt2712-i2c": for MediaTek MT2712
      "mediatek,mt6577-i2c": for MediaTek MT6577
      "mediatek,mt6589-i2c": for MediaTek MT6589
      "mediatek,mt7622-i2c": for MediaTek MT7622
      "mediatek,mt7623-i2c", "mediatek,mt6577-i2c": for MediaTek MT7623
      "mediatek,mt8173-i2c": for MediaTek MT8173
  - reg: physical base address of the controller and dma base, length of memory
    mapped region.
  - interrupts: interrupt number to the cpu.
  - clock-div: the fixed value for frequency divider of clock source in i2c
    module. Each IC may be different.
  - clocks: clock name from clock manager
  - clock-names: Must include "main" and "dma", if enable have-pmic need include
    "pmic" extra.

Optional properties:
  - clock-frequency: Frequency in Hz of the bus when transfer, the default value
    is 100000.
  - mediatek,have-pmic: platform can control i2c form special pmic side.
    Only mt6589 and mt8135 support this feature.
  - mediatek,use-push-pull: IO config use push-pull mode.

Example:

	i2c0: i2c@1100d000 {
			compatible = "mediatek,mt6577-i2c";
			reg = <0x1100d000 0x70>,
			      <0x11000300 0x80>;
			interrupts = <GIC_SPI 44 IRQ_TYPE_LEVEL_LOW>;
			clock-frequency = <400000>;
			mediatek,have-pmic;
			clock-div = <16>;
			clocks = <&i2c0_ck>, <&ap_dma_ck>;
			clock-names = "main", "dma";
	};
```

## Documentation/devicetree/bindings/i2c/i2c-mux-gpio.txt
```
GPIO-based I2C Bus Mux

This binding describes an I2C bus multiplexer that uses GPIOs to
route the I2C signals.

                                  +-----+  +-----+
                                  | dev |  | dev |
    +------------+                +-----+  +-----+
    | SoC        |                   |        |
    |            |          /--------+--------+
    |   +------+ |  +------+    child bus A, on GPIO value set to 0
    |   | I2C  |-|--| Mux  |
    |   +------+ |  +--+---+    child bus B, on GPIO value set to 1
    |            |     |    \----------+--------+--------+
    |   +------+ |     |               |        |        |
    |   | GPIO |-|-----+            +-----+  +-----+  +-----+
    |   +------+ |                  | dev |  | dev |  | dev |
    +------------+                  +-----+  +-----+  +-----+

Required properties:
- compatible: i2c-mux-gpio
- i2c-parent: The phandle of the I2C bus that this multiplexer's master-side
  port is connected to.
- mux-gpios: list of gpios used to control the muxer
* Standard I2C mux properties. See mux.txt in this directory.
* I2C child bus nodes. See mux.txt in this directory.

Optional properties:
- idle-state: value to set the muxer to when idle. When no value is
  given, it defaults to the last value used.

For each i2c child node, an I2C child bus will be created. They will
be numbered based on their order in the device tree.

Whenever an access is made to a device on a child bus, the value set
in the revelant node's reg property will be output using the list of
GPIOs, the first in the list holding the least-significant value.

If an idle state is defined, using the idle-state (optional) property,
whenever an access is not being made to a device on a child bus, the
GPIOs will be set according to the idle value.

If an idle state is not defined, the most recently used value will be
left programmed into hardware whenever no access is being made to a
device on a child bus.

Example:
	i2cmux {
		compatible = "i2c-mux-gpio";
		#address-cells = <1>;
		#size-cells = <0>;
		mux-gpios = <&gpio1 22 0 &gpio1 23 0>;
		i2c-parent = <&i2c1>;

		i2c@1 {
			reg = <1>;
			#address-cells = <1>;
			#size-cells = <0>;

			ssd1307: oled@3c {
				compatible = "solomon,ssd1307fb-i2c";
				reg = <0x3c>;
				pwms = <&pwm 4 3000>;
				reset-gpios = <&gpio2 7 1>;
				reset-active-low;
			};
		};

		i2c@3 {
			reg = <3>;
			#address-cells = <1>;
			#size-cells = <0>;

			pca9555: pca9555@20 {
				compatible = "nxp,pca9555";
				gpio-controller;
				#gpio-cells = <2>;
				reg = <0x20>;
			};
		};
	};
```

## Documentation/devicetree/bindings/i2c/i2c-mux-gpio.yaml
```yaml
# SPDX-License-Identifier: GPL-2.0-only
%YAML 1.2
---
$id: http://devicetree.org/schemas/i2c/i2c-mux-gpio.yaml#
$schema: http://devicetree.org/meta-schemas/core.yaml#

title: GPIO-based I2C Bus Mux

maintainers:
  - Wolfram Sang <wsa@kernel.org>

description: |
  This binding describes an I2C bus multiplexer that uses GPIOs to route the I2C signals.

                                  +-----+  +-----+
                                  | dev |  | dev |
    +------------+                +-----+  +-----+
    | SoC        |                   |        |
    |            |          /--------+--------+
    |   +------+ |  +------+    child bus A, on GPIO value set to 0
    |   | I2C  |-|--| Mux  |
    |   +------+ |  +--+---+    child bus B, on GPIO value set to 1
    |            |     |    \----------+--------+--------+
    |   +------+ |     |               |        |        |
    |   | GPIO |-|-----+            +-----+  +-----+  +-----+
    |   +------+ |                  | dev |  | dev |  | dev |
    +------------+                  +-----+  +-----+  +-----+

  For each I2C child node, an I2C child bus will be created. They will be numbered based on their
  order in the device tree.

  Whenever an access is made to a device on a child bus, the value set in the relevant node's reg
  property will be output using the list of GPIOs, the first in the list holding the least-
  significant value.

  If an idle state is defined, using the idle-state (optional) property, whenever an access is not
  being made to a device on a child bus, the GPIOs will be set according to the idle value.

  If an idle state is not defined, the most recently used value will be left programmed into
  hardware whenever no access is being made to a device on a child bus.

properties:
  compatible:
    const: i2c-mux-gpio

  i2c-parent:
    description: phandle of the I2C bus that this multiplexer's master-side port is connected to
    $ref: "/schemas/types.yaml#/definitions/phandle"

  mux-gpios:
    description: list of GPIOs used to control the muxer
    minItems: 1
    maxItems: 4  # Should be enough

  idle-state:
    description: Value to set the muxer to when idle. When no value is given, it defaults to the
      last value used.
    $ref: "/schemas/types.yaml#/definitions/uint32"

allOf:
  - $ref: i2c-mux.yaml

unevaluatedProperties: false

required:
  - compatible
  - i2c-parent
  - mux-gpios

examples:
  - |
    i2cmux {
      compatible = "i2c-mux-gpio";
      #address-cells = <1>;
      #size-cells = <0>;
      mux-gpios = <&gpio1 22 0>, <&gpio1 23 0>;
      i2c-parent = <&i2c1>;

      i2c@1 {
        reg = <1>;
        #address-cells = <1>;
        #size-cells = <0>;

        ssd1307: oled@3c {
          compatible = "solomon,ssd1307fb-i2c";
          reg = <0x3c>;
          pwms = <&pwm 4 3000>;
          reset-gpios = <&gpio2 7 1>;
        };
      };

      i2c@3 {
        reg = <3>;
        #address-cells = <1>;
        #size-cells = <0>;

        pca9555: pca9555@20 {
          compatible = "nxp,pca9555";
          gpio-controller;
          #gpio-cells = <2>;
          reg = <0x20>;
        };
      };
    };
```

## Documentation/devicetree/bindings/i2c/i2c-mux-gpmux.txt
```
General Purpose I2C Bus Mux

This binding describes an I2C bus multiplexer that uses a mux controller
from the mux subsystem to route the I2C signals.

                                  .-----.  .-----.
                                  | dev |  | dev |
    .------------.                '-----'  '-----'
    | SoC        |                   |        |
    |            |          .--------+--------'
    |   .------. |  .------+    child bus A, on MUX value set to 0
    |   | I2C  |-|--| Mux  |
    |   '------' |  '--+---+    child bus B, on MUX value set to 1
    |   .------. |     |    '----------+--------+--------.
    |   | MUX- | |     |               |        |        |
    |   | Ctrl |-|-----+            .-----.  .-----.  .-----.
    |   '------' |                  | dev |  | dev |  | dev |
    '------------'                  '-----'  '-----'  '-----'

Required properties:
- compatible: i2c-mux
- i2c-parent: The phandle of the I2C bus that this multiplexer's master-side
  port is connected to.
- mux-controls: The phandle of the mux controller to use for operating the
  mux.
* Standard I2C mux properties. See i2c-mux.txt in this directory.
* I2C child bus nodes. See i2c-mux.txt in this directory. The sub-bus number
  is also the mux-controller state described in ../mux/mux-controller.txt

Optional properties:
- mux-locked: If present, explicitly allow unrelated I2C transactions on the
  parent I2C adapter at these times:
   + during setup of the multiplexer
   + between setup of the multiplexer and the child bus I2C transaction
   + between the child bus I2C transaction and releasing of the multiplexer
   + during releasing of the multiplexer
  However, I2C transactions to devices behind all I2C multiplexers connected
  to the same parent adapter that this multiplexer is connected to are blocked
  for the full duration of the complete multiplexed I2C transaction (i.e.
  including the times covered by the above list).
  If mux-locked is not present, the multiplexer is assumed to be parent-locked.
  This means that no unrelated I2C transactions are allowed on the parent I2C
  adapter for the complete multiplexed I2C transaction.
  The properties of mux-locked and parent-locked multiplexers are discussed
  in more detail in Documentation/i2c/i2c-topology.

For each i2c child node, an I2C child bus will be created. They will
be numbered based on their order in the device tree.

Whenever an access is made to a device on a child bus, the value set
in the relevant node's reg property will be set as the state in the
mux controller.

Example:
	mux: mux-controller {
		compatible = "gpio-mux";
		#mux-control-cells = <0>;

		mux-gpios = <&pioA 0 GPIO_ACTIVE_HIGH>,
			    <&pioA 1 GPIO_ACTIVE_HIGH>;
	};

	i2c-mux {
		compatible = "i2c-mux";
		mux-locked;
		i2c-parent = <&i2c1>;

		mux-controls = <&mux>;

		#address-cells = <1>;
		#size-cells = <0>;

		i2c@1 {
			reg = <1>;
			#address-cells = <1>;
			#size-cells = <0>;

			ssd1307: oled@3c {
				compatible = "solomon,ssd1307fb-i2c";
				reg = <0x3c>;
				pwms = <&pwm 4 3000>;
				reset-gpios = <&gpio2 7 1>;
				reset-active-low;
			};
		};

		i2c@3 {
			reg = <3>;
			#address-cells = <1>;
			#size-cells = <0>;

			pca9555: pca9555@20 {
				compatible = "nxp,pca9555";
				gpio-controller;
				#gpio-cells = <2>;
				reg = <0x20>;
			};
		};
	};
```
