## Documentation/devicetree/bindings/i2c/i2c-mux-reg.txt
```
Register-based I2C Bus Mux

This binding describes an I2C bus multiplexer that uses a single register
to route the I2C signals.

Required properties:
- compatible: i2c-mux-reg
- i2c-parent: The phandle of the I2C bus that this multiplexer's master-side
  port is connected to.
* Standard I2C mux properties. See i2c-mux.yaml in this directory.
* I2C child bus nodes. See i2c-mux.yaml in this directory.

Optional properties:
- reg: this pair of <offset size> specifies the register to control the mux.
  The <offset size> depends on its parent node. It can be any memory-mapped
  address. The size must be either 1, 2, or 4 bytes. If reg is omitted, the
  resource of this device will be used.
- little-endian: The existence indicates the register is in little endian.
- big-endian: The existence indicates the register is in big endian.
  If both little-endian and big-endian are omitted, the endianness of the
  CPU will be used.
- write-only: The existence indicates the register is write-only.
- idle-state: value to set the muxer to when idle. When no value is
  given, it defaults to the last value used.

Whenever an access is made to a device on a child bus, the value set
in the relevant node's reg property will be output to the register.

If an idle state is defined, using the idle-state (optional) property,
whenever an access is not being made to a device on a child bus, the
register will be set according to the idle value.

If an idle state is not defined, the most recently used value will be
left programmed into the register.

Example of a mux on PCIe card, the host is a powerpc SoC (big endian):

	i2c-mux {
		/* the <offset size> depends on the address translation
		 * of the parent device. If omitted, device resource
		 * will be used instead. The size is to determine
		 * whether iowrite32, iowrite16, or iowrite8 will be used.
		 */
		reg = <0x6028 0x4>;
		little-endian;		/* little endian register on PCIe */
		compatible = "i2c-mux-reg";
		#address-cells = <1>;
		#size-cells = <0>;
		i2c-parent = <&i2c1>;
		i2c@0 {
			reg = <0>;
			#address-cells = <1>;
			#size-cells = <0>;

			si5338: clock-generator@70 {
				compatible = "silabs,si5338";
				reg = <0x70>;
				/* other stuff */
			};
		};

		i2c@1 {
			/* data is written using iowrite32 */
			reg = <1>;
			#address-cells = <1>;
			#size-cells = <0>;

			si5338: clock-generator@70 {
				compatible = "silabs,si5338";
				reg = <0x70>;
				/* other stuff */
			};
		};
	};
```

## Documentation/devicetree/bindings/i2c/i2c-mux-reg.yaml
```yaml
# SPDX-License-Identifier: (GPL-2.0-only OR BSD-2-Clause)
%YAML 1.2
---
$id: http://devicetree.org/schemas/i2c/i2c-mux-reg.yaml#
$schema: http://devicetree.org/meta-schemas/core.yaml#

title: Register-based I2C Bus Mux

maintainers:
  - Peter Rosin <peda@axentia.se>

description: |
  This binding describes an I2C bus multiplexer that uses a single
  memory-mapped register to route the I2C signals.

  Whenever an access is made to a device on a child bus, the value
  set in the relevant node's reg property is output to the register.

  If an idle state is defined via the idle-state property, the
  register is set to that value whenever no access is being made.
  Otherwise the most recently used value is left programmed.

allOf:
  - $ref: /schemas/i2c/i2c-mux.yaml#

properties:
  compatible:
    const: i2c-mux-reg

  reg:
    maxItems: 1
    description: |
      Offset and size of the register that selects the active child
      bus, relative to the parent node's address space. The size
      determines the access width and must be 1, 2, or 4 bytes. If
      omitted, the platform device's own memory resource is used
      instead.

  i2c-parent:
    $ref: /schemas/types.yaml#/definitions/phandle
    description:
      Phandle of the I2C bus that this multiplexer's master-side port
      is connected to.

  little-endian:
    type: boolean
    description: Register is accessed in little-endian byte order.

  big-endian:
    type: boolean
    description: Register is accessed in big-endian byte order.

  write-only:
    type: boolean
    description:
      Register is write-only; the driver must not read back the
      current selection.

  idle-state:
    $ref: /schemas/types.yaml#/definitions/uint32
    description:
      Value to write to the register when no child bus is selected.

required:
  - compatible
  - i2c-parent

unevaluatedProperties: false

examples:
  - |
    i2c-mux@6028 {
        compatible = "i2c-mux-reg";
        reg = <0x6028 0x4>;
        little-endian;
        #address-cells = <1>;
        #size-cells = <0>;
        i2c-parent = <&i2c1>;

        i2c@0 {
            reg = <0>;
            #address-cells = <1>;
            #size-cells = <0>;
        };

        i2c@1 {
            reg = <1>;
            #address-cells = <1>;
            #size-cells = <0>;
        };
    };
...
```

## Documentation/devicetree/bindings/i2c/i2c-mux.txt
```
Common i2c bus multiplexer/switch properties.

An i2c bus multiplexer/switch will have several child busses that are
numbered uniquely in a device dependent manner.  The yesdes for an i2c bus
multiplexer/switch will have one child yesde for each child bus.

Optional properties:
- #address-cells = <1>;
   This property is required if the i2c-mux child yesde does yest exist.

- #size-cells = <0>;
   This property is required if the i2c-mux child yesde does yest exist.

- i2c-mux
   For i2c multiplexers/switches that have child yesdes that are a mixture
   of both i2c child busses and other child yesdes, the 'i2c-mux' subyesde
   can be used for populating the i2c child busses.  If an 'i2c-mux'
   subyesde is present, only subyesdes of this will be considered as i2c
   child busses.

Required properties for the i2c-mux child yesde:
- #address-cells = <1>;
- #size-cells = <0>;

Required properties for i2c child bus yesdes:
- #address-cells = <1>;
- #size-cells = <0>;
- reg : The sub-bus number.

Optional properties for i2c child bus yesdes:
- Other properties specific to the multiplexer/switch hardware.
- Child yesdes conforming to i2c bus binding


Example :

	/*
	   An NXP pca9548 8 channel I2C multiplexer at address 0x70
	   with two NXP pca8574 GPIO expanders attached, one each to
	   ports 3 and 4.
	 */

	mux@70 {
		compatible = "nxp,pca9548";
		reg = <0x70>;
		#address-cells = <1>;
		#size-cells = <0>;

		i2c@3 {
			#address-cells = <1>;
			#size-cells = <0>;
			reg = <3>;

			gpio1: gpio@38 {
				compatible = "nxp,pca8574";
				reg = <0x38>;
				#gpio-cells = <2>;
				gpio-controller;
			};
		};
		i2c@4 {
			#address-cells = <1>;
			#size-cells = <0>;
			reg = <4>;

			gpio2: gpio@38 {
				compatible = "nxp,pca8574";
				reg = <0x38>;
				#gpio-cells = <2>;
				gpio-controller;
			};
		};
	};
```

## Documentation/devicetree/bindings/i2c/i2c-mux.yaml
```yaml
# SPDX-License-Identifier: GPL-2.0
%YAML 1.2
---
$id: http://devicetree.org/schemas/i2c/i2c-mux.yaml#
$schema: http://devicetree.org/meta-schemas/core.yaml#

title: Common i2c bus multiplexer/switch properties.

maintainers:
  - Peter Rosin <peda@axentia.se>

description: |+
  An i2c bus multiplexer/switch will have several child busses that are numbered
  uniquely in a device dependent manner.  The nodes for an i2c bus
  multiplexer/switch will have one child node for each child bus.

  For i2c multiplexers/switches that have child nodes that are a mixture of both
  i2c child busses and other child nodes, the 'i2c-mux' subnode can be used for
  populating the i2c child busses.  If an 'i2c-mux' subnode is present, only
  subnodes of this will be considered as i2c child busses.

properties:
  $nodename:
    pattern: '^(i2c-?)?mux'

  '#address-cells':
    const: 1

  '#size-cells':
    const: 0

patternProperties:
  '^i2c@[0-9a-f]+$':
    $ref: /schemas/i2c/i2c-controller.yaml
    unevaluatedProperties: false

    properties:
      reg:
        description: The mux selector sub-bus number for the child I2C bus.
        maxItems: 1

additionalProperties: true

examples:
  - |
    /*
     * An NXP pca9548 8 channel I2C multiplexer at address 0x70
     * with two NXP pca8574 GPIO expanders attached, one each to
     * ports 3 and 4.
     */
    i2c {
        #address-cells = <1>;
        #size-cells = <0>;

        i2c-mux@70 {
            compatible = "nxp,pca9548";
            reg = <0x70>;
            #address-cells = <1>;
            #size-cells = <0>;

            i2c@3 {
                #address-cells = <1>;
                #size-cells = <0>;
                reg = <3>;

                gpio@20 {
                    compatible = "nxp,pca9555";
                    gpio-controller;
                    #gpio-cells = <2>;
                    reg = <0x20>;
                };
            };
            i2c@4 {
                #address-cells = <1>;
                #size-cells = <0>;
                reg = <4>;

                gpio@20 {
                    compatible = "nxp,pca9555";
                    gpio-controller;
                    #gpio-cells = <2>;
                    reg = <0x20>;
                };
            };
        };
    };
...
```
