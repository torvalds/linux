## Documentation/devicetree/bindings/i2c/i2c-mux-gpmux.yaml
```yaml
# SPDX-License-Identifier: GPL-2.0
%YAML 1.2
---
$id: http://devicetree.org/schemas/i2c/i2c-mux-gpmux.yaml#
$schema: http://devicetree.org/meta-schemas/core.yaml#

title: General Purpose I2C Bus Mux

maintainers:
  - Peter Rosin <peda@axentia.se>

description: |+
  This binding describes an I2C bus multiplexer that uses a mux controller
  from the mux subsystem to route the I2C signals.

                                    .-----.  .-----.
                                    | dev |  | dev |
      .------------.                '-----'  '-----'
      | SoC        |                   |        |
      |            |          .--------+--------'
      |   .------. |  .------+    child bus A, on MUX value set to 0
      |   | I2C  |-|--| Mux  |
      |   '------' |  '--+---+    child bus B, on MUX value set to 1
      |   .------. |     |    '----------+--------+--------.
      |   | MUX- | |     |               |        |        |
      |   | Ctrl |-|-----+            .-----.  .-----.  .-----.
      |   '------' |                  | dev |  | dev |  | dev |
      '------------'                  '-----'  '-----'  '-----'


allOf:
  - $ref: /schemas/i2c/i2c-mux.yaml#

properties:
  compatible:
    const: i2c-mux

  i2c-parent:
    $ref: /schemas/types.yaml#/definitions/phandle
    description:
      The phandle of the I2C bus that this multiplexer's master-side port is
      connected to.

  mux-controls:
    maxItems: 1
    description:
      The mux-controller states are the I2C sub-bus numbers.

  mux-locked:
    type: boolean
    description: |
      Explicitly allow unrelated I2C transactions on the parent I2C adapter at
      these times:
       - during setup of the multiplexer
       - between setup of the multiplexer and the child bus I2C transaction
       - between the child bus I2C transaction and releasing of the multiplexer
       - during releasing of the multiplexer

      However, I2C transactions to devices behind all I2C multiplexers connected
      to the same parent adapter that this multiplexer is connected to are blocked
      for the full duration of the complete multiplexed I2C transaction (i.e.
      including the times covered by the above list).
      If mux-locked is not present, the multiplexer is assumed to be parent-locked.
      This means that no unrelated I2C transactions are allowed on the parent I2C
      adapter for the complete multiplexed I2C transaction.
      The properties of mux-locked and parent-locked multiplexers are discussed
      in more detail in Documentation/i2c/i2c-topology.rst.

required:
  - compatible
  - i2c-parent
  - mux-controls

unevaluatedProperties: false

examples:
  - |
    #include <dt-bindings/gpio/gpio.h>
    mux: mux-controller {
        compatible = "gpio-mux";
        #mux-control-cells = <0>;

        mux-gpios = <&pioA 0 GPIO_ACTIVE_HIGH>,
                    <&pioA 1 GPIO_ACTIVE_HIGH>;
    };

    i2c-mux {
        compatible = "i2c-mux";
        mux-locked;
        i2c-parent = <&i2c1>;

        mux-controls = <&mux>;

        #address-cells = <1>;
        #size-cells = <0>;

        i2c@1 {
            reg = <1>;
            #address-cells = <1>;
            #size-cells = <0>;

            gpio@20 {
                compatible = "nxp,pca9555";
                gpio-controller;
                #gpio-cells = <2>;
                reg = <0x20>;
            };
        };

        i2c@3 {
            reg = <3>;
            #address-cells = <1>;
            #size-cells = <0>;

            gpio@20 {
                compatible = "nxp,pca9555";
                gpio-controller;
                #gpio-cells = <2>;
                reg = <0x20>;
            };
        };
    };
...
```

## Documentation/devicetree/bindings/i2c/i2c-mux-ltc4306.txt
```
* Linear Technology / Analog Devices I2C bus switch

Required Properties:

  - compatible: Must contain one of the following.
    "lltc,ltc4305", "lltc,ltc4306"
  - reg: The I2C address of the device.

  The following required properties are defined externally:

  - Standard I2C mux properties. See i2c-mux.txt in this directory.
  - I2C child bus nodes. See i2c-mux.txt in this directory.

Optional Properties:

  - enable-gpios: Reference to the GPIO connected to the enable input.
  - i2c-mux-idle-disconnect: Boolean; if defined, forces mux to disconnect all
    children in idle state. This is necessary for example, if there are several
    multiplexers on the bus and the devices behind them use same I2C addresses.
  - gpio-controller: Marks the device node as a GPIO Controller.
  - #gpio-cells: Should be two.  The first cell is the pin number and
	the second cell is used to specify flags.
	See ../gpio/gpio.txt for more information.
  - ltc,downstream-accelerators-enable: Enables the rise time accelerators
	on the downstream port.
  - ltc,upstream-accelerators-enable: Enables the rise time accelerators
	on the upstream port.

Example:

	ltc4306: i2c-mux@4a {
		compatible = "lltc,ltc4306";
		#address-cells = <1>;
		#size-cells = <0>;
		reg = <0x4a>;

		gpio-controller;
		#gpio-cells = <2>;

		i2c@0 {
			#address-cells = <1>;
			#size-cells = <0>;
			reg = <0>;

			eeprom@50 {
				compatible = "atmel,24c02";
				reg = <0x50>;
			};
		};

		i2c@1 {
			#address-cells = <1>;
			#size-cells = <0>;
			reg = <1>;

			eeprom@50 {
				compatible = "atmel,24c02";
				reg = <0x50>;
			};
		};
	};
```

## Documentation/devicetree/bindings/i2c/i2c-mux-pca954x.txt
```
* NXP PCA954x I2C bus switch

The driver supports NXP PCA954x and PCA984x I2C mux/switch devices.

Required Properties:

  - compatible: Must contain one of the following.
    "nxp,pca9540",
    "nxp,pca9542",
    "nxp,pca9543",
    "nxp,pca9544",
    "nxp,pca9545",
    "nxp,pca9546", "nxp,pca9846",
    "nxp,pca9547", "nxp,pca9847",
    "nxp,pca9548", "nxp,pca9848",
    "nxp,pca9849"

  - reg: The I2C address of the device.

  The following required properties are defined externally:

  - Standard I2C mux properties. See i2c-mux.txt in this directory.
  - I2C child bus nodes. See i2c-mux.txt in this directory.

Optional Properties:

  - reset-gpios: Reference to the GPIO connected to the reset input.
  - i2c-mux-idle-disconnect: Boolean; if defined, forces mux to disconnect all
    children in idle state. This is necessary for example, if there are several
    multiplexers on the bus and the devices behind them use same I2C addresses.
  - interrupt-parent: Phandle for the interrupt controller that services
    interrupts for this device.
  - interrupts: Interrupt mapping for IRQ.
  - interrupt-controller: Marks the device node as an interrupt controller.
  - #interrupt-cells : Should be two.
    - first cell is the pin number
    - second cell is used to specify flags.
    See also Documentation/devicetree/bindings/interrupt-controller/interrupts.txt

Example:

	i2c-switch@74 {
		compatible = "nxp,pca9548";
		#address-cells = <1>;
		#size-cells = <0>;
		reg = <0x74>;

		interrupt-parent = <&ipic>;
		interrupts = <17 IRQ_TYPE_LEVEL_LOW>;
		interrupt-controller;
		#interrupt-cells = <2>;

		i2c@2 {
			#address-cells = <1>;
			#size-cells = <0>;
			reg = <2>;

			eeprom@54 {
				compatible = "at,24c08";
				reg = <0x54>;
			};
		};

		i2c@4 {
			#address-cells = <1>;
			#size-cells = <0>;
			reg = <4>;

			rtc@51 {
				compatible = "nxp,pcf8563";
				reg = <0x51>;
			};
		};
	};
```

## Documentation/devicetree/bindings/i2c/i2c-mux-pca954x.yaml
```yaml
# SPDX-License-Identifier: GPL-2.0
%YAML 1.2
---
$id: http://devicetree.org/schemas/i2c/i2c-mux-pca954x.yaml#
$schema: http://devicetree.org/meta-schemas/core.yaml#

title: NXP PCA954x I2C and compatible bus switches

maintainers:
  - Laurent Pinchart <laurent.pinchart@ideasonboard.com>

description:
  The NXP PCA954x and compatible devices are I2C bus
  multiplexer/switches that share the same functionality
  and register layout.
  The devices usually have 4 or 8 child buses, which are
  attached to the parent bus by using the SMBus "Send Byte"
  command.

properties:
  compatible:
    oneOf:
      - enum:
          - maxim,max7356
          - maxim,max7357
          - maxim,max7358
          - maxim,max7367
          - maxim,max7368
          - maxim,max7369
          - nxp,pca9540
          - nxp,pca9542
          - nxp,pca9543
          - nxp,pca9544
          - nxp,pca9545
          - nxp,pca9546
          - nxp,pca9547
          - nxp,pca9548
          - nxp,pca9846
          - nxp,pca9847
          - nxp,pca9848
          - nxp,pca9849
      - items:
          - const: nxp,pca9646
          - const: nxp,pca9546

  reg:
    maxItems: 1

  interrupts:
    maxItems: 1

  "#interrupt-cells":
    const: 2

  interrupt-controller: true

  reset-gpios:
    maxItems: 1

  i2c-mux-idle-disconnect:
    type: boolean
    description: Forces mux to disconnect all children in idle state. This is
      necessary for example, if there are several multiplexers on the bus and
      the devices behind them use same I2C addresses.

  idle-state:
    description: if present, overrides i2c-mux-idle-disconnect
    $ref: /schemas/mux/mux-controller.yaml#/properties/idle-state

  vdd-supply:
    description: A voltage regulator supplying power to the chip. On PCA9846
      the regulator supplies power to VDD2 (core logic) and optionally to VDD1.

  maxim,isolate-stuck-channel:
    type: boolean
    description: Allows to use non faulty channels while a stuck channel is
      isolated from the upstream bus. If not set all channels are isolated from
      the upstream bus until the fault is cleared.

  maxim,send-flush-out-sequence:
    type: boolean
    description: Send a flush-out sequence to stuck auxiliary buses
      automatically after a stuck channel is being detected.

  maxim,preconnection-wiggle-test-enable:
    type: boolean
    description: Send a STOP condition to the auxiliary buses when the switch
      register activates a channel to detect a stuck high fault. On fault the
      channel is isolated from the upstream bus.

required:
  - compatible
  - reg

allOf:
  - $ref: /schemas/i2c/i2c-mux.yaml#
  - if:
      not:
        properties:
          compatible:
            contains:
              enum:
                - maxim,max7367
                - maxim,max7369
                - nxp,pca9542
                - nxp,pca9543
                - nxp,pca9544
                - nxp,pca9545
    then:
      properties:
        interrupts: false
        "#interrupt-cells": false
        interrupt-controller: false

  - if:
      not:
        properties:
          compatible:
            contains:
              enum:
                - maxim,max7357
    then:
      properties:
        maxim,isolate-stuck-channel: false
        maxim,send-flush-out-sequence: false
        maxim,preconnection-wiggle-test-enable: false

unevaluatedProperties: false

examples:
  - |
    #include <dt-bindings/interrupt-controller/irq.h>

    i2c {
        #address-cells = <1>;
        #size-cells = <0>;

        i2c-mux@74 {
            compatible = "nxp,pca9545";
            #address-cells = <1>;
            #size-cells = <0>;
            reg = <0x74>;

            vdd-supply = <&p3v3>;

            interrupt-parent = <&ipic>;
            interrupts = <17 IRQ_TYPE_LEVEL_LOW>;
            interrupt-controller;
            #interrupt-cells = <2>;

            i2c@2 {
                #address-cells = <1>;
                #size-cells = <0>;
                reg = <2>;

                eeprom@54 {
                    compatible = "atmel,24c08";
                    reg = <0x54>;
                };
            };

            i2c@4 {
                #address-cells = <1>;
                #size-cells = <0>;
                reg = <4>;

                rtc@51 {
                    compatible = "nxp,pcf8563";
                    reg = <0x51>;
                };
            };
        };
    };
...
```

## Documentation/devicetree/bindings/i2c/i2c-mux-pinctrl.txt
```
Pinctrl-based I2C Bus Mux

This binding describes an I2C bus multiplexer that uses pin multiplexing to
route the I2C signals, and represents the pin multiplexing configuration
using the pinctrl device tree bindings.

                                 +-----+  +-----+
                                 | dev |  | dev |
    +------------------------+   +-----+  +-----+
    | SoC                    |      |        |
    |                   /----|------+--------+
    |   +---+   +------+     | child bus A, on first set of pins
    |   |I2C|---|Pinmux|     |
    |   +---+   +------+     | child bus B, on second set of pins
    |                   \----|------+--------+--------+
    |                        |      |        |        |
    +------------------------+  +-----+  +-----+  +-----+
                                | dev |  | dev |  | dev |
                                +-----+  +-----+  +-----+

Required properties:
- compatible: i2c-mux-pinctrl
- i2c-parent: The phandle of the I2C bus that this multiplexer's master-side
  port is connected to.

Also required are:

* Standard pinctrl properties that specify the pin mux state for each child
  bus. See ../pinctrl/pinctrl-bindings.txt.

* Standard I2C mux properties. See i2c-mux.txt in this directory.

* I2C child bus nodes. See i2c-mux.txt in this directory.

For each named state defined in the pinctrl-names property, an I2C child bus
will be created. I2C child bus numbers are assigned based on the index into
the pinctrl-names property.

The only exception is that no bus will be created for a state named "idle". If
such a state is defined, it must be the last entry in pinctrl-names. For
example:

	pinctrl-names = "ddc", "pta", "idle"  ->  ddc = bus 0, pta = bus 1
	pinctrl-names = "ddc", "idle", "pta"  ->  Invalid ("idle" not last)
	pinctrl-names = "idle", "ddc", "pta"  ->  Invalid ("idle" not last)

Whenever an access is made to a device on a child bus, the relevant pinctrl
state will be programmed into hardware.

If an idle state is defined, whenever an access is not being made to a device
on a child bus, the idle pinctrl state will be programmed into hardware.

If an idle state is not defined, the most recently used pinctrl state will be
left programmed into hardware whenever no access is being made of a device on
a child bus.

Example:

	i2cmux {
		compatible = "i2c-mux-pinctrl";
		#address-cells = <1>;
		#size-cells = <0>;

		i2c-parent = <&i2c1>;

		pinctrl-names = "ddc", "pta", "idle";
		pinctrl-0 = <&state_i2cmux_ddc>;
		pinctrl-1 = <&state_i2cmux_pta>;
		pinctrl-2 = <&state_i2cmux_idle>;

		i2c@0 {
			reg = <0>;
			#address-cells = <1>;
			#size-cells = <0>;

			eeprom {
				compatible = "eeprom";
				reg = <0x50>;
			};
		};

		i2c@1 {
			reg = <1>;
			#address-cells = <1>;
			#size-cells = <0>;

			eeprom {
				compatible = "eeprom";
				reg = <0x50>;
			};
		};
	};
```
