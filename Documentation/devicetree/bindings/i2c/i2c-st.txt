## Documentation/devicetree/bindings/i2c/i2c-st.txt
```
ST SSC binding, for I2C mode operation

Required properties :
- compatible : Must be "st,comms-ssc-i2c" or "st,comms-ssc4-i2c"
- reg : Offset and length of the register set for the device
- interrupts : the interrupt specifier
- clock-names: Must contain "ssc".
- clocks: Must contain an entry for each name in clock-names. See the common
  clock bindings.
- A pinctrl state named "default" must be defined to set pins in mode of
  operation for I2C transfer.

Optional properties :
- clock-frequency : Desired I2C bus clock frequency in Hz. If not specified,
  the default 100 kHz frequency will be used. As only Normal and Fast modes
  are supported, possible values are 100000 and 400000.
- st,i2c-min-scl-pulse-width-us : The minimum valid SCL pulse width that is
  allowed through the deglitch circuit. In units of us.
- st,i2c-min-sda-pulse-width-us : The minimum valid SDA pulse width that is
  allowed through the deglitch circuit. In units of us.
- A pinctrl state named "idle" could be defined to set pins in idle state
  when I2C instance is not performing a transfer.
- A pinctrl state named "sleep" could be defined to set pins in sleep state
  when driver enters in suspend.



Example :

i2c0: i2c@fed40000 {
	compatible	= "st,comms-ssc4-i2c";
	reg		= <0xfed40000 0x110>;
	interrupts	=  <GIC_SPI 187 IRQ_TYPE_LEVEL_HIGH>;
	clocks		= <&clk_s_a0_ls CLK_ICN_REG>;
	clock-names	= "ssc";
	clock-frequency = <400000>;
	pinctrl-names	= "default";
	pinctrl-0	= <&pinctrl_i2c0_default>;
	st,i2c-min-scl-pulse-width-us = <0>;
	st,i2c-min-sda-pulse-width-us = <5>;
};
```

## Documentation/devicetree/bindings/i2c/i2c-stm32.txt
```
* I2C controller embedded in STMicroelectronics STM32 I2C platform

Required properties :
- compatible : Must be one of the following
  - "st,stm32f4-i2c"
  - "st,stm32f7-i2c"
- reg : Offset and length of the register set for the device
- interrupts : Must contain the interrupt id for I2C event and then the
  interrupt id for I2C error.
- resets: Must contain the phandle to the reset controller.
- clocks: Must contain the input clock of the I2C instance.
- A pinctrl state named "default" must be defined to set pins in mode of
  operation for I2C transfer
- #address-cells = <1>;
- #size-cells = <0>;

Optional properties :
- clock-frequency : Desired I2C bus clock frequency in Hz. If not specified,
  the default 100 kHz frequency will be used.
  For STM32F4 SoC Standard-mode and Fast-mode are supported, possible values are
  100000 and 400000.
  For STM32F7 SoC, Standard-mode, Fast-mode and Fast-mode Plus are supported,
  possible values are 100000, 400000 and 1000000.
- i2c-scl-rising-time-ns : Only for STM32F7, I2C SCL Rising time for the board
  (default: 25)
- i2c-scl-falling-time-ns : Only for STM32F7, I2C SCL Falling time for the board
  (default: 10)
  I2C Timings are derived from these 2 values
- st,syscfg-fmp:  Only for STM32F7, use to set Fast Mode Plus bit within SYSCFG
  whether Fast Mode Plus speed is selected by slave.
	1st cell : phandle to syscfg
	2nd cell : register offset within SYSCFG
	3rd cell : register bitmask for FMP bit

Example :

	i2c@40005400 {
		compatible = "st,stm32f4-i2c";
		#address-cells = <1>;
		#size-cells = <0>;
		reg = <0x40005400 0x400>;
		interrupts = <31>,
			     <32>;
		resets = <&rcc 277>;
		clocks = <&rcc 0 149>;
		pinctrl-0 = <&i2c1_sda_pin>, <&i2c1_scl_pin>;
		pinctrl-names = "default";
	};

	i2c@40005400 {
		compatible = "st,stm32f7-i2c";
		#address-cells = <1>;
		#size-cells = <0>;
		reg = <0x40005400 0x400>;
		interrupts = <31>,
			     <32>;
		resets = <&rcc STM32F7_APB1_RESET(I2C1)>;
		clocks = <&rcc 1 CLK_I2C1>;
		pinctrl-0 = <&i2c1_sda_pin>, <&i2c1_scl_pin>;
		pinctrl-names = "default";
		st,syscfg-fmp = <&syscfg 0x4 0x1>;
	};
```

## Documentation/devicetree/bindings/i2c/i2c-sun6i-p2wi.txt
```
* Allwinner P2WI (Push/Pull 2 Wire Interface) controller

Required properties :

 - reg             : Offset and length of the register set for the device.
 - compatible      : Should one of the following:
                     - "allwinner,sun6i-a31-p2wi"
 - interrupts      : The interrupt line connected to the P2WI peripheral.
 - clocks          : The gate clk connected to the P2WI peripheral.
 - resets          : The reset line connected to the P2WI peripheral.

Optional properties :

 - clock-frequency : Desired P2WI bus clock frequency in Hz. If not set the
default frequency is 100kHz

A P2WI may contain one child node encoding a P2WI slave device.

Slave device properties:
  Required properties:
   - reg           : the I2C slave address used during the initialization
                     process to switch from I2C to P2WI mode

Example:

	p2wi@1f03400 {
		compatible = "allwinner,sun6i-a31-p2wi";
		reg = <0x01f03400 0x400>;
		interrupts = <0 39 4>;
		clocks = <&apb0_gates 3>;
		clock-frequency = <6000000>;
		resets = <&apb0_rst 3>;

		axp221: pmic@68 {
			compatible = "x-powers,axp221";
			reg = <0x68>;

			/* ... */
		};
	};
```

## Documentation/devicetree/bindings/i2c/i2c-synquacer.txt
```
Socionext SynQuacer I2C

Required properties:
- compatible      : Must be "socionext,synquacer-i2c"
- reg             : Offset and length of the register set for the device
- interrupts      : A single interrupt specifier
- #address-cells  : Must be <1>;
- #size-cells     : Must be <0>;
- clock-names     : Must contain "pclk".
- clocks          : Must contain an entry for each name in clock-names.
                    (See the common clock bindings.)

Optional properties:
- clock-frequency : Desired I2C bus clock frequency in Hz. As only Normal and
                    Fast modes are supported, possible values are 100000 and
                    400000.

Example :

    i2c@51210000 {
        compatible = "socionext,synquacer-i2c";
        reg = <0x51210000 0x1000>;
        interrupts = <GIC_SPI 165 IRQ_TYPE_LEVEL_HIGH>;
        #address-cells = <1>;
        #size-cells = <0>;
        clock-names = "pclk";
        clocks = <&clk_i2c>;
        clock-frequency = <400000>;
    };
```

## Documentation/devicetree/bindings/i2c/i2c-uniphier-f.txt
```
UniPhier I2C controller (FIFO-builtin)

Required properties:
- compatible: should be "socionext,uniphier-fi2c".
- #address-cells: should be 1.
- #size-cells: should be 0.
- reg: offset and length of the register set for the device.
- interrupts: a single interrupt specifier.
- clocks: phandle to the input clock.

Optional properties:
- clock-frequency: desired I2C bus frequency in Hz.  The maximum supported
  value is 400000.  Defaults to 100000 if not specified.

Examples:

	i2c0: i2c@58780000 {
		compatible = "socionext,uniphier-fi2c";
		reg = <0x58780000 0x80>;
		#address-cells = <1>;
		#size-cells = <0>;
		interrupts = <0 41 4>;
		clocks = <&i2c_clk>;
		clock-frequency = <100000>;
	};
```

## Documentation/devicetree/bindings/i2c/i2c-uniphier.txt
```
UniPhier I2C controller (FIFO-less)

Required properties:
- compatible: should be "socionext,uniphier-i2c".
- #address-cells: should be 1.
- #size-cells: should be 0.
- reg: offset and length of the register set for the device.
- interrupts: a single interrupt specifier.
- clocks: phandle to the input clock.

Optional properties:
- clock-frequency: desired I2C bus frequency in Hz.  The maximum supported
  value is 400000.  Defaults to 100000 if not specified.

Examples:

	i2c0: i2c@58400000 {
		compatible = "socionext,uniphier-i2c";
		reg = <0x58400000 0x40>;
		#address-cells = <1>;
		#size-cells = <0>;
		interrupts = <0 41 1>;
		clocks = <&i2c_clk>;
		clock-frequency = <100000>;
	};
```

## Documentation/devicetree/bindings/i2c/i2c-virtio.yaml
```yaml
# SPDX-License-Identifier: (GPL-2.0-only OR BSD-2-Clause)
%YAML 1.2
---
$id: http://devicetree.org/schemas/i2c/i2c-virtio.yaml#
$schema: http://devicetree.org/meta-schemas/core.yaml#

title: Virtio I2C Adapter

maintainers:
  - Viresh Kumar <viresh.kumar@linaro.org>

allOf:
  - $ref: /schemas/i2c/i2c-controller.yaml#
  - $ref: /schemas/virtio/virtio-device.yaml#

description:
  Virtio I2C device, see /schemas/virtio/virtio-device.yaml for more details.

properties:
  $nodename:
    const: i2c

  compatible:
    const: virtio,device22

required:
  - compatible

unevaluatedProperties: false

examples:
  - |
    virtio@3000 {
        compatible = "virtio,mmio";
        reg = <0x3000 0x100>;
        interrupts = <41>;

        i2c {
            compatible = "virtio,device22";

            #address-cells = <1>;
            #size-cells = <0>;

            light-sensor@20 {
                compatible = "dynaimage,al3320a";
                reg = <0x20>;
            };
        };
    };

...
```

## Documentation/devicetree/bindings/i2c/i2c-vt8500.txt
```
* Wondermedia I2C Controller

Required properties :

 - compatible : should be "wm,wm8505-i2c"
 - reg : Offset and length of the register set for the device
 - interrupts : <IRQ> where IRQ is the interrupt number
 - clocks : phandle to the I2C clock source

Optional properties :

 - clock-frequency : desired I2C bus clock frequency in Hz.
	Valid values are 100000 and 400000.
	Default to 100000 if not specified, or invalid value.

Example :

	i2c_0: i2c@d8280000 {
		compatible = "wm,wm8505-i2c";
		reg = <0xd8280000 0x1000>;
		interrupts = <19>;
		clocks = <&clki2c0>;
		clock-frequency = <400000>;
	};
```

## Documentation/devicetree/bindings/i2c/i2c-xgene-slimpro.txt
```
APM X-Gene SLIMpro Mailbox I2C Driver

An I2C controller accessed over the "SLIMpro" mailbox.

Required properties :

 - compatible : should be "apm,xgene-slimpro-i2c"
 - mboxes : use the label reference for the mailbox as the first parameter.
	    The second parameter is the channel number.

Example :
	i2cslimpro {
		compatible = "apm,xgene-slimpro-i2c";
		mboxes = <&mailbox 0>;
	};
```

## Documentation/devicetree/bindings/i2c/i2c-xiic.txt
```
Xilinx IIC controller:

Required properties:
- compatible : Must be "xlnx,xps-iic-2.00.a"
- reg : IIC register location and length
- interrupts : IIC controller unterrupt
- #address-cells = <1>
- #size-cells = <0>
- clocks: Input clock specifier. Refer to common clock bindings.

Optional properties:
- Child nodes conforming to i2c bus binding
- clock-names: Input clock name, should be 'pclk'.

Example:

	axi_iic_0: i2c@40800000 {
		compatible = "xlnx,xps-iic-2.00.a";
		clocks = <&clkc 15>;
		interrupts = < 1 2 >;
		reg = < 0x40800000 0x10000 >;

		#size-cells = <0>;
		#address-cells = <1>;
	};
```

## Documentation/devicetree/bindings/i2c/i2c-xlp9xx.txt
```
Device tree configuration for the I2C controller on the XLP9xx/5xx SoC

Required properties:
- compatible      : should be "netlogic,xlp980-i2c"
- reg             : bus address start and address range size of device
- interrupts      : interrupt number

Optional properties:
- clock-frequency : frequency of bus clock in Hz
                    Defaults to 100 KHz when the property is not specified

Example:

i2c0: i2c@113100 {
	compatible = "netlogic,xlp980-i2c";
	#address-cells = <1>;
	#size-cells = <0>;
	reg = <0 0x113100 0x100>;
	clock-frequency = <400000>;
	interrupts = <30>;
	interrupt-parent = <&pic>;
};
```

## Documentation/devicetree/bindings/i2c/i2c-zx2967.txt
```
ZTE zx2967 I2C controller

Required properties:
 - compatible: must be "zte,zx296718-i2c"
 - reg: physical address and length of the device registers
 - interrupts: a single interrupt specifier
 - clocks: clock for the device
 - #address-cells: should be <1>
 - #size-cells: should be <0>
 - clock-frequency: the desired I2C bus clock frequency.

Examples:

	i2c@112000 {
		compatible = "zte,zx296718-i2c";
		reg = <0x00112000 0x1000>;
		interrupts = <GIC_SPI 112 IRQ_TYPE_LEVEL_HIGH>;
		clocks = <&osc24m>;
		#address-cells = <1>
		#size-cells = <0>;
		clock-frequency = <1600000>;
	};
```
