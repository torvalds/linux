## Documentation/devicetree/bindings/i2c/mediatek,mt7621-i2c.yaml
```yaml
# SPDX-License-Identifier: (GPL-2.0-only OR BSD-2-Clause)
%YAML 1.2
---
$id: http://devicetree.org/schemas/i2c/mediatek,mt7621-i2c.yaml#
$schema: http://devicetree.org/meta-schemas/core.yaml#

maintainers:
  - Stefan Roese <sr@denx.de>

title: Mediatek MT7621/MT7628 I2C master controller

allOf:
  - $ref: /schemas/i2c/i2c-controller.yaml#

properties:
  compatible:
    const: mediatek,mt7621-i2c

  reg:
    maxItems: 1

  clocks:
    maxItems: 1

  clock-names:
    const: i2c

  resets:
    maxItems: 1

  reset-names:
    const: i2c

required:
  - compatible
  - reg
  - resets
  - "#address-cells"
  - "#size-cells"

unevaluatedProperties: false

examples:
  - |
    #include <dt-bindings/clock/mt7621-clk.h>
    #include <dt-bindings/reset/mt7621-reset.h>

    i2c: i2c@900 {
      compatible = "mediatek,mt7621-i2c";
      reg = <0x900 0x100>;
      clocks = <&sysc MT7621_CLK_I2C>;
      clock-names = "i2c";
      resets = <&sysc MT7621_RST_I2C>;
      reset-names = "i2c";

      #address-cells = <1>;
      #size-cells = <0>;

      pinctrl-names = "default";
      pinctrl-0 = <&i2c_pins>;
    };
```

## Documentation/devicetree/bindings/i2c/mellanox,i2c-mlxbf.txt
```
Device tree configuration for the Mellanox I2C SMBus on BlueField SoCs

Required Properties:

- compatible : should be "mellanox,i2c-mlxbf1" or "mellanox,i2c-mlxbf2".

- reg : address offset and length of the device registers. The
	registers consist of the following set of resources:
		1) Smbus block registers.
		2) Cause master registers.
		3) Cause slave registers.
		4) Cause coalesce registers (if compatible isn't set
		   to "mellanox,i2c-mlxbf1").

- interrupts : interrupt number.

Optional Properties:

- clock-frequency : bus frequency used to configure timing registers;
			allowed values are 100000, 400000 and 1000000;
			those are expressed in Hz. Default is 100000.

Example:

i2c@2804000 {
	compatible = "mellanox,i2c-mlxbf1";
	reg =	<0x02804000 0x800>,
		<0x02801200 0x020>,
		<0x02801260 0x020>;
	interrupts = <57>;
	clock-frequency = <100000>;
};

i2c@2808800 {
	compatible = "mellanox,i2c-mlxbf2";
	reg =	<0x02808800 0x600>,
	        <0x02808e00 0x020>,
		<0x02808e20 0x020>,
		<0x02808e40 0x010>;
	interrupts = <57>;
	clock-frequency = <400000>;
};
```

## Documentation/devicetree/bindings/i2c/mellanox,i2c-mlxbf.yaml
```yaml
# SPDX-License-Identifier: (GPL-2.0-only OR BSD-2-Clause)
%YAML 1.2
---
$id: http://devicetree.org/schemas/i2c/mellanox,i2c-mlxbf.yaml#
$schema: http://devicetree.org/meta-schemas/core.yaml#

title: Mellanox I2C SMBus on BlueField SoCs

maintainers:
  - Khalil Blaiech <kblaiech@nvidia.com>

allOf:
  - $ref: /schemas/i2c/i2c-controller.yaml#

properties:
  compatible:
    enum:
      - mellanox,i2c-mlxbf1
      - mellanox,i2c-mlxbf2

  reg:
    minItems: 3
    maxItems: 4
    items:
      - description: Smbus block registers
      - description: Cause master registers
      - description: Cause slave registers
      - description: Cause coalesce registers

  interrupts:
    maxItems: 1

  clock-frequency:
    enum: [ 100000, 400000, 1000000 ]
    description:
      bus frequency used to configure timing registers;
      The frequency is expressed in Hz. Default is 100000.

required:
  - compatible
  - reg
  - interrupts

unevaluatedProperties: false

if:
  properties:
    compatible:
      contains:
        enum:
          - mellanox,i2c-mlxbf1

then:
  properties:
    reg:
      maxItems: 3

examples:
  - |
    i2c@2804000 {
        compatible = "mellanox,i2c-mlxbf1";
        reg = <0x02804000 0x800>,
              <0x02801200 0x020>,
              <0x02801260 0x020>;
        interrupts = <57>;
        clock-frequency = <100000>;
    };

  - |
    i2c@2808800 {
        compatible = "mellanox,i2c-mlxbf2";
        reg = <0x02808800 0x600>,
              <0x02808e00 0x020>,
              <0x02808e20 0x020>,
              <0x02808e40 0x010>;
        interrupts = <57>;
        clock-frequency = <400000>;
    };
```

## Documentation/devicetree/bindings/i2c/microchip,corei2c.yaml
```yaml
# SPDX-License-Identifier: (GPL-2.0-only OR BSD-2-Clause)
%YAML 1.2
---
$id: http://devicetree.org/schemas/i2c/microchip,corei2c.yaml#
$schema: http://devicetree.org/meta-schemas/core.yaml#

title: Microchip MPFS I2C Controller

maintainers:
  - Daire McNamara <daire.mcnamara@microchip.com>

allOf:
  - $ref: /schemas/i2c/i2c-controller.yaml#

properties:
  compatible:
    oneOf:
      - items:
          - enum:
              - microchip,pic64gx-i2c
              - microchip,mpfs-i2c # Microchip PolarFire SoC compatible SoCs
          - const: microchip,corei2c-rtl-v7 # Microchip Fabric based i2c IP core
      - const: microchip,corei2c-rtl-v7 # Microchip Fabric based i2c IP core

  reg:
    maxItems: 1

  interrupts:
    maxItems: 1

  clocks:
    maxItems: 1

  clock-frequency:
    description: |
      Desired I2C bus clock frequency in Hz. As only Standard and Fast
      modes are supported, possible values are 100000 and 400000.
    enum: [100000, 400000]

required:
  - compatible
  - reg
  - interrupts
  - clocks

unevaluatedProperties: false

examples:
  - |
    i2c@2010a000 {
      compatible = "microchip,mpfs-i2c", "microchip,corei2c-rtl-v7";
      reg = <0x2010a000 0x1000>;
      clocks = <&clkcfg 15>;
      interrupt-parent = <&plic>;
      interrupts = <58>;
      clock-frequency = <100000>;
    };
...
```

## Documentation/devicetree/bindings/i2c/mrvl-i2c.txt
```
* I2C

Required properties :

 - reg : Offset and length of the register set for the device
 - compatible : should be "mrvl,mmp-twsi" where CHIP is the name of a
   compatible processor, e.g. pxa168, pxa910, mmp2, mmp3.
   For the pxa2xx/pxa3xx, an additional node "mrvl,pxa-i2c" is required
   as shown in the example below.

Recommended properties :

 - interrupts : <a b> where a is the interrupt number and b is a
   field that represents an encoding of the sense and level
   information for the interrupt.  This should be encoded based on
   the information in section 2) depending on the type of interrupt
   controller you have.
 - interrupt-parent : the phandle for the interrupt controller that
   services interrupts for this device.
 - mrvl,i2c-polling : Disable interrupt of i2c controller. Polling
   status register of i2c controller instead.
 - mrvl,i2c-fast-mode : Enable fast mode of i2c controller.

Examples:
	twsi1: i2c@d4011000 {
		compatible = "mrvl,mmp-twsi", "mrvl,pxa-i2c";
		reg = <0xd4011000 0x1000>;
		interrupts = <7>;
		mrvl,i2c-fast-mode;
	};
	
	twsi2: i2c@d4025000 {
		compatible = "mrvl,mmp-twsi", "mrvl,pxa-i2c";
		reg = <0xd4025000 0x1000>;
		interrupts = <58>;
	};
```

## Documentation/devicetree/bindings/i2c/mux.txt
```
Common i2c bus multiplexer/switch properties.

An i2c bus multiplexer/switch will have several child busses that are
numbered uniquely in a device dependent manner.  The nodes for an i2c bus
multiplexer/switch will have one child node for each child
bus.

Required properties:
- #address-cells = <1>;
- #size-cells = <0>;

Required properties for child nodes:
- #address-cells = <1>;
- #size-cells = <0>;
- reg : The sub-bus number.

Optional properties for child nodes:
- Other properties specific to the multiplexer/switch hardware.
- Child nodes conforming to i2c bus binding


Example :

	/*
	   An NXP pca9548 8 channel I2C multiplexer at address 0x70
	   with two NXP pca8574 GPIO expanders attached, one each to
	   ports 3 and 4.
	 */

	mux@70 {
		compatible = "nxp,pca9548";
		reg = <0x70>;
		#address-cells = <1>;
		#size-cells = <0>;

		i2c@3 {
			#address-cells = <1>;
			#size-cells = <0>;
			reg = <3>;

			gpio1: gpio@38 {
				compatible = "nxp,pca8574";
				reg = <0x38>;
				#gpio-cells = <2>;
				gpio-controller;
			};
		};
		i2c@4 {
			#address-cells = <1>;
			#size-cells = <0>;
			reg = <4>;

			gpio2: gpio@38 {
				compatible = "nxp,pca8574";
				reg = <0x38>;
				#gpio-cells = <2>;
				gpio-controller;
			};
		};
	};
```
