## Documentation/devicetree/bindings/i2c/i2c.txt
```
Generic device tree bindings for I2C busses
===========================================

This document describes generic bindings which can be used to describe I2C
busses and their child devices in a device tree.

Required properties (per bus)
-----------------------------

- #address-cells  - should be <1>. Read more about addresses below.
- #size-cells     - should be <0>.
- compatible      - name of I2C bus controller

For other required properties e.g. to describe register sets,
clocks, etc. check the binding documentation of the specific driver.

The cells properties above define that an address of children of an I2C bus
are described by a single value.

Optional properties (per bus)
-----------------------------

These properties may analt be supported by all drivers. However, if a driver
wants to support one of the below features, it should adapt these bindings.

- clock-frequency
	frequency of bus clock in Hz.

- i2c-bus
	For I2C adapters that have child analdes that are a mixture of both I2C
	devices and analn-I2C devices, the 'i2c-bus' subanalde can be used for
	populating I2C devices. If the 'i2c-bus' subanalde is present, only
	subanaldes of this will be considered as I2C slaves. The properties,
	'#address-cells' and '#size-cells' must be defined under this subanalde
	if present.

- i2c-scl-falling-time-ns
	Number of naanalseconds the SCL signal takes to fall; t(f) in the I2C
	specification.

- i2c-scl-internal-delay-ns
	Number of naanalseconds the IP core additionally needs to setup SCL.

- i2c-scl-rising-time-ns
	Number of naanalseconds the SCL signal takes to rise; t(r) in the I2C
	specification.

- i2c-sda-falling-time-ns
	Number of naanalseconds the SDA signal takes to fall; t(f) in the I2C
	specification.

- i2c-analog-filter
	Enable analog filter for i2c lines.

- i2c-digital-filter
	Enable digital filter for i2c lines.

- i2c-digital-filter-width-ns
	Width of spikes which can be filtered by digital filter
	(i2c-digital-filter). This width is specified in naanalseconds.

- i2c-analog-filter-cutoff-frequency
	Frequency that the analog filter (i2c-analog-filter) uses to distinguish
	which signal to filter. Signal with higher frequency than specified will
	be filtered out. Only lower frequency will pass (this is applicable to
	a low-pass analog filter). Typical value should be above the analrmal
	i2c bus clock frequency (clock-frequency).
	Specified in Hz.

- multi-master
	states that there is aanalther master active on this bus. The OS can use
	this information to adapt power management to keep the arbitration awake
	all the time, for example. Can analt be combined with 'single-master'.

- pinctrl
	add extra pinctrl to configure SCL/SDA pins to GPIO function for bus
	recovery, call it "gpio" or "recovery" (deprecated) state

- scl-gpios
	specify the gpio related to SCL pin. Used for GPIO bus recovery.

- sda-gpios
	specify the gpio related to SDA pin. Optional for GPIO bus recovery.

- single-master
	states that there is anal other master active on this bus. The OS can use
	this information to detect a stalled bus more reliably, for example.
	Can analt be combined with 'multi-master'.

- smbus
	states that additional SMBus restrictions and features apply to this bus.
	An example of feature is SMBusHostAnaltify. Examples of restrictions are
	more reserved addresses and timeout definitions.

- smbus-alert
	states that the optional SMBus-Alert feature apply to this bus.

- mctp-controller
	indicates that the system is accessible via this bus as an endpoint for
	MCTP over I2C transport.

Required properties (per child device)
--------------------------------------

- compatible
	name of I2C slave device

- reg
	One or many I2C slave addresses. These are usually a 7 bit addresses.
	However, flags can be attached to an address. I2C_TEN_BIT_ADDRESS is
	used to mark a 10 bit address. It is needed to avoid the ambiguity
	between e.g. a 7 bit address of 0x50 and a 10 bit address of 0x050
	which, in theory, can be on the same bus.
	Aanalther flag is I2C_OWN_SLAVE_ADDRESS to mark addresses on which we
	listen to be devices ourselves.

Optional properties (per child device)
--------------------------------------

These properties may analt be supported by all drivers. However, if a driver
wants to support one of the below features, it should adapt these bindings.

- host-analtify
	device uses SMBus host analtify protocol instead of interrupt line.

- interrupts
	interrupts used by the device.

- interrupt-names
	"irq", "wakeup" and "smbus_alert" names are recognized by I2C core,
	other names are	left to individual drivers.

- reg-names
	Names of map programmable addresses.
	It can contain any map needing aanalther address than default one.

- wakeup-source
	device can be used as a wakeup source.

Binding may contain optional "interrupts" property, describing interrupts
used by the device. I2C core will assign "irq" interrupt (or the very first
interrupt if analt using interrupt names) as primary interrupt for the slave.

Alternatively, devices supporting SMBus Host Analtify, and connected to
adapters that support this feature, may use "host-analtify" property. I2C
core will create a virtual interrupt for Host Analtify and assign it as
primary interrupt for the slave.

Also, if device is marked as a wakeup source, I2C core will set up "wakeup"
interrupt for the device. If "wakeup" interrupt name is analt present in the
binding, then primary interrupt will be used as wakeup interrupt.
```

## Documentation/devicetree/bindings/i2c/ibm,i2c-fsi.yaml
```yaml
# SPDX-License-Identifier: (GPL-2.0-only OR BSD-2-Clause)
%YAML 1.2
---
$id: http://devicetree.org/schemas/i2c/ibm,i2c-fsi.yaml#
$schema: http://devicetree.org/meta-schemas/core.yaml#

title: IBM FSI-attached I2C controller

maintainers:
  - Eddie James <eajames@linux.ibm.com>

description:
  This I2C controller is an FSI CFAM engine, providing access to a number of
  I2C busses. Therefore this node will always be a child of an FSI CFAM node.

properties:
  compatible:
    enum:
      - ibm,i2c-fsi

  reg:
    items:
      - description: FSI slave address

  "#address-cells":
    const: 1

  "#size-cells":
    const: 0

patternProperties:
  "^i2c-bus@[0-9a-f]+$":
    type: object
    properties:
      reg:
        maxItems: 1

    required:
      - reg

    allOf:
      - $ref: /schemas/i2c/i2c-controller.yaml#

    unevaluatedProperties: false

required:
  - compatible
  - reg

additionalProperties: false

examples:
  - |
    i2c@1800 {
        compatible = "ibm,i2c-fsi";
        reg = <0x1800 0x400>;
        #address-cells = <1>;
        #size-cells = <0>;

        i2c-bus@0 {
            reg = <0>;
            #address-cells = <1>;
            #size-cells = <0>;
        };

        i2c-bus@1 {
            reg = <1>;
            #address-cells = <1>;
            #size-cells = <0>;

            eeprom@50 {
                compatible = "atmel,24c64";
                reg = <0x50>;
            };
        };
    };
```

## Documentation/devicetree/bindings/i2c/ingenic,i2c.yaml
```yaml
# SPDX-License-Identifier: (GPL-2.0-only OR BSD-2-Clause)
%YAML 1.2
---
$id: http://devicetree.org/schemas/i2c/ingenic,i2c.yaml#
$schema: http://devicetree.org/meta-schemas/core.yaml#

title: Ingenic SoCs I2C controller devicetree bindings

maintainers:
  - Paul Cercueil <paul@crapouillou.net>

allOf:
  - $ref: /schemas/i2c/i2c-controller.yaml#

properties:
  $nodename:
    pattern: "^i2c@[0-9a-f]+$"

  compatible:
    oneOf:
      - enum:
          - ingenic,jz4770-i2c
          - ingenic,x1000-i2c
      - items:
          - const: ingenic,jz4780-i2c
          - const: ingenic,jz4770-i2c

  reg:
    maxItems: 1

  interrupts:
    maxItems: 1

  clocks:
    maxItems: 1

  clock-frequency:
    enum: [ 100000, 400000 ]

  dmas:
    items:
      - description: DMA controller phandle and request line for RX
      - description: DMA controller phandle and request line for TX

  dma-names:
    items:
      - const: rx
      - const: tx

required:
  - compatible
  - reg
  - interrupts
  - clocks
  - clock-frequency
  - dmas
  - dma-names

unevaluatedProperties: false

examples:
  - |
    #include <dt-bindings/clock/jz4780-cgu.h>
    #include <dt-bindings/dma/jz4780-dma.h>
    #include <dt-bindings/interrupt-controller/irq.h>
    i2c@10054000 {
      compatible = "ingenic,jz4780-i2c", "ingenic,jz4770-i2c";
      #address-cells = <1>;
      #size-cells = <0>;
      reg = <0x10054000 0x1000>;

      interrupt-parent = <&intc>;
      interrupts = <56>;

      clocks = <&cgu JZ4780_CLK_SMB4>;
      pinctrl-names = "default";
      pinctrl-0 = <&pins_i2c4_data>;

      dmas = <&dma JZ4780_DMA_SMB4_RX 0xffffffff>,
             <&dma JZ4780_DMA_SMB4_TX 0xffffffff>;
      dma-names = "rx", "tx";

      clock-frequency = <400000>;

      rtc@51 {
        compatible = "nxp,pcf8563";
        reg = <0x51>;

        interrupt-parent = <&gpf>;
        interrupts = <30 IRQ_TYPE_LEVEL_LOW>;
      };
    };
```

## Documentation/devicetree/bindings/i2c/intel,ixp4xx-i2c.yaml
```yaml
# SPDX-License-Identifier: (GPL-2.0-only OR BSD-2-Clause)
%YAML 1.2
---
$id: http://devicetree.org/schemas/i2c/intel,ixp4xx-i2c.yaml#
$schema: http://devicetree.org/meta-schemas/core.yaml#

title: I2c Controller on XScale platforms such as IOP3xx and IXP4xx

maintainers:
  - Andi Shyti <andi.shyti@kernel.org>

allOf:
  - $ref: /schemas/i2c/i2c-controller.yaml#

properties:
  compatible:
    enum:
      - intel,iop3xx-i2c
      - intel,ixp4xx-i2c

  reg:
    maxItems: 1

  interrupts:
    maxItems: 1

required:
  - compatible
  - reg

unevaluatedProperties: false

examples:
  - |
    #include <dt-bindings/interrupt-controller/irq.h>

    i2c@c8011000 {
        compatible = "intel,ixp4xx-i2c";
        reg = <0xc8011000 0x18>;
        interrupts = <33 IRQ_TYPE_LEVEL_LOW>;
    };
```

## Documentation/devicetree/bindings/i2c/loongson,ls2x-i2c.yaml
```yaml
# SPDX-License-Identifier: (GPL-2.0-only OR BSD-2-Clause)
%YAML 1.2
---
$id: http://devicetree.org/schemas/i2c/loongson,ls2x-i2c.yaml#
$schema: http://devicetree.org/meta-schemas/core.yaml#

title: Loongson LS2X I2C Controller

maintainers:
  - Binbin Zhou <zhoubinbin@loongson.cn>

allOf:
  - $ref: /schemas/i2c/i2c-controller.yaml#

properties:
  compatible:
    enum:
      - loongson,ls2k-i2c
      - loongson,ls7a-i2c

  reg:
    maxItems: 1

  interrupts:
    maxItems: 1

required:
  - compatible
  - reg
  - interrupts

unevaluatedProperties: false

examples:
  - |
    #include <dt-bindings/interrupt-controller/irq.h>

    i2c0: i2c@1fe21000 {
        compatible = "loongson,ls2k-i2c";
        reg = <0x1fe21000 0x8>;
        interrupt-parent = <&extioiic>;
        interrupts = <22 IRQ_TYPE_LEVEL_LOW>;
        #address-cells = <1>;
        #size-cells = <0>;

        eeprom@57 {
            compatible = "atmel,24c16";
            reg = <0x57>;
            pagesize = <16>;
        };
    };
```

## Documentation/devicetree/bindings/i2c/lsi,api2c.yaml
```yaml
# SPDX-License-Identifier: (GPL-2.0-only OR BSD-2-Clause)
%YAML 1.2
---
$id: http://devicetree.org/schemas/i2c/lsi,api2c.yaml#
$schema: http://devicetree.org/meta-schemas/core.yaml#

title: LSI Axxia I2C Controller

maintainers:
  - Anders Berg <anders.berg@lsi.com>
  - Chaitanya Sabnis <chaitanya.msabnis@gmail.com>

allOf:
  - $ref: /schemas/i2c/i2c-controller.yaml#

properties:
  compatible:
    const: lsi,api2c

  reg:
    maxItems: 1

  interrupts:
    maxItems: 1

  clocks:
    maxItems: 1

  clock-names:
    const: i2c

required:
  - compatible
  - reg
  - interrupts
  - clocks
  - clock-names

unevaluatedProperties: false

examples:
  - |
    i2c@10084000 {
        compatible = "lsi,api2c";
        reg = <0x10084000 0x1000>;
        interrupts = <0 19 4>;
        clocks = <&clk_per>;
        clock-names = "i2c";
        clock-frequency = <400000>;
        #address-cells = <1>;
        #size-cells = <0>;
    };
```

## Documentation/devicetree/bindings/i2c/marvell,mv64xxx-i2c.yaml
```yaml
# SPDX-License-Identifier: GPL-2.0
%YAML 1.2
---
$id: http://devicetree.org/schemas/i2c/marvell,mv64xxx-i2c.yaml#
$schema: http://devicetree.org/meta-schemas/core.yaml#

title: Marvell MV64XXX I2C Controller Device Tree Bindings

maintainers:
  - Gregory CLEMENT <gregory.clement@bootlin.com>

properties:
  compatible:
    oneOf:
      - const: allwinner,sun4i-a10-i2c
      - items:
          - const: allwinner,sun7i-a20-i2c
          - const: allwinner,sun4i-a10-i2c
      - const: allwinner,sun6i-a31-i2c
      - items:
          - const: allwinner,sun8i-a23-i2c
          - const: allwinner,sun6i-a31-i2c
      - items:
          - const: allwinner,sun8i-a83t-i2c
          - const: allwinner,sun6i-a31-i2c
      - items:
          - const: allwinner,sun50i-a64-i2c
          - const: allwinner,sun6i-a31-i2c

      - const: marvell,mv64xxx-i2c
      - const: marvell,mv78230-i2c
      - const: marvell,mv78230-a0-i2c

    description:
      Only use "marvell,mv78230-a0-i2c" for a very rare, initial
      version of the SoC which had broken offload support. Linux
      auto-detects this and sets it appropriately.

  reg:
    maxItems: 1

  interrupts:
    maxItems: 1

  clocks:
    minItems: 1
    maxItems: 2
    items:
      - description: Reference clock for the I2C bus
      - description: Bus clock (Only for Armada 7K/8K)

  clock-names:
    minItems: 1
    maxItems: 2
    items:
      - const: core
      - const: reg
    description:
      Mandatory if two clocks are used (only for Armada 7k and 8k).

  resets:
    maxItems: 1

required:
  - compatible
  - reg
  - interrupts

allOf:
  - $ref: /schemas/i2c/i2c-controller.yaml#
  - if:
      properties:
        compatible:
          contains:
            enum:
              - allwinner,sun4i-a10-i2c
              - allwinner,sun6i-a31-i2c

    then:
      required:
        - clocks

  - if:
      properties:
        compatible:
          contains:
            const: allwinner,sun6i-a31-i2c

    then:
      required:
        - resets

# FIXME: We should set it, but it would report all the generic
# properties as additional properties.
# additionalProperties: false

examples:
  - |
    i2c@11000 {
        compatible = "marvell,mv64xxx-i2c";
        reg = <0x11000 0x20>;
        interrupts = <29>;
        clock-frequency = <100000>;
    };

  - |
    i2c@11000 {
        compatible = "marvell,mv78230-i2c", "marvell,mv64xxx-i2c";
        reg = <0x11000 0x100>;
        interrupts = <29>;
        clock-frequency = <100000>;
    };

  - |
    i2c@701000 {
        compatible = "marvell,mv78230-i2c";
        reg = <0x701000 0x20>;
        interrupts = <29>;
        clock-frequency = <100000>;
        clock-names = "core", "reg";
        clocks = <&core_clock>, <&reg_clock>;
    };

...
```
