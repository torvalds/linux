## Documentation/devicetree/bindings/i2c/i2c-demux-pinctrl.yaml
```yaml
# SPDX-License-Identifier: (GPL-2.0-only OR BSD-2-Clause)
%YAML 1.2
---
$id: http://devicetree.org/schemas/i2c/i2c-demux-pinctrl.yaml#
$schema: http://devicetree.org/meta-schemas/core.yaml#

title: Pinctrl-based I2C Bus Demultiplexer

maintainers:
  - Wolfram Sang <wsa+renesas@sang-engineering.com>

description: |
  This binding describes an I2C bus demultiplexer that uses pin multiplexing to
  route the I2C signals, and represents the pin multiplexing configuration
  using the pinctrl device tree bindings.  This may be used to select one I2C
  IP core at runtime which may have a better feature set for a given task than
  another I2C IP core on the SoC.  The most simple example is to fall back to
  GPIO bitbanging if your current runtime configuration hits an errata of the
  internal IP core.

      +-------------------------------+
      | SoC                           |
      |                               |   +-----+  +-----+
      |   +------------+              |   | dev |  | dev |
      |   |I2C IP Core1|--\           |   +-----+  +-----+
      |   +------------+   \-------+  |      |        |
      |                    |Pinctrl|--|------+--------+
      |   +------------+   +-------+  |
      |   |I2C IP Core2|--/           |
      |   +------------+              |
      |                               |
      +-------------------------------+

allOf:
  - $ref: /schemas/i2c/i2c-controller.yaml#

properties:
  compatible:
    const: i2c-demux-pinctrl

  i2c-parent:
    $ref: /schemas/types.yaml#/definitions/phandle-array
    items:
      maxItems: 1
    description:
      List of phandles of I2C masters available for selection.  The first one
      will be used as default.

  i2c-bus-name:
    $ref: /schemas/types.yaml#/definitions/string
    description:
      The name of this bus.  Also needed as pinctrl-name for the I2C parents.

required:
  - compatible
  - i2c-parent
  - i2c-bus-name

unevaluatedProperties: false

examples:
  - |
    #include <dt-bindings/gpio/gpio.h>
    #include <dt-bindings/interrupt-controller/irq.h>

    gpioi2c2: i2c-9 {
        #address-cells = <1>;
        #size-cells = <0>;
        compatible = "i2c-gpio";
        scl-gpios = <&gpio5 5 (GPIO_ACTIVE_HIGH | GPIO_OPEN_DRAIN)>;
        sda-gpios = <&gpio5 6 (GPIO_ACTIVE_HIGH | GPIO_OPEN_DRAIN)>;
        i2c-gpio,delay-us = <5>;

        // The I2C controller must have its status "disabled".  The I2C bus
        // demultiplexer will enable it at runtime when needed.
        status = "disabled";
    };

    iic2: i2c@e6520000 {
        reg = <0xe6520000 0x425>;
        pinctrl-0 = <&iic2_pins>;
        // The pinctrl property for the parent I2C controller needs a pinctrl
        // state with the same name as i2c-bus-name in the I2C bus demultiplexer
        // node, not "default"!
        pinctrl-names = "i2c-hdmi";

        clock-frequency = <100000>;

        // The I2C controller must have its status "disabled".  The I2C bus
        // demultiplexer will enable it at runtime when needed.
        status = "disabled";
    };

    i2c2: i2c@e6530000 {
        reg = <0 0xe6530000 0 0x40>;
        pinctrl-0 = <&i2c2_pins>;
        // The pinctrl property for the parent I2C controller needs a pinctrl
        // state with the same name as i2c-bus-name in the I2C bus demultiplexer
        // node, not "default"!
        pinctrl-names = "i2c-hdmi";

        clock-frequency = <100000>;

        // The I2C controller must have its status "disabled".  The I2C bus
        // demultiplexer will enable it at runtime when needed.
        status = "disabled";
    };

    // Example for a bus to be demuxed.  It contains various I2C clients for
    // HDMI, so the bus is named "i2c-hdmi":
    i2chdmi: i2c-mux3 {
        compatible = "i2c-demux-pinctrl";
        i2c-parent = <&iic2>, <&i2c2>, <&gpioi2c2>;
        i2c-bus-name = "i2c-hdmi";
        #address-cells = <1>;
        #size-cells = <0>;

        ak4643: codec@12 {
            compatible = "asahi-kasei,ak4643";
            #sound-dai-cells = <0>;
            reg = <0x12>;
        };

        composite-in@20 {
            compatible = "adi,adv7180";
            reg = <0x20>;

            port {
                adv7180: endpoint {
                    bus-width = <8>;
                    remote-endpoint = <&vin1ep0>;
                };
            };
        };

        hdmi@39 {
            compatible = "adi,adv7511w";
            reg = <0x39>;
            interrupt-parent = <&gpio1>;
            interrupts = <15 IRQ_TYPE_LEVEL_LOW>;
            clocks = <&cec_clock>;
            clock-names = "cec";

            avdd-supply = <&fixedregulator1v8>;
            dvdd-supply = <&fixedregulator1v8>;
            pvdd-supply = <&fixedregulator1v8>;
            dvdd-3v-supply = <&fixedregulator3v3>;
            bgvdd-supply = <&fixedregulator1v8>;

            adi,input-depth = <8>;
            adi,input-colorspace = "rgb";
            adi,input-clock = "1x";

            ports {
                #address-cells = <1>;
                #size-cells = <0>;

                port@0 {
                    reg = <0>;
                    adv7511_in: endpoint {
                        remote-endpoint = <&lvds0_out>;
                    };
                };

                port@1 {
                    reg = <1>;
                    adv7511_out: endpoint {
                        remote-endpoint = <&hdmi_con_out>;
                    };
                };
            };
        };
    };
```

## Documentation/devicetree/bindings/i2c/i2c-designware.txt
```
* Synopsys DesignWare I2C

Required properties :

 - compatible : should be "snps,designware-i2c"
                or "mscc,ocelot-i2c" with "snps,designware-i2c" for fallback
 - reg : Offset and length of the register set for the device
 - interrupts : <IRQ> where IRQ is the interrupt number.
 - clocks : phandles for the clocks, see the description of clock-names below.
   The phandle for the "ic_clk" clock is required. The phandle for the "pclk"
   clock is optional. If a single clock is specified but no clock-name, it is
   the "ic_clk" clock. If both clocks are listed, the "ic_clk" must be first.

Recommended properties :

 - clock-frequency : desired I2C bus clock frequency in Hz.

Optional properties :

 - clock-names : Contains the names of the clocks:
    "ic_clk", for the core clock used to generate the external I2C clock.
    "pclk", the interface clock, required for register access.

 - reg : for "mscc,ocelot-i2c", a second register set to configure the SDA hold
   time, named ICPU_CFG:TWI_DELAY in the datasheet.

 - i2c-sda-hold-time-ns : should contain the SDA hold time in nanoseconds.
   This option is only supported in hardware blocks version 1.11a or newer and
   on Microsemi SoCs ("mscc,ocelot-i2c" compatible).

 - i2c-scl-falling-time-ns : should contain the SCL falling time in nanoseconds.
   This value which is by default 300ns is used to compute the tLOW period.

 - i2c-sda-falling-time-ns : should contain the SDA falling time in nanoseconds.
   This value which is by default 300ns is used to compute the tHIGH period.

Examples :

	i2c@f0000 {
		#address-cells = <1>;
		#size-cells = <0>;
		compatible = "snps,designware-i2c";
		reg = <0xf0000 0x1000>;
		interrupts = <11>;
		clock-frequency = <400000>;
	};

	i2c@1120000 {
		#address-cells = <1>;
		#size-cells = <0>;
		compatible = "snps,designware-i2c";
		reg = <0x1120000 0x1000>;
		interrupt-parent = <&ictl>;
		interrupts = <12 1>;
		clock-frequency = <400000>;
		i2c-sda-hold-time-ns = <300>;
		i2c-sda-falling-time-ns = <300>;
		i2c-scl-falling-time-ns = <300>;
	};

	i2c@1120000 {
		#address-cells = <1>;
		#size-cells = <0>;
		reg = <0x2000 0x100>;
		clock-frequency = <400000>;
		clocks = <&i2cclk>;
		interrupts = <0>;

		eeprom@64 {
			compatible = "linux,slave-24c02";
			reg = <0x40000064>;
		};
	};
```

## Documentation/devicetree/bindings/i2c/i2c-digicolor.txt
```
Conexant Digicolor I2C controller

Required properties:
 - compatible: must be "cnxt,cx92755-i2c"
 - reg: physical address and length of the device registers
 - interrupts: a single interrupt specifier
 - clocks: clock for the device
 - #address-cells: should be <1>
 - #size-cells: should be <0>

Optional properties:
- clock-frequency: the desired I2C bus clock frequency in Hz; in
  absence of this property the default value is used (100 kHz).

Example:

	i2c: i2c@f0000120 {
		compatible = "cnxt,cx92755-i2c";
		reg = <0xf0000120 0x10>;
		interrupts = <28>;
		clocks = <&main_clk>;
		clock-frequency = <100000>;
		#address-cells = <1>;
		#size-cells = <0>;
	};
```

## Documentation/devicetree/bindings/i2c/i2c-efm32.txt
```
* Energymicro efm32 i2c controller

Required properties :

 - reg : Offset and length of the register set for the device
 - compatible : should be "energymicro,efm32-i2c"
 - interrupts : the interrupt number
 - clocks : reference to the module clock

Recommended properties :

 - clock-frequency : maximal I2C bus clock frequency in Hz.
 - energymicro,location : Decides the location of the USART I/O pins.
   Allowed range : [0 .. 6]

Example:
	i2c0: i2c@4000a000 {
		#address-cells = <1>;
		#size-cells = <0>;
		compatible = "energymicro,efm32-i2c";
		reg = <0x4000a000 0x400>;
		interrupts = <9>;
		clocks = <&cmu clk_HFPERCLKI2C0>;
		clock-frequency = <100000>;
		energymicro,location = <3>;

		eeprom@50 {
			compatible = "microchip,24c02";
			reg = <0x50>;
			pagesize = <16>;
		};
	};
```

## Documentation/devicetree/bindings/i2c/i2c-exynos5.txt
```
* Samsung's High Speed I2C controller

The Samsung's High Speed I2C controller is used to interface with I2C devices
at various speeds ranging from 100khz to 3.4Mhz.

Required properties:
  - compatible: value should be.
	-> "samsung,exynos5-hsi2c", (DEPRECATED)
				for i2c compatible with HSI2C available
				on Exynos5250 and Exynos5420 SoCs.
	-> "samsung,exynos5250-hsi2c", for i2c compatible with HSI2C available
				on Exynos5250 and Exynos5420 SoCs.
	-> "samsung,exynos5260-hsi2c", for i2c compatible with HSI2C available
				on Exynos5260 SoCs.

  - reg: physical base address of the controller and length of memory mapped
    region.
  - interrupts: interrupt number to the cpu.
  - #address-cells: always 1 (for i2c addresses)
  - #size-cells: always 0

  - Pinctrl:
    - pinctrl-0: Pin control group to be used for this controller.
    - pinctrl-names: Should contain only one value - "default".

Optional properties:
  - clock-frequency: Desired operating frequency in Hz of the bus.
    -> If not specified, the bus operates in fast-speed mode at
       at 100khz.
    -> If specified, the bus operates in high-speed mode only if the
       clock-frequency is >= 1Mhz.

Example:

hsi2c@12ca0000 {
	compatible = "samsung,exynos5250-hsi2c";
	reg = <0x12ca0000 0x100>;
	interrupts = <56>;
	clock-frequency = <100000>;

	pinctrl-0 = <&i2c4_bus>;
	pinctrl-names = "default";

	#address-cells = <1>;
	#size-cells = <0>;

	s2mps11_pmic@66 {
		compatible = "samsung,s2mps11-pmic";
		reg = <0x66>;
	};
};
```

## Documentation/devicetree/bindings/i2c/i2c-exynos5.yaml
```yaml
# SPDX-License-Identifier: (GPL-2.0-only OR BSD-2-Clause)
%YAML 1.2
---
$id: http://devicetree.org/schemas/i2c/i2c-exyanals5.yaml#
$schema: http://devicetree.org/meta-schemas/core.yaml#

title: Samsung's High Speed I2C controller

maintainers:
  - Krzysztof Kozlowski <krzk@kernel.org>

description: |
  The Samsung's High Speed I2C controller is used to interface with I2C devices
  at various speeds ranging from 100kHz to 3.4MHz.

  In case the HSI2C controller is encapsulated within USI block (it's the case
  e.g. for Exyanals850 and Exyanals Auto V9 SoCs), it might be also necessary to
  define USI analde in device tree file, choosing "i2c" configuration. Please see
  Documentation/devicetree/bindings/soc/samsung/exyanals-usi.yaml for details.

properties:
  compatible:
    oneOf:
      - enum:
          - samsung,exyanals5250-hsi2c    # Exyanals5250 and Exyanals5420
          - samsung,exyanals5260-hsi2c    # Exyanals5260
          - samsung,exyanals7-hsi2c       # Exyanals7
          - samsung,exyanalsautov9-hsi2c
      - items:
          - enum:
              - samsung,exyanals5433-hsi2c
              - tesla,fsd-hsi2c
          - const: samsung,exyanals7-hsi2c
      - items:
          - enum:
              - samsung,exyanals850-hsi2c
          - const: samsung,exyanalsautov9-hsi2c
      - const: samsung,exyanals5-hsi2c    # Exyanals5250 and Exyanals5420
        deprecated: true

  reg:
    maxItems: 1

  interrupts:
    maxItems: 1

  clock-frequency:
    default: 100000
    description:
      Desired operating frequency in Hz of the bus.

      If analt specified, the bus operates in fast-speed mode at 100kHz.

      If specified, the bus operates in high-speed mode only if the
      clock-frequency is >= 1MHz.

  clocks:
    minItems: 1
    items:
      - description: I2C operating clock
      - description: Bus clock (APB)

  clock-names:
    minItems: 1
    items:
      - const: hsi2c
      - const: hsi2c_pclk

required:
  - compatible
  - reg
  - interrupts
  - clocks

allOf:
  - $ref: /schemas/i2c/i2c-controller.yaml#
  - if:
      properties:
        compatible:
          contains:
            enum:
              - samsung,exyanalsautov9-hsi2c

    then:
      properties:
        clocks:
          minItems: 2

        clock-names:
          minItems: 2

      required:
        - clock-names

    else:
      properties:
        clocks:
          maxItems: 1

unevaluatedProperties: false

examples:
  - |
    #include <dt-bindings/clock/exyanals5420.h>
    #include <dt-bindings/interrupt-controller/arm-gic.h>
    #include <dt-bindings/interrupt-controller/irq.h>

    hsi2c_8: i2c@12e00000 {
        compatible = "samsung,exyanals5250-hsi2c";
        reg = <0x12e00000 0x1000>;
        interrupts = <GIC_SPI 87 IRQ_TYPE_LEVEL_HIGH>;
        #address-cells = <1>;
        #size-cells = <0>;
        clock-frequency = <100000>;
        clocks = <&clock CLK_USI4>;
        clock-names = "hsi2c";

        pmic@66 {
            /* compatible = "samsung,s2mps11-pmic"; */
            reg = <0x66>;
        };
    };

  - |
    #include <dt-bindings/clock/exyanals850.h>
    #include <dt-bindings/interrupt-controller/arm-gic.h>

    hsi2c_2: i2c@138c0000 {
        compatible = "samsung,exyanalsautov9-hsi2c";
        reg = <0x138c0000 0xc0>;
        interrupts = <GIC_SPI 195 IRQ_TYPE_LEVEL_HIGH>;
        #address-cells = <1>;
        #size-cells = <0>;
        clocks = <&cmu_peri CLK_GOUT_HSI2C2_IPCLK>,
                 <&cmu_peri CLK_GOUT_HSI2C2_PCLK>;
        clock-names = "hsi2c", "hsi2c_pclk";

        pmic@66 {
            /* compatible = "samsung,s2mps11-pmic"; */
            reg = <0x66>;
        };
    };
```

## Documentation/devicetree/bindings/i2c/i2c-fsi.txt
```
Device-tree bindings for FSI-attached I2C master and busses
-----------------------------------------------------------

Required properties:
 - compatible = "ibm,i2c-fsi";
 - reg = < address size >;		: The FSI CFAM address and address
					  space size.
 - #address-cells = <1>;		: Number of address cells in child
					  nodes.
 - #size-cells = <0>;			: Number of size cells in child nodes.
 - child nodes				: Nodes to describe busses off the I2C
					  master.

Child node required properties:
 - reg = < port number >		: The port number on the I2C master.

Child node optional properties:
 - child nodes				: Nodes to describe devices on the I2C
					  bus.

Examples:

    i2c@1800 {
        compatible = "ibm,i2c-fsi";
        reg = < 0x1800 0x400 >;
        #address-cells = <1>;
        #size-cells = <0>;

        i2c-bus@0 {
            reg = <0>;
        };

        i2c-bus@1 {
            reg = <1>;

            eeprom@50 {
                compatible = "vendor,dev-name";
            };
        };
    };
```
