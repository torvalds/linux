## Documentation/devicetree/bindings/i2c/i2c-gate.txt
```
An i2c gate is useful to e.g. reduce the digital yesise for RF tuners connected
to the i2c bus. Gates are similar to arbitrators in that you need to perform
some kind of operation to access the i2c bus past the arbitrator/gate, but
there are yes competing masters to consider for gates and therefore there is
yes arbitration happening for gates.

Common i2c gate properties.

- i2c-gate child yesde

Required properties for the i2c-gate child yesde:
- #address-cells = <1>;
- #size-cells = <0>;

Optional properties for i2c-gate child yesde:
- Child yesdes conforming to i2c bus binding


Example :

	/*
	   An Invensense mpu9150 at address 0x68 featuring an on-chip Asahi
	   Kasei ak8975 compass behind a gate.
	 */

	mpu9150@68 {
		compatible = "invensense,mpu9150";
		reg = <0x68>;
		interrupt-parent = <&gpio1>;
		interrupts = <18 1>;

		i2c-gate {
			#address-cells = <1>;
			#size-cells = <0>;

			ax8975@c {
				compatible = "ak,ak8975";
				reg = <0x0c>;
			};
		};
	};
```

## Documentation/devicetree/bindings/i2c/i2c-gate.yaml
```yaml
# SPDX-License-Identifier: (GPL-2.0 OR BSD-2-Clause)
%YAML 1.2
---
$id: http://devicetree.org/schemas/i2c/i2c-gate.yaml#
$schema: http://devicetree.org/meta-schemas/core.yaml#

title: Common i2c gate properties

maintainers:
  - Peter Rosin <peda@axentia.se>

description: |
  An i2c gate is useful to e.g. reduce the digital noise for RF tuners connected
  to the i2c bus. Gates are similar to arbitrators in that you need to perform
  some kind of operation to access the i2c bus past the arbitrator/gate, but
  there are no competing masters to consider for gates and therefore there is
  no arbitration happening for gates.

allOf:
  - $ref: /schemas/i2c/i2c-controller.yaml

properties:
  $nodename:
    const: i2c-gate

additionalProperties: true

examples:
  - |
    i2c-gate {
        #address-cells = <1>;
        #size-cells = <0>;
        ak8975@c {
            compatible = "asahi-kasei,ak8975";
            reg = <0x0c>;
        };
    };
...
```

## Documentation/devicetree/bindings/i2c/i2c-gpio.txt
```
Device-Tree bindings for i2c gpio driver

Required properties:
	- compatible = "i2c-gpio";
	- sda-gpios: gpio used for the sda signal, this should be flagged as
	  active high using open drain with (GPIO_ACTIVE_HIGH|GPIO_OPEN_DRAIN)
	  from <dt-bindings/gpio/gpio.h> since the signal is by definition
	  open drain.
	- scl-gpios: gpio used for the scl signal, this should be flagged as
	  active high using open drain with (GPIO_ACTIVE_HIGH|GPIO_OPEN_DRAIN)
	  from <dt-bindings/gpio/gpio.h> since the signal is by definition
	  open drain.

Optional properties:
	- i2c-gpio,scl-output-only: scl as output only
	- i2c-gpio,delay-us: delay between GPIO operations (may depend on each platform)
	- i2c-gpio,timeout-ms: timeout to get data

Deprecated properties, do not use in new device tree sources:
	- gpios: sda and scl gpio, alternative for {sda,scl}-gpios
	- i2c-gpio,sda-open-drain: this means that something outside of our
	  control has put the GPIO line used for SDA into open drain mode, and
	  that something is not the GPIO chip. It is essentially an
	  inconsistency flag.
	- i2c-gpio,scl-open-drain: this means that something outside of our
	  control has put the GPIO line used for SCL into open drain mode, and
	  that something is not the GPIO chip. It is essentially an
	  inconsistency flag.

Example nodes:

#include <dt-bindings/gpio/gpio.h>

i2c@0 {
	compatible = "i2c-gpio";
	sda-gpios = <&pioA 23 (GPIO_ACTIVE_HIGH|GPIO_OPEN_DRAIN)>;
	scl-gpios = <&pioA 24 (GPIO_ACTIVE_HIGH|GPIO_OPEN_DRAIN)>;
	i2c-gpio,delay-us = <2>;	/* ~100 kHz */
	#address-cells = <1>;
	#size-cells = <0>;

	rv3029c2@56 {
		compatible = "rv3029c2";
		reg = <0x56>;
	};
};
```

## Documentation/devicetree/bindings/i2c/i2c-gpio.yaml
```yaml
# SPDX-License-Identifier: GPL-2.0
%YAML 1.2
---
$id: http://devicetree.org/schemas/i2c/i2c-gpio.yaml#
$schema: http://devicetree.org/meta-schemas/core.yaml#

title: GPIO bitbanged I2C

maintainers:
  - Wolfram Sang <wsa@kernel.org>

allOf:
  - $ref: /schemas/i2c/i2c-controller.yaml#

properties:
  compatible:
    items:
      - const: i2c-gpio

  sda-gpios:
    description:
      gpio used for the sda signal, this should be flagged as
      active high using open drain with (GPIO_ACTIVE_HIGH|GPIO_OPEN_DRAIN)
      from <dt-bindings/gpio/gpio.h> since the signal is by definition
      open drain.
    maxItems: 1

  scl-gpios:
    description:
      gpio used for the scl signal, this should be flagged as
      active high using open drain with (GPIO_ACTIVE_HIGH|GPIO_OPEN_DRAIN)
      from <dt-bindings/gpio/gpio.h> since the signal is by definition
      open drain.
    maxItems: 1

  i2c-gpio,scl-output-only:
    description: scl as output only
    type: boolean

  i2c-gpio,delay-us:
    description: delay between GPIO operations (may depend on each platform)

  i2c-gpio,timeout-ms:
    description: timeout to get data

  # Deprecated properties, do not use in new device tree sources:
  gpios:
    minItems: 2
    maxItems: 2
    description: sda and scl gpio, alternative for {sda,scl}-gpios

  i2c-gpio,sda-open-drain:
    type: boolean
    deprecated: true
    description: this means that something outside of our control has put
      the GPIO line used for SDA into open drain mode, and that something is
      not the GPIO chip. It is essentially an inconsistency flag.

  i2c-gpio,scl-open-drain:
    type: boolean
    deprecated: true
    description: this means that something outside of our control has put the
      GPIO line used for SCL into open drain mode, and that something is not
      the GPIO chip. It is essentially an inconsistency flag.

required:
  - compatible
  - sda-gpios
  - scl-gpios

unevaluatedProperties: false

...
```

## Documentation/devicetree/bindings/i2c/i2c-hix5hd2.txt
```
I2C for Hisilicon hix5hd2 chipset platform

Required properties:
- compatible: Must be "hisilicon,hix5hd2-i2c"
- reg: physical base address of the controller and length of memory mapped
     region.
- interrupts: interrupt number to the cpu.
- #address-cells = <1>;
- #size-cells = <0>;
- clocks: phandles to input clocks.

Optional properties:
- clock-frequency: Desired I2C bus frequency in Hz, otherwise defaults to 100000
- Child nodes conforming to i2c bus binding

Examples:
I2C0@f8b10000 {
	compatible = "hisilicon,hix5hd2-i2c";
	reg = <0xf8b10000 0x1000>;
	interrupts = <0 38 4>;
	clocks = <&clock HIX5HD2_I2C0_RST>;
	#address-cells = <1>;
	#size-cells = <0>;
}
```

## Documentation/devicetree/bindings/i2c/i2c-img-scb.txt
```
IMG Serial Control Bus (SCB) I2C Controller

Required Properties:
- compatible: "img,scb-i2c"
- reg: Physical base address and length of controller registers
- interrupts: Interrupt number used by the controller
- clocks : Should contain a clock specifier for each entry in clock-names
- clock-names : Should contain the following entries:
                "scb", for the SCB core clock.
                "sys", for the system clock.
- clock-frequency: The I2C bus frequency in Hz
- #address-cells: Should be <1>
- #size-cells: Should be <0>

Example:

i2c@18100000 {
	compatible = "img,scb-i2c";
	reg = <0x18100000 0x200>;
	interrupts = <GIC_SHARED 2 IRQ_TYPE_LEVEL_HIGH>;
	clocks = <&i2c0_clk>, <&system_clk>;
	clock-names = "scb", "sys";
	clock-frequency = <400000>;
	#address-cells = <1>;
	#size-cells = <0>;
};
```

## Documentation/devicetree/bindings/i2c/i2c-imx-lpi2c.txt
```
* Freescale Low Power Inter IC (LPI2C) for i.MX

Required properties:
- compatible :
  - "fsl,imx7ulp-lpi2c" for LPI2C compatible with the one integrated on i.MX7ULP soc
- reg : address and length of the lpi2c master registers
- interrupts : lpi2c interrupt
- clocks : lpi2c clock specifier

Examples:

lpi2c7: lpi2c7@40a50000 {
	compatible = "fsl,imx7ulp-lpi2c";
	reg = <0x40A50000 0x10000>;
	interrupt-parent = <&intc>;
	interrupts = <GIC_SPI 37 IRQ_TYPE_LEVEL_HIGH>;
	clocks = <&clks IMX7ULP_CLK_LPI2C7>;
};
```
