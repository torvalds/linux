## Documentation/devicetree/bindings/i2c/i2c-arb.txt
```
Common i2c arbitration bus properties.

- i2c-arb child node

Required properties for the i2c-arb child node:
- #address-cells = <1>;
- #size-cells = <0>;

Optional properties for i2c-arb child node:
- Child nodes conforming to i2c bus binding


Example :

	/*
	   An NXP pca9541 I2C bus master selector at address 0x74
	   with a NXP pca8574 GPIO expander attached.
	 */

	arb@74 {
		compatible = "nxp,pca9541";
		reg = <0x74>;

		i2c-arb {
			#address-cells = <1>;
			#size-cells = <0>;

			gpio@38 {
				compatible = "nxp,pca8574";
				reg = <0x38>;
				#gpio-cells = <2>;
				gpio-controller;
			};
		};
	};
```

## Documentation/devicetree/bindings/i2c/i2c-aspeed.txt
```
Device tree configuration for the I2C busses on the AST24XX and AST25XX SoCs.

Required Properties:
- #address-cells	: should be 1
- #size-cells		: should be 0
- reg			: address offset and range of bus
- compatible		: should be "aspeed,ast2400-i2c-bus"
			  or "aspeed,ast2500-i2c-bus"
- clocks		: root clock of bus, should reference the APB
			  clock in the second cell
- resets		: phandle to reset controller with the reset number in
			  the second cell
- interrupts		: interrupt number

Optional Properties:
- bus-frequency	: frequency of the bus clock in Hz defaults to 100 kHz when not
		  specified
- multi-master	: states that there is another master active on this bus.

Example:

i2c {
	compatible = "simple-bus";
	#address-cells = <1>;
	#size-cells = <1>;
	ranges = <0 0x1e78a000 0x1000>;

	i2c_ic: interrupt-controller@0 {
		#interrupt-cells = <1>;
		compatible = "aspeed,ast2400-i2c-ic";
		reg = <0x0 0x40>;
		interrupts = <12>;
		interrupt-controller;
	};

	i2c0: i2c-bus@40 {
		#address-cells = <1>;
		#size-cells = <0>;
		#interrupt-cells = <1>;
		reg = <0x40 0x40>;
		compatible = "aspeed,ast2400-i2c-bus";
		clocks = <&syscon ASPEED_CLK_APB>;
		resets = <&syscon ASPEED_RESET_I2C>;
		bus-frequency = <100000>;
		interrupts = <0>;
		interrupt-parent = <&i2c_ic>;
	};
};
```

## Documentation/devicetree/bindings/i2c/i2c-at91.txt
```
I2C for Atmel platforms

Required properties :
- compatible : Must be one of:
	"atmel,at91rm9200-i2c",
	"atmel,at91sam9261-i2c",
	"atmel,at91sam9260-i2c",
	"atmel,at91sam9g20-i2c",
	"atmel,at91sam9g10-i2c",
	"atmel,at91sam9x5-i2c",
	"atmel,sama5d4-i2c",
	"atmel,sama5d2-i2c",
	"microchip,sam9x60-i2c".
- reg: physical base address of the controller and length of memory mapped
     region.
- interrupts: interrupt number to the cpu.
- #address-cells = <1>;
- #size-cells = <0>;
- clocks: phandles to input clocks.

Optional properties:
- clock-frequency: Desired I2C bus frequency in Hz, otherwise defaults to 100000
- dmas: A list of two dma specifiers, one for each entry in dma-names.
- dma-names: should contain "tx" and "rx".
- atmel,fifo-size: maximum number of data the RX and TX FIFOs can store for FIFO
  capable I2C controllers.
- i2c-sda-hold-time-ns: TWD hold time, only available for:
	"atmel,sama5d4-i2c",
	"atmel,sama5d2-i2c",
	"microchip,sam9x60-i2c".
- scl-gpios: specify the gpio related to SCL pin
- sda-gpios: specify the gpio related to SDA pin
- pinctrl: add extra pinctrl to configure i2c pins to gpio function for i2c
  bus recovery, call it "gpio" state
- Child nodes conforming to i2c bus binding


Examples :

i2c0: i2c@fff84000 {
	compatible = "atmel,at91sam9g20-i2c";
	reg = <0xfff84000 0x100>;
	interrupts = <12 4 6>;
	#address-cells = <1>;
	#size-cells = <0>;
	clocks = <&twi0_clk>;
	clock-frequency = <400000>;

	24c512@50 {
		compatible = "atmel,24c512";
		reg = <0x50>;
		pagesize = <128>;
	}
}

i2c0: i2c@f8034600 {
	compatible = "atmel,sama5d2-i2c";
	reg = <0xf8034600 0x100>;
	interrupts = <19 IRQ_TYPE_LEVEL_HIGH 7>;
	dmas = <&dma0
		(AT91_XDMAC_DT_MEM_IF(0) | AT91_XDMAC_DT_PER_IF(1))
		AT91_XDMAC_DT_PERID(11)>,
	       <&dma0
		(AT91_XDMAC_DT_MEM_IF(0) | AT91_XDMAC_DT_PER_IF(1))
		AT91_XDMAC_DT_PERID(12)>;
	dma-names = "tx", "rx";
	#address-cells = <1>;
	#size-cells = <0>;
	clocks = <&flx0>;
	atmel,fifo-size = <16>;
	i2c-sda-hold-time-ns = <336>;
	pinctrl-names = "default", "gpio";
	pinctrl-0 = <&pinctrl_i2c0>;
	pinctrl-1 = <&pinctrl_i2c0_gpio>;
	sda-gpios = <&pioA 30 GPIO_ACTIVE_HIGH>;
	scl-gpios = <&pioA 31 GPIO_ACTIVE_HIGH>;

	wm8731: wm8731@1a {
		compatible = "wm8731";
		reg = <0x1a>;
	};
};
```

## Documentation/devicetree/bindings/i2c/i2c-atr.yaml
```yaml
# SPDX-License-Identifier: GPL-2.0-only OR BSD-2-Clause
%YAML 1.2
---
$id: http://devicetree.org/schemas/i2c/i2c-atr.yaml#
$schema: http://devicetree.org/meta-schemas/core.yaml#

title: Common i2c address translator properties

maintainers:
  - Tomi Valkeinen <tomi.valkeinen@ideasonboard.com>

description:
  An I2C Address Translator (ATR) is a device with an I2C slave parent
  ("upstream") port and N I2C master child ("downstream") ports, and
  forwards transactions from upstream to the appropriate downstream port
  with a modified slave address. The address used on the parent bus is
  called the "alias" and is (potentially) different from the physical
  slave address of the child bus. Address translation is done by the
  hardware.

properties:
  i2c-alias-pool:
    $ref: /schemas/types.yaml#/definitions/uint32-array
    description:
      I2C alias pool is a pool of I2C addresses on the main I2C bus that can be
      used to access the remote peripherals on the serializer's I2C bus. The
      addresses must be available, not used by any other peripheral. Each
      remote peripheral is assigned an alias from the pool, and transactions to
      that address will be forwarded to the remote peripheral, with the address
      translated to the remote peripheral's real address. This property is not
      needed if there are no I2C addressable remote peripherals.

additionalProperties: true
...
```

## Documentation/devicetree/bindings/i2c/i2c-axxia.txt
```
LSI Axxia I2C

Required properties :
- compatible : Must be "lsi,api2c"
- reg : Offset and length of the register set for the device
- interrupts : the interrupt specifier
- #address-cells : Must be <1>;
- #size-cells : Must be <0>;
- clock-names : Must contain "i2c".
- clocks: Must contain an entry for each name in clock-names. See the common
  clock bindings.

Optional properties :
- clock-frequency : Desired I2C bus clock frequency in Hz. If not specified,
  the default 100 kHz frequency will be used. As only Normal and Fast modes
  are supported, possible values are 100000 and 400000.

Example :

i2c@2010084000 {
	compatible = "lsi,api2c";
	device_type = "i2c";
	#address-cells = <1>;
	#size-cells = <0>;
	reg = <0x20 0x10084000 0x00 0x1000>;
	interrupts = <0 19 4>;
	clocks = <&clk_per>;
	clock-names = "i2c";
	clock-frequency = <400000>;
};
```

## Documentation/devicetree/bindings/i2c/i2c-brcmstb.txt
```
Broadcom stb bsc iic master controller

Required properties:

- compatible: should be "brcm,brcmstb-i2c"
- clock-frequency: 32-bit decimal value of iic master clock freqency in Hz
		   valid values are 375000, 390000, 187500, 200000
		   93750, 97500, 46875 and 50000
- reg: specifies the base physical address and size of the registers

Optional properties :

- interrupt-parent: specifies the phandle to the parent interrupt controller
  this one is cascaded from
- interrupts: specifies the interrupt number, the irq line to be used
- interrupt-names: Interrupt name string

Example:

bsca: i2c@f0406200 {
      clock-frequency = <390000>;
      compatible = "brcm,brcmstb-i2c";
      interrupt-parent = <&irq0_intc>;
      reg = <0xf0406200 0x58>;
      interrupts = <0x18>;
      interrupt-names = "upg_bsca";
};
```

## Documentation/devicetree/bindings/i2c/i2c-cadence.txt
```
Binding for the Cadence I2C controller

Required properties:
  - reg: Physical base address and size of the controller's register area.
  - compatible: Should contain one of:
		* "cdns,i2c-r1p10"
		Note:	Use this when cadence i2c controller version 1.0 is used.
		* "cdns,i2c-r1p14"
		Note:	Use this when cadence i2c controller version 1.4 is used.
  - clocks: Input clock specifier. Refer to common clock bindings.
  - interrupts: Interrupt specifier. Refer to interrupt bindings.
  - #address-cells: Should be 1.
  - #size-cells: Should be 0.

Optional properties:
  - clock-frequency: Desired operating frequency, in Hz, of the bus.
  - clock-names: Input clock name, should be 'pclk'.

Example:
	i2c@e0004000 {
		compatible = "cdns,i2c-r1p10";
		clocks = <&clkc 38>;
		interrupts = <GIC_SPI 25 IRQ_TYPE_LEVEL_HIGH>;
		reg = <0xe0004000 0x1000>;
		clock-frequency = <400000>;
		#address-cells = <1>;
		#size-cells = <0>;
	};
```

## Documentation/devicetree/bindings/i2c/i2c-cbus-gpio.txt
```
Device tree bindings for i2c-cbus-gpio driver

Required properties:
	- compatible = "i2c-cbus-gpio";
	- gpios: clk, dat, sel
	- #address-cells = <1>;
	- #size-cells = <0>;

Optional properties:
	- child nodes conforming to i2c bus binding

Example:

i2c@0 {
	compatible = "i2c-cbus-gpio";
	gpios = <&gpio 66 0 /* clk */
		 &gpio 65 0 /* dat */
		 &gpio 64 0 /* sel */
		>;
	#address-cells = <1>;
	#size-cells = <0>;

	retu-mfd: retu@1 {
		compatible = "retu-mfd";
		reg = <0x1>;
	};
};
```

## Documentation/devicetree/bindings/i2c/i2c-cros-ec-tunnel.txt
```
I2C bus that tunnels through the ChromeOS EC (cros-ec)
======================================================
On some ChromeOS board designs we've got a connection to the EC (embedded
controller) but no direct connection to some devices on the other side of
the EC (like a battery and PMIC).  To get access to those devices we need
to tunnel our i2c commands through the EC.

The node for this device should be under a cros-ec node like google,cros-ec-spi
or google,cros-ec-i2c.


Required properties:
- compatible: google,cros-ec-i2c-tunnel
- google,remote-bus: The EC bus we'd like to talk to.

Optional child nodes:
- One node per I2C device connected to the tunnelled I2C bus.


Example:
	cros-ec@0 {
		compatible = "google,cros-ec-spi";

		...

		i2c-tunnel {
			compatible = "google,cros-ec-i2c-tunnel";
			#address-cells = <1>;
			#size-cells = <0>;

			google,remote-bus = <0>;

			battery: sbs-battery@b {
				compatible = "sbs,sbs-battery";
				reg = <0xb>;
				sbs,poll-retry-count = <1>;
			};
		};
	}
```

## Documentation/devicetree/bindings/i2c/i2c-davinci.txt
```
* Texas Instruments Davinci/Keystone I2C

This file provides information, what the device node for the
davinci/keystone i2c interface contains.

Required properties:
- compatible: "ti,davinci-i2c" or "ti,keystone-i2c";
- reg : Offset and length of the register set for the device
- clocks: I2C functional clock phandle.
	  For 66AK2G this property should be set per binding,
	  Documentation/devicetree/bindings/clock/ti,sci-clk.txt

SoC-specific Required Properties:

The following are mandatory properties for Keystone 2 66AK2G SoCs only:

- power-domains:	Should contain a phandle to a PM domain provider node
			and an args specifier containing the I2C device id
			value. This property is as per the binding,
			Documentation/devicetree/bindings/soc/ti/sci-pm-domain.txt

Recommended properties :
- interrupts : standard interrupt property.
- clock-frequency : desired I2C bus clock frequency in Hz.
- ti,has-pfunc: boolean; if defined, it indicates that SoC supports PFUNC
	registers. PFUNC registers allow to switch I2C pins to function as
	GPIOs, so they can by toggled manually.

Example (enbw_cmc board):
	i2c@1c22000 {
		compatible = "ti,davinci-i2c";
		reg = <0x22000 0x1000>;
		clock-frequency = <100000>;
		interrupts = <15>;
		interrupt-parent = <&intc>;
		#address-cells = <1>;
		#size-cells = <0>;

		dtt@48 {
			compatible = "national,lm75";
			reg = <0x48>;
		};
	};
```

## Documentation/devicetree/bindings/i2c/i2c-demux-pinctrl.txt
```
Pinctrl-based I2C Bus DeMux

This binding describes an I2C bus demultiplexer that uses pin multiplexing to
route the I2C signals, and represents the pin multiplexing configuration using
the pinctrl device tree bindings. This may be used to select one I2C IP core at
runtime which may have a better feature set for a given task than another I2C
IP core on the SoC. The most simple example is to fall back to GPIO bitbanging
if your current runtime configuration hits an errata of the internal IP core.

    +-------------------------------+
    | SoC                           |
    |                               |   +-----+  +-----+
    |   +------------+              |   | dev |  | dev |
    |   |I2C IP Core1|--\           |   +-----+  +-----+
    |   +------------+   \-------+  |      |        |
    |                    |Pinctrl|--|------+--------+
    |   +------------+   +-------+  |
    |   |I2C IP Core2|--/           |
    |   +------------+              |
    |                               |
    +-------------------------------+

Required properties:
- compatible: "i2c-demux-pinctrl"
- i2c-parent: List of phandles of I2C masters available for selection. The first
	      one will be used as default.
- i2c-bus-name: The name of this bus. Also needed as pinctrl-name for the I2C
		parents.

Furthermore, I2C mux properties and child nodes. See i2c-mux.yaml in this
directory.

Example:

Here is a snipplet for a bus to be demuxed. It contains various i2c clients for
HDMI, so the bus is named "i2c-hdmi":

	i2chdmi: i2c@8 {

		compatible = "i2c-demux-pinctrl";
		i2c-parent = <&gpioi2c>, <&iic2>, <&i2c2>;
		i2c-bus-name = "i2c-hdmi";
		#address-cells = <1>;
		#size-cells = <0>;

		ak4643: sound-codec@12 {
			compatible = "asahi-kasei,ak4643";

			#sound-dai-cells = <0>;
			reg = <0x12>;
		};

		composite-in@20 {
			compatible = "adi,adv7180";
			reg = <0x20>;
			remote = <&vin1>;

			port {
				adv7180: endpoint {
					bus-width = <8>;
					remote-endpoint = <&vin1ep0>;
				};
			};
		};

		hdmi@39 {
			compatible = "adi,adv7511w";
			reg = <0x39>;
			interrupt-parent = <&gpio1>;
			interrupts = <15 IRQ_TYPE_LEVEL_LOW>;

			adi,input-depth = <8>;
			adi,input-colorspace = "rgb";
			adi,input-clock = "1x";
			adi,input-style = <1>;
			adi,input-justification = "evenly";

			ports {
				#address-cells = <1>;
				#size-cells = <0>;

				port@0 {
					reg = <0>;
					adv7511_in: endpoint {
						remote-endpoint = <&du_out_lvds0>;
					};
				};

				port@1 {
					reg = <1>;
					adv7511_out: endpoint {
						remote-endpoint = <&hdmi_con>;
					};
				};
			};
		};
	};

And for clarification, here are the snipplets for the i2c-parents:

	gpioi2c: i2c@9 {
		#address-cells = <1>;
		#size-cells = <0>;
		compatible = "i2c-gpio";
		gpios = <&gpio5 6 GPIO_ACTIVE_HIGH /* sda */
			 &gpio5 5 GPIO_ACTIVE_HIGH /* scl */
			>;
		i2c-gpio,delay-us = <5>;
	};

...

&i2c2	{
	pinctrl-0 = <&i2c2_pins>;
	pinctrl-names = "i2c-hdmi";

	clock-frequency = <100000>;
};

...

&iic2	{
	pinctrl-0 = <&iic2_pins>;
	pinctrl-names = "i2c-hdmi";

	clock-frequency = <100000>;
};

Please note:

- pinctrl properties for the parent I2C controllers need a pinctrl state
  with the same name as i2c-bus-name, not "default"!

- the i2c masters must have their status "disabled". This driver will
  enable them at runtime when needed.
```
