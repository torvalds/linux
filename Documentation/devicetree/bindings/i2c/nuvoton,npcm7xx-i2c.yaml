## Documentation/devicetree/bindings/i2c/nuvoton,npcm7xx-i2c.yaml
```yaml
# SPDX-License-Identifier: GPL-2.0-only OR BSD-2-Clause
%YAML 1.2
---
$id: http://devicetree.org/schemas/i2c/nuvoton,npcm7xx-i2c.yaml#
$schema: http://devicetree.org/meta-schemas/core.yaml#

title: nuvoton NPCM7XX I2C Controller

description: |
  I2C bus controllers of the NPCM series support both master and
  slave mode. Each controller can switch between master and slave at run time
  (i.e. IPMB mode). HW FIFO for TX and RX are supported.

maintainers:
  - Tali Perry <tali.perry1@gmail.com>

properties:
  compatible:
    enum:
      - nuvoton,npcm750-i2c
      - nuvoton,npcm845-i2c

  reg:
    maxItems: 1

  interrupts:
    maxItems: 1

  clocks:
    maxItems: 1
    description: Reference clock for the I2C bus

  clock-frequency:
    description: Desired I2C bus clock frequency in Hz. If not specified,
                 the default 100 kHz frequency will be used.
                 possible values are 100000, 400000 and 1000000.
    default: 100000
    enum: [100000, 400000, 1000000]

  nuvoton,sys-mgr:
    $ref: /schemas/types.yaml#/definitions/phandle
    description: The phandle of system manager register node.

required:
  - compatible
  - reg
  - interrupts
  - clocks

allOf:
  - $ref: /schemas/i2c/i2c-controller.yaml#
  - if:
      properties:
        compatible:
          contains:
            const: nuvoton,npcm845-i2c

    then:
      required:
        - nuvoton,sys-mgr

unevaluatedProperties: false

examples:
  - |
    #include <dt-bindings/clock/nuvoton,npcm7xx-clock.h>
    #include <dt-bindings/interrupt-controller/arm-gic.h>
    i2c0: i2c@80000 {
        reg = <0x80000 0x1000>;
        clocks = <&clk NPCM7XX_CLK_APB2>;
        clock-frequency = <100000>;
        interrupts = <GIC_SPI 64 IRQ_TYPE_LEVEL_HIGH>;
        compatible = "nuvoton,npcm750-i2c";
        nuvoton,sys-mgr = <&gcr>;
    };

...
```

## Documentation/devicetree/bindings/i2c/nvidia,tegra186-bpmp-i2c.yaml
```yaml
# SPDX-License-Identifier: (GPL-2.0-only OR BSD-2-Clause)
%YAML 1.2
---
$id: http://devicetree.org/schemas/i2c/nvidia,tegra186-bpmp-i2c.yaml#
$schema: http://devicetree.org/meta-schemas/core.yaml#

title: NVIDIA Tegra186 (and later) BPMP I2C controller

maintainers:
  - Thierry Reding <thierry.reding@gmail.com>
  - Jon Hunter <jonathanh@nvidia.com>

description: |
  In Tegra186 and later, the BPMP (Boot and Power Management Processor)
  owns certain HW devices, such as the I2C controller for the power
  management I2C bus. Software running on other CPUs must perform IPC to
  the BPMP in order to execute transactions on that I2C bus. This
  binding describes an I2C bus that is accessed in such a fashion.

  The BPMP I2C node must be located directly inside the main BPMP node.
  See ../firmware/nvidia,tegra186-bpmp.yaml for details of the BPMP
  binding.

  This node represents an I2C controller. See ../i2c/i2c.txt for details
  of the core I2C binding.

properties:
  compatible:
    const: nvidia,tegra186-bpmp-i2c

  nvidia,bpmp-bus-id:
    $ref: /schemas/types.yaml#/definitions/uint32
    description: Indicates the I2C bus number this DT node represents,
      as defined by the BPMP firmware.

allOf:
  - $ref: /schemas/i2c/i2c-controller.yaml

unevaluatedProperties: false

required:
  - compatible
  - "#address-cells"
  - "#size-cells"
  - nvidia,bpmp-bus-id
```

## Documentation/devicetree/bindings/i2c/nvidia,tegra20-i2c.txt
```
NVIDIA Tegra20/Tegra30/Tegra114 I2C controller driver.

Required properties:
- compatible : should be:
	"nvidia,tegra114-i2c"
	"nvidia,tegra30-i2c"
	"nvidia,tegra20-i2c"
	"nvidia,tegra20-i2c-dvc"
  Details of compatible are as follows:
  nvidia,tegra20-i2c-dvc: Tegra20 has specific I2C controller called as DVC I2C
	controller. This only support master mode of I2C communication. Register
	interface/offset and interrupts handling are different than generic I2C
	controller. Driver of DVC I2C controller is only compatible with
	"nvidia,tegra20-i2c-dvc".
  nvidia,tegra20-i2c: Tegra20 has 4 generic I2C controller. This can support
	master and slave mode of I2C communication. The i2c-tegra driver only
	support master mode of I2C communication. Driver of I2C controller is
	only compatible with "nvidia,tegra20-i2c".
  nvidia,tegra30-i2c: Tegra30 has 5 generic I2C controller. This controller is
	very much similar to Tegra20 I2C controller with additional feature:
	Continue Transfer Support. This feature helps to implement M_NO_START
	as per I2C core API transfer flags. Driver of I2C controller is
	compatible with "nvidia,tegra30-i2c" to enable the continue transfer
	support. This is also compatible with "nvidia,tegra20-i2c" without
	continue transfer support.
  nvidia,tegra114-i2c: Tegra114 has 5 generic I2C controller. This controller is
	very much similar to Tegra30 I2C controller with some hardware
	modification:
	 - Tegra30/Tegra20 I2C controller has 2 clock source called div-clk and
	   fast-clk. Tegra114 has only one clock source called as div-clk and
	   hence clock mechanism is changed in I2C controller.
	 - Tegra30/Tegra20 I2C controller has enabled per packet transfer by
	   default and there is no way to disable it. Tegra114 has this
	   interrupt disable by default and SW need to enable explicitly.
	Due to above changes, Tegra114 I2C driver makes incompatible with
	previous hardware driver. Hence, tegra114 I2C controller is compatible
	with "nvidia,tegra114-i2c".
- reg: Should contain I2C controller registers physical address and length.
- interrupts: Should contain I2C controller interrupts.
- address-cells: Address cells for I2C device address.
- size-cells: Size of the I2C device address.
- clocks: Must contain an entry for each entry in clock-names.
  See ../clocks/clock-bindings.txt for details.
- clock-names: Must include the following entries:
  Tegra20/Tegra30:
  - div-clk
  - fast-clk
  Tegra114:
  - div-clk
- resets: Must contain an entry for each entry in reset-names.
  See ../reset/reset.txt for details.
- reset-names: Must include the following entries:
  - i2c
- dmas: Must contain an entry for each entry in clock-names.
  See ../dma/dma.txt for details.
- dma-names: Must include the following entries:
  - rx
  - tx

Example:

	i2c@7000c000 {
		compatible = "nvidia,tegra20-i2c";
		reg = <0x7000c000 0x100>;
		interrupts = <0 38 0x04>;
		#address-cells = <1>;
		#size-cells = <0>;
		clocks = <&tegra_car 12>, <&tegra_car 124>;
		clock-names = "div-clk", "fast-clk";
		resets = <&tegra_car 12>;
		reset-names = "i2c";
		dmas = <&apbdma 16>, <&apbdma 16>;
		dma-names = "rx", "tx";
		status = "disabled";
	};
```

## Documentation/devicetree/bindings/i2c/nvidia,tegra20-i2c.yaml
```yaml
# SPDX-License-Identifier: (GPL-2.0-only OR BSD-2-Clause)
%YAML 1.2
---
$id: http://devicetree.org/schemas/i2c/nvidia,tegra20-i2c.yaml#
$schema: http://devicetree.org/meta-schemas/core.yaml#

maintainers:
  - Thierry Reding <thierry.reding@gmail.com>
  - Jon Hunter <jonathanh@nvidia.com>

title: NVIDIA Tegra I2C controller driver

properties:
  compatible:
    oneOf:
      - description: Tegra20 has 4 generic I2C controller. This can support
          master and slave mode of I2C communication. The i2c-tegra driver
          only support master mode of I2C communication. Driver of I2C
          controller is only compatible with "nvidia,tegra20-i2c".
        const: nvidia,tegra20-i2c
      - description: Tegra20 has specific I2C controller called as DVC I2C
          controller. This only support master mode of I2C communication.
          Register interface/offset and interrupts handling are different than
          generic I2C controller. Driver of DVC I2C controller is only
          compatible with "nvidia,tegra20-i2c-dvc".
        const: nvidia,tegra20-i2c-dvc
      - description: |
          Tegra30 has 5 generic I2C controller. This controller is very much
          similar to Tegra20 I2C controller with additional feature: Continue
          Transfer Support. This feature helps to implement M_NO_START as per
          I2C core API transfer flags. Driver of I2C controller is compatible
          with "nvidia,tegra30-i2c" to enable the continue transfer support.
          This is also compatible with "nvidia,tegra20-i2c" without continue
          transfer support.
        items:
          - const: nvidia,tegra30-i2c
          - const: nvidia,tegra20-i2c
      - description: |
          Tegra114 has 5 generic I2C controllers. This controller is very much
          similar to Tegra30 I2C controller with some hardware modification:
            - Tegra30/Tegra20 I2C controller has 2 clock source called div-clk
              and fast-clk. Tegra114 has only one clock source called as
              div-clk and hence clock mechanism is changed in I2C controller.
            - Tegra30/Tegra20 I2C controller has enabled per packet transfer
              by default and there is no way to disable it. Tegra114 has this
              interrupt disable by default and SW need to enable explicitly.
          Due to above changes, Tegra114 I2C driver makes incompatible with
          previous hardware driver. Hence, Tegra114 I2C controller is
          compatible with "nvidia,tegra114-i2c".
        const: nvidia,tegra114-i2c
      - description: |
          Tegra124 has 6 generic I2C controllers. These controllers are very
          similar to those found on Tegra114 but also contain several hardware
          improvements and new registers.
        const: nvidia,tegra124-i2c
      - description: |
          Tegra210 has 6 generic I2C controllers. These controllers are very
          similar to those found on Tegra124.
        items:
          - const: nvidia,tegra210-i2c
          - const: nvidia,tegra124-i2c
      - description: |
          Tegra210 has one I2C controller that is on host1x bus and is part of
          the VE power domain and typically used for camera use-cases. This VI
          I2C controller is mostly compatible with the programming model of
          the regular I2C controllers with a few exceptions. The I2C registers
          start at an offset of 0xc00 (instead of 0), registers are 16 bytes
          apart (rather than 4) and the controller does not support slave
          mode.
        const: nvidia,tegra210-i2c-vi
      - description: |
          Tegra186 has 9 generic I2C controllers, two of which are in the AON
          (always-on) partition of the SoC. All of these controllers are very
          similar to those found on Tegra210.
        const: nvidia,tegra186-i2c
      - description: |
          Tegra194 has 8 generic I2C controllers, two of which are in the AON
          (always-on) partition of the SoC. All of these controllers are very
          similar to those found on Tegra186. However, these controllers have
          support for 64 KiB transactions whereas earlier chips supported no
          more than 4 KiB per transactions.
        const: nvidia,tegra194-i2c

  reg:
    maxItems: 1

  interrupts:
    maxItems: 1

  clocks:
    minItems: 1
    maxItems: 2

  clock-names:
    minItems: 1
    maxItems: 2

  resets:
    items:
      - description:
          Module reset. This property is optional for controllers in Tegra194,
          Tegra234 etc where an internal software reset is available as an
          alternative.

  reset-names:
    items:
      - const: i2c

  power-domains:
    maxItems: 1

  dmas:
    items:
      - description: DMA channel for the reception FIFO
      - description: DMA channel for the transmission FIFO

  dma-names:
    items:
      - const: rx
      - const: tx

required:
  - compatible
  - reg
  - interrupts
  - clocks
  - clock-names

allOf:
  - $ref: /schemas/i2c/i2c-controller.yaml
  - if:
      properties:
        compatible:
          contains:
            enum:
              - nvidia,tegra20-i2c
              - nvidia,tegra30-i2c
    then:
      properties:
        clocks:
          minItems: 2
        clock-names:
          items:
            - const: div-clk
            - const: fast-clk

  - if:
      properties:
        compatible:
          contains:
            enum:
              - nvidia,tegra114-i2c
              - nvidia,tegra210-i2c
    then:
      properties:
        clocks:
          maxItems: 1
        clock-names:
          items:
            - const: div-clk

  - if:
      properties:
        compatible:
          contains:
            const: nvidia,tegra210-i2c-vi
    then:
      properties:
        clocks:
          minItems: 2
        clock-names:
          items:
            - const: div-clk
            - const: slow
        power-domains:
          items:
            - description: phandle to the VENC power domain
    else:
      properties:
        power-domains: false

  - if:
      not:
        properties:
          compatible:
            contains:
              enum:
                - nvidia,tegra194-i2c
    then:
      required:
        - resets
        - reset-names

unevaluatedProperties: false

examples:
  - |
    i2c@7000c000 {
        compatible = "nvidia,tegra20-i2c";
        reg = <0x7000c000 0x100>;
        interrupts = <0 38 0x04>;
        clocks = <&tegra_car 12>, <&tegra_car 124>;
        clock-names = "div-clk", "fast-clk";
        resets = <&tegra_car 12>;
        reset-names = "i2c";
        dmas = <&apbdma 16>, <&apbdma 16>;
        dma-names = "rx", "tx";

        #address-cells = <1>;
        #size-cells = <0>;
    };
```

## Documentation/devicetree/bindings/i2c/nxp,lpc1788-i2c.yaml
```yaml
# SPDX-License-Identifier: GPL-2.0-only OR BSD-2-Clause
%YAML 1.2
---
$id: http://devicetree.org/schemas/i2c/nxp,lpc1788-i2c.yaml#
$schema: http://devicetree.org/meta-schemas/core.yaml#

title: NXP I2C controller for LPC2xxx/178x/18xx/43xx

maintainers:
  - Vladimir Zapolskiy <vz@mleia.com>

allOf:
  - $ref: /schemas/i2c/i2c-controller.yaml#

properties:
  compatible:
    const: nxp,lpc1788-i2c

  reg:
    maxItems: 1

  interrupts:
    maxItems: 1

  clocks:
    maxItems: 1

  clock-frequency:
    description: the desired I2C bus clock frequency in Hz
    default: 100000

  resets:
    maxItems: 1

required:
  - compatible
  - reg
  - interrupts
  - clocks

unevaluatedProperties: false

examples:
  - |
    #include "dt-bindings/clock/lpc18xx-ccu.h"

    i2c@400a1000 {
        compatible = "nxp,lpc1788-i2c";
        reg = <0x400a1000 0x1000>;
        interrupts = <18>;
        clocks = <&ccu1 CLK_APB1_I2C0>;
        #address-cells = <1>;
        #size-cells = <0>;
    };
```

## Documentation/devicetree/bindings/i2c/nxp,pca9541.txt
```
* NXP PCA9541 I2C bus master selector

Required Properties:

  - compatible: Must be "nxp,pca9541"

  - reg: The I2C address of the device.

  The following required properties are defined externally:

  - I2C arbitration bus node. See i2c-arb.txt in this directory.


Example:

	i2c-arbitrator@74 {
		compatible = "nxp,pca9541";
		reg = <0x74>;

		i2c-arb {
			#address-cells = <1>;
			#size-cells = <0>;

			eeprom@54 {
				compatible = "at,24c08";
				reg = <0x54>;
			};
		};
	};
```
