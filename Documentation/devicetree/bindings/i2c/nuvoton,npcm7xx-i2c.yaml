## Documentation/devicetree/bindings/i2c/qcom,i2c-geni-qcom.yaml
```yaml
# SPDX-License-Identifier: (GPL-2.0-only OR BSD-2-Clause)
%YAML 1.2
---
$id: "http://devicetree.org/schemas/i2c/qcom,i2c-geni-qcom.yaml#"
$schema: "http://devicetree.org/meta-schemas/core.yaml#"

title: Qualcomm Geni based QUP I2C Controller

maintainers:
  - Andy Gross <agross@kernel.org>
  - Bjorn Andersson <bjorn.andersson@linaro.org>

properties:
  compatible:
    enum:
      - qcom,geni-i2c
      - qcom,geni-i2c-master-hub

  clocks:
    minItems: 1
    maxItems: 2

  clock-names:
    minItems: 1
    maxItems: 2

  clock-frequency:
    default: 100000

  dmas:
    maxItems: 2

  dma-names:
    items:
      - const: tx
      - const: rx

  interconnects:
    minItems: 2
    maxItems: 3

  interconnect-names:
    minItems: 2
    maxItems: 3

  interrupts:
    maxItems: 1

  operating-points-v2: true

  pinctrl-0: true
  pinctrl-1: true

  pinctrl-names:
    minItems: 1
    items:
      - const: default
      - const: sleep

  power-domains:
    maxItems: 1

  reg:
    maxItems: 1

  required-opps:
    maxItems: 1

required:
  - compatible
  - interrupts
  - clocks
  - clock-names
  - reg

allOf:
  - $ref: /schemas/i2c/i2c-controller.yaml#
  - if:
      properties:
        compatible:
          contains:
            const: qcom,geni-i2c-master-hub
    then:
      properties:
        clocks:
          minItems: 2

        clock-names:
          items:
            - const: se
            - const: core

        dmas: false
        dma-names: false

        interconnects:
          maxItems: 2

        interconnect-names:
          items:
            - const: qup-core
            - const: qup-config
    else:
      properties:
        clocks:
          maxItems: 1

        clock-names:
          const: se

        interconnects:
          minItems: 3

        interconnect-names:
          items:
            - const: qup-core
            - const: qup-config
            - const: qup-memory

unevaluatedProperties: false

examples:
  - |
    #include <dt-bindings/interrupt-controller/arm-gic.h>
    #include <dt-bindings/clock/qcom,gcc-sc7180.h>
    #include <dt-bindings/interconnect/qcom,sc7180.h>
    #include <dt-bindings/power/qcom-rpmpd.h>

    i2c@88000 {
        compatible = "qcom,geni-i2c";
        reg = <0x00880000 0x4000>;
        clock-names = "se";
        clocks = <&gcc GCC_QUPV3_WRAP0_S0_CLK>;
        pinctrl-names = "default";
        pinctrl-0 = <&qup_i2c0_default>;
        interrupts = <GIC_SPI 601 IRQ_TYPE_LEVEL_HIGH>;
        #address-cells = <1>;
        #size-cells = <0>;
        interconnects = <&qup_virt MASTER_QUP_CORE_0 0 &qup_virt SLAVE_QUP_CORE_0 0>,
                        <&gem_noc MASTER_APPSS_PROC 0 &config_noc SLAVE_QUP_0 0>,
                        <&aggre1_noc MASTER_QUP_0 0 &mc_virt SLAVE_EBI1 0>;
        interconnect-names = "qup-core", "qup-config", "qup-memory";
        power-domains = <&rpmhpd SC7180_CX>;
        required-opps = <&rpmhpd_opp_low_svs>;
    };
...
```

## Documentation/devicetree/bindings/i2c/qcom,i2c-qup.txt
```
Qualcomm Universal Peripheral (QUP) I2C controller

Required properties:
 - compatible: Should be:
   * "qcom,i2c-qup-v1.1.1" for 8660, 8960 and 8064.
   * "qcom,i2c-qup-v2.1.1" for 8974 v1.
   * "qcom,i2c-qup-v2.2.1" for 8974 v2 and later.
 - reg: Should contain QUP register address and length.
 - interrupts: Should contain I2C interrupt.

 - clocks: A list of phandles + clock-specifiers, one for each entry in
   clock-names.
 - clock-names: Should contain:
   * "core" for the core clock
   * "iface" for the AHB clock

 - #address-cells: Should be <1> Address cells for i2c device address
 - #size-cells: Should be <0> as i2c addresses have no size component

Optional properties:
 - clock-frequency: Should specify the desired i2c bus clock frequency in Hz,
                    defaults to 100kHz if omitted.

Child nodes should conform to i2c bus binding.

Example:

 i2c@f9924000 {
 	compatible = "qcom,i2c-qup-v2.2.1";
 	reg = <0xf9924000 0x1000>;
 	interrupts = <0 96 0>;

 	clocks = <&gcc GCC_BLSP1_QUP2_I2C_APPS_CLK>, <&gcc GCC_BLSP1_AHB_CLK>;
 	clock-names = "core", "iface";

 	clock-frequency = <355000>;

 	#address-cells = <1>;
 	#size-cells = <0>;
 };
```

## Documentation/devicetree/bindings/i2c/qcom,i2c-qup.yaml
```yaml
# SPDX-License-Identifier: GPL-2.0 OR BSD-2-Clause
%YAML 1.2
---
$id: http://devicetree.org/schemas/i2c/qcom,i2c-qup.yaml#
$schema: http://devicetree.org/meta-schemas/core.yaml#

title: Qualcomm Universal Peripheral (QUP) I2C controller

maintainers:
  - Andy Gross <agross@kernel.org>
  - Bjorn Andersson <bjorn.andersson@linaro.org>
  - Krzysztof Kozlowski <krzysztof.kozlowski@linaro.org>

allOf:
  - $ref: /schemas/i2c/i2c-controller.yaml#

properties:
  compatible:
    enum:
      - qcom,i2c-qup-v1.1.1     # for 8660, 8960 and 8064
      - qcom,i2c-qup-v2.1.1     # for 8974 v1
      - qcom,i2c-qup-v2.2.1     # for 8974 v2 and later

  clocks:
    maxItems: 2

  clock-names:
    items:
      - const: core
      - const: iface

  clock-frequency:
    default: 100000

  dmas:
    maxItems: 2

  dma-names:
    items:
      - const: tx
      - const: rx

  interconnects:
    maxItems: 1

  interrupts:
    maxItems: 1

  pinctrl-0: true
  pinctrl-1: true

  pinctrl-names:
    minItems: 1
    items:
      - const: default
      - const: sleep

  power-domains:
    maxItems: 1

  reg:
    maxItems: 1

  required-opps:
    maxItems: 1

required:
  - compatible
  - clock-names
  - clocks
  - interrupts
  - reg

unevaluatedProperties: false

examples:
  - |
    #include <dt-bindings/clock/qcom,gcc-msm8998.h>
    #include <dt-bindings/interconnect/qcom,msm8996.h>
    #include <dt-bindings/interrupt-controller/arm-gic.h>
    #include <dt-bindings/power/qcom-rpmpd.h>

    i2c@c175000 {
        compatible = "qcom,i2c-qup-v2.2.1";
        reg = <0x0c175000 0x600>;
        interrupts = <GIC_SPI 95 IRQ_TYPE_LEVEL_HIGH>;

        clocks = <&gcc GCC_BLSP1_QUP1_I2C_APPS_CLK>,
                 <&gcc GCC_BLSP1_AHB_CLK>;
        clock-names = "core", "iface";
        dmas = <&blsp1_dma 6>, <&blsp1_dma 7>;
        dma-names = "tx", "rx";
        pinctrl-names = "default", "sleep";
        pinctrl-0 = <&blsp1_i2c1_default>;
        pinctrl-1 = <&blsp1_i2c1_sleep>;
        power-domains = <&rpmpd MSM8909_VDDCX>;
        required-opps = <&rpmpd_opp_svs_krait>;
        interconnects = <&pnoc MASTER_BLSP_1 &bimc SLAVE_EBI_CH0>;
        clock-frequency = <400000>;

        #address-cells = <1>;
        #size-cells = <0>;
    };
```

## Documentation/devicetree/bindings/i2c/qcom,sa8255p-geni-i2c.yaml
```yaml
# SPDX-License-Identifier: (GPL-2.0-only OR BSD-2-Clause)
%YAML 1.2
---
$id: http://devicetree.org/schemas/i2c/qcom,sa8255p-geni-i2c.yaml#
$schema: http://devicetree.org/meta-schemas/core.yaml#

title: Qualcomm SA8255p QUP GENI I2C Controller

maintainers:
  - Praveen Talari <praveen.talari@oss.qualcomm.com>

properties:
  compatible:
    oneOf:
      - const: qcom,sa8255p-geni-i2c
      - items:
          - const: qcom,sa8797p-geni-i2c
          - const: qcom,sa8255p-geni-i2c

  reg:
    maxItems: 1

  dmas:
    maxItems: 2

  dma-names:
    items:
      - const: tx
      - const: rx

  interrupts:
    maxItems: 1

  power-domains:
    maxItems: 2

  power-domain-names:
    items:
      - const: power
      - const: perf

required:
  - compatible
  - reg
  - interrupts
  - power-domains

allOf:
  - $ref: /schemas/i2c/i2c-controller.yaml#

unevaluatedProperties: false

examples:
  - |
    #include <dt-bindings/interrupt-controller/arm-gic.h>
    #include <dt-bindings/dma/qcom-gpi.h>

    i2c@a90000 {
        compatible = "qcom,sa8255p-geni-i2c";
        reg = <0xa90000 0x4000>;
        interrupts = <GIC_SPI 357 IRQ_TYPE_LEVEL_HIGH>;
        dmas = <&gpi_dma0 0 0 QCOM_GPI_I2C>,
               <&gpi_dma0 1 0 QCOM_GPI_I2C>;
        dma-names = "tx", "rx";
        power-domains = <&scmi0_pd 0>, <&scmi0_dvfs 0>;
        power-domain-names = "power", "perf";
    };
...
```

## Documentation/devicetree/bindings/i2c/realtek,rtl9301-i2c.yaml
```yaml
# SPDX-License-Identifier: (GPL-2.0-only OR BSD-2-Clause)
%YAML 1.2
---
$id: http://devicetree.org/schemas/i2c/realtek,rtl9301-i2c.yaml#
$schema: http://devicetree.org/meta-schemas/core.yaml#

title: Realtek RTL I2C Controller

maintainers:
  - Chris Packham <chris.packham@alliedtelesis.co.nz>

description:
  RTL9300 SoCs have two I2C controllers. Each of these has an SCL line (which
  if not-used for SCL can be a GPIO). There are 8 common SDA lines that can be
  assigned to either I2C controller.
  RTL9310 SoCs have equal capabilities but support 12 common SDA lines which
  can be assigned to either I2C controller.

properties:
  compatible:
    oneOf:
      - items:
          - enum:
              - realtek,rtl9302b-i2c
              - realtek,rtl9302c-i2c
              - realtek,rtl9303-i2c
          - const: realtek,rtl9301-i2c
      - items:
          - enum:
              - realtek,rtl9311-i2c
              - realtek,rtl9312-i2c
              - realtek,rtl9313-i2c
          - const: realtek,rtl9310-i2c
      - enum:
          - realtek,rtl9301-i2c
          - realtek,rtl9310-i2c

  reg:
    items:
      - description: Register offset and size of this I2C controller.

  "#address-cells":
    const: 1

  "#size-cells":
    const: 0

  realtek,scl:
    $ref: /schemas/types.yaml#/definitions/uint32
    description:
      The SCL line number of this I2C controller.
    enum: [ 0, 1 ]

patternProperties:
  '^i2c@[0-9ab]$':
    $ref: /schemas/i2c/i2c-controller.yaml
    unevaluatedProperties: false

    properties:
      reg:
        description: The SDA line number associated with the I2C bus.
        maxItems: 1

    required:
      - reg


allOf:
  - if:
      properties:
        compatible:
          contains:
            const: realtek,rtl9310-i2c
    then:
      required:
        - realtek,scl
  - if:
      properties:
        compatible:
          contains:
            const: realtek,rtl9301-i2c
    then:
      patternProperties:
        '^i2c@[89ab]$': false

required:
  - compatible
  - reg

additionalProperties: false

examples:
  - |
    i2c@36c {
      compatible = "realtek,rtl9301-i2c";
      reg = <0x36c 0x14>;
      #address-cells = <1>;
      #size-cells = <0>;

      i2c@2 {
        reg = <2>;
        #address-cells = <1>;
        #size-cells = <0>;
      };
    };
```

## Documentation/devicetree/bindings/i2c/renesas,iic-emev2.txt
```
Device tree configuration for Renesas EMEV2 IIC controller

Required properties:
- compatible      : "renesas,iic-emev2"
- reg             : address start and address range size of device
- interrupts      : specifier for the IIC controller interrupt
- clocks          : phandle to the IP core SCLK
- clock-names     : must be "sclk"
- #address-cells  : should be <1>
- #size-cells     : should be <0>

Example:

	iic0: i2c@e0070000 {
		#address-cells = <1>;
		#size-cells = <0>;
		compatible = "renesas,iic-emev2";
		reg = <0xe0070000 0x28>;
		interrupts = <0 32 IRQ_TYPE_EDGE_RISING>;
		clocks = <&iic0_sclk>;
		clock-names = "sclk";
	};
```

## Documentation/devicetree/bindings/i2c/renesas,iic-emev2.yaml
```yaml
# SPDX-License-Identifier: (GPL-2.0-only OR BSD-2-Clause)
%YAML 1.2
---
$id: http://devicetree.org/schemas/i2c/renesas,iic-emev2.yaml#
$schema: http://devicetree.org/meta-schemas/core.yaml#

title: Renesas EMMA Mobile EV2 IIC Interface

maintainers:
  - Wolfram Sang <wsa+renesas@sang-engineering.com>

allOf:
  - $ref: /schemas/i2c/i2c-controller.yaml#

properties:
  compatible:
    const: renesas,iic-emev2

  reg:
    maxItems: 1

  interrupts:
    maxItems: 1

  clocks:
    maxItems: 1

  clock-names:
    const: sclk

required:
  - compatible
  - reg
  - interrupts
  - clocks
  - clock-names
  - '#address-cells'
  - '#size-cells'

unevaluatedProperties: false

examples:
  - |
    #include <dt-bindings/interrupt-controller/arm-gic.h>

    iic0: i2c@e0070000 {
            #address-cells = <1>;
            #size-cells = <0>;
            compatible = "renesas,iic-emev2";
            reg = <0xe0070000 0x28>;
            interrupts = <GIC_SPI 32 IRQ_TYPE_EDGE_RISING>;
            clocks = <&iic0_sclk>;
            clock-names = "sclk";
    };
```
