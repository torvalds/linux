## Documentation/devicetree/bindings/i2c/renesas,rcar-i2c.yaml
```yaml
# SPDX-License-Identifier: (GPL-2.0-only OR BSD-2-Clause)
%YAML 1.2
---
$id: http://devicetree.org/schemas/i2c/renesas,rcar-i2c.yaml#
$schema: http://devicetree.org/meta-schemas/core.yaml#

title: Renesas R-Car I2C Controller

maintainers:
  - Wolfram Sang <wsa+renesas@sang-engineering.com>

properties:
  compatible:
    oneOf:
      - items:
          - enum:
              - renesas,i2c-r8a7778      # R-Car M1A
              - renesas,i2c-r8a7779      # R-Car H1
          - const: renesas,rcar-gen1-i2c # R-Car Gen1

      - items:
          - enum:
              - renesas,i2c-r8a7742      # RZ/G1H
              - renesas,i2c-r8a7743      # RZ/G1M
              - renesas,i2c-r8a7744      # RZ/G1N
              - renesas,i2c-r8a7745      # RZ/G1E
              - renesas,i2c-r8a77470     # RZ/G1C
              - renesas,i2c-r8a7790      # R-Car H2
              - renesas,i2c-r8a7791      # R-Car M2-W
              - renesas,i2c-r8a7792      # R-Car V2H
              - renesas,i2c-r8a7793      # R-Car M2-N
              - renesas,i2c-r8a7794      # R-Car E2
          - const: renesas,rcar-gen2-i2c # R-Car Gen2 and RZ/G1

      - items:
          - enum:
              - renesas,i2c-r8a774a1     # RZ/G2M
              - renesas,i2c-r8a774b1     # RZ/G2N
              - renesas,i2c-r8a774c0     # RZ/G2E
              - renesas,i2c-r8a774e1     # RZ/G2H
              - renesas,i2c-r8a7795      # R-Car H3
              - renesas,i2c-r8a7796      # R-Car M3-W
              - renesas,i2c-r8a77961     # R-Car M3-W+
              - renesas,i2c-r8a77965     # R-Car M3-N
              - renesas,i2c-r8a77970     # R-Car V3M
              - renesas,i2c-r8a77980     # R-Car V3H
              - renesas,i2c-r8a77990     # R-Car E3
              - renesas,i2c-r8a77995     # R-Car D3
          - const: renesas,rcar-gen3-i2c # R-Car Gen3 and RZ/G2

      - items:
          - enum:
              - renesas,i2c-r8a779a0     # R-Car V3U
              - renesas,i2c-r8a779f0     # R-Car S4-8
          - const: renesas,rcar-gen4-i2c # R-Car Gen4

  reg:
    maxItems: 1

  interrupts:
    maxItems: 1

  clock-frequency:
    description:
      Desired I2C bus clock frequency in Hz. The absence of this property
      indicates the default frequency 100 kHz.

  clocks:
    maxItems: 1

  power-domains:
    maxItems: 1

  resets:
    maxItems: 1

  dmas:
    minItems: 2
    maxItems: 4
    description:
      Must contain a list of pairs of references to DMA specifiers, one for
      transmission, and one for reception.

  dma-names:
    minItems: 2
    maxItems: 4
    items:
      enum:
        - tx
        - rx

  i2c-scl-falling-time-ns:
    default: 35
    description:
      Number of nanoseconds the SCL signal takes to fall; t(f) in the I2C
      specification.

  i2c-scl-internal-delay-ns:
    default: 50
    description:
      Number of nanoseconds the IP core additionally needs to setup SCL.

  i2c-scl-rising-time-ns:
    default: 200
    description:
      Number of nanoseconds the SCL signal takes to rise; t(r) in the I2C
      specification.

required:
  - compatible
  - reg
  - interrupts
  - clocks
  - power-domains
  - '#address-cells'
  - '#size-cells'

allOf:
  - $ref: /schemas/i2c/i2c-controller.yaml#

  - if:
      properties:
        compatible:
          contains:
            enum:
              - renesas,rcar-gen1-i2c
              - renesas,rcar-gen2-i2c
    then:
      properties:
        dmas: false
        dma-names: false

  - if:
      properties:
        compatible:
          contains:
            enum:
              - renesas,rcar-gen2-i2c
              - renesas,rcar-gen3-i2c
              - renesas,rcar-gen4-i2c
    then:
      required:
        - resets

unevaluatedProperties: false

examples:
  - |
    #include <dt-bindings/clock/r8a7791-cpg-mssr.h>
    #include <dt-bindings/interrupt-controller/arm-gic.h>
    #include <dt-bindings/power/r8a7791-sysc.h>

    i2c0: i2c@e6508000 {
            #address-cells = <1>;
            #size-cells = <0>;
            compatible = "renesas,i2c-r8a7791", "renesas,rcar-gen2-i2c";
            reg = <0xe6508000 0x40>;
            interrupts = <GIC_SPI 287 IRQ_TYPE_LEVEL_HIGH>;
            clock-frequency = <400000>;
            clocks = <&cpg CPG_MOD 931>;
            power-domains = <&sysc R8A7791_PD_ALWAYS_ON>;
            resets = <&cpg 931>;
            i2c-scl-internal-delay-ns = <6>;
    };
```

## Documentation/devicetree/bindings/i2c/renesas,riic.yaml
```yaml
# SPDX-License-Identifier: (GPL-2.0-only OR BSD-2-Clause)
%YAML 1.2
---
$id: http://devicetree.org/schemas/i2c/renesas,riic.yaml#
$schema: http://devicetree.org/meta-schemas/core.yaml#

title: Renesas RZ/A and RZ/G2L I2C Bus Interface (RIIC)

maintainers:
  - Chris Brandt <chris.brandt@renesas.com>
  - Wolfram Sang <wsa+renesas@sang-engineering.com>

properties:
  compatible:
    oneOf:
      - items:
          - enum:
              - renesas,riic-r7s72100   # RZ/A1H
              - renesas,riic-r7s9210    # RZ/A2M
              - renesas,riic-r9a07g043  # RZ/G2UL and RZ/Five
              - renesas,riic-r9a07g044  # RZ/G2{L,LC}
              - renesas,riic-r9a07g054  # RZ/V2L
          - const: renesas,riic-rz      # RZ/A or RZ/G2L

      - items:
          - enum:
              - renesas,riic-r9a08g045   # RZ/G3S
              - renesas,riic-r9a09g047   # RZ/G3E
              - renesas,riic-r9a09g056   # RZ/V2N
          - const: renesas,riic-r9a09g057   # RZ/V2H(P)

      - enum:
          - renesas,riic-r9a09g057   # RZ/V2H(P)
          - renesas,riic-r9a09g077   # RZ/T2H

      - items:
          - const: renesas,riic-r9a09g087  # RZ/N2H
          - const: renesas,riic-r9a09g077  # RZ/T2H

  reg:
    maxItems: 1

  interrupts:
    oneOf:
      - items:
          - description: Transmit End Interrupt
          - description: Receive Data Full Interrupt
          - description: Transmit Data Empty Interrupt
          - description: Stop Condition Detection Interrupt
          - description: Start Condition Detection Interrupt
          - description: NACK Reception Interrupt
          - description: Arbitration-Lost Interrupt
          - description: Timeout Interrupt
      - items:
          - description: Transfer Error Or Event Generation
          - description: Receive Data Full Interrupt
          - description: Transmit Data Empty Interrupt
          - description: Transmit End Interrupt

  interrupt-names:
    oneOf:
      - items:
          - const: tei
          - const: ri
          - const: ti
          - const: spi
          - const: sti
          - const: naki
          - const: ali
          - const: tmoi
      - items:
          - const: eei
          - const: rxi
          - const: txi
          - const: tei

  clock-frequency:
    description:
      Desired I2C bus clock frequency in Hz. The absence of this property
      indicates the default frequency 100 kHz.

  clocks:
    maxItems: 1

  power-domains:
    maxItems: 1

  resets:
    maxItems: 1

required:
  - compatible
  - reg
  - interrupts
  - interrupt-names
  - clocks
  - clock-frequency
  - power-domains
  - '#address-cells'
  - '#size-cells'

allOf:
  - $ref: /schemas/i2c/i2c-controller.yaml#

  - if:
      properties:
        compatible:
          contains:
            const: renesas,riic-r9a09g077
    then:
      properties:
        interrupts:
          maxItems: 4
        interrupt-names:
          maxItems: 4
        resets: false
    else:
      properties:
        interrupts:
          minItems: 8
        interrupt-names:
          minItems: 8

  - if:
      properties:
        compatible:
          contains:
            enum:
              - renesas,riic-r9a07g043
              - renesas,riic-r9a07g044
              - renesas,riic-r9a07g054
              - renesas,riic-r9a09g057
    then:
      required:
        - resets

unevaluatedProperties: false

examples:
  - |
    #include <dt-bindings/clock/r7s72100-clock.h>
    #include <dt-bindings/interrupt-controller/arm-gic.h>

    i2c0: i2c@fcfee000 {
        compatible = "renesas,riic-r7s72100", "renesas,riic-rz";
        reg = <0xfcfee000 0x44>;
        interrupts = <GIC_SPI 157 IRQ_TYPE_LEVEL_HIGH>,
                     <GIC_SPI 158 IRQ_TYPE_EDGE_RISING>,
                     <GIC_SPI 159 IRQ_TYPE_EDGE_RISING>,
                     <GIC_SPI 160 IRQ_TYPE_LEVEL_HIGH>,
                     <GIC_SPI 161 IRQ_TYPE_LEVEL_HIGH>,
                     <GIC_SPI 162 IRQ_TYPE_LEVEL_HIGH>,
                     <GIC_SPI 163 IRQ_TYPE_LEVEL_HIGH>,
                     <GIC_SPI 164 IRQ_TYPE_LEVEL_HIGH>;
        interrupt-names = "tei", "ri", "ti", "spi", "sti", "naki", "ali",
                          "tmoi";
        clocks = <&mstp9_clks R7S72100_CLK_I2C0>;
        clock-frequency = <100000>;
        power-domains = <&cpg_clocks>;
        #address-cells = <1>;
        #size-cells = <0>;
    };
```

## Documentation/devicetree/bindings/i2c/renesas,rmobile-iic.yaml
```yaml
# SPDX-License-Identifier: (GPL-2.0-only OR BSD-2-Clause)
%YAML 1.2
---
$id: http://devicetree.org/schemas/i2c/renesas,rmobile-iic.yaml#
$schema: http://devicetree.org/meta-schemas/core.yaml#

title: Renesas R-Mobile I2C Bus Interface (IIC)

maintainers:
  - Wolfram Sang <wsa+renesas@sang-engineering.com>

properties:
  compatible:
    oneOf:
      - items:
          - enum:
              - renesas,iic-r8a73a4      # R-Mobile APE6
              - renesas,iic-r8a7740      # R-Mobile A1
              - renesas,iic-sh73a0       # SH-Mobile AG5
          - const: renesas,rmobile-iic   # Generic

      - items:
          - enum:
              - renesas,iic-r8a7742      # RZ/G1H
              - renesas,iic-r8a7743      # RZ/G1M
              - renesas,iic-r8a7744      # RZ/G1N
              - renesas,iic-r8a7745      # RZ/G1E
              - renesas,iic-r8a7790      # R-Car H2
              - renesas,iic-r8a7791      # R-Car M2-W
              - renesas,iic-r8a7792      # R-Car V2H
              - renesas,iic-r8a7793      # R-Car M2-N
              - renesas,iic-r8a7794      # R-Car E2
          - const: renesas,rcar-gen2-iic # R-Car Gen2 and RZ/G1
          - const: renesas,rmobile-iic   # Generic

      - items:
          - enum:
              - renesas,iic-r8a774a1     # RZ/G2M
              - renesas,iic-r8a774b1     # RZ/G2N
              - renesas,iic-r8a774c0     # RZ/G2E
              - renesas,iic-r8a774e1     # RZ/G2H
              - renesas,iic-r8a7795      # R-Car H3
              - renesas,iic-r8a7796      # R-Car M3-W
              - renesas,iic-r8a77961     # R-Car M3-W+
              - renesas,iic-r8a77965     # R-Car M3-N
              - renesas,iic-r8a77990     # R-Car E3
          - const: renesas,rcar-gen3-iic # R-Car Gen3 and RZ/G2
          - const: renesas,rmobile-iic   # Generic

  reg:
    maxItems: 1

  interrupts: true

  clock-frequency:
    description:
      Desired I2C bus clock frequency in Hz. The absence of this property
      indicates the default frequency 100 kHz.

  clocks:
    maxItems: 1

  power-domains:
    maxItems: 1

  resets:
    maxItems: 1

  dmas:
    minItems: 2
    maxItems: 4
    description:
      Must contain a list of pairs of references to DMA specifiers, one for
      transmission, and one for reception.

  dma-names:
    minItems: 2
    maxItems: 4
    items:
      enum:
        - tx
        - rx

required:
  - compatible
  - reg
  - interrupts
  - clocks
  - power-domains
  - '#address-cells'
  - '#size-cells'

allOf:
  - $ref: /schemas/i2c/i2c-controller.yaml#

  - if:
      properties:
        compatible:
          contains:
            enum:
              - renesas,iic-r8a7740
              - renesas,iic-sh73a0
    then:
      properties:
        interrupts:
          items:
            - description: Arbitration Lost Interrupt (ALI)
            - description: Non-acknowledge Detection Interrupt (TACKI)
            - description: Wait Interrupt (WAITI)
            - description: Data Transmit Enable interrupt (DTEI)
    else:
      properties:
        interrupts:
          items:
            - description: Single combined interrupt

  - if:
      properties:
        compatible:
          contains:
            enum:
              - renesas,rcar-gen2-iic
              - renesas,rcar-gen3-iic
    then:
      required:
        - resets

unevaluatedProperties: false

examples:
  - |
    #include <dt-bindings/clock/r8a7790-cpg-mssr.h>
    #include <dt-bindings/interrupt-controller/arm-gic.h>
    #include <dt-bindings/power/r8a7790-sysc.h>

    iic0: i2c@e6500000 {
        compatible = "renesas,iic-r8a7790", "renesas,rcar-gen2-iic",
                     "renesas,rmobile-iic";
        reg = <0xe6500000 0x425>;
        interrupts = <GIC_SPI 174 IRQ_TYPE_LEVEL_HIGH>;
        clocks = <&cpg CPG_MOD 318>;
        clock-frequency = <400000>;
        dmas = <&dmac0 0x61>, <&dmac0 0x62>, <&dmac1 0x61>, <&dmac1 0x62>;
        dma-names = "tx", "rx", "tx", "rx";
        power-domains = <&sysc R8A7790_PD_ALWAYS_ON>;
        resets = <&cpg 318>;
        #address-cells = <1>;
        #size-cells = <0>;
    };
```

## Documentation/devicetree/bindings/i2c/renesas,rzv2m.yaml
```yaml
# SPDX-License-Identifier: (GPL-2.0-only OR BSD-2-Clause)
%YAML 1.2
---
$id: http://devicetree.org/schemas/i2c/renesas,rzv2m.yaml#
$schema: http://devicetree.org/meta-schemas/core.yaml#

title: Renesas RZ/V2M I2C Bus Interface

maintainers:
  - Phil Edworthy <phil.edworthy@renesas.com>

allOf:
  - $ref: /schemas/i2c/i2c-controller.yaml#

properties:
  compatible:
    items:
      - enum:
          - renesas,i2c-r9a09g011  # RZ/V2M
      - const: renesas,rzv2m-i2c

  reg:
    maxItems: 1

  interrupts:
    items:
      - description: Data transmission/reception interrupt
      - description: Status interrupt

  interrupt-names:
    items:
      - const: tia
      - const: tis

  clock-frequency:
    default: 100000
    enum: [ 100000, 400000 ]
    description:
      Desired I2C bus clock frequency in Hz.

  clocks:
    maxItems: 1

  power-domains:
    maxItems: 1

  resets:
    maxItems: 1

required:
  - compatible
  - reg
  - interrupts
  - interrupt-names
  - clocks
  - power-domains
  - resets
  - '#address-cells'
  - '#size-cells'

unevaluatedProperties: false

examples:
  - |
    #include <dt-bindings/clock/r9a09g011-cpg.h>
    #include <dt-bindings/interrupt-controller/arm-gic.h>

    i2c0: i2c@a4030000 {
        compatible = "renesas,i2c-r9a09g011", "renesas,rzv2m-i2c";
        reg = <0xa4030000 0x80>;
        interrupts = <GIC_SPI 232 IRQ_TYPE_EDGE_RISING>,
                     <GIC_SPI 236 IRQ_TYPE_EDGE_RISING>;
        interrupt-names = "tia", "tis";
        clocks = <&cpg CPG_MOD R9A09G011_IIC_PCLK0>;
        resets = <&cpg R9A09G011_IIC_GPA_PRESETN>;
        power-domains = <&cpg>;
        clock-frequency = <100000>;
        #address-cells = <1>;
        #size-cells = <0>;
    };
```
