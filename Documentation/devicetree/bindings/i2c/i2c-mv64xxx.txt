## Documentation/devicetree/bindings/i2c/i2c-mv64xxx.txt
```
* Marvell MV64XXX I2C controller

Required properties :

 - reg             : Offset and length of the register set for the device
 - compatible      : Should be either:
                     - "allwinner,sun4i-a10-i2c"
                     - "allwinner,sun6i-a31-i2c"
                     - "marvell,mv64xxx-i2c"
                     - "marvell,mv78230-i2c"
                     - "marvell,mv78230-a0-i2c"
                       * Note: Only use "marvell,mv78230-a0-i2c" for a
                         very rare, initial version of the SoC which
                         had broken offload support.  Linux
                         auto-detects this and sets it appropriately.
 - interrupts      : The interrupt number

Optional properties :

 - clock-frequency : Desired I2C bus clock frequency in Hz. If not set the
default frequency is 100kHz

 - resets          : phandle to the parent reset controller. Mandatory
                     whenever you're using the "allwinner,sun6i-a31-i2c"
                     compatible.

 - clocks:	   : pointers to the reference clocks for this device, the
		     first one is the one used for the clock on the i2c bus,
		     the second one is the clock used to acces the registers
		     of the controller

 - clock-names	   : names of used clocks, mandatory if the second clock is
		     used, the name must be "core", and "reg" (the latter is
		     only for Armada 7K/8K).

Examples:

	i2c@11000 {
		compatible = "marvell,mv64xxx-i2c";
		reg = <0x11000 0x20>;
		interrupts = <29>;
		clock-frequency = <100000>;
	};

For the Armada XP:

	i2c@11000 {
		compatible = "marvell,mv78230-i2c", "marvell,mv64xxx-i2c";
		reg = <0x11000 0x100>;
		interrupts = <29>;
		clock-frequency = <100000>;
	};

For the Armada 7040:

	i2c@701000 {
		compatible = "marvell,mv78230-i2c";
		reg = <0x701000 0x20>;
		interrupts = <29>;
		clock-frequency = <100000>;
		clock-names = "core", "reg";
		clocks = <&core_clock>, <&reg_clock>;
	};
```

## Documentation/devicetree/bindings/i2c/i2c-mxs.txt
```
* Freescale MXS Inter IC (I2C) Controller

Required properties:
- compatible: Should be "fsl,<chip>-i2c"
- reg: Should contain registers location and length
- interrupts: Should contain ERROR interrupt number
- clock-frequency: Desired I2C bus clock frequency in Hz.
                   Only 100000Hz and 400000Hz modes are supported.
- dmas: DMA specifier, consisting of a phandle to DMA controller node
  and I2C DMA channel ID.
  Refer to dma.txt and fsl-mxs-dma.txt for details.
- dma-names: Must be "rx-tx".

Examples:

i2c0: i2c@80058000 {
	#address-cells = <1>;
	#size-cells = <0>;
	compatible = "fsl,imx28-i2c";
	reg = <0x80058000 2000>;
	interrupts = <111>;
	clock-frequency = <100000>;
	dmas = <&dma_apbx 6>;
	dma-names = "rx-tx";
};
```

## Documentation/devicetree/bindings/i2c/i2c-mxs.yaml
```yaml
# SPDX-License-Identifier: (GPL-2.0-only OR BSD-2-Clause)
%YAML 1.2
---
$id: http://devicetree.org/schemas/i2c/i2c-mxs.yaml#
$schema: http://devicetree.org/meta-schemas/core.yaml#

title: Freescale MXS Inter IC (I2C) Controller

maintainers:
  - Shawn Guo <shawnguo@kernel.org>

allOf:
  - $ref: /schemas/i2c/i2c-controller.yaml#

properties:
  compatible:
    enum:
      - fsl,imx23-i2c
      - fsl,imx28-i2c

  reg:
    maxItems: 1

  interrupts:
    maxItems: 1

  clock-frequency:
    enum: [ 100000, 400000 ]

  dmas:
    maxItems: 1

  dma-names:
    const: rx-tx

required:
  - compatible
  - reg
  - interrupts
  - dmas
  - dma-names

unevaluatedProperties: false

examples:
  - |
    i2c@80058000 {
        compatible = "fsl,imx28-i2c";
        reg = <0x80058000 2000>;
        interrupts = <111>;
        clock-frequency = <100000>;
        dmas = <&dma_apbx 6>;
        dma-names = "rx-tx";
    };
```

## Documentation/devicetree/bindings/i2c/i2c-nomadik.txt
```
I2C for Nomadik based systems

Required (non-standard) properties:
 - Nil

Recommended (non-standard) properties:
 - clock-frequency : Maximum bus clock frequency for the device

Optional (non-standard) properties:
 - Nil

Example :

i2c@80004000 {
        compatible = "stericsson,db8500-i2c", "st,nomadik-i2c";
        reg = <0x80004000 0x1000>;
        interrupts = <0 21 0x4>;
        #address-cells = <1>;
        #size-cells = <0>;
        v-i2c-supply = <&db8500_vape_reg>;

        clock-frequency = <400000>;
};
```

## Documentation/devicetree/bindings/i2c/i2c-ocores.txt
```
Device tree configuration for i2c-ocores

Required properties:
- compatible      : "opencores,i2c-ocores"
                    "aeroflexgaisler,i2cmst"
                    "sifive,fu540-c000-i2c", "sifive,i2c0"
                    For Opencore based I2C IP block reimplemented in
                    FU540-C000 SoC.
                    "sifive,fu740-c000-i2c", "sifive,i2c0"
                    For Opencore based I2C IP block reimplemented in
                    FU740-C000 SoC.
                    Please refer to sifive-blocks-ip-versioning.txt for
                    additional details.
- reg             : bus address start and address range size of device
- clocks          : handle to the controller clock; see the note below.
                    Mutually exclusive with opencores,ip-clock-frequency
- opencores,ip-clock-frequency: frequency of the controller clock in Hz;
                    see the note below. Mutually exclusive with clocks
- #address-cells  : should be <1>
- #size-cells     : should be <0>

Optional properties:
- interrupts      : interrupt number.
- clock-frequency : frequency of bus clock in Hz; see the note below.
                    Defaults to 100 KHz when the property is not specified
- reg-shift       : device register offsets are shifted by this value
- reg-io-width    : io register width in bytes (1, 2 or 4)
- regstep         : deprecated, use reg-shift above

Note
clock-frequency property is meant to control the bus frequency for i2c bus
drivers, but it was incorrectly used to specify i2c controller input clock
frequency. So the following rules are set to fix this situation:
- if clock-frequency is present and neither opencores,ip-clock-frequency nor
  clocks are, then clock-frequency specifies i2c controller clock frequency.
  This is to keep backwards compatibility with setups using old DTB. i2c bus
  frequency is fixed at 100 KHz.
- if clocks is present it specifies i2c controller clock. clock-frequency
  property specifies i2c bus frequency.
- if opencores,ip-clock-frequency is present it specifies i2c controller
  clock frequency. clock-frequency property specifies i2c bus frequency.

Examples:

	i2c0: ocores@a0000000 {
		#address-cells = <1>;
		#size-cells = <0>;
		compatible = "opencores,i2c-ocores";
		reg = <0xa0000000 0x8>;
		interrupts = <10>;
		opencores,ip-clock-frequency = <20000000>;

		reg-shift = <0>;	/* 8 bit registers */
		reg-io-width = <1>;	/* 8 bit read/write */

		dummy@60 {
			compatible = "dummy";
			reg = <0x60>;
		};
	};
or
	i2c0: ocores@a0000000 {
		#address-cells = <1>;
		#size-cells = <0>;
		compatible = "opencores,i2c-ocores";
		reg = <0xa0000000 0x8>;
		interrupts = <10>;
		clocks = <&osc>;
		clock-frequency = <400000>; /* i2c bus frequency 400 KHz */

		reg-shift = <0>;	/* 8 bit registers */
		reg-io-width = <1>;	/* 8 bit read/write */

		dummy@60 {
			compatible = "dummy";
			reg = <0x60>;
		};
	};
```

## Documentation/devicetree/bindings/i2c/i2c-octeon.txt
```
* Two Wire Serial Interface (TWSI) / I2C

- compatible: "cavium,octeon-3860-twsi"

  Compatibility with all cn3XXX, cn5XXX and cn6XXX SOCs.

- reg: The base address of the TWSI/I2C bus controller register bank.

- #address-cells: Must be <1>.

- #size-cells: Must be <0>.  I2C addresses have no size component.

- interrupts: A single interrupt specifier.

- clock-frequency: The I2C bus clock rate in Hz.

Example:
	twsi0: i2c@1180000001000 {
		#address-cells = <1>;
		#size-cells = <0>;
		compatible = "cavium,octeon-3860-twsi";
		reg = <0x11800 0x00001000 0x0 0x200>;
		interrupts = <0 45>;
		clock-frequency = <100000>;

		rtc@68 {
			compatible = "dallas,ds1337";
			reg = <0x68>;
		};
		tmp@4c {
			compatible = "ti,tmp421";
			reg = <0x4c>;
		};
	};
```

## Documentation/devicetree/bindings/i2c/i2c-omap.txt
```
I2C for OMAP platforms

Required properties :
- compatible : Must be "ti,omap2420-i2c", "ti,omap2430-i2c", "ti,omap3-i2c"
  or "ti,omap4-i2c"
- ti,hwmods : Must be "i2c<n>", n being the instance number (1-based)
- #address-cells = <1>;
- #size-cells = <0>;

Recommended properties :
- clock-frequency : Desired I2C bus clock frequency in Hz. Otherwise
  the default 100 kHz frequency will be used.

Optional properties:
- Child nodes conforming to i2c bus binding

Note: Current implementation will fetch base address, irq and dma
from omap hwmod data base during device registration.
Future plan is to migrate hwmod data base contents into device tree
blob so that, all the required data will be used from device tree dts
file.

Examples :

i2c1: i2c@0 {
    compatible = "ti,omap3-i2c";
    #address-cells = <1>;
    #size-cells = <0>;
    ti,hwmods = "i2c1";
    clock-frequency = <400000>;
};
```

## Documentation/devicetree/bindings/i2c/i2c-opal.txt
```
Device-tree bindings for I2C OPAL driver
----------------------------------------

Most of the device node and properties layout is specific to the firmware and
used by the firmware itself for configuring the port. From the linux
perspective, the properties of use are "ibm,port-name" and "ibm,opal-id".

Required properties:

- reg: Port-id within a given master
- compatible: must be "ibm,opal-i2c"
- ibm,opal-id: Refers to a specific bus and used to identify it when calling
	       the relevant OPAL functions.
- bus-frequency: Operating frequency of the i2c bus (in HZ). Informational for
		 linux, used by the FW though.

Optional properties:
- ibm,port-name: Firmware provides this name that uniquely identifies the i2c
		 port.

The node contains a number of other properties that are used by the FW itself
and depend on the specific hardware implementation. The example below depicts
a P8 on-chip bus.

Example:

i2c-bus@0 {
	reg = <0x0>;
	bus-frequency = <0x61a80>;
	compatible = "ibm,power8-i2c-port", "ibm,opal-i2c";
	ibm,opal-id = <0x1>;
	ibm,port-name = "p8_00000000_e1p0";
	#address-cells = <0x1>;
	phandle = <0x10000006>;
	#size-cells = <0x0>;
	linux,phandle = <0x10000006>;
};
```

## Documentation/devicetree/bindings/i2c/i2c-owl.txt
```
Actions Semiconductor Owl I2C controller

Required properties:

- compatible        : Should be one of the following:
		      - "actions,s700-i2c" for S700 SoC
		      - "actions,s900-i2c" for S900 SoC
- reg               : Offset and length of the register set for the device.
- #address-cells    : Should be 1.
- #size-cells       : Should be 0.
- interrupts        : A single interrupt specifier.
- clocks            : Phandle of the clock feeding the I2C controller.

Optional properties:

- clock-frequency   : Desired I2C bus clock frequency in Hz. As only Normal and
                      Fast modes are supported, possible values are 100000 and
                      400000.
Examples:

        i2c0: i2c@e0170000 {
                compatible = "actions,s900-i2c";
                reg = <0 0xe0170000 0 0x1000>;
                #address-cells = <1>;
                #size-cells = <0>;
                interrupts = <GIC_SPI 25 IRQ_TYPE_LEVEL_HIGH>;
                clocks = <&clock CLK_I2C0>;
                clock-frequency = <100000>;
        };
```

## Documentation/devicetree/bindings/i2c/i2c-owl.yaml
```yaml
# SPDX-License-Identifier: (GPL-2.0-only OR BSD-2-Clause)
%YAML 1.2
---
$id: http://devicetree.org/schemas/i2c/i2c-owl.yaml#
$schema: http://devicetree.org/meta-schemas/core.yaml#

title: Actions Semi Owl I2C Controller

maintainers:
  - Manivannan Sadhasivam <manivannan.sadhasivam@linaro.org>

description: |
  This I2C controller is found in the Actions Semi Owl SoCs:
  S500, S700 and S900.

allOf:
  - $ref: /schemas/i2c/i2c-controller.yaml#

properties:
  compatible:
    enum:
      - actions,s500-i2c # Actions Semi S500 compatible SoCs
      - actions,s700-i2c # Actions Semi S700 compatible SoCs
      - actions,s900-i2c # Actions Semi S900 compatible SoCs

  reg:
    maxItems: 1

  interrupts:
    maxItems: 1

  clocks:
    description: Phandle of the clock feeding the I2C controller.
    minItems: 1

  clock-frequency:
    description: |
      Desired I2C bus clock frequency in Hz. As only Standard and Fast
      modes are supported, possible values are 100000 and 400000.
    enum: [100000, 400000]

required:
  - compatible
  - reg
  - interrupts
  - clocks

unevaluatedProperties: false

examples:
  - |
    #include <dt-bindings/clock/actions,s900-cmu.h>
    #include <dt-bindings/interrupt-controller/arm-gic.h>
    i2c@e0170000 {
        compatible = "actions,s900-i2c";
        reg = <0xe0170000 0x1000>;
        interrupts = <GIC_SPI 25 IRQ_TYPE_LEVEL_HIGH>;
        clocks = <&cmu CLK_I2C0>;
        clock-frequency = <100000>;
    };

...
```

## Documentation/devicetree/bindings/i2c/i2c-pca-platform.txt
```
* NXP PCA PCA9564/PCA9665 I2C controller

The PCA9564/PCA9665 serves as an interface between most standard
parallel-bus microcontrollers/microprocessors and the serial I2C-bus
and allows the parallel bus system to communicate bi-directionally
with the I2C-bus.

Required properties :

 - reg : Offset and length of the register set for the device
 - compatible : one of "nxp,pca9564" or "nxp,pca9665"

Optional properties
 - interrupts : the interrupt number
 - reset-gpios : gpio specifier for gpio connected to RESET_N pin. As the line
   is active low, it should be marked GPIO_ACTIVE_LOW.
 - clock-frequency : I2C bus frequency.

Example:
	i2c0: i2c@80000 {
		compatible = "nxp,pca9564";
		#address-cells = <1>;
		#size-cells = <0>;
		reg = <0x80000 0x4>;
		reset-gpios = <&gpio1 0 GPIO_ACTIVE_LOW>;
		clock-frequency = <100000>;
	};
```

## Documentation/devicetree/bindings/i2c/i2c-pnx.txt
```
* NXP PNX I2C Controller

Required properties:

 - reg: Offset and length of the register set for the device
 - compatible: should be "nxp,pnx-i2c"
 - interrupts: configure one interrupt line
 - #address-cells: always 1 (for i2c addresses)
 - #size-cells: always 0
 - interrupt-parent: the phandle for the interrupt controller that
   services interrupts for this device.

Optional properties:

 - clock-frequency: desired I2C bus clock frequency in Hz, Default: 100000 Hz

Examples:

	i2c1: i2c@400a0000 {
		compatible = "nxp,pnx-i2c";
		reg = <0x400a0000 0x100>;
		interrupt-parent = <&mic>;
		interrupts = <51 0>;
		#address-cells = <1>;
		#size-cells = <0>;
	};

	i2c2: i2c@400a8000 {
		compatible = "nxp,pnx-i2c";
		reg = <0x400a8000 0x100>;
		interrupt-parent = <&mic>;
		interrupts = <50 0>;
		#address-cells = <1>;
		#size-cells = <0>;
		clock-frequency = <100000>;
	};
```
