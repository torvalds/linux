## Documentation/devicetree/bindings/i2c/i2c-pxa-pci-ce4100.txt
```
CE4100 I2C
----------

CE4100 has one PCI device which is described as the I2C-Controller. This
PCI device has three PCI-bars, each bar contains a complete I2C
controller. So we have a total of three independent I2C-Controllers
which share only an interrupt line.
The driver is probed via the PCI-ID and is gathering the information of
attached devices from the devices tree.
Grant Likely recommended to use the ranges property to map the PCI-Bar
number to its physical address and to use this to find the child nodes
of the specific I2C controller. This were his exact words:

       Here's where the magic happens.  Each entry in
       ranges describes how the parent pci address space
       (middle group of 3) is translated to the local
       address space (first group of 2) and the size of
       each range (last cell).  In this particular case,
       the first cell of the local address is chosen to be
       1:1 mapped to the BARs, and the second is the
       offset from be base of the BAR (which would be
       non-zero if you had 2 or more devices mapped off
       the same BAR)

       ranges allows the address mapping to be described
       in a way that the OS can interpret without
       requiring custom device driver code.

This is an example which is used on FalconFalls:
------------------------------------------------
	i2c-controller@b,2 {
		#address-cells = <2>;
		#size-cells = <1>;
		compatible = "pci8086,2e68.2",
				"pci8086,2e68",
				"pciclass,ff0000",
				"pciclass,ff00";

		reg = <0x15a00 0x0 0x0 0x0 0x0>;
		interrupts = <16 1>;

		/* as described by Grant, the first number in the group of
		* three is the bar number followed by the 64bit bar address
		* followed by size of the mapping. The bar address
		* requires also a valid translation in parents ranges
		* property.
		*/
		ranges = <0 0   0x02000000 0 0xdffe0500 0x100
			  1 0   0x02000000 0 0xdffe0600 0x100
			  2 0   0x02000000 0 0xdffe0700 0x100>;

		i2c@0 {
			#address-cells = <1>;
			#size-cells = <0>;
			compatible = "intel,ce4100-i2c-controller";

			/* The first number in the reg property is the
			* number of the bar
			*/
			reg = <0 0 0x100>;

			/* This I2C controller has no devices */
		};

		i2c@1 {
			#address-cells = <1>;
			#size-cells = <0>;
			compatible = "intel,ce4100-i2c-controller";
			reg = <1 0 0x100>;

			/* This I2C controller has one gpio controller */
			gpio@26 {
				#gpio-cells = <2>;
				compatible = "ti,pcf8575";
				reg = <0x26>;
				gpio-controller;
			};
		};

		i2c@2 {
			#address-cells = <1>;
			#size-cells = <0>;
			compatible = "intel,ce4100-i2c-controller";
			reg = <2 0 0x100>;

			gpio@26 {
				#gpio-cells = <2>;
				compatible = "ti,pcf8575";
				reg = <0x26>;
				gpio-controller;
			};
		};
	};
```

## Documentation/devicetree/bindings/i2c/i2c-pxa.txt
```
* Marvell MMP I2C controller

Required properties :

 - reg : Offset and length of the register set for the device
 - compatible : should be "mrvl,mmp-twsi" where mmp is the name of a
   compatible processor, e.g. pxa168, pxa910, mmp2, mmp3.
   For the pxa2xx/pxa3xx, an additional node "mrvl,pxa-i2c" is required
   as shown in the example below.
   For the Armada 3700, the compatible should be "marvell,armada-3700-i2c".

Recommended properties :

 - interrupts : the interrupt number
 - interrupt-parent : the phandle for the interrupt controller that
   services interrupts for this device. If the parent is the default
   interrupt controller in device tree, it could be ignored.
 - mrvl,i2c-polling : Disable interrupt of i2c controller. Polling
   status register of i2c controller instead.
 - mrvl,i2c-fast-mode : Enable fast mode of i2c controller.

Examples:
	twsi1: i2c@d4011000 {
		compatible = "mrvl,mmp-twsi";
		reg = <0xd4011000 0x1000>;
		interrupts = <7>;
		mrvl,i2c-fast-mode;
	};
	
	twsi2: i2c@d4025000 {
		compatible = "mrvl,mmp-twsi";
		reg = <0xd4025000 0x1000>;
		interrupts = <58>;
	};
```

## Documentation/devicetree/bindings/i2c/i2c-pxa.yaml
```yaml
# SPDX-License-Identifier: GPL-2.0-only
%YAML 1.2
---
$id: http://devicetree.org/schemas/i2c/i2c-pxa.yaml#
$schema: http://devicetree.org/meta-schemas/core.yaml#

title: Marvell MMP I2C controller

maintainers:
  - Rob Herring <robh@kernel.org>

allOf:
  - $ref: /schemas/i2c/i2c-controller.yaml#
  - if:
      not:
        required:
          - mrvl,i2c-polling
    then:
      required:
        - interrupts

properties:
  compatible:
    enum:
      - mrvl,mmp-twsi
      - mrvl,pxa-i2c
      - marvell,armada-3700-i2c

  reg:
    maxItems: 1

  interrupts:
    maxItems: 1

  clocks:
    minItems: 1

  resets:
    minItems: 1

  mrvl,i2c-polling:
    $ref: /schemas/types.yaml#/definitions/flag
    description: |
      Disable interrupt of i2c controller. Polling status register of i2c
      controller instead.

  mrvl,i2c-fast-mode:
    $ref: /schemas/types.yaml#/definitions/flag
    description: Enable fast mode of i2c controller.

unevaluatedProperties: false

required:
  - compatible
  - reg
  - interrupts
  - clocks
  - '#address-cells'
  - '#size-cells'

examples:
  - |
    #include <dt-bindings/clock/marvell,mmp2.h>
    i2c@d4011000 {
        compatible = "mrvl,mmp-twsi";
        reg = <0xd4011000 0x1000>;
        interrupts = <7>;
        clocks = <&soc_clocks MMP2_CLK_TWSI1>;
        mrvl,i2c-fast-mode;
        #address-cells = <1>;
        #size-cells = <0>;
    };

...
```

## Documentation/devicetree/bindings/i2c/i2c-qcom-cci.txt
```
Qualcomm Camera Control Interface (CCI) I2C controller

PROPERTIES:

- compatible:
	Usage: required
	Value type: <string>
	Definition: must be one of:
		"qcom,msm8916-cci"
		"qcom,msm8996-cci"
		"qcom,sdm845-cci"

- reg
	Usage: required
	Value type: <prop-encoded-array>
	Definition: base address CCI I2C controller and length of memory
		    mapped region.

- interrupts:
	Usage: required
	Value type: <prop-encoded-array>
	Definition: specifies the CCI I2C interrupt. The format of the
		    specifier is defined by the binding document describing
		    the node's interrupt parent.

- clocks:
	Usage: required
	Value type: <prop-encoded-array>
	Definition: a list of phandle, should contain an entry for each
		    entries in clock-names.

- clock-names
	Usage: required
	Value type: <string>
	Definition: a list of clock names, must include "cci" clock.

- power-domains
	Usage: required for "qcom,msm8996-cci"
	Value type: <prop-encoded-array>
	Definition:

SUBNODES:

The CCI provides I2C masters for one (msm8916) or two i2c busses (msm8996 and
sdm845), described as subdevices named "i2c-bus@0" and "i2c-bus@1".

PROPERTIES:

- reg:
	Usage: required
	Value type: <u32>
	Definition: Index of the CCI bus/master

- clock-frequency:
	Usage: optional
	Value type: <u32>
	Definition: Desired I2C bus clock frequency in Hz, defaults to 100
		    kHz if omitted.

Example:

	cci@a0c000 {
		compatible = "qcom,msm8996-cci";
		#address-cells = <1>;
		#size-cells = <0>;
		reg = <0xa0c000 0x1000>;
		interrupts = <GIC_SPI 295 IRQ_TYPE_EDGE_RISING>;
		clocks = <&mmcc MMSS_MMAGIC_AHB_CLK>,
			 <&mmcc CAMSS_TOP_AHB_CLK>,
			 <&mmcc CAMSS_CCI_AHB_CLK>,
			 <&mmcc CAMSS_CCI_CLK>,
			 <&mmcc CAMSS_AHB_CLK>;
		clock-names = "mmss_mmagic_ahb",
			      "camss_top_ahb",
			      "cci_ahb",
			      "cci",
			      "camss_ahb";

		i2c-bus@0 {
			reg = <0>;
			clock-frequency = <400000>;
			#address-cells = <1>;
			#size-cells = <0>;
		};

		i2c-bus@1 {
			reg = <1>;
			clock-frequency = <400000>;
			#address-cells = <1>;
			#size-cells = <0>;
		};
	};
```

## Documentation/devicetree/bindings/i2c/i2c-rcar.txt
```
I2C for R-Car platforms

Required properties:
- compatible:
	"renesas,i2c-r8a7743" if the device is a part of a R8A7743 SoC.
	"renesas,i2c-r8a7744" if the device is a part of a R8A7744 SoC.
	"renesas,i2c-r8a7745" if the device is a part of a R8A7745 SoC.
	"renesas,i2c-r8a77470" if the device is a part of a R8A77470 SoC.
	"renesas,i2c-r8a774a1" if the device is a part of a R8A774A1 SoC.
	"renesas,i2c-r8a774c0" if the device is a part of a R8A774C0 SoC.
	"renesas,i2c-r8a7778" if the device is a part of a R8A7778 SoC.
	"renesas,i2c-r8a7779" if the device is a part of a R8A7779 SoC.
	"renesas,i2c-r8a7790" if the device is a part of a R8A7790 SoC.
	"renesas,i2c-r8a7791" if the device is a part of a R8A7791 SoC.
	"renesas,i2c-r8a7792" if the device is a part of a R8A7792 SoC.
	"renesas,i2c-r8a7793" if the device is a part of a R8A7793 SoC.
	"renesas,i2c-r8a7794" if the device is a part of a R8A7794 SoC.
	"renesas,i2c-r8a7795" if the device is a part of a R8A7795 SoC.
	"renesas,i2c-r8a7796" if the device is a part of a R8A7796 SoC.
	"renesas,i2c-r8a77965" if the device is a part of a R8A77965 SoC.
	"renesas,i2c-r8a77970" if the device is a part of a R8A77970 SoC.
	"renesas,i2c-r8a77980" if the device is a part of a R8A77980 SoC.
	"renesas,i2c-r8a77990" if the device is a part of a R8A77990 SoC.
	"renesas,i2c-r8a77995" if the device is a part of a R8A77995 SoC.
	"renesas,rcar-gen1-i2c" for a generic R-Car Gen1 compatible device.
	"renesas,rcar-gen2-i2c" for a generic R-Car Gen2 or RZ/G1 compatible
				device.
	"renesas,rcar-gen3-i2c" for a generic R-Car Gen3 or RZ/G2 compatible
				device.
	"renesas,i2c-rcar" (deprecated)

	When compatible with the generic version, nodes must list the
	SoC-specific version corresponding to the platform first followed
	by the generic version.

- reg: physical base address of the controller and length of memory mapped
  region.
- interrupts: interrupt specifier.

Optional properties:
- clock-frequency: desired I2C bus clock frequency in Hz. The absence of this
  property indicates the default frequency 100 kHz.
- clocks: clock specifier.
- dmas: Must contain a list of two references to DMA specifiers, one for
  transmission, and one for reception.
- dma-names: Must contain a list of two DMA names, "tx" and "rx".

- i2c-scl-falling-time-ns: see i2c.txt
- i2c-scl-internal-delay-ns: see i2c.txt
- i2c-scl-rising-time-ns: see i2c.txt

Examples :

i2c0: i2c@e6508000 {
	#address-cells = <1>;
	#size-cells = <0>;
	compatible = "renesas,i2c-r8a7791", "renesas,rcar-gen2-i2c";
	reg = <0 0xe6508000 0 0x40>;
	interrupts = <0 287 IRQ_TYPE_LEVEL_HIGH>;
	clocks = <&mstp9_clks R8A7791_CLK_I2C0>;
	clock-frequency = <400000>;
};
```

## Documentation/devicetree/bindings/i2c/i2c-riic.txt
```
Device tree configuration for Renesas RIIC driver

Required properties:
- compatible      : "renesas,riic-<soctype>". "renesas,riic-rz" as fallback
- reg             : address start and address range size of device
- interrupts      : 8 interrupts (TEI, RI, TI, SPI, STI, NAKI, ALI, TMOI)
- clock-frequency : frequency of bus clock in Hz
- #address-cells  : should be <1>
- #size-cells     : should be <0>

Pinctrl properties might be needed, too. See there.

Example:

	i2c0: i2c@fcfee000 {
		compatible = "renesas,riic-r7s72100", "renesas,riic-rz";
		reg = <0xfcfee000 0x44>;
		interrupts = <0 157 IRQ_TYPE_LEVEL_HIGH>,
			     <0 158 IRQ_TYPE_EDGE_RISING>,
			     <0 159 IRQ_TYPE_EDGE_RISING>,
			     <0 160 IRQ_TYPE_LEVEL_HIGH>,
			     <0 161 IRQ_TYPE_LEVEL_HIGH>,
			     <0 162 IRQ_TYPE_LEVEL_HIGH>,
			     <0 163 IRQ_TYPE_LEVEL_HIGH>,
			     <0 164 IRQ_TYPE_LEVEL_HIGH>;
		clock-frequency = <100000>;
		#address-cells = <1>;
		#size-cells = <0>;
	};
```

## Documentation/devicetree/bindings/i2c/i2c-rk3x.txt
```
* Rockchip RK3xxx I2C controller

This driver interfaces with the native I2C controller present in Rockchip
RK3xxx SoCs.

Required properties :

 - reg : Offset and length of the register set for the device
 - compatible: should be one of the following:
   - "rockchip,rv1108-i2c": for rv1108
   - "rockchip,rk3066-i2c": for rk3066
   - "rockchip,rk3188-i2c": for rk3188
   - "rockchip,rk3228-i2c": for rk3228
   - "rockchip,rk3288-i2c": for rk3288
   - "rockchip,rk3328-i2c", "rockchip,rk3399-i2c": for rk3328
   - "rockchip,rk3399-i2c": for rk3399
 - interrupts : interrupt number
 - clocks: See ../clock/clock-bindings.txt
   - For older hardware (rk3066, rk3188, rk3228, rk3288):
     - There is one clock that's used both to derive the functional clock
       for the device and as the bus clock.
   - For newer hardware (rk3399): specified by name
     - "i2c": This is used to derive the functional clock.
     - "pclk": This is the bus clock.

Required on RK3066, RK3188 :

 - rockchip,grf : the phandle of the syscon node for the general register
		  file (GRF)
 - on those SoCs an alias with the correct I2C bus ID (bit offset in the GRF)
   is also required.

Optional properties :

 - clock-frequency : SCL frequency to use (in Hz). If omitted, 100kHz is used.
 - i2c-scl-rising-time-ns : Number of nanoseconds the SCL signal takes to rise
	(t(r) in I2C specification). If not specified this is assumed to be
	the maximum the specification allows(1000 ns for Standard-mode,
	300 ns for Fast-mode) which might cause slightly slower communication.
 - i2c-scl-falling-time-ns : Number of nanoseconds the SCL signal takes to fall
	(t(f) in the I2C specification). If not specified this is assumed to
	be the maximum the specification allows (300 ns) which might cause
	slightly slower communication.
 - i2c-sda-falling-time-ns : Number of nanoseconds the SDA signal takes to fall
	(t(f) in the I2C specification). If not specified we'll use the SCL
	value since they are the same in nearly all cases.

Example:

aliases {
	i2c0 = &i2c0;
}

i2c0: i2c@2002d000 {
	compatible = "rockchip,rk3188-i2c";
	reg = <0x2002d000 0x1000>;
	interrupts = <GIC_SPI 40 IRQ_TYPE_LEVEL_HIGH>;
	#address-cells = <1>;
	#size-cells = <0>;

	rockchip,grf = <&grf>;

	clock-names = "i2c";
	clocks = <&cru PCLK_I2C0>;

	i2c-scl-rising-time-ns = <800>;
	i2c-scl-falling-time-ns = <100>;
};
```
