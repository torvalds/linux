## Documentation/devicetree/bindings/i2c/i2c-rk3x.yaml
```yaml
# SPDX-License-Identifier: GPL-2.0
%YAML 1.2
---
$id: http://devicetree.org/schemas/i2c/i2c-rk3x.yaml#
$schema: http://devicetree.org/meta-schemas/core.yaml#

title: Rockchip RK3xxx I2C controller

description:
  This driver interfaces with the native I2C controller present in Rockchip
  RK3xxx SoCs.

allOf:
  - $ref: /schemas/i2c/i2c-controller.yaml#

maintainers:
  - Heiko Stuebner <heiko@sntech.de>

# Everything else is described in the common file
properties:
  compatible:
    oneOf:
      - const: rockchip,rv1108-i2c
      - const: rockchip,rk3066-i2c
      - const: rockchip,rk3188-i2c
      - const: rockchip,rk3228-i2c
      - const: rockchip,rk3288-i2c
      - const: rockchip,rk3399-i2c
      - items:
          - enum:
              - rockchip,rk3036-i2c
              - rockchip,rk3128-i2c
              - rockchip,rk3368-i2c
          - const: rockchip,rk3288-i2c
      - items:
          - enum:
              - rockchip,px30-i2c
              - rockchip,rk3308-i2c
              - rockchip,rk3328-i2c
              - rockchip,rk3568-i2c
              - rockchip,rk3588-i2c
              - rockchip,rv1126-i2c
          - const: rockchip,rk3399-i2c

  reg:
    maxItems: 1

  interrupts:
    maxItems: 1

  clocks:
    minItems: 1
    items:
      - description:
          For older hardware (rk3066, rk3188, rk3228, rk3288)
          there is one clock that is used both to derive the functional clock
          for the device and as the bus clock.
          For newer hardware (rk3399) this clock is used to derive
          the functional clock
      - description:
          For newer hardware (rk3399) this is the bus clock

  clock-names:
    minItems: 1
    items:
      - const: i2c
      - const: pclk

  rockchip,grf:
    $ref: /schemas/types.yaml#/definitions/phandle
    description:
      Required on RK3066, RK3188 the phandle of the syscon node for
      the general register file (GRF)
      On those SoCs an alias with the correct I2C bus ID
      (bit offset in the GRF) is also required.

  clock-frequency:
    default: 100000
    description:
      SCL frequency to use (in Hz). If omitted, 100kHz is used.

  i2c-scl-rising-time-ns:
    default: 1000
    description:
      Number of nanoseconds the SCL signal takes to rise
      (t(r) in I2C specification). If not specified this is assumed to be
      the maximum the specification allows(1000 ns for Standard-mode,
      300 ns for Fast-mode) which might cause slightly slower communication.

  i2c-scl-falling-time-ns:
    default: 300
    description:
      Number of nanoseconds the SCL signal takes to fall
      (t(f) in the I2C specification). If not specified this is assumed to
      be the maximum the specification allows (300 ns) which might cause
      slightly slower communication.

  i2c-sda-falling-time-ns:
    default: 300
    description:
      Number of nanoseconds the SDA signal takes to fall
      (t(f) in the I2C specification). If not specified we will use the SCL
      value since they are the same in nearly all cases.

required:
  - compatible
  - reg
  - interrupts
  - clocks
  - clock-names

if:
  properties:
    compatible:
      contains:
        enum:
          - rockchip,rk3066-i2c
          - rockchip,rk3188-i2c

then:
  required:
    - rockchip,grf

unevaluatedProperties: false

examples:
  - |
    #include <dt-bindings/clock/rk3188-cru-common.h>
    #include <dt-bindings/interrupt-controller/arm-gic.h>
    #include <dt-bindings/interrupt-controller/irq.h>
    i2c0: i2c@2002d000 {
      compatible = "rockchip,rk3188-i2c";
      reg = <0x2002d000 0x1000>;
      interrupts = <GIC_SPI 40 IRQ_TYPE_LEVEL_HIGH>;
      clocks = <&cru PCLK_I2C0>;
      clock-names = "i2c";
      rockchip,grf = <&grf>;
      i2c-scl-falling-time-ns = <100>;
      i2c-scl-rising-time-ns = <800>;
      #address-cells = <1>;
      #size-cells = <0>;
    };
```

## Documentation/devicetree/bindings/i2c/i2c-s3c2410.txt
```
* Samsung's I2C controller

The Samsung's I2C controller is used to interface with I2C devices.

Required properties:
  - compatible: value should be either of the following.
      (a) "samsung, s3c2410-i2c", for i2c compatible with s3c2410 i2c.
      (b) "samsung, s3c2440-i2c", for i2c compatible with s3c2440 i2c.
      (c) "samsung, s3c2440-hdmiphy-i2c", for s3c2440-like i2c used
          inside HDMIPHY block found on several samsung SoCs
  - reg: physical base address of the controller and length of memory mapped
    region.
  - interrupts: interrupt number to the cpu.
  - samsung,i2c-sda-delay: Delay (in ns) applied to data line (SDA) edges.

Required for all cases except "samsung,s3c2440-hdmiphy-i2c":
  - Samsung GPIO variant (deprecated):
    - gpios: The order of the gpios should be the following: <SDA, SCL>.
      The gpio specifier depends on the gpio controller. Required in all
      cases except for "samsung,s3c2440-hdmiphy-i2c" whose input/output
      lines are permanently wired to the respective clienta
  - Pinctrl variant (preferred, if available):
    - pinctrl-0: Pin control group to be used for this controller.
    - pinctrl-names: Should contain only one value - "default".

Optional properties:
  - samsung,i2c-slave-addr: Slave address in multi-master enviroment. If not
    specified, default value is 0.
  - samsung,i2c-max-bus-freq: Desired frequency in Hz of the bus. If not
    specified, the default value in Hz is 100000.

Example:

	i2c@13870000 {
		compatible = "samsung,s3c2440-i2c";
		reg = <0x13870000 0x100>;
		interrupts = <345>;
		samsung,i2c-sda-delay = <100>;
		samsung,i2c-max-bus-freq = <100000>;
		/* Samsung GPIO variant begins here */
		gpios = <&gpd1 2 0 /* SDA */
			 &gpd1 3 0 /* SCL */>;
		/* Samsung GPIO variant ends here */
		/* Pinctrl variant begins here */
		pinctrl-0 = <&i2c3_bus>;
		pinctrl-names = "default";
		/* Pinctrl variant ends here */
		#address-cells = <1>;
		#size-cells = <0>;

		wm8994@1a {
			compatible = "wlf,wm8994";
			reg = <0x1a>;
		};
	};
```

## Documentation/devicetree/bindings/i2c/i2c-sh_mobile.txt
```
Device tree configuration for Renesas IIC (sh_mobile) driver

Required properties:
- compatible      :
			- "renesas,iic-r8a73a4" (R-Mobile APE6)
			- "renesas,iic-r8a7740" (R-Mobile A1)
			- "renesas,iic-r8a7743" (RZ/G1M)
			- "renesas,iic-r8a7745" (RZ/G1E)
			- "renesas,iic-r8a7790" (R-Car H2)
			- "renesas,iic-r8a7791" (R-Car M2-W)
			- "renesas,iic-r8a7792" (R-Car V2H)
			- "renesas,iic-r8a7793" (R-Car M2-N)
			- "renesas,iic-r8a7794" (R-Car E2)
			- "renesas,iic-r8a7795" (R-Car H3)
			- "renesas,iic-r8a7796" (R-Car M3-W)
			- "renesas,iic-sh73a0" (SH-Mobile AG5)
			- "renesas,rcar-gen2-iic" (generic R-Car Gen2 or RZ/G1
							compatible device)
			- "renesas,rcar-gen3-iic" (generic R-Car Gen3 compatible device)
			- "renesas,rmobile-iic" (generic device)

			When compatible with a generic R-Car version, nodes
			must list the SoC-specific version corresponding to
			the platform first followed by the generic R-Car
			version.

			renesas,rmobile-iic must always follow.

- reg             : address start and address range size of device
- interrupts      : interrupt of device
- clocks          : clock for device
- #address-cells  : should be <1>
- #size-cells     : should be <0>

Optional properties:
- clock-frequency : frequency of bus clock in Hz. Default 100kHz if unset.
- dmas            : Must contain a list of two references to DMA
		    specifiers, one for transmission, and one for
		    reception.
- dma-names       : Must contain a list of two DMA names, "tx" and "rx".


Pinctrl properties might be needed, too. See there.

Example:

	iic0: i2c@e6500000 {
		compatible = "renesas,iic-r8a7790", "renesas,rcar-gen2-iic",
			     "renesas,rmobile-iic";
		reg = <0 0xe6500000 0 0x425>;
		interrupts = <0 174 IRQ_TYPE_LEVEL_HIGH>;
		clocks = <&mstp3_clks R8A7790_CLK_IIC0>;
		clock-frequency = <400000>;
		#address-cells = <1>;
		#size-cells = <0>;
	};
```

## Documentation/devicetree/bindings/i2c/i2c-sirf.txt
```
I2C for SiRFprimaII platforms

Required properties :
- compatible : Must be "sirf,prima2-i2c"
- reg: physical base address of the controller and length of memory mapped
     region.
- interrupts: interrupt number to the cpu.

Optional properties:
- clock-frequency : Constains desired I2C/HS-I2C bus clock frequency in Hz.
  The absence of the property indicates the default frequency 100 kHz.

Examples :

i2c0: i2c@b00e0000 {
    compatible = "sirf,prima2-i2c";
    reg = <0xb00e0000 0x10000>;
    interrupts = <24>;
};
```

## Documentation/devicetree/bindings/i2c/i2c-sprd.txt
```
I2C for Spreadtrum platforms

Required properties:
- compatible: Should be "sprd,sc9860-i2c".
- reg: Specify the physical base address of the controller and length
  of memory mapped region.
- interrupts: Should contain I2C interrupt.
- clock-names: Should contain following entries:
  "i2c" for I2C clock,
  "source" for I2C source (parent) clock,
  "enable" for I2C module enable clock.
- clocks: Should contain a clock specifier for each entry in clock-names.
- clock-frequency: Constains desired I2C bus clock frequency in Hz.
- #address-cells: Should be 1 to describe address cells for I2C device address.
- #size-cells: Should be 0 means no size cell for I2C device address.

Optional properties:
- Child nodes conforming to I2C bus binding

Examples:
i2c0: i2c@70500000 {
	compatible = "sprd,sc9860-i2c";
	reg = <0 0x70500000 0 0x1000>;
	interrupts = <GIC_SPI 11 IRQ_TYPE_LEVEL_HIGH>;
	clock-names = "i2c", "source", "enable";
	clocks = <&clk_i2c3>, <&ext_26m>, <&clk_ap_apb_gates 11>;
	clock-frequency = <400000>;
	#address-cells = <1>;
	#size-cells = <0>;
};
```

## Documentation/devicetree/bindings/i2c/i2c-st-ddci2c.txt
```
ST Microelectronics DDC I2C

Required properties :
- compatible : Must be "st,ddci2c"
- reg: physical base address of the controller and length of memory mapped
     region.
- interrupts: interrupt number to the cpu.
- #address-cells = <1>;
- #size-cells = <0>;

Optional properties:
- Child nodes conforming to i2c bus binding

Examples :
```
