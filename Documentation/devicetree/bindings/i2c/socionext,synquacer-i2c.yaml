## Documentation/devicetree/bindings/i3c/snps,dw-i3c-master.txt
```
Bindings for Synopsys DesignWare I3C master block
=================================================

Required properties:
--------------------
- compatible: shall be "snps,dw-i3c-master-1.00a"
- clocks: shall reference the core_clk
- interrupts: the interrupt line connected to this I3C master
- reg: Offset and length of I3C master registers

Mandatory properties defined by the generic binding (see
Documentation/devicetree/bindings/i3c/i3c.txt for more details):

- #address-cells: shall be set to 3
- #size-cells: shall be set to 0

Optional properties defined by the generic binding (see
Documentation/devicetree/bindings/i3c/i3c.txt for more details):

- i2c-scl-hz
- i3c-scl-hz

I3C device connected on the bus follow the generic description (see
Documentation/devicetree/bindings/i3c/i3c.txt for more details).

Example:

	i3c-master@2000 {
		compatible = "snps,dw-i3c-master-1.00a";
		#address-cells = <3>;
		#size-cells = <0>;
		reg = <0x02000 0x1000>;
		interrupts = <0>;
		clocks = <&i3cclk>;

		eeprom@57{
			compatible = "atmel,24c01";
			reg = <0x57 0x0 0x10>;
			pagesize = <0x8>;
		};
	};
```

## Documentation/devicetree/bindings/i3c/snps,dw-i3c-master.yaml
```yaml
# SPDX-License-Identifier: GPL-2.0
%YAML 1.2
---
$id: http://devicetree.org/schemas/i3c/snps,dw-i3c-master.yaml#
$schema: http://devicetree.org/meta-schemas/core.yaml#

title: Synopsys DesignWare I3C master block

maintainers:
  - Alexandre Belloni <alexandre.belloni@bootlin.com>

allOf:
  - $ref: i3c.yaml#

properties:
  compatible:
    const: snps,dw-i3c-master-1.00a

  reg:
    maxItems: 1

  clocks:
    maxItems: 1

  interrupts:
    maxItems: 1

required:
  - compatible
  - reg
  - clocks
  - interrupts

unevaluatedProperties: false

examples:
  - |
    i3c@2000 {
        compatible = "snps,dw-i3c-master-1.00a";
        #address-cells = <3>;
        #size-cells = <0>;
        reg = <0x02000 0x1000>;
        interrupts = <0>;
        clocks = <&i3cclk>;

        eeprom@57{
            compatible = "atmel,24c01";
            reg = <0x57 0x0 0x10>;
            pagesize = <0x8>;
        };
    };
...
```
