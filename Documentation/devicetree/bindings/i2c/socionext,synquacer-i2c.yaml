## Documentation/devicetree/bindings/i2c/tsd,mule-i2c-mux.yaml
```yaml
# SPDX-License-Identifier: (GPL-2.0-only OR BSD-2-Clause)
%YAML 1.2
---
$id: http://devicetree.org/schemas/i2c/tsd,mule-i2c-mux.yaml#
$schema: http://devicetree.org/meta-schemas/core.yaml#

title: Theobroma Systems Mule I2C multiplexer

maintainers:
  - Farouk Bouabid <farouk.bouabid@cherry.de>
  - Quentin Schulz <quentin.schulz@cherry.de>

description: |
  Theobroma Systems Mule is an MCU that emulates a set of I2C devices, among
  which devices that are reachable through an I2C-mux. The devices on the mux
  can be selected by writing the appropriate device number to an I2C config
  register.


      +--------------------------------------------------+
      | Mule                                             |
  0x18|    +---------------+                             |
  -------->|Config register|----+                        |
      |    +---------------+    |                        |
      |                         V_                       |
      |                        |  \          +--------+  |
      |                        |   \-------->| dev #0 |  |
      |                        |   |         +--------+  |
  0x6f|                        | M |-------->| dev #1 |  |
  ---------------------------->| U |         +--------+  |
      |                        | X |-------->| dev #2 |  |
      |                        |   |         +--------+  |
      |                        |   /-------->| dev #3 |  |
      |                        |__/          +--------+  |
      +--------------------------------------------------+


allOf:
  - $ref: /schemas/i2c/i2c-mux.yaml#

properties:
  compatible:
    const: tsd,mule-i2c-mux

required:
  - compatible

unevaluatedProperties: false

examples:
  - |
    i2c-mux {
        compatible = "tsd,mule-i2c-mux";
        #address-cells = <1>;
        #size-cells = <0>;

        i2c@0 {
            reg = <0x0>;
            #address-cells = <1>;
            #size-cells = <0>;

            rtc@6f {
                compatible = "isil,isl1208";
                reg = <0x6f>;
            };
        };
    };
...
```

## Documentation/devicetree/bindings/i2c/wm,wm8505-i2c.yaml
```yaml
# SPDX-License-Identifier: GPL-2.0 OR BSD-2-Clause
%YAML 1.2
---
$id: http://devicetree.org/schemas/i2c/wm,wm8505-i2c.yaml#
$schema: http://devicetree.org/meta-schemas/core.yaml#

title: I2C Controller on WonderMedia WM8505 and related SoCs

maintainers:
  - Alexey Charkov <alchark@gmail.com>

allOf:
  - $ref: /schemas/i2c/i2c-controller.yaml#

properties:
  compatible:
    const: wm,wm8505-i2c

  reg:
    maxItems: 1

  interrupts:
    maxItems: 1

  clocks:
    maxItems: 1

  clock-frequency:
    enum: [100000, 400000]

required:
  - compatible
  - reg
  - interrupts
  - clocks

unevaluatedProperties: false

examples:
  - |
    i2c_0: i2c@d8280000 {
        compatible = "wm,wm8505-i2c";
        reg = <0xd8280000 0x1000>;
        interrupts = <19>;
        clocks = <&clki2c0>;
        clock-frequency = <400000>;
    };
```

## Documentation/devicetree/bindings/i2c/xlnx,xps-iic-2.00.a.yaml
```yaml
# SPDX-License-Identifier: (GPL-2.0 OR BSD-2-Clause)
%YAML 1.2
---
$id: "http://devicetree.org/schemas/i2c/xlnx,xps-iic-2.00.a.yaml#"
$schema: "http://devicetree.org/meta-schemas/core.yaml#"

title: ilinx IIC controller Device Tree Bindings

maintainers:
  - info@mocean-labs.com

allOf:
  - $ref: /schemas/i2c/i2c-controller.yaml#

properties:
  compatible:
    const: xlnx,xps-iic-2.00.a

  reg:
    maxItems: 1

  interrupts:
    maxItems: 1

  clocks:
    minItems: 1

  clock-name:
    const: pclk
    description: |
      Input clock name.

required:
  - compatible
  - reg
  - interrupts
  - clocks

unevaluatedProperties: false

examples:
  - |
    axi_iic_0: i2c@40800000 {
      compatible = "xlnx,xps-iic-2.00.a";
      clocks = <&clkc 15>;
      interrupts = < 1 2 >;
      reg = < 0x40800000 0x10000 >;

      #size-cells = <0>;
      #address-cells = <1>;
    };
```

## Documentation/devicetree/bindings/i3c/adi,i3c-master.yaml
```yaml
# SPDX-License-Identifier: GPL-2.0-only OR BSD-2-Clause
%YAML 1.2
---
$id: http://devicetree.org/schemas/i3c/adi,i3c-master.yaml#
$schema: http://devicetree.org/meta-schemas/core.yaml#

title: Analog Devices I3C Controller

description:
  FPGA-based I3C controller designed to interface with I3C and I2C peripherals,
  implementing a subset of the I3C-basic specification. The IP core is tested
  on arm, microblaze, and arm64 architectures.

  https://analogdevicesinc.github.io/hdl/library/i3c_controller

maintainers:
  - Jorge Marques <jorge.marques@analog.com>

properties:
  compatible:
    const: adi,i3c-master-v1

  reg:
    maxItems: 1

  clocks:
    minItems: 1
    items:
      - description: The AXI interconnect clock, drives the register map.
      - description:
          The secondary clock, drives the internal logic asynchronously to the
          register map. The presence of this entry states that the IP Core was
          synthesized with a second clock input, and the absence of this entry
          indicates a topology where a single clock input drives all the
          internal logic.

  clock-names:
    minItems: 1
    items:
      - const: axi
      - const: i3c

  interrupts:
    maxItems: 1

required:
  - compatible
  - reg
  - clocks
  - clock-names
  - interrupts

allOf:
  - $ref: i3c.yaml#

unevaluatedProperties: false

examples:
  - |
    #include <dt-bindings/interrupt-controller/irq.h>

    i3c@44a00000 {
        compatible = "adi,i3c-master-v1";
        reg = <0x44a00000 0x1000>;
        interrupts = <3 IRQ_TYPE_LEVEL_HIGH>;
        clocks = <&clkc 15>, <&clkc 15>;
        clock-names = "axi", "i3c";
        #address-cells = <3>;
        #size-cells = <0>;

        /* I3C and I2C devices */
    };
```

## Documentation/devicetree/bindings/i3c/aspeed,ast2600-i3c.yaml
```yaml
# SPDX-License-Identifier: GPL-2.0 OR BSD-2-Clause
%YAML 1.2
---
$id: http://devicetree.org/schemas/i3c/aspeed,ast2600-i3c.yaml#
$schema: http://devicetree.org/meta-schemas/core.yaml#

title: ASPEED AST2600 i3c controller

maintainers:
  - Jeremy Kerr <jk@codeconstruct.com.au>

allOf:
  - $ref: i3c.yaml#

properties:
  compatible:
    const: aspeed,ast2600-i3c

  reg:
    maxItems: 1

  clocks:
    maxItems: 1

  resets:
    maxItems: 1

  interrupts:
    maxItems: 1

  sda-pullup-ohms:
    enum: [545, 750, 2000]
    default: 2000
    description: |
      Value to configure SDA pullup resistor, in Ohms.

  aspeed,global-regs:
    $ref: /schemas/types.yaml#/definitions/phandle-array
    items:
      - items:
          - description: phandle to i3c global register syscon node
          - description: index of this i3c controller in the global register set
    description: |
      A (phandle, controller index) reference to the i3c global register set
      used for this device.

required:
  - compatible
  - reg
  - clocks
  - interrupts
  - aspeed,global-regs

unevaluatedProperties: false

examples:
  - |
    #include <dt-bindings/interrupt-controller/arm-gic.h>

    i3c-master@2000 {
        compatible = "aspeed,ast2600-i3c";
        reg = <0x2000 0x1000>;
        #address-cells = <3>;
        #size-cells = <0>;
        clocks = <&syscon 0>;
        resets = <&syscon 0>;
        aspeed,global-regs = <&i3c_global 0>;
        pinctrl-names = "default";
        pinctrl-0 = <&pinctrl_i3c1_default>;
        interrupts = <GIC_SPI 102 IRQ_TYPE_LEVEL_HIGH>;
    };
...
```

## Documentation/devicetree/bindings/i3c/cdns,i3c-master.txt
```
Bindings for cadence I3C master block
=====================================

Required properties:
--------------------
- compatible: shall be "cdns,i3c-master"
- clocks: shall reference the pclk and sysclk
- clock-names: shall contain "pclk" and "sysclk"
- interrupts: the interrupt line connected to this I3C master
- reg: I3C master registers

Mandatory properties defined by the generic binding (see
Documentation/devicetree/bindings/i3c/i3c.yaml for more details):

- #address-cells: shall be set to 1
- #size-cells: shall be set to 0

Optional properties defined by the generic binding (see
Documentation/devicetree/bindings/i3c/i3c.yaml for more details):

- i2c-scl-hz
- i3c-scl-hz

I3C device connected on the bus follow the generic description (see
Documentation/devicetree/bindings/i3c/i3c.yaml for more details).

Example:

	i3c-master@0d040000 {
		compatible = "cdns,i3c-master";
		clocks = <&coreclock>, <&i3csysclock>;
		clock-names = "pclk", "sysclk";
		interrupts = <3 0>;
		reg = <0x0d040000 0x1000>;
		#address-cells = <1>;
		#size-cells = <0>;
		i2c-scl-hz = <100000>;

		nunchuk: nunchuk@52 {
			compatible = "nintendo,nunchuk";
			reg = <0x52 0x0 0x10>;
		};
	};
```

## Documentation/devicetree/bindings/i3c/cdns,i3c-master.yaml
```yaml
# SPDX-License-Identifier: GPL-2.0
%YAML 1.2
---
$id: http://devicetree.org/schemas/i3c/cdns,i3c-master.yaml#
$schema: http://devicetree.org/meta-schemas/core.yaml#

title: Cadence I3C master block

maintainers:
  - Boris Brezillon <bbrezillon@kernel.org>

allOf:
  - $ref: i3c.yaml#

properties:
  compatible:
    oneOf:
      - const: cdns,i3c-master
      - items:
          - enum:
              - axiado,ax3000-i3c
          - const: cdns,i3c-master

  reg:
    maxItems: 1

  clocks:
    maxItems: 2

  clock-names:
    items:
      - const: pclk
      - const: sysclk

  interrupts:
    maxItems: 1

required:
  - compatible
  - reg
  - clocks
  - clock-names
  - interrupts

unevaluatedProperties: false

examples:
  - |
    i3c@d040000 {
        compatible = "cdns,i3c-master";
        clocks = <&coreclock>, <&i3csysclock>;
        clock-names = "pclk", "sysclk";
        interrupts = <3 0>;
        reg = <0x0d040000 0x1000>;
        #address-cells = <3>;
        #size-cells = <0>;
        i2c-scl-hz = <100000>;

        eeprom@57{
            compatible = "atmel,24c01";
            reg = <0x57 0x0 0x10>;
            pagesize = <0x8>;
        };
    };
...
```

## Documentation/devicetree/bindings/i3c/i3c.txt
```
Generic device tree bindings for I3C busses
===========================================

This document describes generic bindings that should be used to describe I3C
busses in a device tree.

Required properties
-------------------

- #address-cells  - should be <3>. Read more about addresses below.
- #size-cells     - should be <0>.
- compatible      - name of the I3C master controller driving the I3C bus

For other required properties e.g. to describe register sets,
clocks, etc. check the binding documentation of the specific driver.
The node describing an I3C bus should be named i3c-master.

Optional properties
-------------------

These properties may not be supported by all I3C master drivers. Each I3C
master bindings should specify which of them are supported.

- i3c-scl-hz: frequency of the SCL signal used for I3C transfers.
	      When undefined the core sets it to 12.5MHz.

- i2c-scl-hz: frequency of the SCL signal used for I2C transfers.
	      When undefined, the core looks at LVR (Legacy Virtual Register)
	      values of I2C devices described in the device tree to determine
	      the maximum I2C frequency.

I2C devices
===========

Each I2C device connected to the bus should be described in a subnode. All
properties described in Documentation/devicetree/bindings/i2c/i2c.txt are
valid here, but several new properties have been added.

New constraint on existing properties:
--------------------------------------
- reg: contains 3 cells
  + first cell : still encoding the I2C address. 10 bit addressing is not
    supported. Devices with 10 bit address can't be properly passed through
    DEFSLVS command.

  + second cell: shall be 0

  + third cell: shall encode the I3C LVR (Legacy Virtual Register)
	bit[31:8]: unused/ignored
	bit[7:5]: I2C device index. Possible values
	* 0: I2C device has a 50 ns spike filter
	* 1: I2C device does not have a 50 ns spike filter but supports high
	     frequency on SCL
	* 2: I2C device does not have a 50 ns spike filter and is not tolerant
	     to high frequencies
	* 3-7: reserved

	bit[4]: tell whether the device operates in FM (Fast Mode) or FM+ mode
	* 0: FM+ mode
	* 1: FM mode

	bit[3:0]: device type
	* 0-15: reserved

The I2C node unit-address should always match the first cell of the reg
property: <device-type>@<i2c-address>.

I3C devices
===========

All I3C devices are supposed to support DAA (Dynamic Address Assignment), and
are thus discoverable. So, by default, I3C devices do not have to be described
in the device tree.
This being said, one might want to attach extra resources to these devices,
and those resources may have to be described in the device tree, which in turn
means we have to describe I3C devices.

Another use case for describing an I3C device in the device tree is when this
I3C device has a static I2C address and we want to assign it a specific I3C
dynamic address before the DAA takes place (so that other devices on the bus
can't take this dynamic address).

The I3C device should be names <device-type>@<static-i2c-address>,<i3c-pid>,
where device-type is describing the type of device connected on the bus
(gpio-controller, sensor, ...).

Required properties
-------------------
- reg: contains 3 cells
  + first cell : encodes the static I2C address. Should be 0 if the device does
		 not have one (0 is not a valid I2C address).

  + second and third cells: should encode the ProvisionalID. The second cell
			    contains the manufacturer ID left-shifted by 1.
			    The third cell contains ORing of the part ID
			    left-shifted by 16, the instance ID left-shifted
			    by 12 and the extra information. This encoding is
			    following the PID definition provided by the I3C
			    specification.

Optional properties
-------------------
- assigned-address: dynamic address to be assigned to this device. This
		    property is only valid if the I3C device has a static
		    address (first cell of the reg property != 0).


Example:

	i3c-master@d040000 {
		compatible = "cdns,i3c-master";
		clocks = <&coreclock>, <&i3csysclock>;
		clock-names = "pclk", "sysclk";
		interrupts = <3 0>;
		reg = <0x0d040000 0x1000>;
		#address-cells = <3>;
		#size-cells = <0>;
		i2c-scl-hz = <100000>;

		/* I2C device. */
		nunchuk: nunchuk@52 {
			compatible = "nintendo,nunchuk";
			reg = <0x52 0x0 0x10>;
		};

		/* I3C device with a static I2C address. */
		thermal_sensor: sensor@68,39200144004 {
			reg = <0x68 0x392 0x144004>;
			assigned-address = <0xa>;
		};

		/*
		 * I3C device without a static I2C address but requiring
		 * resources described in the DT.
		 */
		sensor@0,39200154004 {
			reg = <0x0 0x392 0x154004>;
			clocks = <&clock_provider 0>;
		};
	};
```
