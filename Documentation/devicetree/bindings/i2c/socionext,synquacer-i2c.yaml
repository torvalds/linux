## Documentation/devicetree/bindings/i2c/socionext,synquacer-i2c.yaml
```yaml
# SPDX-License-Identifier: (GPL-2.0-only OR BSD-2-Clause)
%YAML 1.2
---
$id: http://devicetree.org/schemas/i2c/socionext,synquacer-i2c.yaml#
$schema: http://devicetree.org/meta-schemas/core.yaml#

title: Socionext SynQuacer I2C Controller

maintainers:
  - Ard Biesheuvel <ardb@kernel.org>

allOf:
  - $ref: /schemas/i2c/i2c-controller.yaml#

properties:
  compatible:
    const: socionext,synquacer-i2c

  reg:
    maxItems: 1

  clocks:
    maxItems: 1

  clock-names:
    const: pclk

  clock-frequency:
    minimum: 100000
    maximum: 400000

  interrupts:
    maxItems: 1

required:
  - compatible
  - reg
  - interrupts
  - clocks
  - clock-names

unevaluatedProperties: false

examples:
  - |
    #include <dt-bindings/interrupt-controller/arm-gic.h>

    i2c@51210000 {
        compatible = "socionext,synquacer-i2c";
        reg = <0x51210000 0x1000>;
        interrupts = <GIC_SPI 165 IRQ_TYPE_LEVEL_HIGH>;
        #address-cells = <1>;
        #size-cells = <0>;
        clock-names = "pclk";
        clocks = <&clk_i2c>;
        clock-frequency = <400000>;
    };
...
```

## Documentation/devicetree/bindings/i2c/socionext,uniphier-fi2c.yaml
```yaml
# SPDX-License-Identifier: GPL-2.0-only OR BSD-2-Clause
%YAML 1.2
---
$id: http://devicetree.org/schemas/i2c/socionext,uniphier-fi2c.yaml#
$schema: http://devicetree.org/meta-schemas/core.yaml#

title: UniPhier I2C controller (FIFO-builtin)

maintainers:
  - Masahiro Yamada <yamada.masahiro@socionext.com>

allOf:
  - $ref: /schemas/i2c/i2c-controller.yaml#

properties:
  compatible:
    const: socionext,uniphier-fi2c

  reg:
    maxItems: 1

  interrupts:
    maxItems: 1

  clocks:
    maxItems: 1

  clock-frequency:
    minimum: 100000
    maximum: 400000

  resets:
    maxItems: 1

required:
  - compatible
  - reg
  - "#address-cells"
  - "#size-cells"
  - interrupts
  - clocks

unevaluatedProperties: false

examples:
  - |
    i2c0: i2c@58780000 {
        compatible = "socionext,uniphier-fi2c";
        reg = <0x58780000 0x80>;
        #address-cells = <1>;
        #size-cells = <0>;
        interrupts = <0 41 4>;
        clocks = <&i2c_clk>;
        clock-frequency = <100000>;
    };
```

## Documentation/devicetree/bindings/i2c/socionext,uniphier-i2c.yaml
```yaml
# SPDX-License-Identifier: GPL-2.0-only OR BSD-2-Clause
%YAML 1.2
---
$id: http://devicetree.org/schemas/i2c/socionext,uniphier-i2c.yaml#
$schema: http://devicetree.org/meta-schemas/core.yaml#

title: UniPhier I2C controller (FIFO-less)

maintainers:
  - Masahiro Yamada <yamada.masahiro@socionext.com>

allOf:
  - $ref: /schemas/i2c/i2c-controller.yaml#

properties:
  compatible:
    const: socionext,uniphier-i2c

  reg:
    maxItems: 1

  interrupts:
    maxItems: 1

  clocks:
    maxItems: 1

  clock-frequency:
    minimum: 100000
    maximum: 400000

required:
  - compatible
  - reg
  - "#address-cells"
  - "#size-cells"
  - interrupts
  - clocks

examples:
  - |
    i2c0: i2c@58400000 {
        compatible = "socionext,uniphier-i2c";
        reg = <0x58400000 0x40>;
        #address-cells = <1>;
        #size-cells = <0>;
        interrupts = <0 41 1>;
        clocks = <&i2c_clk>;
        clock-frequency = <100000>;
    };
```

## Documentation/devicetree/bindings/i2c/spacemit,k1-i2c.yaml
```yaml
# SPDX-License-Identifier: (GPL-2.0-only OR BSD-2-Clause)
%YAML 1.2
---
$id: http://devicetree.org/schemas/i2c/spacemit,k1-i2c.yaml#
$schema: http://devicetree.org/meta-schemas/core.yaml#

title: I2C controller embedded in SpacemiT's K1 SoC

maintainers:
  - Troy Mitchell <troymitchell988@gmail.com>

properties:
  compatible:
    const: spacemit,k1-i2c

  reg:
    maxItems: 1

  interrupts:
    maxItems: 1

  clocks:
    items:
      - description: I2C Functional Clock
      - description: APB Bus Clock

  clock-names:
    items:
      - const: func
      - const: bus

  clock-frequency:
    description: |
      K1 support three different modes which running different frequencies
      standard speed mode: up to 100000 (100Hz)
      fast speed mode    : up to 400000 (400Hz)
      high speed mode    : up to 3300000 (3.3Mhz)
    default: 400000
    maximum: 3300000

required:
  - compatible
  - reg
  - interrupts
  - clocks

unevaluatedProperties: false

examples:
  - |
    i2c@d4010800 {
        compatible = "spacemit,k1-i2c";
        reg = <0xd4010800 0x38>;
        interrupt-parent = <&plic>;
        interrupts = <36>;
        clocks =<&ccu 32>, <&ccu 84>;
        clock-names = "func", "bus";
        clock-frequency = <100000>;
    };

...
```

## Documentation/devicetree/bindings/i2c/sprd,sc9860-i2c.yaml
```yaml
# SPDX-License-Identifier: GPL-2.0-only OR BSD-2-Clause
%YAML 1.2
---
$id: http://devicetree.org/schemas/i2c/sprd,sc9860-i2c.yaml#
$schema: http://devicetree.org/meta-schemas/core.yaml#

title: Spreadtrum SC9860 I2C controller

maintainers:
  - Orson Zhai <orsonzhai@gmail.com>
  - Baolin Wang <baolin.wang7@gmail.com>
  - Chunyan Zhang <zhang.lyra@gmail.com>

allOf:
  - $ref: /schemas/i2c/i2c-controller.yaml#

properties:
  compatible:
    const: sprd,sc9860-i2c

  reg:
    maxItems: 1

  interrupts:
    maxItems: 1

  clocks:
    items:
      - description: I2C clock
      - description: I2C source (parent) clock
      - description: I2C module enable clock

  clock-names:
    items:
      - const: i2c
      - const: source
      - const: enable

  clock-frequency: true

required:
  - compatible
  - reg
  - interrupts
  - clocks
  - clock-names
  - clock-frequency

unevaluatedProperties: false

examples:
  - |
    #include <dt-bindings/interrupt-controller/arm-gic.h>
    #include <dt-bindings/interrupt-controller/irq.h>

    i2c@70500000 {
      compatible = "sprd,sc9860-i2c";
      reg = <0x70500000 0x1000>;
      interrupts = <GIC_SPI 11 IRQ_TYPE_LEVEL_HIGH>;
      clocks = <&clk_i2c3>, <&ext_26m>, <&clk_ap_apb_gates 11>;
      clock-names = "i2c", "source", "enable";
      clock-frequency = <400000>;
      #address-cells = <1>;
      #size-cells = <0>;
    };
```

## Documentation/devicetree/bindings/i2c/st,nomadik-i2c.yaml
```yaml
# SPDX-License-Identifier: (GPL-2.0-only OR BSD-2-Clause)
%YAML 1.2
---
$id: http://devicetree.org/schemas/i2c/st,nomadik-i2c.yaml#
$schema: http://devicetree.org/meta-schemas/core.yaml#

title: ST Microelectronics Nomadik I2C

description: The Nomadik I2C host controller began its life in the ST
  Microelectronics STn8800 SoC, and was then inherited into STn8810 and
  STn8815. It was part of the prototype STn8500 which then became ST-Ericsson
  DB8500 after the merge of these two companies wireless divisions.

maintainers:
  - Linus Walleij <linus.walleij@linaro.org>

# Need a custom select here or 'arm,primecell' will match on lots of nodes
select:
  properties:
    compatible:
      contains:
        enum:
          - st,nomadik-i2c
          - mobileye,eyeq5-i2c
          - mobileye,eyeq6h-i2c
  required:
    - compatible

properties:
  compatible:
    oneOf:
      - items:
          - enum:
              - st,nomadik-i2c
              - mobileye,eyeq5-i2c
              - mobileye,eyeq6h-i2c
          - const: arm,primecell
      - items:
          - const: stericsson,db8500-i2c
          - const: st,nomadik-i2c
          - const: arm,primecell

  reg:
    maxItems: 1

  interrupts:
    maxItems: 1

  clocks:
    maxItems: 2

  clock-names:
    oneOf:
      # Clock name in STn8815
      - items:
          - const: mclk
          - const: apb_pclk
      # Clock name in DB8500 or EyeQ
      - items:
          - const: i2cclk
          - const: apb_pclk

  power-domains:
    maxItems: 1

  resets:
    maxItems: 1

  clock-frequency:
    minimum: 1
    maximum: 3400000

  mobileye,olb:
    $ref: /schemas/types.yaml#/definitions/phandle-array
    items:
      - items:
          - description: Phandle to OLB system controller node.
          - description: Platform-wide controller ID (integer starting from zero).
    description:
      The phandle pointing to OLB system controller node, with the I2C
      controller index.

required:
  - compatible
  - reg
  - interrupts
  - clocks
  - clock-names

unevaluatedProperties: false

allOf:
  - $ref: /schemas/i2c/i2c-controller.yaml#
  - if:
      properties:
        compatible:
          contains:
            const: mobileye,eyeq5-i2c
    then:
      required:
        - mobileye,olb
    else:
      properties:
        mobileye,olb: false

examples:
  - |
    #include <dt-bindings/interrupt-controller/irq.h>
    #include <dt-bindings/interrupt-controller/arm-gic.h>
    #include <dt-bindings/reset/stericsson,db8500-prcc-reset.h>
    #include <dt-bindings/arm/ux500_pm_domains.h>
    i2c@80004000 {
      compatible = "stericsson,db8500-i2c", "st,nomadik-i2c", "arm,primecell";
      reg = <0x80004000 0x1000>;
      interrupts = <GIC_SPI 21 IRQ_TYPE_LEVEL_HIGH>;

      #address-cells = <1>;
      #size-cells = <0>;

      clock-frequency = <400000>;
      clocks = <&prcc_kclk 3 3>, <&prcc_pclk 3 3>;
      clock-names = "i2cclk", "apb_pclk";
      power-domains = <&pm_domains DOMAIN_VAPE>;
      resets = <&prcc_reset DB8500_PRCC_3 DB8500_PRCC_3_RESET_I2C0>;
    };

    i2c@101f8000 {
      compatible = "st,nomadik-i2c", "arm,primecell";
      reg = <0x101f8000 0x1000>;
      interrupt-parent = <&vica>;
      interrupts = <20>;
      clock-frequency = <100000>;
      #address-cells = <1>;
      #size-cells = <0>;
      clocks = <&i2c0clk>, <&pclki2c0>;
      clock-names = "mclk", "apb_pclk";
    };
  - |
    #include <dt-bindings/interrupt-controller/mips-gic.h>
    i2c@300000 {
      compatible = "mobileye,eyeq5-i2c", "arm,primecell";
      reg = <0x300000 0x1000>;
      interrupt-parent = <&gic>;
      interrupts = <GIC_SHARED 1 IRQ_TYPE_LEVEL_HIGH>;
      clock-frequency = <400000>;
      #address-cells = <1>;
      #size-cells = <0>;
      clocks = <&i2c_ser_clk>, <&i2c_clk>;
      clock-names = "i2cclk", "apb_pclk";
      mobileye,olb = <&olb 0>;
    };

...
```

## Documentation/devicetree/bindings/i2c/st,sti-i2c.yaml
```yaml
# SPDX-License-Identifier: (GPL-2.0-only OR BSD-2-Clause)
%YAML 1.2
---
$id: http://devicetree.org/schemas/i2c/st,sti-i2c.yaml#
$schema: http://devicetree.org/meta-schemas/core.yaml#

title: I2C controller embedded in STMicroelectronics STi platform

maintainers:
  - Patrice Chotard <patrice.chotard@foss.st.com>

allOf:
  - $ref: /schemas/i2c/i2c-controller.yaml#

properties:
  compatible:
    enum:
      - st,comms-ssc-i2c
      - st,comms-ssc4-i2c

  reg:
    maxItems: 1

  interrupts:
    maxItems: 1

  clocks:
    maxItems: 1

  clock-names:
    maxItems: 1

  clock-frequency:
    enum: [ 100000, 400000 ]
    default: 100000

  st,i2c-min-scl-pulse-width-us:
    description:
      The minimum valid SCL pulse width that is allowed through the
      deglitch circuit. In units of us.

  st,i2c-min-sda-pulse-width-us:
    description:
      The minimum valid SDA pulse width that is allowed through the
      deglitch circuit. In units of us.

required:
  - compatible
  - reg
  - interrupts
  - clocks
  - clock-names

unevaluatedProperties: false

examples:
  - |
    #include <dt-bindings/interrupt-controller/arm-gic.h>
    #include <dt-bindings/clock/stih407-clks.h>
    i2c@fed40000 {
        compatible = "st,comms-ssc4-i2c";
        reg = <0xfed40000 0x110>;
        interrupts =  <GIC_SPI 187 IRQ_TYPE_LEVEL_HIGH>;
        clocks = <&clk_s_a0_ls CLK_ICN_REG>;
        clock-names = "ssc";
        clock-frequency = <400000>;
        pinctrl-names = "default";
        pinctrl-0 = <&pinctrl_i2c0_default>;
        st,i2c-min-scl-pulse-width-us = <0>;
        st,i2c-min-sda-pulse-width-us = <5>;
    };
```

## Documentation/devicetree/bindings/i2c/st,stm32-i2c.yaml
```yaml
# SPDX-License-Identifier: (GPL-2.0-only OR BSD-2-Clause)
%YAML 1.2
---
$id: http://devicetree.org/schemas/i2c/st,stm32-i2c.yaml#
$schema: http://devicetree.org/meta-schemas/core.yaml#

title: I2C controller embedded in STMicroelectronics STM32 I2C platform

maintainers:
  - Pierre-Yves MORDRET <pierre-yves.mordret@st.com>

allOf:
  - $ref: /schemas/i2c/i2c-controller.yaml#
  - if:
      properties:
        compatible:
          contains:
            enum:
              - st,stm32f7-i2c
    then:
      properties:
        i2c-scl-rising-time-ns:
          default: 25

        i2c-scl-falling-time-ns:
          default: 10

        st,syscfg-fmp:
          description: Use to set Fast Mode Plus bit within SYSCFG when
                       Fast Mode Plus speed is selected by slave.
                       Format is phandle to syscfg / register offset within
                       syscfg / register bitmask for FMP bit.
          allOf:
            - $ref: "/schemas/types.yaml#/definitions/phandle-array"
            - items:
                minItems: 3
                maxItems: 3

  - if:
      properties:
        compatible:
          contains:
            enum:
              - st,stm32f4-i2c
    then:
      properties:
        clock-frequency:
          enum: [100000, 400000]

properties:
  compatible:
    enum:
      - st,stm32f4-i2c
      - st,stm32f7-i2c

  reg:
    maxItems: 1

  interrupts:
    items:
      - description: interrupt ID for I2C event
      - description: interrupt ID for I2C error

  resets:
    maxItems: 1

  clocks:
    maxItems: 1

  dmas:
    items:
      - description: RX DMA Channel phandle
      - description: TX DMA Channel phandle

  dma-names:
    items:
      - const: rx
      - const: tx

  clock-frequency:
    description: Desired I2C bus clock frequency in Hz. If not specified,
                 the default 100 kHz frequency will be used.
                 For STM32F7, STM32H7 and STM32MP1 SoCs, Standard-mode,
                 Fast-mode and Fast-mode Plus are supported, possible
                 values are 100000, 400000 and 1000000.
    default: 100000
    enum: [100000, 400000, 1000000]

required:
  - compatible
  - reg
  - interrupts
  - resets
  - clocks

examples:
  - |
    #include <dt-bindings/mfd/stm32f7-rcc.h>
    #include <dt-bindings/clock/stm32fx-clock.h>
    //Example 1 (with st,stm32f4-i2c compatible)
      i2c@40005400 {
          compatible = "st,stm32f4-i2c";
          #address-cells = <1>;
          #size-cells = <0>;
          reg = <0x40005400 0x400>;
          interrupts = <31>,
                       <32>;
          resets = <&rcc 277>;
          clocks = <&rcc 0 149>;
      };

    //Example 2 (with st,stm32f7-i2c compatible)
      i2c@40005800 {
          compatible = "st,stm32f7-i2c";
          #address-cells = <1>;
          #size-cells = <0>;
          reg = <0x40005800 0x400>;
          interrupts = <31>,
                       <32>;
          resets = <&rcc STM32F7_APB1_RESET(I2C1)>;
          clocks = <&rcc 1 CLK_I2C1>;
      };

    //Example 3 (with st,stm32f7-i2c compatible on stm32mp)
    #include <dt-bindings/interrupt-controller/arm-gic.h>
    #include <dt-bindings/clock/stm32mp1-clks.h>
    #include <dt-bindings/reset/stm32mp1-resets.h>
      i2c@40013000 {
          compatible = "st,stm32f7-i2c";
          #address-cells = <1>;
          #size-cells = <0>;
          reg = <0x40013000 0x400>;
          interrupts = <GIC_SPI 33 IRQ_TYPE_LEVEL_HIGH>,
                       <GIC_SPI 34 IRQ_TYPE_LEVEL_HIGH>;
          clocks = <&rcc I2C2_K>;
          resets = <&rcc I2C2_R>;
          i2c-scl-rising-time-ns = <185>;
          i2c-scl-falling-time-ns = <20>;
          st,syscfg-fmp = <&syscfg 0x4 0x2>;
      };
...
```
