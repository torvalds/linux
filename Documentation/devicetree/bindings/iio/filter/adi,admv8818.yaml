## Documentation/devicetree/bindings/iio/frequency/adi,adf4350.yaml
```yaml
# SPDX-License-Identifier: (GPL-2.0 OR BSD-2-Clause)
%YAML 1.2
---
$id: http://devicetree.org/schemas/iio/frequency/adi,adf4350.yaml#
$schema: http://devicetree.org/meta-schemas/core.yaml#

title: Analog Devices ADF4350/ADF4351 wideband synthesizer

maintainers:
  - Michael Hennerich <michael.hennerich@analog.com>

properties:
  compatible:
    enum:
      - adi,adf4350
      - adi,adf4351

  reg:
    maxItems: 1

  spi-max-frequency:
    maximum: 20000000

  clocks:
    maxItems: 1
    description: Clock to provide CLKIN reference clock signal.

  clock-names:
    const: clkin

  '#clock-cells':
    const: 0

  clock-output-names:
    maxItems: 1

  gpios:
    maxItems: 1
    description: Lock detect GPIO.

  adi,channel-spacing:
    $ref: /schemas/types.yaml#/definitions/uint32
    description:
      Channel spacing in Hz (influences MODULUS).

  adi,power-up-frequency:
    $ref: /schemas/types.yaml#/definitions/uint32
    description:
      If set the PLL tunes to this frequency (in Hz) on driver probe.

  adi,reference-div-factor:
    $ref: /schemas/types.yaml#/definitions/uint32
    description:
      If set the driver skips dynamic calculation and uses this default
      value instead.

  adi,reference-doubler-enable:
    $ref: /schemas/types.yaml#/definitions/flag
    description: Enables reference doubler.

  adi,reference-div2-enable:
    $ref: /schemas/types.yaml#/definitions/flag
    description: Enables reference divider.

  adi,phase-detector-polarity-positive-enable:
    $ref: /schemas/types.yaml#/definitions/flag
    description: Enables positive phase detector polarity. Default negative.

  adi,lock-detect-precision-6ns-enable:
    $ref: /schemas/types.yaml#/definitions/flag
    description: Enables 6ns lock detect precision. Default = 10ns.

  adi,lock-detect-function-integer-n-enable:
    $ref: /schemas/types.yaml#/definitions/flag
    description:
      Enables lock detect for integer-N mode. Default = factional-N mode.

  adi,charge-pump-current:
    $ref: /schemas/types.yaml#/definitions/uint32
    description: Charge pump current in mA. Default = 2500mA.

  adi,muxout-select:
    $ref: /schemas/types.yaml#/definitions/uint32
    minimum: 0
    maximum: 6
    description: |
      On chip multiplexer output selection.
      Valid values for the multiplexer output are:
      0: Three-State Output (default)
      1: DVDD
      2: DGND
      3: R-Counter output
      4: N-Divider output
      5: Analog lock detect
      6: Digital lock detect

  adi,low-spur-mode-enable:
    $ref: /schemas/types.yaml#/definitions/flag
    description: Enables low spur mode. Default = Low noise mode.

  adi,cycle-slip-reduction-enable:
    $ref: /schemas/types.yaml#/definitions/flag
    description: Enables cycle slip reduction.

  adi,charge-cancellation-enable:
    $ref: /schemas/types.yaml#/definitions/flag
    description:
      Enabled charge pump charge cancellation for integer-N modes.

  adi,anti-backlash-3ns-enable:
    $ref: /schemas/types.yaml#/definitions/flag
    description:
      Enables 3ns antibacklash pulse width for integer-N modes.

  adi,band-select-clock-mode-high-enable:
    $ref: /schemas/types.yaml#/definitions/flag
    description: Enables faster band selection logic.

  adi,12bit-clk-divider:
    $ref: /schemas/types.yaml#/definitions/uint32
    description:
      Clock divider value used when adi,12bit-clkdiv-mode != 0

  adi,clk-divider-mode:
    $ref: /schemas/types.yaml#/definitions/uint32
    enum: [0, 1, 2]
    description: |
      Valid values for the clkdiv mode are:
      0: Clock divider off (default)
      1: Fast lock enable
      2: Phase resync enable

  adi,aux-output-enable:
    $ref: /schemas/types.yaml#/definitions/flag
    description: Enables auxiliary RF output.

  adi,aux-output-fundamental-enable:
    $ref: /schemas/types.yaml#/definitions/flag
    description: |
      Selects fundamental VCO output on the auxiliary RF output.
      Default = Output of RF dividers.

  adi,mute-till-lock-enable:
    $ref: /schemas/types.yaml#/definitions/flag
    description: Enables Mute-Till-Lock-Detect function.

  adi,output-power:
    $ref: /schemas/types.yaml#/definitions/uint32
    enum: [0, 1, 2, 3]
    description: |
      Output power selection.
      Valid values for the power mode are:
      0: -4dBm (default)
      1: -1dBm
      2: +2dBm
      3: +5dBm

  adi,aux-output-power:
    $ref: /schemas/types.yaml#/definitions/uint32
    enum: [0, 1, 2, 3]
    description: |
      Auxiliary output power selection.
      Valid values for the power mode are:
      0: -4dBm (default)
      1: -1dBm
      2: +2dBm
      3: +5dBm

required:
  - compatible
  - reg
  - clocks

allOf:
  - $ref: /schemas/spi/spi-peripheral-props.yaml#

unevaluatedProperties: false

examples:
  - |
    spi {
        #address-cells = <1>;
        #size-cells = <0>;

        pll@4 {
            compatible = "adi,adf4351";
            reg = <4>;
            spi-max-frequency = <10000000>;
            clocks = <&clk0_ad9523 9>;
            clock-names = "clkin";
            adi,channel-spacing = <10000>;
            adi,power-up-frequency = <2400000000>;
            adi,phase-detector-polarity-positive-enable;
            adi,charge-pump-current = <2500>;
            adi,output-power = <3>;
            adi,mute-till-lock-enable;
        };
    };
...
```

## Documentation/devicetree/bindings/iio/frequency/adi,adf4377.yaml
```yaml
# SPDX-License-Identifier: (GPL-2.0-only OR BSD-2-Clause)
%YAML 1.2
---
$id: http://devicetree.org/schemas/iio/frequency/adi,adf4377.yaml#
$schema: http://devicetree.org/meta-schemas/core.yaml#

title: ADF4377 Microwave Wideband Synthesizer with Integrated VCO

maintainers:
  - Antoniu Miclaus <antoniu.miclaus@analog.com>
  - Dragos Bogdan <dragos.bogdan@analog.com>

description: |
   The ADF4377 is a high performance, ultralow jitter, dual output integer-N
   phased locked loop (PLL) with integrated voltage controlled oscillator (VCO)
   ideally suited for data converter and mixed signal front end (MxFE) clock
   applications.

   https://www.analog.com/en/products/adf4377.html
   https://www.analog.com/en/products/adf4378.html

properties:
  compatible:
    enum:
      - adi,adf4377
      - adi,adf4378

  reg:
    maxItems: 1

  spi-max-frequency:
    maximum: 10000000

  clocks:
    maxItems: 1

  clock-names:
    description:
      External clock that provides reference input frequency.
    items:
      - const: ref_in

  chip-enable-gpios:
    description:
      GPIO that controls the Chip Enable Pin.
    maxItems: 1

  clk1-enable-gpios:
    description:
      GPIO that controls the Enable Clock 1 Output Buffer Pin.
    maxItems: 1

  clk2-enable-gpios:
    description:
      GPIO that controls the Enable Clock 2 Output Buffer Pin.
    maxItems: 1

  adi,muxout-select:
    description:
      On chip multiplexer output selection.
      high_z - MUXOUT Pin set to high-Z.
      lock_detect - MUXOUT Pin set to lock detector output.
      muxout_low - MUXOUT Pin set to low.
      f_div_rclk_2 - MUXOUT Pin set to fDIV_RCLK/2.
      f_div_nclk_2 - MUXOUT Pin set to fDIV_NCLK/2.
      muxout_high - MUXOUT Pin set to high.
    enum: [high_z, lock_detect, muxout_low, f_div_rclk_2, f_div_nclk_2, muxout_high]

required:
  - compatible
  - reg
  - clocks
  - clock-names

allOf:
  - $ref: /schemas/spi/spi-peripheral-props.yaml#
  - if:
      properties:
        compatible:
          contains:
            enum:
              - adi,adf4378
    then:
      properties:
        clk2-enable-gpios: false

unevaluatedProperties: false

examples:
  - |
    spi {
        #address-cells = <1>;
        #size-cells = <0>;
        frequency@0 {
            compatible = "adi,adf4377";
            reg = <0>;
            spi-max-frequency = <10000000>;
            clocks = <&adf4377_ref_in>;
            clock-names = "ref_in";
        };
    };
...
```

## Documentation/devicetree/bindings/iio/frequency/adi,admfm2000.yaml
```yaml
# SPDX-License-Identifier: (GPL-2.0-only OR BSD-2-Clause)
# Copyright 2024 Analog Devices Inc.
%YAML 1.2
---
$id: http://devicetree.org/schemas/iio/frequency/adi,admfm2000.yaml#
$schema: http://devicetree.org/meta-schemas/core.yaml#

title: ADMFM2000 Dual Microwave Down Converter

maintainers:
  - Kim Seer Paller <kimseer.paller@analog.com>

description:
  Dual microwave down converter module with input RF and LO frequency ranges
  from 0.5 to 32 GHz and an output IF frequency range from 0.1 to 8 GHz.
  It consists of a LNA, mixer, IF filter, DSA, and IF amplifier for each down
  conversion path.

properties:
  compatible:
    enum:
      - adi,admfm2000

  '#address-cells':
    const: 1

  '#size-cells':
    const: 0

patternProperties:
  "^channel@[0-1]$":
    type: object
    description: Represents a channel of the device.

    additionalProperties: false

    properties:
      reg:
        description:
          The channel number.
        minimum: 0
        maximum: 1

      adi,mixer-mode:
        description:
          Enable mixer mode for the channel. It downconverts RF between 5 GHz
          and 32 GHz to IF between 0.5 GHz and 8 GHz. If not present, the channel
          is in direct IF mode which bypasses the mixer and downconverts RF
          between 2 GHz and 8 GHz to IF between 0.5 GHz and 8 GHz.
        type: boolean

      switch-gpios:
        description: |
          GPIOs to select the RF path for the channel. The same state of CTRL-A
          and CTRL-B GPIOs is not permitted.
          CTRL-A   CTRL-B    CH1 Status        CH2 Status
          1        0         Direct IF mode    Mixer mode
          0        1         Mixer mode        Direct IF mode

        items:
          - description: CTRL-A GPIO
          - description: CTRL-B GPIO

      attenuation-gpios:
        description: |
          Choice of attenuation:
          DSA-V4  DSA-V3  DSA-V2  DSA-V1  DSA-V0
          1       1       1       1       1        0 dB
          1       1       1       1       0        -1 dB
          1       1       1       0       1        -2 dB
          1       1       0       1       1        -4 dB
          1       0       1       1       1        -8 dB
          0       1       1       1       1        -16 dB
          0       0       0       0       0        -31 dB

        items:
          - description: DSA-V0 GPIO
          - description: DSA-V1 GPIO
          - description: DSA-V2 GPIO
          - description: DSA-V3 GPIO
          - description: DSA-V4 GPIO

    required:
      - reg
      - switch-gpios
      - attenuation-gpios

required:
  - compatible

additionalProperties: false

examples:
  - |
    #include <dt-bindings/gpio/gpio.h>
    converter {
      compatible = "adi,admfm2000";

      #address-cells = <1>;
      #size-cells = <0>;

      channel@0 {
        reg = <0>;
        switch-gpios = <&gpio 1 GPIO_ACTIVE_LOW>,
                       <&gpio 2 GPIO_ACTIVE_HIGH>;

        attenuation-gpios = <&gpio 17 GPIO_ACTIVE_LOW>,
                            <&gpio 22 GPIO_ACTIVE_LOW>,
                            <&gpio 23 GPIO_ACTIVE_LOW>,
                            <&gpio 24 GPIO_ACTIVE_LOW>,
                            <&gpio 25 GPIO_ACTIVE_LOW>;
      };

      channel@1 {
        reg = <1>;
        adi,mixer-mode;
        switch-gpios = <&gpio 3 GPIO_ACTIVE_LOW>,
                       <&gpio 4 GPIO_ACTIVE_HIGH>;

        attenuation-gpios = <&gpio 0 GPIO_ACTIVE_LOW>,
                            <&gpio 5 GPIO_ACTIVE_LOW>,
                            <&gpio 6 GPIO_ACTIVE_LOW>,
                            <&gpio 16 GPIO_ACTIVE_LOW>,
                            <&gpio 26 GPIO_ACTIVE_LOW>;
      };
    };
...
```

## Documentation/devicetree/bindings/iio/frequency/adi,admv1013.yaml
```yaml
# SPDX-License-Identifier: (GPL-2.0-only OR BSD-2-Clause)
%YAML 1.2
---
$id: http://devicetree.org/schemas/iio/frequency/adi,admv1013.yaml#
$schema: http://devicetree.org/meta-schemas/core.yaml#

title: ADMV1013 Microwave Upconverter

maintainers:
  - Antoniu Miclaus <antoniu.miclaus@analog.com>

description: |
   Wideband, microwave upconverter optimized for point to point microwave
   radio designs operating in the 24 GHz to 44 GHz frequency range.

   https://www.analog.com/en/products/admv1013.html

properties:
  compatible:
    enum:
      - adi,admv1013

  reg:
    maxItems: 1

  spi-max-frequency:
    maximum: 1000000

  clocks:
    description:
      Definition of the external clock.
    minItems: 1

  clock-names:
    items:
      - const: lo_in

  vcm-supply:
    description:
      Analog voltage regulator.

  vcc-drv-supply:
    description:
      RF Driver voltage regulator.

  vcc2-drv-supply:
    description:
      RF predriver voltage regulator.

  vcc-vva-supply:
    description:
      VVA Control Circuit voltage regulator.

  vcc-amp1-supply:
    description:
      RF Amplifier 1 voltage regulator.

  vcc-amp2-supply:
    description:
      RF Amplifier 2 voltage regulator.

  vcc-env-supply:
    description:
      Envelope Detector voltage regulator.

  vcc-bg-supply:
    description:
      Mixer Chip Band Gap Circuit voltage regulator.

  vcc-bg2-supply:
    description:
      VGA Chip Band Gap Circuit voltage regulator.

  vcc-mixer-supply:
    description:
      Mixer voltage regulator.

  vcc-quad-supply:
    description:
      Quadruppler voltage regulator.

  adi,detector-enable:
    description:
      Enable the Envelope Detector available at output pins VENV_P and
      VENV_N. Disable to reduce power consumption.
    type: boolean

  adi,input-mode:
    description:
      Select the input mode.
      iq - in-phase quadrature (I/Q) input
      if - complex intermediate frequency (IF) input
    enum: [iq, if]

  adi,quad-se-mode:
    description:
      Switch the LO path from differential to single-ended operation.
      se-neg - Single-Ended Mode, Negative Side Disabled.
      se-pos - Single-Ended Mode, Positive Side Disabled.
      diff - Differential Mode.
    enum: [se-neg, se-pos, diff]

  '#clock-cells':
    const: 0

required:
  - compatible
  - reg
  - clocks
  - clock-names
  - vcm-supply
  - vcc-drv-supply
  - vcc2-drv-supply
  - vcc-vva-supply
  - vcc-amp1-supply
  - vcc-amp2-supply
  - vcc-env-supply
  - vcc-bg-supply
  - vcc-bg2-supply
  - vcc-mixer-supply
  - vcc-quad-supply

allOf:
  - $ref: /schemas/spi/spi-peripheral-props.yaml#

unevaluatedProperties: false

examples:
  - |
    spi {
      #address-cells = <1>;
      #size-cells = <0>;
      admv1013@0{
        compatible = "adi,admv1013";
        reg = <0>;
        spi-max-frequency = <1000000>;
        clocks = <&admv1013_lo>;
        clock-names = "lo_in";
        vcm-supply = <&vcm>;
        vcc-drv-supply = <&vcc_drv>;
        vcc2-drv-supply = <&vcc2_drv>;
        vcc-vva-supply = <&vcc_vva>;
        vcc-amp1-supply = <&vcc_amp1>;
        vcc-amp2-supply = <&vcc_amp2>;
        vcc-env-supply = <&vcc_env>;
        vcc-bg-supply = <&vcc_bg>;
        vcc-bg2-supply = <&vcc_bg2>;
        vcc-mixer-supply = <&vcc_mixer>;
        vcc-quad-supply = <&vcc_quad>;
        adi,quad-se-mode = "diff";
        adi,detector-enable;
      };
    };
...
```
