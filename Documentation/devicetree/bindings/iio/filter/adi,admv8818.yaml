## Documentation/devicetree/bindings/iio/frequency/adi,admv1014.yaml
```yaml
# SPDX-License-Identifier: (GPL-2.0-only OR BSD-2-Clause)
%YAML 1.2
---
$id: http://devicetree.org/schemas/iio/frequency/adi,admv1014.yaml#
$schema: http://devicetree.org/meta-schemas/core.yaml#

title: ADMV1014 Microwave Downconverter

maintainers:
  - Antoniu Miclaus <antoniu.miclaus@analog.com>

description: |
   Wideband, microwave downconverter optimized for point to point microwave
   radio designs operating in the 24 GHz to 44 GHz frequency range.

   https://www.analog.com/en/products/admv1014.html

properties:
  compatible:
    enum:
      - adi,admv1014

  reg:
    maxItems: 1

  spi-max-frequency:
    maximum: 1000000

  clocks:
    maxItems: 1

  clock-names:
    items:
      - const: lo_in
    description:
      External clock that provides the Local Oscilator input.

  vcm-supply:
    description:
      Common-mode voltage regulator.

  vcc-if-bb-supply:
    description:
      BB and IF supply voltage regulator.

  vcc-vga-supply:
    description:
      RF Amplifier supply voltage regulator.

  vcc-vva-supply:
    description:
      VVA Control Circuit supply voltage regulator.

  vcc-lna-3p3-supply:
    description:
      Low Noise Amplifier 3.3V supply voltage regulator.

  vcc-lna-1p5-supply:
    description:
      Low Noise Amplifier 1.5V supply voltage regulator.

  vcc-bg-supply:
    description:
      Band Gap Circuit supply voltage regulator.

  vcc-quad-supply:
    description:
      Quadruple supply voltage regulator.

  vcc-mixer-supply:
    description:
      Mixer supply voltage regulator.

  adi,input-mode:
    description:
      Select the input mode.
      iq - in-phase quadrature (I/Q) input
      if - complex intermediate frequency (IF) input
    enum: [iq, if]

  adi,detector-enable:
    description:
      Digital Rx Detector Enable. The Square Law Detector output is
      available at output pin VDET.
    type: boolean

  adi,p1db-compensation-enable:
    description:
      Turn on bits to optimize P1dB.
    type: boolean

  adi,quad-se-mode:
    description:
      Switch the LO path from differential to single-ended operation.
      se-neg - Single-Ended Mode, Negative Side Disabled.
      se-pos - Single-Ended Mode, Positive Side Disabled.
      diff - Differential Mode.
    enum: [se-neg, se-pos, diff]

required:
  - compatible
  - reg
  - clocks
  - clock-names
  - vcm-supply
  - vcc-if-bb-supply
  - vcc-vga-supply
  - vcc-vva-supply
  - vcc-lna-3p3-supply
  - vcc-lna-1p5-supply
  - vcc-bg-supply
  - vcc-quad-supply
  - vcc-mixer-supply

allOf:
  - $ref: /schemas/spi/spi-peripheral-props.yaml#

unevaluatedProperties: false

examples:
  - |
    spi {
      #address-cells = <1>;
      #size-cells = <0>;
      converter@0 {
        compatible = "adi,admv1014";
        reg = <0>;
        spi-max-frequency = <1000000>;
        clocks = <&admv1014_lo>;
        clock-names = "lo_in";
        vcm-supply = <&vcm>;
        vcc-if-bb-supply = <&vcc_if_bb>;
        vcc-vga-supply = <&vcc_vga>;
        vcc-vva-supply = <&vcc_vva>;
        vcc-lna-3p3-supply = <&vcc_lna_3p3>;
        vcc-lna-1p5-supply = <&vcc_lna_1p5>;
        vcc-bg-supply = <&vcc_bg>;
        vcc-quad-supply = <&vcc_quad>;
        vcc-mixer-supply = <&vcc_mixer>;
        adi,quad-se-mode = "diff";
        adi,detector-enable;
        adi,p1db-compensation-enable;
      };
    };
...
```

## Documentation/devicetree/bindings/iio/frequency/adi,admv4420.yaml
```yaml
# SPDX-License-Identifier: (GPL-2.0 OR BSD-2-Clause)
%YAML 1.2
---
$id: http://devicetree.org/schemas/iio/frequency/adi,admv4420.yaml#
$schema: http://devicetree.org/meta-schemas/core.yaml#

title: ADMV4420 K Band Downconverter

maintainers:
  - Nuno Sá <nuno.sa@analog.com>

description:
  The ADMV4420 is a highly integrated, double balanced, active
  mixer with an integrated fractional-N synthesizer, ideally suited
  for next generation K band satellite communications

properties:
  compatible:
    enum:
      - adi,admv4420

  reg:
    maxItems: 1

  spi-max-frequency:
    maximum: 1000000

  adi,lo-freq-khz:
    description: LO Frequency
    $ref: /schemas/types.yaml#/definitions/uint32

  adi,ref-ext-single-ended-en:
    description: External reference selected.
    type: boolean

required:
  - compatible
  - reg


allOf:
  - $ref: /schemas/spi/spi-peripheral-props.yaml#

unevaluatedProperties: false

examples:
  - |
    spi {
      #address-cells = <1>;
      #size-cells = <0>;
      mixer@0 {
        compatible = "adi,admv4420";
        reg = <0>;
        spi-max-frequency = <1000000>;
        adi,lo-freq-khz = <16750000>;
        adi,ref-ext-single-ended-en;
      };
    };
...
```

## Documentation/devicetree/bindings/iio/frequency/adi,adrf6780.yaml
```yaml
# SPDX-License-Identifier: (GPL-2.0-only OR BSD-2-Clause)
%YAML 1.2
---
$id: http://devicetree.org/schemas/iio/frequency/adi,adrf6780.yaml#
$schema: http://devicetree.org/meta-schemas/core.yaml#

title: ADRF6780 Microwave Upconverter

maintainers:
  - Antoniu Miclaus <antoniu.miclaus@analog.com>

description: |
   Wideband, microwave upconverter optimized for point to point microwave
   radio designs operating in the 5.9 GHz to 23.6 GHz frequency range.

   https://www.analog.com/en/products/adrf6780.html

properties:
  compatible:
    enum:
      - adi,adrf6780

  reg:
    maxItems: 1

  spi-max-frequency:
    maximum: 1000000

  clocks:
    description:
      Definition of the external clock.
    minItems: 1

  clock-names:
    items:
      - const: lo_in

  clock-output-names:
    maxItems: 1

  adi,vga-buff-en:
    description:
      RF Variable Gain Amplifier Buffer Enable. Gain is controlled by
      the voltage on the VATT pin.
    type: boolean

  adi,lo-buff-en:
    description:
      Local Oscillator Amplifier Enable. Disable to put the part in
      a power down state.
    type: boolean

  adi,if-mode-en:
    description:
      Intermediate Frequency Mode Enable. Either IF Mode or I/Q Mode
      can be enabled at a time.
    type: boolean

  adi,iq-mode-en:
    description:
      I/Q Mode Enable. Either IF Mode or I/Q Mode can be enabled at a
      time.
    type: boolean

  adi,lo-x2-en:
    description:
      Double the Local Oscillator output frequency from the Local
      Oscillator Input Frequency. Either LOx1 or LOx2 can be enabled
      at a time.
    type: boolean

  adi,lo-ppf-en:
    description:
      Local Oscillator input frequency equal to the Local Oscillator
      output frequency (LO x1). Either LOx1 or LOx2 can be enabled
      at a time.
    type: boolean

  adi,lo-en:
    description:
      Enable additional cirtuitry in the LO chain. Disable to put the
      part in a power down state.
    type: boolean

  adi,uc-bias-en:
    description:
      Enable all bias circuitry thourghout the entire part.
      Disable to put the part in a power down state.
    type: boolean

  adi,lo-sideband:
    description:
      Switch to the Lower LO Sideband. By default the Upper LO
      sideband is enabled.
    type: boolean

  adi,vdet-out-en:
    description:
      VDET Output Select Enable. Expose the RF detector output to the
      VDET external pin.
    type: boolean

  '#clock-cells':
    const: 0

dependencies:
  adi,lo-x2-en: [ "adi,lo-en" ]
  adi,lo-ppf-en: [ "adi,lo-en" ]

required:
  - compatible
  - reg
  - clocks
  - clock-names

additionalProperties: false

examples:
  - |
    spi {
      #address-cells = <1>;
      #size-cells = <0>;
      adrf6780@0 {
        compatible = "adi,adrf6780";
        reg = <0>;
        spi-max-frequency = <1000000>;
        clocks = <&adrf6780_lo>;
        clock-names = "lo_in";
      };
    };
...
```

## Documentation/devicetree/bindings/iio/gyroscope/adi,adxrs290.yaml
```yaml
# SPDX-License-Identifier: (GPL-2.0 OR BSD-2-Clause)
# Copyright 2020 Analog Devices Inc.
%YAML 1.2
---
$id: http://devicetree.org/schemas/iio/gyroscope/adi,adxrs290.yaml#
$schema: http://devicetree.org/meta-schemas/core.yaml#

title: Analog Devices ADXRS290 Dual-Axis MEMS Gyroscope

maintainers:
  - Nishant Malpani <nish.malpani25@gmail.com>

description: |
  Bindings for the Analog Devices ADXRS290 dual-axis MEMS gyroscope device.
  https://www.analog.com/media/en/technical-documentation/data-sheets/ADXRS290.pdf

properties:
  compatible:
    const: adi,adxrs290

  reg:
    maxItems: 1

  spi-max-frequency:
    maximum: 5000000

  spi-cpol: true

  spi-cpha: true

  interrupts:
    maxItems: 1

required:
  - compatible
  - reg
  - spi-max-frequency
  - spi-cpol
  - spi-cpha

additionalProperties: false

examples:
  - |
    #include <dt-bindings/interrupt-controller/irq.h>
    spi {
        #address-cells = <1>;
        #size-cells = <0>;
        gyro@0 {
                   compatible = "adi,adxrs290";
                   reg = <0>;
                   spi-max-frequency = <5000000>;
                   spi-cpol;
                   spi-cpha;
                   interrupt-parent = <&gpio>;
                   interrupts = <25 IRQ_TYPE_EDGE_RISING>;
        };
    };
...
```

## Documentation/devicetree/bindings/iio/gyroscope/bmg160.txt
```
* Bosch BMG160 triaxial rotation sensor (gyroscope)

Required properties:

  - compatible : should be "bosch,bmg160" or "bosch,bmi055_gyro"
  - reg : the I2C address of the sensor (0x69)

Optional properties:

  - interrupts : interrupt mapping for GPIO IRQ, it should by configured with
		flags IRQ_TYPE_EDGE_RISING

Example:

bmg160@69 {
	compatible = "bosch,bmg160";
	reg = <0x69>;
	interrupt-parent = <&gpio6>;
	interrupts = <18 (IRQ_TYPE_EDGE_RISING)>;
};
```

## Documentation/devicetree/bindings/iio/gyroscope/bosch,bmg160.yaml
```yaml
# SPDX-License-Identifier: (GPL-2.0-only OR BSD-2-Clause)
%YAML 1.2
---
$id: http://devicetree.org/schemas/iio/gyroscope/bosch,bmg160.yaml#
$schema: http://devicetree.org/meta-schemas/core.yaml#

title: Bosch BMG160 triaxial rotation sensor (gyroscope)

maintainers:
  - H. Nikolaus Schaller <hns@goldelico.com>

properties:
  compatible:
    enum:
      - bosch,bmg160
      - bosch,bmi055_gyro
      - bosch,bmi088_gyro

  reg:
    maxItems: 1

  vdd-supply: true
  vddio-supply: true

  interrupts:
    minItems: 1
    maxItems: 2
    description:
      Should be configured with type IRQ_TYPE_EDGE_RISING.
      If two interrupts are provided, expected order is INT1 and INT2.

required:
  - compatible
  - reg

additionalProperties: false

examples:
  - |
    #include <dt-bindings/interrupt-controller/irq.h>
    i2c {
        #address-cells = <1>;
        #size-cells = <0>;
        gyroscope@69 {
            compatible = "bosch,bmg160";
            reg = <0x69>;
            interrupt-parent = <&gpio6>;
            interrupts = <18 IRQ_TYPE_EDGE_RISING>;
        };
    };
...
```

## Documentation/devicetree/bindings/iio/gyroscope/invensense,itg3200.yaml
```yaml
# SPDX-License-Identifier: (GPL-2.0 OR BSD-2-Clause)
%YAML 1.2
---
$id: http://devicetree.org/schemas/iio/gyroscope/invensense,itg3200.yaml#
$schema: http://devicetree.org/meta-schemas/core.yaml#

title: Invensense ITG-3200 Gyroscope

maintainers:
  - Jonathan Cameron <jic23@kernel.org>

description: |
  Triple-axis, digital output gyroscope with a three 16-bit analog-to-digital
  converters (ADCs) for digitizing the gyro outputs, a user-selectable internal
  low-pass filter bandwidth, and a Fast-Mode I2C.

properties:
  compatible:
    const: invensense,itg3200

  reg:
    maxItems: 1

  vdd-supply: true

  vlogic-supply: true

  interrupts:
    maxItems: 1

  mount-matrix:
    description: an optional 3x3 mounting rotation matrix.

  clocks:
    maxItems: 1

  clock-names:
    items:
      - const: ext_clock

required:
  - compatible
  - reg

additionalProperties: false

examples:
  - |
    #include <dt-bindings/interrupt-controller/irq.h>
    i2c {
        #address-cells = <1>;
        #size-cells = <0>;
        gyroscope@68 {
            compatible = "invensense,itg3200";
            reg = <0x68>;
            interrupt-parent = <&gpio2>;
            interrupts = <24 IRQ_TYPE_EDGE_FALLING>;
        };
    };
```

## Documentation/devicetree/bindings/iio/gyroscope/invensense,mpu3050.txt
```
Invensense MPU-3050 Gyroscope device tree bindings

Required properties:
  - compatible : should be "invensense,mpu3050"
  - reg : the I2C address of the sensor

Optional properties:
  - interrupt-parent : should be the phandle for the interrupt controller
  - interrupts : interrupt mapping for the trigger interrupt from the
    internal oscillator. The following IRQ modes are supported:
    IRQ_TYPE_EDGE_RISING, IRQ_TYPE_EDGE_FALLING, IRQ_TYPE_LEVEL_HIGH and
    IRQ_TYPE_LEVEL_LOW. The driver should detect and configure the hardware
    for the desired interrupt type.
  - vdd-supply : supply regulator for the main power voltage.
  - vlogic-supply : supply regulator for the signal voltage.
  - mount-matrix : see iio/mount-matrix.txt

Optional subnodes:
  - The MPU-3050 will pass through and forward the I2C signals from the
    incoming I2C bus, alternatively drive traffic to a slave device (usually
    an accelerometer) on its own initiative. Therefore is supports a subnode
    i2c gate node. For details see: i2c/i2c-gate.txt

Example:

mpu3050@68 {
	compatible = "invensense,mpu3050";
	reg = <0x68>;
	interrupt-parent = <&foo>;
	interrupts = <12 IRQ_TYPE_EDGE_FALLING>;
	vdd-supply = <&bar>;
	vlogic-supply = <&baz>;

	/* External I2C interface */
	i2c-gate {
		#address-cells = <1>;
		#size-cells = <0>;

		fnord@18 {
			compatible = "fnord";
			reg = <0x18>;
			interrupt-parent = <&foo>;
			interrupts = <13 IRQ_TYPE_EDGE_FALLING>;
		};
	};
};
```

## Documentation/devicetree/bindings/iio/gyroscope/invensense,mpu3050.yaml
```yaml
# SPDX-License-Identifier: (GPL-2.0-only OR BSD-2-Clause)
%YAML 1.2
---
$id: http://devicetree.org/schemas/iio/gyroscope/invensense,mpu3050.yaml#
$schema: http://devicetree.org/meta-schemas/core.yaml#

title: Invensense MPU-3050 Gyroscope

maintainers:
  - Linus Walleij <linus.walleij@linaro.org>

properties:
  compatible:
    const: invensense,mpu3050

  reg:
    maxItems: 1

  vdd-supply: true

  vlogic-supply: true

  interrupts:
    maxItems: 1
    description:
      Interrupt mapping for the trigger interrupt from the internal oscillator.

  mount-matrix: true

  i2c-gate:
    $ref: /schemas/i2c/i2c-controller.yaml
    unevaluatedProperties: false
    description: |
      The MPU-3050 will pass through and forward the I2C signals from the
      incoming I2C bus, alternatively drive traffic to a slave device (usually
      an accelerometer) on its own initiative. Therefore is supports an
      i2c-gate subnode.

required:
  - compatible
  - reg

additionalProperties: false

examples:
  - |
    #include <dt-bindings/interrupt-controller/irq.h>
    i2c {
        #address-cells = <1>;
        #size-cells = <0>;
        gyroscope@68 {
            compatible = "invensense,mpu3050";
            reg = <0x68>;
            interrupt-parent = <&foo>;
            interrupts = <12 IRQ_TYPE_EDGE_FALLING>;
            vdd-supply = <&bar>;
            vlogic-supply = <&baz>;

            i2c-gate {
                #address-cells = <1>;
                #size-cells = <0>;

                magnetometer@c {
                    compatible = "asahi-kasei,ak8975";
                    reg = <0x0c>;
                };
            };
        };
    };
...
```
