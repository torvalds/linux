## Documentation/devicetree/bindings/iio/gyroscope/nxp,fxas21002c.txt
```
* NXP FXAS21002C Gyroscope device tree bindings

http://www.nxp.com/products/sensors/gyroscopes/3-axis-digital-gyroscope:FXAS21002C

Required properties:
  - compatible : should be "nxp,fxas21002c"
  - reg : the I2C address of the sensor or SPI chip select number for the
          device.
  - vdd-supply: phandle to the regulator that provides power to the sensor.
  - vddio-supply: phandle to the regulator that provides power to the bus.

Optional properties:
  - reset-gpios : gpio used to reset the device, see gpio/gpio.txt
  - interrupts : device support 2 interrupts, INT1 and INT2,
                 the interrupts can be triggered on rising or falling edges.
                 See interrupt-controller/interrupts.txt
  - interrupt-names: should contain "INT1" or "INT2", the gyroscope interrupt
                     line in use.
  - drive-open-drain: the interrupt/data ready line will be configured
                      as open drain, which is useful if several sensors share
                      the same interrupt line. This is a boolean property.
                      (This binding is taken from pinctrl/pinctrl-bindings.txt)

Example:

gyroscope@20 {
	compatible = "nxp,fxas21002c";
	reg = <0x20>;
	vdd-supply = <&reg_peri_3p15v>;
	vddio-supply = <&reg_peri_3p15v>;
};
```

## Documentation/devicetree/bindings/iio/gyroscope/nxp,fxas21002c.yaml
```yaml
# SPDX-License-Identifier: (GPL-2.0 OR BSD-2-Clause)
%YAML 1.2
---
$id: http://devicetree.org/schemas/iio/gyroscope/nxp,fxas21002c.yaml#
$schema: http://devicetree.org/meta-schemas/core.yaml#

title: NXP FXAS21002C Gyroscope

maintainers:
  - Rui Miguel Silva <rmfrfs@gmail.com>

description: |
  3 axis digital gyroscope device with an I2C and SPI interface.
  http://www.nxp.com/products/sensors/gyroscopes/3-axis-digital-gyroscope:FXAS21002C

properties:
  compatible:
    const: nxp,fxas21002c

  reg:
    maxItems: 1

  vdd-supply:
    description: Regulator that provides power to the sensor

  vddio-supply:
    description: Regulator that provides power to the bus

  reset-gpios:
    maxItems: 1
    description: GPIO connected to reset

  interrupts:
    minItems: 1
    maxItems: 2
    description: Either interrupt may be triggered on rising or falling edges.

  interrupt-names:
    minItems: 1
    maxItems: 2
    items:
      enum:
        - INT1
        - INT2

  drive-open-drain:
    type: boolean
    description: the interrupt/data ready line will be configured as open drain,
                 which is useful if several sensors share the same interrupt
                 line.

  spi-max-frequency:
    maximum: 2000000

required:
  - compatible
  - reg

additionalProperties: false

examples:
  - |
    #include <dt-bindings/interrupt-controller/irq.h>

    i2c0 {
        #address-cells = <1>;
        #size-cells = <0>;

        gyroscope@20 {
          compatible = "nxp,fxas21002c";
          reg = <0x20>;

          vdd-supply = <&reg_peri_3p15v>;
          vddio-supply = <&reg_peri_3p15v>;

          interrupt-parent = <&gpio1>;
          interrupts = <7 IRQ_TYPE_EDGE_RISING>;
          interrupt-names = "INT1";
        };
    };
    spi0 {
        #address-cells = <1>;
        #size-cells = <0>;

        gyroscope@0 {
          compatible = "nxp,fxas21002c";
          reg = <0x0>;

          spi-max-frequency = <2000000>;

          interrupt-parent = <&gpio2>;
          interrupts = <7 IRQ_TYPE_EDGE_RISING>;
          interrupt-names = "INT2";
        };
    };
```

## Documentation/devicetree/bindings/iio/health/afe4403.txt
```
Texas Instruments AFE4403 Heart rate and Pulse Oximeter

Required properties:
 - compatible		: Should be "ti,afe4403".
 - reg			: SPI chip select address of device.
 - tx-supply		: Regulator supply to transmitting LEDs.
 - interrupt-parent	: Phandle to he parent interrupt controller.
 - interrupts		: The interrupt line the device ADC_RDY pin is
			  connected to. For details refer to,
			  ../../interrupt-controller/interrupts.txt.

Optional properties:
 - reset-gpios		: GPIO used to reset the device.
			  For details refer to, ../../gpio/gpio.txt.

For other required and optional properties of SPI slave nodes
please refer to ../../spi/spi-bus.txt.

Example:

&spi0 {
	heart_mon@0 {
		compatible = "ti,afe4403";
		reg = <0>;
		spi-max-frequency = <10000000>;

		tx-supply = <&vbat>;

		interrupt-parent = <&gpio1>;
		interrupts = <28 IRQ_TYPE_EDGE_RISING>;

		reset-gpios = <&gpio1 16 GPIO_ACTIVE_LOW>;
	};
};
```

## Documentation/devicetree/bindings/iio/health/afe4404.txt
```
Texas Instruments AFE4404 Heart rate and Pulse Oximeter

Required properties:
 - compatible		: Should be "ti,afe4404".
 - reg			: I2C address of the device.
 - tx-supply		: Regulator supply to transmitting LEDs.
 - interrupts		: The interrupt line the device ADC_RDY pin is
			  connected to. For details refer to,
			  ../interrupt-controller/interrupts.txt.

Optional properties:
 - reset-gpios		: GPIO used to reset the device.
			  For details refer to, ../gpio/gpio.txt.

Example:

&i2c2 {
	heart_mon@58 {
		compatible = "ti,afe4404";
		reg = <0x58>;

		tx-supply = <&vbat>;

		interrupt-parent = <&gpio1>;
		interrupts = <28 IRQ_TYPE_EDGE_RISING>;

		reset-gpios = <&gpio1 16 GPIO_ACTIVE_LOW>;
	};
};
```

## Documentation/devicetree/bindings/iio/health/max30100.txt
```
Maxim MAX30100 heart rate and pulse oximeter sensor

* https://datasheets.maximintegrated.com/en/ds/MAX30100.pdf

Required properties:
  - compatible: must be "maxim,max30100"
  - reg: the I2C address of the sensor
  - interrupts: the sole interrupt generated by the device

  Refer to interrupt-controller/interrupts.txt for generic
  interrupt client node bindings.

Optional properties:
  - maxim,led-current-microamp: configuration for LED current in microamperes
    while the engine is running. First indexed value is the configuration for
    the RED LED, and second value is for the IR LED.

    Refer to the datasheet for the allowed current values.

Example:

max30100@57 {
	compatible = "maxim,max30100";
	reg = <0x57>;
	maxim,led-current-microamp = <24000 50000>;
	interrupt-parent = <&gpio1>;
	interrupts = <16 2>;
};
```

## Documentation/devicetree/bindings/iio/health/max30102.txt
```
Maxim MAX30102 heart rate and pulse oximeter sensor
Maxim MAX30105 optical particle-sensing module

* https://datasheets.maximintegrated.com/en/ds/MAX30102.pdf
* https://datasheets.maximintegrated.com/en/ds/MAX30105.pdf

Required properties:
  - compatible: must be "maxim,max30102" or "maxim,max30105"
  - reg: the I2C address of the sensor
  - interrupts: the sole interrupt generated by the device

  Refer to interrupt-controller/interrupts.txt for generic
  interrupt client node bindings.

Optional properties:
  - maxim,red-led-current-microamp: configuration for red LED current
  - maxim,ir-led-current-microamp: configuration for IR LED current
  - maxim,green-led-current-microamp: configuration for green LED current
    (max30105 only)

    Note that each step is approximately 200 microamps, ranging from 0 uA to
    50800 uA.

Example:

max30102@57 {
	compatible = "maxim,max30102";
	reg = <0x57>;
	maxim,red-led-current-microamp = <7000>;
	maxim,ir-led-current-microamp = <7000>;
	interrupt-parent = <&gpio1>;
	interrupts = <16 2>;
};
```

## Documentation/devicetree/bindings/iio/health/maxim,max30100.yaml
```yaml
# SPDX-License-Identifier: (GPL-2.0 OR BSD-2-Clause)
%YAML 1.2
---
$id: http://devicetree.org/schemas/iio/health/maxim,max30100.yaml#
$schema: http://devicetree.org/meta-schemas/core.yaml#

title: Maxim MAX30100 heart rate and pulse oximeter sensor

maintainers:
  - Matt Ranostay <matt.ranostay@konsulko.com>

properties:
  compatible:
    const: maxim,max30100

  reg:
    maxItems: 1

  interrupts:
    maxItems: 1
    description: Connected to ADC_RDY pin.

  maxim,led-current-microamp:
    minItems: 2
    maxItems: 2
    description: |
      LED current whilst the engine is running. First indexed value is
      the configuration for the RED LED, and second value is for the IR LED.

  maxim,pulse-width-us:
    description: |
      LED pulse width in microseconds. Appropriate pulse width depends on
      factors such as optical window absorption, LED-to-sensor distance,
      and expected reflectivity of the skin or contact surface.
    enum: [200, 400, 800, 1600]
    default: 1600

additionalProperties: false

required:
  - compatible
  - reg
  - interrupts

examples:
  - |
    i2c {
        #address-cells = <1>;
        #size-cells = <0>;

        heart-rate@57 {
            compatible = "maxim,max30100";
            reg = <0x57>;
            maxim,led-current-microamp = <24000 50000>;
            interrupt-parent = <&gpio1>;
            interrupts = <16 2>;
        };
    };
...
```

## Documentation/devicetree/bindings/iio/health/maxim,max30102.yaml
```yaml
# SPDX-License-Identifier: (GPL-2.0 OR BSD-2-Clause)
%YAML 1.2
---
$id: http://devicetree.org/schemas/iio/health/maxim,max30102.yaml#
$schema: http://devicetree.org/meta-schemas/core.yaml#

title: Maxim MAX30101/2 heart rate and pulse oximeter and MAX30105 particle-sensor

maintainers:
  - Matt Ranostay <matt.ranostay@konsulko.com>

properties:
  compatible:
    oneOf:
      - enum:
          - maxim,max30102
          - maxim,max30105
      - items:
          - const: maxim,max30101
          - const: maxim,max30105

  reg:
    maxItems: 1

  interrupts:
    maxItems: 1
    description: Connected to ADC_RDY pin.

  maxim,red-led-current-microamp:
    description: RED LED current. Each step is approximately 200 microamps.
    minimum: 0
    maximum: 50800

  maxim,ir-led-current-microamp:
    description: IR LED current. Each step is approximately 200 microamps.
    minimum: 0
    maximum: 50800

  maxim,green-led-current-microamp:
    description: Green LED current. Each step is approximately 200 microamps.
    minimum: 0
    maximum: 50800

allOf:
  - if:
      properties:
        compatible:
          contains:
            const: maxim,max30102
    then:
      properties:
        maxim,green-led-current-microamp: false

additionalProperties: false

required:
  - compatible
  - reg
  - interrupts

examples:
  - |
    i2c {
        #address-cells = <1>;
        #size-cells = <0>;

        heart-rate@57 {
            compatible = "maxim,max30102";
            reg = <0x57>;
            maxim,red-led-current-microamp = <7000>;
            maxim,ir-led-current-microamp = <7000>;
            interrupt-parent = <&gpio1>;
            interrupts = <16 2>;
        };
    };
...
```
