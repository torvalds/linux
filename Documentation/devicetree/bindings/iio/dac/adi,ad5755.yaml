## Documentation/devicetree/bindings/iio/dac/adi,ad5770r.yaml
```yaml
# SPDX-License-Identifier: (GPL-2.0 OR BSD-2-Clause)
# Copyright 2020 Analog Devices Inc.
%YAML 1.2
---
$id: http://devicetree.org/schemas/iio/dac/adi,ad5770r.yaml#
$schema: http://devicetree.org/meta-schemas/core.yaml#

title: Analog Devices AD5770R DAC device driver

maintainers:
  - Alexandru Tachici <alexandru.tachici@analog.com>

description: |
  Bindings for the Analog Devices AD5770R current DAC device. Datasheet can be
  found here:
    https://www.analog.com/media/en/technical-documentation/data-sheets/AD5770R.pdf

properties:
  compatible:
    enum:
      - adi,ad5770r

  reg:
    maxItems: 1

  avdd-supply:
    description:
      AVdd voltage supply. Represents two different supplies in the datasheet
      that are in fact the same.

  iovdd-supply:
    description:
      Voltage supply for the chip interface.

  vref-supply:
    description: Specify the voltage of the external reference used.
      Available reference options are 1.25 V or 2.5 V. If no
      external reference declared then the device will use the
      internal reference of 1.25 V.

  adi,external-resistor:
    description: Specify if an external 2.5k ohm resistor is used. If not
      specified the device will use an internal 2.5k ohm resistor.
      The precision resistor is used for reference current generation.
    type: boolean

  reset-gpios:
    description: GPIO spec for the RESET pin. If specified, it will be
      asserted during driver probe.
    maxItems: 1

  '#address-cells':
    const: 1

  '#size-cells':
    const: 0

  channel@0:
    description: Represents an external channel which are
      connected to the DAC. Channel 0 can act both as a current
      source and sink.
    type: object
    additionalProperties: false

    properties:
      reg:
        description: This represents the channel number.
        const: 0

      adi,range-microamp:
        description: Output range of the channel.
        oneOf:
          - items:
              - const: 0
              - const: 300000
          - items:
              - const: -60000
              - const: 0
          - items:
              - const: -60000
              - const: 300000

  channel@1:
    description: Represents an external channel which are
      connected to the DAC.
    type: object
    additionalProperties: false

    properties:
      reg:
        description: This represents the channel number.
        const: 1

      adi,range-microamp:
        description: Output range of the channel.
        items:
          - const: 0
          - enum: [140000, 250000]

  channel@2:
    description: Represents an external channel which are
      connected to the DAC.
    type: object
    additionalProperties: false

    properties:
      reg:
        description: This represents the channel number.
        const: 2

      adi,range-microamp:
        description: Output range of the channel.
        items:
          - const: 0
          - enum: [55000, 150000]

patternProperties:
  "^channel@([3-5])$":
    type: object
    additionalProperties: false
    description: Represents the external channels which are connected to the DAC.
    properties:
      reg:
        description: This represents the channel number.
        minimum: 3
        maximum: 5

      adi,range-microamp:
        description: Output range of the channel.
        items:
          - const: 0
          - enum: [45000, 100000]

required:
  - reg
  - channel@0
  - channel@1
  - channel@2
  - channel@3
  - channel@4
  - channel@5

allOf:
  - $ref: /schemas/spi/spi-peripheral-props.yaml#

unevaluatedProperties: false

examples:
  - |
    spi {
        #address-cells = <1>;
        #size-cells = <0>;

        ad5770r@0 {
            compatible = "adi,ad5770r";
            reg = <0>;
            spi-max-frequency = <1000000>;
            vref-supply = <&vref>;
            adi,external-resistor;
            reset-gpios = <&gpio 22 0>;
            #address-cells = <1>;
            #size-cells = <0>;

            channel@0 {
                reg = <0>;
                adi,range-microamp = <0 300000>;
            };

            channel@1 {
                reg = <1>;
                adi,range-microamp = <0 140000>;
            };

            channel@2 {
                reg = <2>;
                adi,range-microamp = <0 55000>;
            };

            channel@3 {
                reg = <3>;
                adi,range-microamp = <0 45000>;
            };

            channel@4 {
                reg = <4>;
                adi,range-microamp = <0 45000>;
            };

            channel@5 {
                reg = <5>;
                adi,range-microamp = <0 45000>;
            };
        };
    };
...
```

## Documentation/devicetree/bindings/iio/dac/adi,ad5791.yaml
```yaml
# SPDX-License-Identifier: (GPL-2.0 OR BSD-2-Clause)
%YAML 1.2
---
$id: http://devicetree.org/schemas/iio/dac/adi,ad5791.yaml#
$schema: http://devicetree.org/meta-schemas/core.yaml#

title: Analog Devices AD5791 and similar DACs

maintainers:
  - Michael Hennerich <michael.hennerich@analog.com>
  - Jonathan Cameron <jic23@kernel.org>

properties:

  compatible:
    enum:
      - adi,ad5760
      - adi,ad5780
      - adi,ad5781
      - adi,ad5790
      - adi,ad5791

  reg:
    maxItems: 1

  vdd-supply: true
  vss-supply: true

  vcc-supply:
    description:
      Supply that powers the chip.

  iovcc-supply:
    description:
      Supply for the digital interface.

  vrefp-supply:
    description:
      Positive referance input voltage range. From 5v to (vdd - 2.5)

  vrefn-supply:
    description:
      Negative referance input voltage range. From (vss + 2.5) to 0.

  adi,rbuf-gain2-en:
    description: Specify to allow an external amplifier to be connected in a
      gain of two configuration.
    type: boolean

  reset-gpios:
    maxItems: 1

  clear-gpios:
    maxItems: 1

  ldac-gpios:
    description:
      LDAC pin to be used as a hardware trigger to update the DAC channels.
    maxItems: 1

required:
  - compatible
  - reg
  - vdd-supply
  - vss-supply
  - vcc-supply
  - iovcc-supply
  - vrefp-supply
  - vrefn-supply

allOf:
  - $ref: /schemas/spi/spi-peripheral-props.yaml#

unevaluatedProperties: false

examples:
  - |
    #include <dt-bindings/gpio/gpio.h>
    spi {
        #address-cells = <1>;
        #size-cells = <0>;

        dac@0 {
            compatible = "adi,ad5791";
            reg = <0>;
            vss-supply = <&dac_vss>;
            vdd-supply = <&dac_vdd>;
            vcc-supply = <&dac_vcc>;
            iovcc-supply = <&dac_iovcc>;
            vrefp-supply = <&dac_vrefp>;
            vrefn-supply = <&dac_vrefn>;
            reset-gpios = <&gpio_bd 16 GPIO_ACTIVE_LOW>;
            clear-gpios = <&gpio_bd 17 GPIO_ACTIVE_LOW>;
            ldac-gpios = <&gpio_bd 18 GPIO_ACTIVE_LOW>;
        };
    };
...
```

## Documentation/devicetree/bindings/iio/dac/adi,ad7293.yaml
```yaml
# SPDX-License-Identifier: (GPL-2.0-only OR BSD-2-Clause)
%YAML 1.2
---
$id: http://devicetree.org/schemas/iio/dac/adi,ad7293.yaml#
$schema: http://devicetree.org/meta-schemas/core.yaml#

title: AD7293 12-Bit Power Amplifier Current Controller with ADC,
       DACs, Temperature and Current Sensors

maintainers:
  - Antoniu Miclaus <antoniu.miclaus@analog.com>

description: |
   Power Amplifier drain current controller containing functionality
   for general-purpose monitoring and control of current, voltage,
   and temperature, integrated into a single chip solution with an
   SPI-compatible interface.

   https://www.analog.com/en/products/ad7293.html

properties:
  compatible:
    enum:
      - adi,ad7293

  avdd-supply: true

  vdrive-supply: true

  vrefin-supply: true

  reset-gpios:
    maxItems: 1

  reg:
    maxItems: 1

  spi-max-frequency:
    maximum: 1000000

required:
  - compatible
  - reg
  - avdd-supply
  - vdrive-supply

additionalProperties: false

examples:
  - |
    spi {
      #address-cells = <1>;
      #size-cells = <0>;
      ad7293@0 {
        compatible = "adi,ad7293";
        reg = <0>;
        spi-max-frequency = <1000000>;
        avdd-supply = <&avdd>;
        vdrive-supply = <&vdrive>;
        reset-gpios = <&gpio 10 0>;
      };
    };
...
```

## Documentation/devicetree/bindings/iio/dac/adi,ad7303.yaml
```yaml
# SPDX-License-Identifier: (GPL-2.0 OR BSD-2-Clause)
%YAML 1.2
---
$id: http://devicetree.org/schemas/iio/dac/adi,ad7303.yaml#
$schema: http://devicetree.org/meta-schemas/core.yaml#

title: Analog Devices AD7303 DAC

maintainers:
  - Lars-Peter Clausen <lars@metafoo.de>

properties:
  compatible:
    const: adi,ad7303

  reg:
    maxItems: 1

  Vdd-supply:
    description:
      Used to calculate output channel scalling if REF-supply not specified.
  REF-supply:
    description:
      If not provided, Vdd/2 is used as the reference voltage.

  spi-max-frequency:
    maximum: 30000000

required:
  - compatible
  - reg
  - Vdd-supply

additionalProperties: false

examples:
  - |
    spi {
        #address-cells = <1>;
        #size-cells = <0>;

        dac@4 {
            compatible = "adi,ad7303";
            reg = <4>;
            spi-max-frequency = <10000000>;
            Vdd-supply = <&vdd_supply>;
            REF-supply = <&vref_supply>;
        };
    };
...
```

## Documentation/devicetree/bindings/iio/dac/adi,ad8460.yaml
```yaml
# SPDX-License-Identifier: (GPL-2.0 OR BSD-2-Clause)
# Copyright 2024 Analog Devices Inc.
%YAML 1.2
---
$id: http://devicetree.org/schemas/iio/dac/adi,ad8460.yaml#
$schema: http://devicetree.org/meta-schemas/core.yaml#

title: Analog Devices AD8460 DAC

maintainers:
  - Mariel Tinaco <mariel.tinaco@analog.com>

description: |
  Analog Devices AD8460 110 V High Voltage, 1 A High Current,
  Arbitrary Waveform Generator with Integrated 14-Bit High Speed DAC
  https://www.analog.com/media/en/technical-documentation/data-sheets/ad8460.pdf

properties:
  compatible:
    enum:
      - adi,ad8460

  reg:
    maxItems: 1

  clocks:
    maxItems: 1

  dmas:
    maxItems: 1

  dma-names:
    items:
      - const: tx

  spi-max-frequency:
    maximum: 20000000

  hvcc-supply:
    description: Positive high voltage power supply line

  hvee-supply:
    description: Negative high voltage power supply line

  vcc-5v-supply:
    description: Low voltage power supply

  vref-5v-supply:
    description: Reference voltage for analog low voltage

  dvdd-3p3v-supply:
    description: Digital supply bypass

  avdd-3p3v-supply:
    description: Analog supply bypass

  refio-1p2v-supply:
    description: Drive voltage in the range of 1.2V maximum to as low as
      low as 0.12V through the REF_IO pin to adjust full scale output span

  adi,external-resistor-ohms:
    description: Specify value of external resistor connected to FS_ADJ pin
      to establish internal HVDAC's reference current I_REF
    minimum: 2000
    maximum: 20000
    default: 2000

  adi,range-microvolt:
    description: Voltage output range specified as <minimum, maximum>
    items:
      - minimum: -55000000
        maximum: 0
        default: 0
      - minimum: 0
        maximum: 55000000
        default: 0

  adi,range-microamp:
    description: Current output range specified as <minimum, maximum>
    items:
      - minimum: -1000000
        maximum: 0
        default: 0
      - minimum: 0
        maximum: 1000000
        default: 0

  adi,max-millicelsius:
    description: Overtemperature threshold
    minimum: 0
    maximum: 150000
    default: 0

  shutdown-reset-gpios:
    description: Corresponds to SDN_RESET pin. To exit shutdown
      or sleep mode, pulse SDN_RESET HIGH, then leave LOW.
    maxItems: 1

  reset-gpios:
    description: Manual Power On Reset (POR). Pull this GPIO pin
      LOW and then HIGH to reset all digital registers to default
    maxItems: 1

  shutdown-gpios:
    description: Corresponds to SDN_IO pin. Shutdown may be
      initiated by the user, by pulsing SDN_IO high. To exit shutdown,
      pulse SDN_IO low, then float.
    maxItems: 1

required:
  - compatible
  - reg
  - clocks
  - hvcc-supply
  - hvee-supply
  - vcc-5v-supply
  - vref-5v-supply
  - dvdd-3p3v-supply
  - avdd-3p3v-supply
  - refio-1p2v-supply

allOf:
  - $ref: /schemas/spi/spi-peripheral-props.yaml#

unevaluatedProperties: false

examples:
  - |
    #include <dt-bindings/gpio/gpio.h>

    spi {
        #address-cells = <1>;
        #size-cells = <0>;

        dac@0 {
            compatible = "adi,ad8460";
            reg = <0>;
            spi-max-frequency = <8000000>;

            dmas = <&tx_dma 0>;
            dma-names = "tx";

            shutdown-reset-gpios = <&gpio 86 GPIO_ACTIVE_HIGH>;
            reset-gpios = <&gpio 91 GPIO_ACTIVE_LOW>;
            shutdown-gpios = <&gpio 88 GPIO_ACTIVE_HIGH>;

            clocks = <&sync_ext_clk>;

            hvcc-supply = <&hvcc>;
            hvee-supply = <&hvee>;
            vcc-5v-supply = <&vcc_5>;
            vref-5v-supply = <&vref_5>;
            dvdd-3p3v-supply = <&dvdd_3_3>;
            avdd-3p3v-supply = <&avdd_3_3>;
            refio-1p2v-supply = <&refio_1_2>;

            adi,external-resistor-ohms = <2000>;
            adi,range-microvolt = <(-40000000) 40000000>;
            adi,range-microamp = <0 50000>;
            adi,max-millicelsius = <50000>;
        };
    };

...
```

## Documentation/devicetree/bindings/iio/dac/adi,ad8801.yaml
```yaml
# SPDX-License-Identifier: (GPL-2.0 OR BSD-2-Clause)
%YAML 1.2
---
$id: http://devicetree.org/schemas/iio/dac/adi,ad8801.yaml#
$schema: http://devicetree.org/meta-schemas/core.yaml#

title: Analog Devices AD8801 and AD8803 DACs

maintainers:
  - Jonathan Cameron <jic23@kernel.org>

properties:

  compatible:
    enum:
      - adi,ad8801
      - adi,ad8803

  reg:
    maxItems: 1

  vrefh-supply: true
  vrefl-supply: true

required:
  - compatible
  - reg
  - vrefh-supply

allOf:
  - $ref: /schemas/spi/spi-peripheral-props.yaml#
  - if:
      properties:
        compatible:
          contains:
            const: adi,ad8803
    then:
      required:
        - vrefl-supply
    else:
      properties:
        vrefl-supply: false

unevaluatedProperties: false

examples:
  - |
    spi {
        #address-cells = <1>;
        #size-cells = <0>;

        dac@0 {
            compatible = "adi,ad8803";
            reg = <0>;
            vrefl-supply = <&dac_vrefl>;
            vrefh-supply = <&dac_vrefh>;
        };
    };
...
```
