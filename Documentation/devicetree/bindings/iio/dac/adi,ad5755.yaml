## Documentation/devicetree/bindings/iio/dac/lpc1850-dac.txt
```
NXP LPC1850 DAC bindings

Required properties:
- compatible: Should be "nxp,lpc1850-dac"
- reg: Offset and length of the register set for the ADC device
- interrupts: The interrupt number for the ADC device
- clocks: The root clock of the ADC controller
- vref-supply: The regulator supply ADC reference voltage
- resets: phandle to reset controller and line specifier

Example:
dac: dac@400e1000 {
	compatible = "nxp,lpc1850-dac";
	reg = <0x400e1000 0x1000>;
	interrupts = <0>;
	clocks = <&ccu1 CLK_APB3_DAC>;
	vref-supply = <&reg_vdda>;
	resets = <&rgu 42>;
	status = "disabled";
};
```
