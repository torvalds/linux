## Documentation/devicetree/bindings/iio/dac/adi,ad9739a.yaml
```yaml
# SPDX-License-Identifier: (GPL-2.0-only OR BSD-2-Clause)
%YAML 1.2
---
$id: http://devicetree.org/schemas/iio/dac/adi,ad9739a.yaml#
$schema: http://devicetree.org/meta-schemas/core.yaml#

title: Analog Devices AD9739A RF DAC

maintainers:
  - Dragos Bogdan <dragos.bogdan@analog.com>
  - Nuno Sa <nuno.sa@analog.com>

description: |
  The AD9739A is a 14-bit, 2.5 GSPS high performance RF DACs that are capable
  of synthesizing wideband signals from dc up to 3 GHz.

  https://www.analog.com/media/en/technical-documentation/data-sheets/ad9737a_9739a.pdf

properties:
  compatible:
    enum:
      - adi,ad9739a

  reg:
    maxItems: 1

  clocks:
    maxItems: 1

  reset-gpios:
    maxItems: 1

  interrupts:
    maxItems: 1

  vdd-3p3-supply:
    description: 3.3V Digital input supply.

  vdd-supply:
    description: 1.8V Digital input supply.

  vdda-supply:
    description: 3.3V Analog input supply.

  vddc-supply:
    description: 1.8V Clock input supply.

  vref-supply:
    description: Input/Output reference supply.

  io-backends:
    maxItems: 1

  adi,full-scale-microamp:
    description: This property represents the DAC full scale current.
    minimum: 8580
    maximum: 31700
    default: 20000

required:
  - compatible
  - reg
  - clocks
  - io-backends
  - vdd-3p3-supply
  - vdd-supply
  - vdda-supply
  - vddc-supply

allOf:
  - $ref: /schemas/spi/spi-peripheral-props.yaml#

unevaluatedProperties: false

examples:
  - |
    spi {
        #address-cells = <1>;
        #size-cells = <0>;

        dac@0 {
            compatible = "adi,ad9739a";
            reg = <0>;

            clocks = <&dac_clk>;

            io-backends = <&iio_backend>;

            vdd-3p3-supply = <&vdd_3_3>;
            vdd-supply = <&vdd>;
            vdda-supply = <&vdd_3_3>;
            vddc-supply = <&vdd>;
        };
    };
...
```

## Documentation/devicetree/bindings/iio/dac/adi,axi-dac.yaml
```yaml
# SPDX-License-Identifier: (GPL-2.0-only OR BSD-2-Clause)
%YAML 1.2
---
$id: http://devicetree.org/schemas/iio/dac/adi,axi-dac.yaml#
$schema: http://devicetree.org/meta-schemas/core.yaml#

title: Analog Devices AXI DAC IP core

maintainers:
  - Nuno Sa <nuno.sa@analog.com>

description: |
  Analog Devices Generic AXI DAC IP core for interfacing a DAC device
  with a high speed serial (JESD204B/C) or source synchronous parallel
  interface (LVDS/CMOS).
  Usually, some other interface type (i.e SPI) is used as a control
  interface for the actual DAC, while this IP core will interface
  to the data-lines of the DAC and handle the streaming of data from
  memory via DMA into the DAC.

  https://wiki.analog.com/resources/fpga/docs/axi_dac_ip
  https://analogdevicesinc.github.io/hdl/library/axi_ad3552r/index.html

properties:
  compatible:
    enum:
      - adi,axi-dac-9.1.b
      - adi,axi-ad3552r

  reg:
    maxItems: 1

  dmas:
    maxItems: 1

  dma-names:
    items:
      - const: tx

  clocks:
    minItems: 1
    maxItems: 2

  clock-names:
    items:
      - const: s_axi_aclk
      - const: dac_clk
    minItems: 1

  '#io-backend-cells':
    const: 0

required:
  - compatible
  - dmas
  - reg
  - clocks

allOf:
  - if:
      properties:
        compatible:
          contains:
            const: adi,axi-ad3552r
    then:
      $ref: /schemas/spi/spi-controller.yaml#
      properties:
        clocks:
          minItems: 2
        clock-names:
          minItems: 2
      required:
        - clock-names
    else:
      properties:
        clocks:
          maxItems: 1
        clock-names:
          maxItems: 1

unevaluatedProperties: false

examples:
  - |
    dac@44a00000 {
        compatible = "adi,axi-dac-9.1.b";
        reg = <0x44a00000 0x10000>;
        dmas = <&tx_dma 0>;
        dma-names = "tx";
        #io-backend-cells = <0>;
        clocks = <&clkc 15>;
        clock-names = "s_axi_aclk";
    };

  - |
    #include <dt-bindings/gpio/gpio.h>
    axi_dac: spi@44a70000 {
        compatible = "adi,axi-ad3552r";
        reg = <0x44a70000 0x1000>;
        dmas = <&dac_tx_dma 0>;
        dma-names = "tx";
        #io-backend-cells = <0>;
        clocks = <&clkc 15>, <&ref_clk>;
        clock-names = "s_axi_aclk", "dac_clk";

        #address-cells = <1>;
        #size-cells = <0>;

        dac@0 {
            compatible = "adi,ad3552r";
            reg = <0>;
            reset-gpios = <&gpio0 92 GPIO_ACTIVE_HIGH>;
            io-backends = <&axi_dac>;
            spi-max-frequency = <20000000>;

            #address-cells = <1>;
            #size-cells = <0>;

            channel@0 {
                reg = <0>;
                adi,output-range-microvolt = <(-10000000) (10000000)>;
            };
        };
    };
...
```

## Documentation/devicetree/bindings/iio/dac/adi,ltc2664.yaml
```yaml
# SPDX-License-Identifier: (GPL-2.0-only OR BSD-2-Clause)
%YAML 1.2
---
$id: http://devicetree.org/schemas/iio/dac/adi,ltc2664.yaml#
$schema: http://devicetree.org/meta-schemas/core.yaml#

title: Analog Devices LTC2664 DAC

maintainers:
  - Michael Hennerich <michael.hennerich@analog.com>
  - Kim Seer Paller <kimseer.paller@analog.com>

description: |
  Analog Devices LTC2664 4 channel, 12-/16-Bit, +-10V DAC
  https://www.analog.com/media/en/technical-documentation/data-sheets/2664fa.pdf

properties:
  compatible:
    enum:
      - adi,ltc2664

  reg:
    maxItems: 1

  spi-max-frequency:
    maximum: 50000000

  vcc-supply:
    description: Analog Supply Voltage Input.

  v-pos-supply:
    description: Positive Supply Voltage Input.

  v-neg-supply:
    description: Negative Supply Voltage Input.

  iovcc-supply:
    description: Digital Input/Output Supply Voltage.

  ref-supply:
    description:
      Reference Input/Output. The voltage at the REF pin sets the full-scale
      range of all channels. If not provided the internal reference is used and
      also provided on the VREF pin.

  reset-gpios:
    description:
      Active-low Asynchronous Clear Input. A logic low at this level-triggered
      input clears the part to the reset code and range determined by the
      hardwired option chosen using the MSPAN pins. The control registers are
      cleared to zero.
    maxItems: 1

  adi,manual-span-operation-config:
    description:
      This property must mimic the MSPAN pin configurations. By tying the MSPAN
      pins (MSP2, MSP1 and MSP0) to GND and/or VCC, any output range can be
      hardware-configured with different mid-scale or zero-scale reset options.
      The hardware configuration is latched during power on reset for proper
      operation.
        0 - MPS2=GND, MPS1=GND, MSP0=GND (+-10V, reset to 0V)
        1 - MPS2=GND, MPS1=GND, MSP0=VCC (+-5V, reset to 0V)
        2 - MPS2=GND, MPS1=VCC, MSP0=GND (+-2.5V, reset to 0V)
        3 - MPS2=GND, MPS1=VCC, MSP0=VCC (0V to 10, reset to 0V)
        4 - MPS2=VCC, MPS1=GND, MSP0=GND (0V to 10V, reset to 5V)
        5 - MPS2=VCC, MPS1=GND, MSP0=VCC (0V to 5V, reset to 0V)
        6 - MPS2=VCC, MPS1=VCC, MSP0=GND (0V to 5V, reset to 2.5V)
        7 - MPS2=VCC, MPS1=VCC, MSP0=VCC (0V to 5V, reset to 0V, enables SoftSpan)
    $ref: /schemas/types.yaml#/definitions/uint32
    enum: [0, 1, 2, 3, 4, 5, 6, 7]
    default: 7

  io-channels:
    description:
      ADC channel to monitor voltages and temperature at the MUXOUT pin.
    maxItems: 1

  '#address-cells':
    const: 1

  '#size-cells':
    const: 0

patternProperties:
  "^channel@[0-3]$":
    $ref: dac.yaml
    type: object
    additionalProperties: false

    properties:
      reg:
        description: The channel number representing the DAC output channel.
        maximum: 3

      adi,toggle-mode:
        description:
          Set the channel as a toggle enabled channel. Toggle operation enables
          fast switching of a DAC output between two different DAC codes without
          any SPI transaction.
        type: boolean

      output-range-microvolt:
        description:
          This property is only allowed when SoftSpan is enabled. If not present,
          [0, 5000000] is the default output range.
        oneOf:
          - items:
              - const: 0
              - enum: [5000000, 10000000]
          - items:
              - const: -5000000
              - const: 5000000
          - items:
              - const: -10000000
              - const: 10000000
          - items:
              - const: -2500000
              - const: 2500000

    required:
      - reg

    allOf:
      - if:
          not:
            properties:
              adi,manual-span-operation-config:
                const: 7
        then:
          patternProperties:
            "^channel@[0-3]$":
              properties:
                output-range-microvolt: false

required:
  - compatible
  - reg
  - spi-max-frequency
  - vcc-supply
  - iovcc-supply
  - v-pos-supply
  - v-neg-supply

allOf:
  - $ref: /schemas/spi/spi-peripheral-props.yaml#

additionalProperties: false

examples:
  - |
    spi {
        #address-cells = <1>;
        #size-cells = <0>;
        dac@0 {
            compatible = "adi,ltc2664";
            reg = <0>;
            spi-max-frequency = <10000000>;

            vcc-supply = <&vcc>;
            iovcc-supply = <&vcc>;
            ref-supply = <&vref>;
            v-pos-supply = <&vpos>;
            v-neg-supply = <&vneg>;

            io-channels = <&adc 0>;

            #address-cells = <1>;
            #size-cells = <0>;
            channel@0 {
                reg = <0>;
                adi,toggle-mode;
                output-range-microvolt = <(-10000000) 10000000>;
            };

            channel@1 {
                reg = <1>;
                output-range-microvolt= <0 10000000>;
            };
        };
    };
...
```

## Documentation/devicetree/bindings/iio/dac/adi,ltc2672.yaml
```yaml
# SPDX-License-Identifier: (GPL-2.0-only OR BSD-2-Clause)
%YAML 1.2
---
$id: http://devicetree.org/schemas/iio/dac/adi,ltc2672.yaml#
$schema: http://devicetree.org/meta-schemas/core.yaml#

title: Analog Devices LTC2672 DAC

maintainers:
  - Michael Hennerich <michael.hennerich@analog.com>
  - Kim Seer Paller <kimseer.paller@analog.com>

description: |
  Analog Devices LTC2672 5 channel, 12-/16-Bit, 300mA DAC
  https://www.analog.com/media/en/technical-documentation/data-sheets/ltc2672.pdf

properties:
  compatible:
    enum:
      - adi,ltc2672

  reg:
    maxItems: 1

  spi-max-frequency:
    maximum: 50000000

  vcc-supply:
    description: Analog Supply Voltage Input.

  v-neg-supply:
    description: Negative Supply Voltage Input.

  vdd0-supply:
    description: Positive Supply Voltage Input for DAC OUT0.

  vdd1-supply:
    description: Positive Supply Voltage Input for DAC OUT1.

  vdd2-supply:
    description: Positive Supply Voltage Input for DAC OUT2.

  vdd3-supply:
    description: Positive Supply Voltage Input for DAC OUT3.

  vdd4-supply:
    description: Positive Supply Voltage Input for DAC OUT4.

  iovcc-supply:
    description: Digital Input/Output Supply Voltage.

  ref-supply:
    description:
      Reference Input/Output. The voltage at the REF pin sets the full-scale
      range of all channels. If not provided the internal reference is used and
      also provided on the VREF pin.

  reset-gpios:
    description:
      Active Low Asynchronous Clear Input. A logic low at this level triggered
      input clears the device to the default reset code and output range, which
      is zero-scale with the outputs off. The control registers are cleared to
      zero.
    maxItems: 1

  adi,rfsadj-ohms:
    description:
      If FSADJ is tied to VCC, an internal RFSADJ (20 kΩ) is selected, which
      results in nominal output ranges. When an external resistor of 19 kΩ to
      41 kΩ can be used instead by connecting the resistor between FSADJ and GND
      it controls the scaling of the ranges, and the internal resistor is
      automatically disconnected.
    minimum: 19000
    maximum: 41000
    default: 20000

  io-channels:
    description:
      ADC channel to monitor voltages and currents at the MUX pin.
    maxItems: 1

  '#address-cells':
    const: 1

  '#size-cells':
    const: 0

patternProperties:
  "^channel@[0-4]$":
    $ref: dac.yaml
    type: object
    additionalProperties: false

    properties:
      reg:
        description: The channel number representing the DAC output channel.
        maximum: 4

      adi,toggle-mode:
        description:
          Set the channel as a toggle enabled channel. Toggle operation enables
          fast switching of a DAC output between two different DAC codes without
          any SPI transaction.
        type: boolean

      output-range-microamp:
        items:
          - const: 0
          - enum: [3125000, 6250000, 12500000, 25000000, 50000000, 100000000,
                   200000000, 300000000]

    required:
      - reg
      - output-range-microamp

required:
  - compatible
  - reg
  - spi-max-frequency
  - vcc-supply
  - iovcc-supply
  - v-neg-supply

allOf:
  - $ref: /schemas/spi/spi-peripheral-props.yaml#

unevaluatedProperties: false

examples:
  - |
    spi {
        #address-cells = <1>;
        #size-cells = <0>;
        dac@0 {
            compatible = "adi,ltc2672";
            reg = <0>;
            spi-max-frequency = <10000000>;

            vcc-supply = <&vcc>;
            iovcc-supply = <&vcc>;
            ref-supply = <&vref>;
            v-neg-supply = <&vneg>;

            io-channels = <&adc 0>;

            #address-cells = <1>;
            #size-cells = <0>;
            channel@0 {
                reg = <0>;
                adi,toggle-mode;
                output-range-microamp = <0 3125000>;
            };

            channel@1 {
                reg = <1>;
                output-range-microamp = <0 6250000>;
            };
        };
    };
...
```
