## Documentation/devicetree/bindings/iio/dac/adi,ltc2688.yaml
```yaml
# SPDX-License-Identifier: (GPL-2.0-only OR BSD-2-Clause)
%YAML 1.2
---
$id: http://devicetree.org/schemas/iio/dac/adi,ltc2688.yaml#
$schema: http://devicetree.org/meta-schemas/core.yaml#

title: Analog Devices LTC2688 DAC

maintainers:
  - Nuno Sá <nuno.sa@analog.com>

description: |
  Analog Devices LTC2688 16 channel, 16 bit, +-15V DAC
  https://www.analog.com/media/en/technical-documentation/data-sheets/ltc2688.pdf

properties:
  compatible:
    enum:
      - adi,ltc2688

  reg:
    maxItems: 1

  vcc-supply:
    description: Analog Supply Voltage Input.

  iovcc-supply:
    description: Digital Input/Output Supply Voltage.

  vref-supply:
    description:
      Reference Input/Output. The voltage at the REF pin sets the full-scale
      range of all channels. If not provided the internal reference is used and
      also provided on the VREF pin".

  clr-gpios:
    description:
      If specified, it will be asserted during driver probe. As the line is
      active low, it should be marked GPIO_ACTIVE_LOW.
    maxItems: 1

  '#address-cells':
    const: 1

  '#size-cells':
    const: 0

patternProperties:
  "^channel@([0-9]|1[0-5])$":
    type: object
    additionalProperties: false

    properties:
      reg:
        description: The channel number representing the DAC output channel.
        maximum: 15

      adi,toggle-mode:
        description:
          Set the channel as a toggle enabled channel. Toggle operation enables
          fast switching of a DAC output between two different DAC codes without
          any SPI transaction.
        type: boolean

      adi,output-range-microvolt:
        description: Specify the channel output full scale range.
        oneOf:
          - items:
              - const: 0
              - enum: [5000000, 10000000]
          - items:
              - const: -5000000
              - const: 5000000
          - items:
              - const: -10000000
              - const: 10000000
          - items:
              - const: -15000000
              - const: 15000000

      adi,overrange:
        description: Enable 5% overrange over the selected full scale range.
        type: boolean

      clocks:
        maxItems: 1

      adi,toggle-dither-input:
        description:
          Selects the TGPx pin to be associated with this channel. This setting
          only makes sense for toggle or dither enabled channels. If
          @adi,toggle-mode is not set and this property is given, the channel is
          assumed to be a dither capable channel. Note that multiple channels
          can be mapped to the same pin. If this setting is given, the
          respective @clock must also be provided. Mappings between this and
          input pins
            0 - TGP1
            1 - TGP2
            2 - TGP3
        $ref: /schemas/types.yaml#/definitions/uint32
        enum: [0, 1, 2]

    dependencies:
      adi,toggle-dither-input: [ clocks ]

    required:
      - reg

required:
  - compatible
  - reg

additionalProperties: false

examples:
  - |

    spi {
        #address-cells = <1>;
        #size-cells = <0>;
        ltc2688: ltc2688@0 {
            compatible = "adi,ltc2688";
            reg = <0>;

            vcc-supply = <&vcc>;
            iovcc-supply = <&vcc>;
            vref-supply = <&vref>;

            #address-cells = <1>;
            #size-cells = <0>;
            channel@0 {
                reg = <0>;
                adi,toggle-mode;
                adi,overrange;
            };

            channel@1 {
                reg = <1>;
                adi,output-range-microvolt = <0 10000000>;

                clocks = <&clock_tgp3>;
                adi,toggle-dither-input = <2>;
            };
        };
    };

...
```

## Documentation/devicetree/bindings/iio/dac/adi,max22007.yaml
```yaml
# SPDX-License-Identifier: (GPL-2.0 OR BSD-2-Clause)
%YAML 1.2
---
$id: http://devicetree.org/schemas/iio/dac/adi,max22007.yaml#
$schema: http://devicetree.org/meta-schemas/core.yaml#

title: Analog Devices MAX22007 DAC

maintainers:
  - Janani Sunil <janani.sunil@analog.com>

description:
  The MAX22007 is a quad-channel, 12-bit digital-to-analog converter (DAC)
  with integrated precision output amplifiers and current output capability.
  Each channel can be independently configured for voltage or current output.
  Datasheet available at https://www.analog.com/en/products/max22007.html

$ref: /schemas/spi/spi-peripheral-props.yaml#

properties:
  compatible:
    const: adi,max22007

  reg:
    maxItems: 1

  spi-max-frequency:
    maximum: 500000

  '#address-cells':
    const: 1

  '#size-cells':
    const: 0

  vdd-supply:
    description: Low-Voltage Power Supply from +2.7V to +5.5V.

  hvdd-supply:
    description:
      Positive High-Voltage Power Supply from +8V to (HVSS +24V) for
      the Output Channels.

  hvss-supply:
    description:
      Optional Negative High-Voltage Power Supply from -2V to 0V for the Output
      Channels. For most applications HVSS can be connected to GND (0V), but for
      applications requiring output down to true 0V or 0mA, connect to a -2V supply.

  reset-gpios:
    maxItems: 1
    description:
      Active low GPIO.

patternProperties:
  "^channel@[0-3]$":
    $ref: /schemas/iio/dac/dac.yaml#
    type: object
    description:
      Represents the external channels which are connected to the DAC.

    properties:
      reg:
        description: Channel number
        items:
          minimum: 0
          maximum: 3

      adi,ch-func:
        description:
          Channel output type. Use CH_FUNC_VOLTAGE_OUTPUT for voltage
          output or CH_FUNC_CURRENT_OUTPUT for current output.
        $ref: /schemas/types.yaml#/definitions/uint32
        enum: [1, 2]

    required:
      - reg
      - adi,ch-func

    unevaluatedProperties: false

required:
  - compatible
  - reg
  - vdd-supply
  - hvdd-supply

unevaluatedProperties: false

examples:
  - |
    #include <dt-bindings/gpio/gpio.h>
    #include <dt-bindings/iio/addac/adi,ad74413r.h>

    spi {
        #address-cells = <1>;
        #size-cells = <0>;

        dac@0 {
            compatible = "adi,max22007";
            reg = <0>;
            spi-max-frequency = <500000>;
            reset-gpios = <&gpio 19 GPIO_ACTIVE_LOW>;
            vdd-supply = <&vdd_reg>;
            hvdd-supply = <&hvdd_reg>;
            #address-cells = <1>;
            #size-cells = <0>;

            channel@0 {
                reg = <0>;
                adi,ch-func = <CH_FUNC_VOLTAGE_OUTPUT>;
            };

            channel@1 {
                reg = <1>;
                adi,ch-func = <CH_FUNC_CURRENT_OUTPUT>;
            };
        };
    };
...
```

## Documentation/devicetree/bindings/iio/dac/dac.yaml
```yaml
# SPDX-License-Identifier: (GPL-2.0-only OR BSD-2-Clause)
%YAML 1.2
---
$id: http://devicetree.org/schemas/iio/dac/dac.yaml#
$schema: http://devicetree.org/meta-schemas/core.yaml#

title: IIO Common Properties for DAC Channels

maintainers:
  - Jonathan Cameron <jic23@kernel.org>

description:
  A few properties are defined in a common way for DAC channels.

properties:
  $nodename:
    pattern: "^channel(@[0-9a-f]+)?$"
    description:
      A channel index should match reg.

  reg:
    maxItems: 1

  label:
    description: Unique name to identify which channel this is.

  output-range-microamp:
    maxItems: 2
    minItems: 2
    description:
      Specify the channel output full scale range in microamperes.

  output-range-microvolt:
    maxItems: 2
    minItems: 2
    description:
      Specify the channel output full scale range in microvolts.

anyOf:
  - oneOf:
      - required:
          - reg
          - output-range-microamp
      - required:
          - reg
          - output-range-microvolt
  - required:
      - reg

additionalProperties: true
```

## Documentation/devicetree/bindings/iio/dac/dpot-dac.txt
```
Bindings for DAC emulation using a digital potentiometer

It is assumed that the dpot is used as a voltage divider between the
current dpot wiper setting and the maximum resistance of the dpot. The
divided voltage is provided by a vref regulator.

                  .------.
   .-----------.  |      |
   | vref      |--'    .---.
   | regulator |--.    |   |
   '-----------'  |    | d |
                  |    | p |
                  |    | o |  wiper
                  |    | t |<---------+
                  |    |   |
                  |    '---'       dac output voltage
                  |      |
                  '------+------------+

Required properties:
- compatible: Should be "dpot-dac"
- vref-supply: The regulator supplying the voltage divider.
- io-channels: Channel node of the dpot to be used for the voltage division.
- io-channel-names: Should be "dpot".

Example:

	&i2c {
		dpot: mcp4651-503@28 {
			compatible = "microchip,mcp4651-503";
			reg = <0x28>;
			#io-channel-cells = <1>;
		};
	};

	dac {
		compatible = "dpot-dac";
		vref-supply = <&reg_3v3>;
		io-channels = <&dpot 0>;
		io-channel-names = "dpot";
	};
```

## Documentation/devicetree/bindings/iio/dac/dpot-dac.yaml
```yaml
# SPDX-License-Identifier: (GPL-2.0 OR BSD-2-Clause)
%YAML 1.2
---
$id: http://devicetree.org/schemas/iio/dac/dpot-dac.yaml#
$schema: http://devicetree.org/meta-schemas/core.yaml#

title: DAC emulation using a digital potentiometer

maintainers:
  - Peter Rosin <peda@axentia.se>

description: |
  It is assumed that the dpot is used as a voltage divider between the
  current dpot wiper setting and the maximum resistance of the dpot. The
  divided voltage is provided by a vref regulator.

                  .------.
   .-----------.  |      |
   | vref      |--'    .---.
   | regulator |--.    |   |
   '-----------'  |    | d |
                  |    | p |
                  |    | o |  wiper
                  |    | t |<---------+
                  |    |   |
                  |    '---'       dac output voltage
                  |      |
                  '------+------------+

properties:
  compatible:
    const: dpot-dac

  vref-supply:
    description: Regulator supplying the voltage divider.

  io-channels:
    maxItems: 1
    description: |
      Channel node of the dpot to be used for the voltage division.

  io-channel-names:
    const: dpot

  "#io-channel-cells":
    const: 1

required:
  - compatible
  - vref-supply
  - io-channels
  - io-channel-names

additionalProperties: false

examples:
  - |
    dac {
        compatible = "dpot-dac";
        vref-supply = <&reg_3v3>;
        io-channels = <&dpot 0>;
        io-channel-names = "dpot";
    };
...
```

## Documentation/devicetree/bindings/iio/dac/ds4424.txt
```
Maxim Integrated DS4422/DS4424 7-bit Sink/Source Current DAC Device Driver

Datasheet publicly available at:
https://datasheets.maximintegrated.com/en/ds/DS4422-DS4424.pdf

Required properties:
	- compatible: Should be one of
		maxim,ds4422
		maxim,ds4424
	- reg: Should contain the DAC I2C address

Optional properties:
	- vcc-supply: Power supply is optional. If not defined, driver will ignore it.

Example:
	ds4224@10 {
		compatible = "maxim,ds4424";
		reg = <0x10>; /* When A0, A1 pins are ground */
		vcc-supply = <&vcc_3v3>;
	};
```

## Documentation/devicetree/bindings/iio/dac/fsl,vf610-dac.yaml
```yaml
# SPDX-License-Identifier: (GPL-2.0 OR BSD-2-Clause)
%YAML 1.2
---
$id: http://devicetree.org/schemas/iio/dac/fsl,vf610-dac.yaml#
$schema: http://devicetree.org/meta-schemas/core.yaml#

title: Freescale vf610 Digital to Analog Converter

maintainers:
  - Sanchayan Maity <maitysanchayan@gmail.com>

properties:
  compatible:
    const: fsl,vf610-dac

  reg:
    maxItems: 1

  interrupts:
    maxItems: 1

  clocks:
    maxItems: 1

  clock-names:
    const: dac

required:
  - compatible
  - reg
  - interrupts
  - clocks
  - clock-names

additionalProperties: false

examples:
  - |
    #include <dt-bindings/interrupt-controller/irq.h>
    #include <dt-bindings/clock/vf610-clock.h>
    bus@40000000 {
        compatible = "fsl,aips-bus", "simple-bus";
        reg = <0x40000000 0x00070000>;
        ranges;
        #address-cells = <1>;
        #size-cells = <1>;
        dac@400cc000 {
            compatible = "fsl,vf610-dac";
            reg = <0x400cc000 0x1000>;
            interrupts = <55 IRQ_TYPE_LEVEL_HIGH>;
            clock-names = "dac";
            clocks = <&clks VF610_CLK_DAC0>;
        };
    };
...
```

## Documentation/devicetree/bindings/iio/dac/lltc,ltc1660.yaml
```yaml
# SPDX-License-Identifier: GPL-2.0 OR BSD-2-Clause
# Copyright 2019 Marcus Folkesson <marcus.folkesson@gmail.com>
%YAML 1.2
---
$id: "http://devicetree.org/schemas/bindings/iio/dac/lltc,ltc1660.yaml#"
$schema: "http://devicetree.org/meta-schemas/core.yaml#"

title: Linear Technology Micropower octal 8-Bit and 10-Bit DACs

maintainers:
  - Marcus Folkesson <marcus.folkesson@gmail.com>

description: |
  Bindings for the Linear Technology Micropower octal 8-Bit and 10-Bit DAC.
  Datasheet can be found here: https://www.analog.com/media/en/technical-documentation/data-sheets/166560fa.pdf

properties:
  compatible:
    enum:
      - lltc,ltc1660
      - lltc,ltc1665

  reg:
    maxItems: 1

  spi-max-frequency:
    maximum: 5000000

  vref-supply:
    description: Phandle to the external reference voltage supply.

required:
  - compatible
  - reg
  - vref-supply

examples:
  - |
    spi {
      #address-cells = <1>;
      #size-cells = <0>;
  
      dac@0 {
        compatible = "lltc,ltc1660";
        reg = <0>;
        spi-max-frequency = <5000000>;
        vref-supply = <&vref_reg>;
      };
    };
```

## Documentation/devicetree/bindings/iio/dac/lltc,ltc2632.yaml
```yaml
# SPDX-License-Identifier: GPL-2.0 OR BSD-2-Clause
%YAML 1.2
---
$id: http://devicetree.org/schemas/iio/dac/lltc,ltc2632.yaml#
$schema: http://devicetree.org/meta-schemas/core.yaml#

title: Linear Technology LTC263x 12-/10-/8-Bit Rail-to-Rail DAC

maintainers:
  - Michael Hennerich <michael.hennerich@analog.com>

description: |
  Bindings for the Linear Technology LTC2632/2634/2636 DAC
  Datasheet can be found here: https://www.analog.com/media/en/technical-documentation/data-sheets/LTC263[246].pdf

properties:
  compatible:
    enum:
      - lltc,ltc2632-l12
      - lltc,ltc2632-l10
      - lltc,ltc2632-l8
      - lltc,ltc2632-h12
      - lltc,ltc2632-h10
      - lltc,ltc2632-h8
      - lltc,ltc2634-l12
      - lltc,ltc2634-l10
      - lltc,ltc2634-l8
      - lltc,ltc2634-h12
      - lltc,ltc2634-h10
      - lltc,ltc2634-h8
      - lltc,ltc2636-l12
      - lltc,ltc2636-l10
      - lltc,ltc2636-l8
      - lltc,ltc2636-h12
      - lltc,ltc2636-h10
      - lltc,ltc2636-h8

  reg:
    maxItems: 1

  spi-max-frequency:
    maximum: 2000000

  vref-supply:
    description:
      Phandle to the external reference voltage supply. This should
      only be set if there is an external reference voltage connected to the VREF
      pin. If the property is not set the internal reference is used.

required:
  - compatible
  - reg

additionalProperties: false

examples:
  - |
    vref: regulator-vref {
        compatible = "regulator-fixed";
        regulator-name = "vref-ltc2632";
        regulator-min-microvolt = <1250000>;
        regulator-max-microvolt = <1250000>;
        regulator-always-on;
    };

    spi {
        #address-cells = <1>;
        #size-cells = <0>;

        dac@0 {
            compatible = "lltc,ltc2632-l12";
            reg = <0>;    /* CS0 */
            spi-max-frequency = <1000000>;
            vref-supply = <&vref>;
        };
    };
...
```
