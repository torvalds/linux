## Documentation/devicetree/bindings/iio/dac/st,stm32-dac.txt
```
STMicroelectronics STM32 DAC

The STM32 DAC is a 12-bit voltage output digital-to-analog converter. The DAC
may be configured in 8 or 12-bit mode. It has two output channels, each with
its own converter.
It has built-in noise and triangle waveform generator and supports external
triggers for conversions. The DAC's output buffer allows a high drive output
current.

Contents of a stm32 dac root node:
-----------------------------------
Required properties:
- compatible: Must be "st,stm32h7-dac-core".
- reg: Offset and length of the device's register set.
- clocks: Must contain an entry for pclk (which feeds the peripheral bus
  interface)
- clock-names: Must be "pclk".
- vref-supply: Phandle to the vref+ input analog reference supply.
- #address-cells = <1>;
- #size-cells = <0>;

Optional properties:
- resets: Must contain the phandle to the reset controller.
- A pinctrl state named "default" for each DAC channel may be defined to set
  DAC_OUTx pin in mode of operation for analog output on external pin.

Contents of a stm32 dac child node:
-----------------------------------
DAC core node should contain at least one subnode, representing a
DAC instance/channel available on the machine.

Required properties:
- compatible: Must be "st,stm32-dac".
- reg: Must be either 1 or 2, to define (single) channel in use
- #io-channel-cells = <1>: See the IIO bindings section "IIO consumers" in
  Documentation/devicetree/bindings/iio/iio-bindings.txt

Example:
	dac: dac@40007400 {
		compatible = "st,stm32h7-dac-core";
		reg = <0x40007400 0x400>;
		clocks = <&clk>;
		clock-names = "pclk";
		vref-supply = <&reg_vref>;
		pinctrl-names = "default";
		pinctrl-0 = <&dac_out1 &dac_out2>;
		#address-cells = <1>;
		#size-cells = <0>;

		dac1: dac@1 {
			compatible = "st,stm32-dac";
			#io-channels-cells = <1>;
			reg = <1>;
		};

		dac2: dac@2 {
			compatible = "st,stm32-dac";
			#io-channels-cells = <1>;
			reg = <2>;
		};
	};
```

## Documentation/devicetree/bindings/iio/dac/st,stm32-dac.yaml
```yaml
# SPDX-License-Identifier: (GPL-2.0 OR BSD-2-Clause)
%YAML 1.2
---
$id: "http://devicetree.org/schemas/iio/dac/st,stm32-dac.yaml#"
$schema: "http://devicetree.org/meta-schemas/core.yaml#"

title: STMicroelectronics STM32 DAC

description: |
  The STM32 DAC is a 12-bit voltage output digital-to-analog converter. The DAC
  may be configured in 8 or 12-bit mode. It has two output channels, each with
  its own converter.
  It has built-in noise and triangle waveform generator and supports external
  triggers for conversions. The DAC's output buffer allows a high drive output
  current.

maintainers:
  - Fabrice Gasnier <fabrice.gasnier@foss.st.com>

properties:
  compatible:
    enum:
      - st,stm32f4-dac-core
      - st,stm32h7-dac-core

  reg:
    maxItems: 1

  resets:
    maxItems: 1

  clocks:
    maxItems: 1

  clock-names:
    items:
      - const: pclk

  vref-supply:
    description: Phandle to the vref input analog reference voltage.

  '#address-cells':
    const: 1

  '#size-cells':
    const: 0

additionalProperties: false

required:
  - compatible
  - reg
  - clocks
  - clock-names
  - vref-supply
  - '#address-cells'
  - '#size-cells'

patternProperties:
  "^dac@[1-2]+$":
    type: object
    description:
      A DAC block node should contain at least one subnode, representing an
      DAC instance/channel available on the machine.

    properties:
      compatible:
        const: st,stm32-dac

      reg:
        description: Must be either 1 or 2, to define (single) channel in use
        enum: [1, 2]

      '#io-channel-cells':
        const: 1

    additionalProperties: false

    required:
      - compatible
      - reg
      - '#io-channel-cells'

examples:
  - |
    // Example on stm32mp157c
    #include <dt-bindings/clock/stm32mp1-clks.h>
    dac: dac@40017000 {
      compatible = "st,stm32h7-dac-core";
      reg = <0x40017000 0x400>;
      clocks = <&rcc DAC12>;
      clock-names = "pclk";
      vref-supply = <&vref>;
      #address-cells = <1>;
      #size-cells = <0>;

      dac@1 {
        compatible = "st,stm32-dac";
        #io-channel-cells = <1>;
        reg = <1>;
      };

      dac@2 {
        compatible = "st,stm32-dac";
        #io-channel-cells = <1>;
        reg = <2>;
      };
    };

...
```

## Documentation/devicetree/bindings/iio/dac/ti,dac082s085.yaml
```yaml
# SPDX-License-Identifier: (GPL-2.0 OR BSD-2-Clause)
%YAML 1.2
---
$id: http://devicetree.org/schemas/iio/dac/ti,dac082s085.yaml#
$schema: http://devicetree.org/meta-schemas/core.yaml#

title: Texas Instruments DAC082s085 and similar DACs

description:
  A family of Texas Instruments 8/10/12-bit 2/4-channel DACs

maintainers:
  - Lukas Wunner <lukas@wunner.de>

properties:
  compatible:
    enum:
      - ti,dac082s085
      - ti,dac102s085
      - ti,dac122s085
      - ti,dac084s085
      - ti,dac104s085
      - ti,dac124s085

  reg:
    maxItems: 1

  spi-cpha: true
  spi-cpol:
    description:
      Must be either spi-cpha, or spi-cpol but not both.

  vref-supply:
    description: Needed to provide output scaling.

  spi-max-frequency: true

required:
  - compatible
  - reg
  - vref-supply

additionalProperties: false

oneOf:
  - required:
      - spi-cpha
  - required:
      - spi-cpol

examples:
  - |
    vref_2v5_reg: regulator-vref {
        compatible = "regulator-fixed";
        regulator-name = "2v5";
        regulator-min-microvolt = <2500000>;
        regulator-max-microvolt = <2500000>;
        regulator-always-on;
    };
    spi {
        #address-cells = <1>;
        #size-cells = <0>;

        dac@0 {
            compatible = "ti,dac082s085";
            reg = <0>;
            spi-max-frequency = <40000000>;
            spi-cpol;
            vref-supply = <&vref_2v5_reg>;
        };
    };
...
```

## Documentation/devicetree/bindings/iio/dac/ti,dac5571.txt
```
* Texas Instruments DAC5571 Family

Required properties:
 - compatible: Should contain
    "ti,dac5571"
    "ti,dac6571"
    "ti,dac7571"
    "ti,dac5574"
    "ti,dac6574"
    "ti,dac7574"
    "ti,dac5573"
    "ti,dac6573"
    "ti,dac7573"
 - reg: Should contain the DAC I2C address

Optional properties:
 - vref-supply: The regulator supply for DAC reference voltage

Example:
dac@0 {
	compatible = "ti,dac5571";
	reg = <0x4C>;
	vref-supply = <&vdd_supply>;
};
```

## Documentation/devicetree/bindings/iio/dac/ti,dac5571.yaml
```yaml
# SPDX-License-Identifier: (GPL-2.0 OR BSD-2-Clause)
%YAML 1.2
---
$id: http://devicetree.org/schemas/iio/dac/ti,dac5571.yaml#
$schema: http://devicetree.org/meta-schemas/core.yaml#

title: Texas Instruments DAC5571 Family

maintainers:
  - Sean Nyekjaer <sean@geanix.com>

properties:
  compatible:
    enum:
      - ti,dac5571
      - ti,dac6571
      - ti,dac7571
      - ti,dac5574
      - ti,dac6574
      - ti,dac7574
      - ti,dac5573
      - ti,dac6573
      - ti,dac7573
      - ti,dac081c081
      - ti,dac121c081

  reg:
    maxItems: 1

  vref-supply:
    description:
      Reference voltage must be supplied to establish the scaling of the
      output voltage.

required:
  - compatible
  - reg
  - vref-supply

additionalProperties: false

examples:
  - |
    i2c {
        #address-cells = <1>;
        #size-cells = <0>;

        dac@4c {
            compatible = "ti,dac5571";
            reg = <0x4c>;
            vref-supply = <&vdd_supply>;
        };
    };
...
```

## Documentation/devicetree/bindings/iio/dac/ti,dac7311.txt
```
TI DAC7311 device tree bindings

Required properties:
- compatible: must be set to:
	* "ti,dac7311"
	* "ti,dac6311"
	* "ti,dac5311"
- reg: spi chip select number for the device
- vref-supply: The regulator supply for ADC reference voltage

Optional properties:
- spi-max-frequency: Max SPI frequency to use

Example:

	spi_master {
		dac@0 {
			compatible = "ti,dac7311";
			reg = <0>; /* CS0 */
			spi-max-frequency = <1000000>;
			vref-supply = <&vdd_supply>;
		};
	};
```

## Documentation/devicetree/bindings/iio/dac/ti,dac7311.yaml
```yaml
# SPDX-License-Identifier: (GPL-2.0 OR BSD-2-Clause)
%YAML 1.2
---
$id: http://devicetree.org/schemas/iio/dac/ti,dac7311.yaml#
$schema: http://devicetree.org/meta-schemas/core.yaml#

title: Texas Instruments DAC5311 and similar SPI DACs

maintainers:
  - Charles-Antoine Couret <charles-antoine.couret@essensium.com>

properties:
  compatible:
    enum:
      - ti,dac7311
      - ti,dac6311
      - ti,dac5311

  reg:
    maxItems: 1

  vref-supply:
    description:
      Reference voltage must be supplied to establish the scaling of the
      output voltage.

  spi-max-frequency: true

required:
  - compatible
  - reg
  - vref-supply

additionalProperties: false

examples:
  - |
    spi {
        #address-cells = <1>;
        #size-cells = <0>;

        dac@0 {
            compatible = "ti,dac7311";
            reg = <0>; /* CS0 */
            spi-max-frequency = <1000000>;
            vref-supply = <&vdd_supply>;
        };
    };
...
```

## Documentation/devicetree/bindings/iio/dac/ti,dac7512.yaml
```yaml
# SPDX-License-Identifier: (GPL-2.0 OR BSD-2-Clause)
%YAML 1.2
---
$id: http://devicetree.org/schemas/iio/dac/ti,dac7512.yaml#
$schema: http://devicetree.org/meta-schemas/core.yaml#

title: Texas Instruments DAC7512 DAC

maintainers:
  - Jonathan Cameron <jic23@kernel.org>

properties:
  compatible:
    const: ti,dac7512

  reg:
    maxItems: 1

  spi-max-frequency:
    description:
      Maximum frequency is reduced for supply voltage of less than 3.6V
    maximum: 30000000

required:
  - compatible
  - reg

additionalProperties: false

examples:
  - |
    spi {
        #address-cells = <1>;
        #size-cells = <0>;

        dac@0 {
            compatible = "ti,dac7512";
            reg = <0>; /* CS0 */
            spi-max-frequency = <1000000>;
        };
    };
...
```

## Documentation/devicetree/bindings/iio/dac/ti,dac7612.txt
```
* Texas Instruments Dual, 12-Bit Serial Input Digital-to-Analog Converter

The DAC7612 is a dual, 12-bit digital-to-analog converter (DAC) with guaranteed
12-bit monotonicity performance over the industrial temperature range.
Is is programmable through an SPI interface.

The internal DACs are loaded when the LOADDACS pin is pulled down.

http://www.ti.com/lit/ds/sbas106/sbas106.pdf

Required Properties:
- compatible: Should be one of:
		"ti,dac7612"
		"ti,dac7612u"
		"ti,dac7612ub"
- reg: Definition as per Documentation/devicetree/bindings/spi/spi-bus.txt

Optional Properties:
- ti,loaddacs-gpios: GPIO descriptor for the LOADDACS pin.
- spi-*: Definition as per Documentation/devicetree/bindings/spi/spi-bus.txt

Example:

	dac@1 {
		compatible = "ti,dac7612";
		reg = <0x1>;
		ti,loaddacs-gpios = <&msmgpio 25 GPIO_ACTIVE_LOW>;
	};
```

## Documentation/devicetree/bindings/iio/dac/ti,dac7612.yaml
```yaml
# SPDX-License-Identifier: (GPL-2.0 OR BSD-2-Clause)
%YAML 1.2
---
$id: http://devicetree.org/schemas/iio/dac/ti,dac7612.yaml#
$schema: http://devicetree.org/meta-schemas/core.yaml#

title: Texas Instruments DAC7612 family of DACs

description:
  The DAC7612 is a dual, 12-bit digital-to-analog converter (DAC) with
  guaranteed 12-bit monotonicity performance over the industrial temperature
  range. Is is programmable through an SPI interface.

maintainers:
  - Ricardo Ribalda Delgado <ricardo@ribalda.com>

properties:
  compatible:
    enum:
      - ti,dac7612
      - ti,dac7612u
      - ti,dac7612ub

  reg:
    maxItems: 1

  ti,loaddacs-gpios:
    description:
      DACs are loaded when the pin connected to this GPIO is pulled low.
    maxItems: 1

  spi-max-frequency: true

required:
  - compatible
  - reg

additionalProperties: false

examples:
  - |
    #include <dt-bindings/gpio/gpio.h>
    spi {
        #address-cells = <1>;
        #size-cells = <0>;

        dac@1 {
            compatible = "ti,dac7612";
            reg = <0x1>;
            ti,loaddacs-gpios = <&msmgpio 25 GPIO_ACTIVE_LOW>;
        };
    };
...
```

## Documentation/devicetree/bindings/iio/dac/ti-dac082s085.txt
```
Texas Instruments 8/10/12-bit 2/4-channel DAC driver

Required properties:
 - compatible:		Must be one of:
			"ti,dac082s085"
			"ti,dac102s085"
			"ti,dac122s085"
			"ti,dac084s085"
			"ti,dac104s085"
			"ti,dac124s085"
 - reg: 		Chip select number.
 - spi-cpha, spi-cpol:	SPI mode (0,1) or (1,0) must be used, so specify
			either spi-cpha or spi-cpol (but not both).
 - vref-supply: 	Phandle to the external reference voltage supply.

For other required and optional properties of SPI slave nodes please refer to
../../spi/spi-bus.txt.

Example:
	vref_2v5_reg: regulator-vref {
		compatible = "regulator-fixed";
		regulator-name = "2v5";
		regulator-min-microvolt = <2500000>;
		regulator-max-microvolt = <2500000>;
		regulator-always-on;
	};

	dac@0 {
		compatible = "ti,dac082s085";
		reg = <0>;
		spi-max-frequency = <40000000>;
		spi-cpol;
		vref-supply = <&vref_2v5_reg>;
	};
```

## Documentation/devicetree/bindings/iio/dac/vf610-dac.txt
```
Freescale vf610 Digital to Analog Converter bindings

The devicetree bindings are for the new DAC driver written for
vf610 SoCs from Freescale.

Required properties:
- compatible: Should contain "fsl,vf610-dac"
- reg: Offset and length of the register set for the device
- interrupts: Should contain the interrupt for the device
- clocks: The clock is needed by the DAC controller
- clock-names: Must contain "dac" matching entry in the clocks property.

Example:
dac0: dac@400cc000 {
	compatible = "fsl,vf610-dac";
	reg = <0x400cc000 0x1000>;
	interrupts = <55 IRQ_TYPE_LEVEL_HIGH>;
	clock-names = "dac";
	clocks = <&clks VF610_CLK_DAC0>;
};
```
