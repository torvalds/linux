## Documentation/devicetree/bindings/iio/dac/ltc1660.txt
```
* Linear Technology Micropower octal 8-Bit and 10-Bit DACs

Required properties:
 - compatible: Must be one of the following:
		"lltc,ltc1660"
		"lltc,ltc1665"
 - reg: SPI chip select number for the device
 - vref-supply: Phandle to the voltage reference supply

Recommended properties:
 - spi-max-frequency: Definition as per
	 Documentation/devicetree/bindings/spi/spi-bus.txt.
	 Max frequency for this chip is 5 MHz.

Example:
dac@0 {
	compatible = "lltc,ltc1660";
	reg = <0>;
	spi-max-frequency = <5000000>;
	vref-supply = <&vref_reg>;
};
```

## Documentation/devicetree/bindings/iio/dac/ltc2632.txt
```
Linear Technology LTC2632 DAC device driver

Required properties:
 - compatible: Has to contain one of the following:
	lltc,ltc2632-l12
	lltc,ltc2632-l10
	lltc,ltc2632-l8
	lltc,ltc2632-h12
	lltc,ltc2632-h10
	lltc,ltc2632-h8

Property rules described in Documentation/devicetree/bindings/spi/spi-bus.txt
apply. In particular, "reg" and "spi-max-frequency" properties must be given.

Optional properties:
	- vref-supply: Phandle to the external reference voltage supply. This should
	  only be set if there is an external reference voltage connected to the VREF
	  pin. If the property is not set the internal reference is used.

Example:

	vref: regulator-vref {
		compatible = "regulator-fixed";
		regulator-name = "vref-ltc2632";
		regulator-min-microvolt = <1250000>;
		regulator-max-microvolt = <1250000>;
		regulator-always-on;
	};

	spi_master {
		dac: ltc2632@0 {
			compatible = "lltc,ltc2632-l12";
			reg = <0>; /* CS0 */
			spi-max-frequency = <1000000>;
			vref-supply = <&vref>; /* optional */
		};
	};
```

## Documentation/devicetree/bindings/iio/dac/max5821.txt
```
Maxim max5821 DAC device driver

Required properties:
	- compatible: Must be "maxim,max5821"
	- reg: Should contain the DAC I2C address
	- vref-supply: Phandle to the vref power supply

Example:

	max5821@38 {
		compatible = "maxim,max5821";
		reg = <0x38>;
		vref-supply = <&reg_max5821>;
	};
```

## Documentation/devicetree/bindings/iio/dac/maxim,ds4424.yaml
```yaml
# SPDX-License-Identifier: (GPL-2.0 OR BSD-2-Clause)
%YAML 1.2
---
$id: http://devicetree.org/schemas/iio/dac/maxim,ds4424.yaml#
$schema: http://devicetree.org/meta-schemas/core.yaml#

title: Maxim Integrated DS4422/DS4424 7-bit Sink/Source Current DAC

maintainers:
  - Ismail Kose <ihkose@gmail.com>

description: |
  Datasheet publicly available at:
  https://datasheets.maximintegrated.com/en/ds/DS4422-DS4424.pdf

properties:
  compatible:
    enum:
      - maxim,ds4422
      - maxim,ds4424

  reg:
    maxItems: 1

  vcc-supply: true

required:
  - compatible
  - reg

additionalProperties: false

examples:
  - |
    i2c {
        #address-cells = <1>;
        #size-cells = <0>;

        dac@10 {
            compatible = "maxim,ds4424";
            reg = <0x10>; /* When A0, A1 pins are ground */
            vcc-supply = <&vcc_3v3>;
        };
    };
...
```

## Documentation/devicetree/bindings/iio/dac/maxim,max5522.yaml
```yaml
# SPDX-License-Identifier: (GPL-2.0 OR BSD-2-Clause)
%YAML 1.2
---
$id: http://devicetree.org/schemas/iio/dac/maxim,max5522.yaml#
$schema: http://devicetree.org/meta-schemas/core.yaml#

title: Maxim Integrated MAX5522 Dual 10-bit Voltage-Output SPI DACs

maintainers:
  - Angelo Dureghello <angelo.dureghello@timesys.com>
  - Jonathan Cameron <jic23@kernel.org>

description: |
  Datasheet available at:
  https://www.analog.com/en/products/max5522.html

properties:
  compatible:
    const: maxim,max5522

  reg:
    maxItems: 1

  vdd-supply: true
  vrefin-supply: true

required:
  - compatible
  - reg
  - vrefin-supply

allOf:
  - $ref: /schemas/spi/spi-peripheral-props.yaml#

unevaluatedProperties: false

examples:
  - |
    spi {
        #address-cells = <1>;
        #size-cells = <0>;

        dac@0 {
            compatible = "maxim,max5522";
            reg = <0>;
            vrefin-supply = <&vref>;
        };
    };
...
```

## Documentation/devicetree/bindings/iio/dac/maxim,max5821.yaml
```yaml
# SPDX-License-Identifier: (GPL-2.0 OR BSD-2-Clause)
%YAML 1.2
---
$id: http://devicetree.org/schemas/iio/dac/maxim,max5821.yaml#
$schema: http://devicetree.org/meta-schemas/core.yaml#

title: Maxim max5821 dual 10-bit DAC

maintainers:
  - Philippe Reynes <tremyfr@yahoo.fr>

description: |
  Datasheet publicly available at:
  https://datasheets.maximintegrated.com/en/ds/MAX5821.pdf

properties:
  compatible:
    const: maxim,max5821

  reg:
    maxItems: 1

  vref-supply: true

required:
  - compatible
  - reg
  - vref-supply

additionalProperties: false

examples:
  - |
    i2c {
        #address-cells = <1>;
        #size-cells = <0>;

        dac@38 {
            compatible = "maxim,max5821";
            reg = <0x38>;
            vref-supply = <&reg_max5821>;
        };
    };
...
```

## Documentation/devicetree/bindings/iio/dac/mcp4725.txt
```
Microchip mcp4725 and mcp4726 DAC device driver

Required properties:
	- compatible: Must be "microchip,mcp4725" or "microchip,mcp4726"
	- reg: Should contain the DAC I2C address
	- vdd-supply: Phandle to the Vdd power supply. This supply is used as a
	  voltage reference on mcp4725. It is used as a voltage reference on
	  mcp4726 if there is no vref-supply specified.

Optional properties (valid only for mcp4726):
	- vref-supply: Optional phandle to the Vref power supply. Vref pin is
	  used as a voltage reference when this supply is specified.
	- microchip,vref-buffered: Boolean to enable buffering of the external
	  Vref pin. This boolean is not valid without the vref-supply. Quoting
	  the datasheet: This is offered in cases where the reference voltage
	  does not have the current capability not to drop its voltage when
	  connected to the internal resistor ladder circuit.

Examples:

	/* simple mcp4725 */
	mcp4725@60 {
		compatible = "microchip,mcp4725";
		reg = <0x60>;
		vdd-supply = <&vdac_vdd>;
	};

	/* mcp4726 with the buffered external reference voltage */
	mcp4726@60 {
		compatible = "microchip,mcp4726";
		reg = <0x60>;
		vdd-supply = <&vdac_vdd>;
		vref-supply = <&vdac_vref>;
		microchip,vref-buffered;
	};
```

## Documentation/devicetree/bindings/iio/dac/microchip,mcp4725.yaml
```yaml
# SPDX-License-Identifier: (GPL-2.0 OR BSD-2-Clause)
%YAML 1.2
---
$id: http://devicetree.org/schemas/iio/dac/microchip,mcp4725.yaml#
$schema: http://devicetree.org/meta-schemas/core.yaml#

title: Microchip mcp4725 and mcp4726 DAC

maintainers:
  - Tomas Novotny <tomas@novotny.cz>

properties:
  compatible:
    enum:
      - microchip,mcp4725
      - microchip,mcp4726

  reg:
    maxItems: 1

  vdd-supply:
    description: |
      Provides both power and acts as the reference supply on the mcp4725.
      For the mcp4726 it will be used as the reference voltage if vref-supply
      is not provided.

  vref-supply:
    description:
      Vref pin is used as a voltage reference when this supply is specified.

  microchip,vref-buffered:
    type: boolean
    description: |
      Enable buffering of the external Vref pin. This boolean is not valid
      without the vref-supply. Quoting the datasheet: This is offered in
      cases where the reference voltage does not have the current
      capability not to drop its voltage when connected to the internal
      resistor ladder circuit.

allOf:
  - if:
      not:
        properties:
          compatible:
            contains:
              const: microchip,mcp4726
    then:
      properties:
        vref-supply: false
        microchip,vref-buffered: false

required:
  - compatible
  - reg
  - vdd-supply

additionalProperties: false

examples:
  - |
    i2c {
        #address-cells = <1>;
        #size-cells = <0>;

        mcp4725@60 {
            compatible = "microchip,mcp4725";
            reg = <0x60>;
            vdd-supply = <&vdac_vdd>;
        };
    };
...
```

## Documentation/devicetree/bindings/iio/dac/microchip,mcp4728.yaml
```yaml
# SPDX-License-Identifier: (GPL-2.0 OR BSD-2-Clause)
%YAML 1.2
---

$id: http://devicetree.org/schemas/iio/dac/microchip,mcp4728.yaml#
$schema: http://devicetree.org/meta-schemas/core.yaml#

title: Microchip MCP4728 DAC

maintainers:
  - Andrea Collamati <andrea.collamati@gmail.com>

description: |
  MCP4728 is a quad channel, 12-bit voltage output
  Digital-to-Analog Converter with non-volatile
  memory and I2C compatible Serial Interface.
  https://www.microchip.com/en-us/product/mcp4728

properties:
  compatible:
    const: microchip,mcp4728

  reg:
    maxItems: 1

  vdd-supply:
    description: |
      Provides both power and acts as the reference supply on the MCP4728
      when Internal Vref is not selected.

required:
  - compatible
  - reg
  - vdd-supply

additionalProperties: false

examples:
  - |
    i2c {
        #address-cells = <1>;
        #size-cells = <0>;

        dac@60 {
            compatible = "microchip,mcp4728";
            reg = <0x60>;
            vdd-supply = <&vdac_vdd>;
        };
    };
```

## Documentation/devicetree/bindings/iio/dac/microchip,mcp4821.yaml
```yaml
# SPDX-License-Identifier: (GPL-2.0 OR BSD-2-Clause)
%YAML 1.2
---
$id: http://devicetree.org/schemas/iio/dac/microchip,mcp4821.yaml#
$schema: http://devicetree.org/meta-schemas/core.yaml#

title: Microchip MCP4821 and similar DACs

description: |
  Supports MCP48x1 (single channel) and MCP48x2 (dual channel) series of DACs.
  Device supports simplex communication over SPI in Mode 0 and Mode 3.

  +---------+--------------+-------------+
  | Device  |  Resolution  |   Channels  |
  |---------|--------------|-------------|
  | MCP4801 |     8-bit    |      1      |
  | MCP4802 |     8-bit    |      2      |
  | MCP4811 |    10-bit    |      1      |
  | MCP4812 |    10-bit    |      2      |
  | MCP4821 |    12-bit    |      1      |
  | MCP4822 |    12-bit    |      2      |
  +---------+--------------+-------------+

  Datasheet:
    MCP48x1: https://ww1.microchip.com/downloads/en/DeviceDoc/22244B.pdf
    MCP48x2: https://ww1.microchip.com/downloads/en/DeviceDoc/20002249B.pdf

maintainers:
  - Anshul Dalal <anshulusr@gmail.com>

allOf:
  - $ref: /schemas/spi/spi-peripheral-props.yaml#

properties:
  compatible:
    enum:
      - microchip,mcp4801
      - microchip,mcp4802
      - microchip,mcp4811
      - microchip,mcp4812
      - microchip,mcp4821
      - microchip,mcp4822

  reg:
    maxItems: 1

  vdd-supply: true

  ldac-gpios:
    description: |
      Active Low LDAC (Latch DAC Input) pin used to update the DAC output.
    maxItems: 1

  powerdown-gpios:
    description: |
      Active Low SHDN pin used to enter the shutdown mode.
    maxItems: 1

  spi-cpha: true
  spi-cpol: true

required:
  - compatible
  - reg
  - vdd-supply

additionalProperties: false

examples:
  - |
    #include <dt-bindings/gpio/gpio.h>

    spi {
        #address-cells = <1>;
        #size-cells = <0>;

        dac@0 {
            compatible = "microchip,mcp4821";
            reg = <0>;
            vdd-supply = <&vdd_regulator>;
            ldac-gpios = <&gpio0 1 GPIO_ACTIVE_HIGH>;
            powerdown-gpios = <&gpio0 2 GPIO_ACTIVE_HIGH>;
            spi-cpha;
            spi-cpol;
        };
    };
```

## Documentation/devicetree/bindings/iio/dac/microchip,mcp4922.yaml
```yaml
# SPDX-License-Identifier: (GPL-2.0 OR BSD-2-Clause)
%YAML 1.2
---
$id: http://devicetree.org/schemas/iio/dac/microchip,mcp4922.yaml#
$schema: http://devicetree.org/meta-schemas/core.yaml#

title: Microchip MCP4902, MCP4912 and MPC4922 dual output SPI DACs

maintainers:
  - Jonathan Cameron <jic23@kernel.org>
  - Michael Welling <mwelling@ieee.org>

properties:
  compatible:
    enum:
      - microchip,mcp4902
      - microchip,mcp4912
      - microchip,mcp4922

  reg:
    maxItems: 1

  spi-max-frequency: true

  vref-supply: true

additionalProperties: false

required:
  - compatible
  - reg
  - vref-supply

examples:
  - |
    spi {
        #address-cells = <1>;
        #size-cells = <0>;

        dac@0 {
            compatible = "microchip,mcp4912";
            reg = <0>;
            vref-supply = <&dac_vref>;
        };
    };
...
```

## Documentation/devicetree/bindings/iio/dac/nxp,lpc1850-dac.yaml
```yaml
# SPDX-License-Identifier: (GPL-2.0 OR BSD-2-Clause)
%YAML 1.2
---
$id: http://devicetree.org/schemas/iio/dac/nxp,lpc1850-dac.yaml#
$schema: http://devicetree.org/meta-schemas/core.yaml#

title: NXP LPC1850 DAC

maintainers:
  - Jonathan Cameron <jic23@kernel.org>

description:
  Supports the DAC found on the LPC1850 SoC.

properties:
  compatible:
    const: nxp,lpc1850-dac

  reg:
    maxItems: 1

  interrupts:
    maxItems: 1

  clocks:
    maxItems: 1

  vref-supply: true

  resets:
    maxItems: 1

required:
  - compatible
  - reg
  - interrupts
  - clocks
  - vref-supply
  - resets

additionalProperties: false

examples:
  - |
    #include <dt-bindings/clock/lpc18xx-ccu.h>
    soc {
        #address-cells = <1>;
        #size-cells = <1>;
        dac: dac@400e1000 {
            compatible = "nxp,lpc1850-dac";
            reg = <0x400e1000 0x1000>;
            interrupts = <0>;
            clocks = <&ccu1 CLK_APB3_DAC>;
            vref-supply = <&reg_vdda>;
            resets = <&rgu 42>;
        };
    };
...
```

## Documentation/devicetree/bindings/iio/dac/rohm,bd79703.yaml
```yaml
# SPDX-License-Identifier: (GPL-2.0 OR BSD-2-Clause)
# Copyright 2024 ROHM Semiconductor.
%YAML 1.2
---
$id: http://devicetree.org/schemas/iio/dac/rohm,bd79703.yaml#
$schema: http://devicetree.org/meta-schemas/core.yaml#

title: ROHM BD79700, BD79701, BD79702 and BD79703 DACs

maintainers:
  - Matti Vaittinen <mazziesaccount@gmail.com>

description: |
  The ROHM BD7970[0,1,2,3] are 8-bit DACs. The BD79700 has 2 channels,
  BD79701 3 channels, BD79702 4 channels and BD79703 has 6 channels.
  Datasheets for BD79702 and BD79703 can be found from
  https://fscdn.rohm.com/en/products/databook/datasheet/ic/data_converter/dac/bd79702fv-lb_bd79703fv-lb-e.pdf
  and for the BD79700 and the BD79701 from
  https://fscdn.rohm.com/en/products/databook/datasheet/ic/data_converter/dac/bd79700fvm-lb_bd79701fvm-lb-e.pdf

properties:
  compatible:
    enum:
      - rohm,bd79700
      - rohm,bd79701
      - rohm,bd79702
      - rohm,bd79703

  reg:
    maxItems: 1

  spi-max-frequency:
    maximum: 30000000

  vfs-supply:
    description:
      The regulator to use as a full scale voltage. The voltage should be
      between 2.7V .. VCC. Not present on BD79700 and BD79701.

  vcc-supply:
    description:
      The regulator supplying the operating voltage. Should be between
      2.7V ... 5.5V. Is used also as a Vfs on BD79700 and BD79701.

required:
  - compatible
  - reg
  - spi-max-frequency
  - vcc-supply

if:
  properties:
    compatible:
      contains:
        enum:
          - rohm,bd79702
          - rohm,bd79703
then:
  required:
    - vfs-supply

allOf:
  - $ref: /schemas/spi/spi-peripheral-props.yaml#

unevaluatedProperties: false

examples:
  - |
    spi {
        #address-cells = <1>;
        #size-cells = <0>;

        dac@0 {
            compatible = "rohm,bd79703";
            reg = <0>;
            spi-max-frequency = <30000000>;
            vcc-supply = <&vcc>;
            vfs-supply = <&vref>;
        };
    };
...
```
