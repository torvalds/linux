## Documentation/devicetree/bindings/iio/resolver/adi,ad2s1210.yaml
```yaml
# SPDX-License-Identifier: (GPL-2.0-only OR BSD-2-Clause)
%YAML 1.2
---
$id: http://devicetree.org/schemas/iio/resolver/adi,ad2s1210.yaml#
$schema: http://devicetree.org/meta-schemas/core.yaml#

title: Analog Devices AD2S1210 Resolver-to-Digital Converter

maintainers:
  - Michael Hennerich <michael.hennerich@analog.com>

description: |
  The AD2S1210 is a complete 10-bit to 16-bit resolution tracking
  resolver-to-digital converter, integrating an on-board programmable
  sinusoidal oscillator that provides sine wave excitation for
  resolvers.

  The AD2S1210 allows the user to read the angular position or the
  angular velocity data directly from the parallel outputs or through
  the serial interface.

  The mode of operation of the communication channel (parallel or serial) is
  selected by the A0 and A1 input pins. In normal mode, data is latched by
  toggling the SAMPLE line and can then be read directly. In configuration mode,
  data is read or written using a register access scheme (address byte with
  read/write flag and data byte).

    A1  A0  Result
     0   0  Normal mode - position output
     0   1  Normal mode - velocity output
     1   0  Reserved
     1   1  Configuration mode

  In normal mode, the resolution of the digital output is selected using
  the RES0 and RES1 input pins. In configuration mode, the resolution is
  selected by setting the RES0 and RES1 bits in the control register.

  RES1  RES0  Resolution (Bits)
     0     0  10
     0     1  12
     1     0  14
     1     1  16

  Note on SPI connections: The CS line on the AD2S1210 should hard-wired to
  logic low and the WR/FSYNC line on the AD2S1210 should be connected to the
  SPI CSn output of the SPI controller.

  Datasheet:
  https://www.analog.com/media/en/technical-documentation/data-sheets/ad2s1210.pdf

properties:
  compatible:
    const: adi,ad2s1210

  reg:
    maxItems: 1

  spi-max-frequency:
    maximum: 25000000

  spi-cpha: true

  avdd-supply:
    description:
      A 4.75 to 5.25 V regulator that powers the Analog Supply Voltage (AVDD)
      pin.

  dvdd-supply:
    description:
      A 4.75 to 5.25 V regulator that powers the Digital Supply Voltage (DVDD)
      pin.

  vdrive-supply:
    description:
      A 2.3 to 5.25 V regulator that powers the Logic Power Supply Input
      (VDrive) pin.

  clocks:
    maxItems: 1
    description: External oscillator clock (CLKIN).

  reset-gpios:
    description:
      GPIO connected to the /RESET pin. As the line needs to be low for the
      reset to be active, it should be configured as GPIO_ACTIVE_LOW.
    maxItems: 1

  sample-gpios:
    description:
      GPIO connected to the /SAMPLE pin. As the line needs to be low to trigger
      a sample, it should be configured as GPIO_ACTIVE_LOW.
    maxItems: 1

  mode-gpios:
    description:
      GPIO lines connected to the A0 and A1 pins. These pins select the data
      transfer mode.
    minItems: 2
    maxItems: 2

  resolution-gpios:
    description:
      GPIO lines connected to the RES0 and RES1 pins. These pins select the
      resolution of the digital output. If omitted, it is assumed that the
      RES0 and RES1 pins are hard-wired to match the assigned-resolution-bits
      property.
    minItems: 2
    maxItems: 2

  fault-gpios:
    description:
      GPIO lines connected to the LOT and DOS pins. These pins combined indicate
      the type of fault present, if any. As these pins a pulled low to indicate
      a fault condition, they should be configured as GPIO_ACTIVE_LOW.
    minItems: 2
    maxItems: 2

  adi,fixed-mode:
    description:
      This is used to indicate the selected mode if A0 and A1 are hard-wired
      instead of connected to GPIOS (i.e. mode-gpios is omitted).
    $ref: /schemas/types.yaml#/definitions/string
    enum: [config, velocity, position]

  assigned-resolution-bits:
    description:
      Resolution of the digital output required by the application. This
      determines the precision of the angle and/or the maximum speed that can
      be measured. If resolution-gpios is omitted, it is assumed that RES0 and
      RES1 are hard-wired to match this value.
    enum: [10, 12, 14, 16]

required:
  - compatible
  - reg
  - spi-cpha
  - avdd-supply
  - dvdd-supply
  - vdrive-supply
  - clocks
  - sample-gpios
  - assigned-resolution-bits

oneOf:
  - required:
      - mode-gpios
  - required:
      - adi,fixed-mode

allOf:
  - $ref: /schemas/spi/spi-peripheral-props.yaml#

unevaluatedProperties: false

examples:
  - |
    #include <dt-bindings/gpio/gpio.h>

    spi {
        #address-cells = <1>;
        #size-cells = <0>;

        resolver@0 {
            compatible = "adi,ad2s1210";
            reg = <0>;
            spi-max-frequency = <20000000>;
            spi-cpha;
            avdd-supply = <&avdd_regulator>;
            dvdd-supply = <&dvdd_regulator>;
            vdrive-supply = <&vdrive_regulator>;
            clocks = <&ext_osc>;
            sample-gpios = <&gpio0 90 GPIO_ACTIVE_LOW>;
            mode-gpios = <&gpio0 86 0>, <&gpio0 87 0>;
            resolution-gpios = <&gpio0 88 0>, <&gpio0 89 0>;
            assigned-resolution-bits = <16>;
        };
    };
```

## Documentation/devicetree/bindings/iio/resolver/adi,ad2s90.yaml
```yaml
# SPDX-License-Identifier: (GPL-2.0 OR BSD-2-Clause)
%YAML 1.2
---
$id: http://devicetree.org/schemas/iio/resolver/adi,ad2s90.yaml#
$schema: http://devicetree.org/meta-schemas/core.yaml#

title: Analog Devices AD2S90 Resolver-to-Digital Converter

maintainers:
  - Matheus Tavares <matheus.bernardino@usp.br>

description: |
  Datasheet: https://www.analog.com/en/products/ad2s90.html

properties:
  compatible:
    const: adi,ad2s90

  reg:
    maxItems: 1

  spi-max-frequency:
    maximum: 830000
    description: |
      Chip's max frequency, as specified in its datasheet, is 2Mhz. But a 600ns
      delay is expected between the application of a logic LO to CS and the
      application of SCLK, as also specified. And since the delay is not
      implemented in the spi code, to satisfy it, SCLK's period should be at
      most 2 * 600ns, so the max frequency should be 1 / (2 * 6e-7), which gives
      roughly 830000Hz.

  spi-cpol: true

  spi-cpha: true

required:
  - compatible
  - reg

dependencies:
  spi-cpol: [ spi-cpha ]
  spi-cpha: [ spi-cpol ]

allOf:
  - $ref: /schemas/spi/spi-peripheral-props.yaml#

unevaluatedProperties: false

examples:
  - |
    spi {
        #address-cells = <1>;
        #size-cells = <0>;

        resolver@0 {
            compatible = "adi,ad2s90";
            reg = <0>;
            spi-max-frequency = <830000>;
            spi-cpol;
            spi-cpha;
        };
    };
...
```

## Documentation/devicetree/bindings/iio/samsung,sensorhub-rinato.yaml
```yaml
# SPDX-License-Identifier: (GPL-2.0 OR BSD-2-Clause)
%YAML 1.2
---
$id: http://devicetree.org/schemas/iio/samsung,sensorhub-rinato.yaml#
$schema: http://devicetree.org/meta-schemas/core.yaml#

title: Samsung Sensorhub driver

maintainers:
  - Jonathan Cameron <jic23@kernel.org>

description: |
  Sensorhub is a MCU which manages several sensors and also plays the role
  of a virtual sensor device.

properties:
  compatible:
    enum:
      - samsung,sensorhub-rinato
      - samsung,sensorhub-thermostat

  reg:
    maxItems: 1

  interrupts:
    maxItems: 1

  ap-mcu-gpios:
    maxItems: 1
    description:
      Application Processor to sensorhub line - used during communication

  mcu-ap-gpios:
    maxItems: 1
    description:
      Sensorhub to Application Processor - used during communication

  mcu-reset-gpios:
    maxItems: 1
    description:
      Reset the sensorhub.

  spi-max-frequency: true

additionalProperties: false

required:
  - compatible
  - reg
  - interrupts
  - ap-mcu-gpios
  - mcu-ap-gpios
  - mcu-reset-gpios

examples:
  - |
    spi {
        #address-cells = <1>;
        #size-cells = <0>;

        sensorhub@0 {
            compatible = "samsung,sensorhub-rinato";
            reg = <0>;
            spi-max-frequency = <5000000>;
            interrupt-parent = <&gpx0>;
            interrupts = <2 0>;
            ap-mcu-gpios = <&gpx0 0 0>;
            mcu-ap-gpios = <&gpx0 4 0>;
            mcu-reset-gpios = <&gpx0 5 0>;
        };
    };
...
```

## Documentation/devicetree/bindings/iio/sensorhub.txt
```
Samsung Sensorhub driver

Sensorhub is a MCU which manages several sensors and also plays the role
of a virtual sensor device.

Required properties:
- compatible: "samsung,sensorhub-rinato" or "samsung,sensorhub-thermostat"
- spi-max-frequency: max SPI clock frequency
- interrupts: communication interrupt
- ap-mcu-gpios: [out] ap to sensorhub line - used during communication
- mcu-ap-gpios: [in] sensorhub to ap - used during communication
- mcu-reset-gpios: [out] sensorhub reset

Example:

	shub_spi: shub {
		compatible = "samsung,sensorhub-rinato";
		spi-max-frequency = <5000000>;
		interrupt-parent = <&gpx0>;
		interrupts = <2 0>;
		ap-mcu-gpios = <&gpx0 0 0>;
		mcu-ap-gpios = <&gpx0 4 0>;
		mcu-reset-gpios = <&gpx0 5 0>;
	};
```

## Documentation/devicetree/bindings/iio/st,st-sensors.yaml
```yaml
# SPDX-License-Identifier: (GPL-2.0-only OR BSD-2-Clause)
%YAML 1.2
---
$id: http://devicetree.org/schemas/iio/st,st-sensors.yaml#
$schema: http://devicetree.org/meta-schemas/core.yaml#

title: STMicroelectronics MEMS sensors

description: The STMicroelectronics sensor devices are pretty straight-forward
  I2C or SPI devices, all sharing the same device tree descriptions no matter
  what type of sensor it is.
  Note that whilst this covers many STMicro MEMs sensors, some more complex
  IMUs need their own bindings.

maintainers:
  - Denis Ciocca <denis.ciocca@st.com>
  - Linus Walleij <linus.walleij@linaro.org>

properties:
  compatible:
    oneOf:
      - description: STMicroelectronics Accelerometers
        enum:
          - st,h3lis331dl-accel
          - st,lis2de12
          - st,lis2dw12
          - st,lis2hh12
          - st,lis2dh12-accel
          - st,lis302dl
          - st,lis331dl-accel
          - st,lis331dlh-accel
          - st,lis3de
          - st,lis3dh-accel
          - st,lis3dhh
          - st,lis3l02dq
          - st,lis3lv02dl-accel
          - st,lng2dm-accel
          - st,lsm303agr-accel
          - st,lsm303c-accel
          - st,lsm303dl-accel
          - st,lsm303dlh-accel
          - st,lsm303dlhc-accel
          - st,lsm303dlm-accel
          - st,lsm330-accel
          - st,lsm330d-accel
          - st,lsm330dl-accel
          - st,lsm330dlc-accel
      - items:
          - const: st,iis328dq
          - const: st,h3lis331dl-accel
      - description: Silan Accelerometers
        enum:
          - silan,sc7a20
      - description: STMicroelectronics Gyroscopes
        enum:
          - st,l3g4200d-gyro
          - st,l3g4is-gyro
          - st,l3gd20-gyro
          - st,l3gd20h-gyro
          - st,lsm330-gyro
          - st,lsm330d-gyro
          - st,lsm330dl-gyro
          - st,lsm330dlc-gyro
          - st,lsm9ds0-gyro
      - description: STMicroelectronics Magnetometers
        enum:
          - st,lis2mdl
          - st,lis3mdl-magn
          - st,lsm303agr-magn
          - st,lsm303c-magn
          - st,lsm303dlh-magn
          - st,lsm303dlhc-magn
          - st,lsm303dlm-magn
          - st,lsm9ds1-magn
      - description: STMicroelectronics Pressure Sensors
        enum:
          - st,lps001wp-press
          - st,lps22df
          - st,lps22hb-press
          - st,lps22hh
          - st,lps25h-press
          - st,lps331ap-press
          - st,lps33hw
          - st,lps35hw
      - description: IMUs
        enum:
          - st,lsm303d-imu
          - st,lsm9ds0-imu
      - description: Deprecated bindings
        enum:
          - st,lis302dl-spi
          - st,lis3lv02d
        deprecated: true

  reg:
    maxItems: 1

  interrupts:
    description: interrupt line(s) connected to the DRDY line(s) and/or the
      Intertial interrupt lines INT1 and INT2 if these exist. This means up to
      three interrupts, and the DRDY must be the first one if it exists on
      the package. The trigger edge of the interrupts is sometimes software
      configurable in the hardware so the operating system should parse this
      flag and set up the trigger edge as indicated in the device tree.
    minItems: 1
    maxItems: 2

  vdd-supply: true
  vddio-supply: true

  st,drdy-int-pin:
    description: the pin on the package that will be used to signal
      "data ready" (valid values 1 or 2). This property is not configurable
      on all sensors.
    $ref: /schemas/types.yaml#/definitions/uint32
    enum: [1, 2]

  drive-open-drain:
    $ref: /schemas/types.yaml#/definitions/flag
    description: the interrupt/data ready line will be configured
      as open drain, which is useful if several sensors share the same
      interrupt line. (This binding is taken from pinctrl.)

  mount-matrix:
    description: an optional 3x3 mounting rotation matrix.

allOf:
  - if:
      properties:
        compatible:
          enum:
            # These have no interrupts
            - st,lps001wp
    then:
      properties:
        interrupts: false
        st,drdy-int-pin: false
        drive-open-drain: false

  - if:
      properties:
        compatible:
          enum:
            # These have only DRDY
            - st,lis2mdl
            - st,lis3l02dq
            - st,lis3lv02dl-accel
            - st,lps22df
            - st,lps22hb-press
            - st,lps22hh
            - st,lps25h-press
            - st,lps33hw
            - st,lps35hw
            - st,lsm303agr-magn
            - st,lsm303dlh-magn
            - st,lsm303dlhc-magn
            - st,lsm303dlm-magn
    then:
      properties:
        interrupts:
          maxItems: 1
        st,drdy-int-pin: false

required:
  - compatible
  - reg

additionalProperties: false

examples:
  - |
    #include <dt-bindings/interrupt-controller/irq.h>
    i2c {
      #address-cells = <1>;
      #size-cells = <0>;

      accelerometer@1c {
        compatible = "st,lis331dl-accel";
        reg = <0x1c>;
        st,drdy-int-pin = <1>;
        vdd-supply = <&ldo1>;
        vddio-supply = <&ldo2>;
        interrupt-parent = <&gpio>;
        interrupts = <18 IRQ_TYPE_EDGE_RISING>, <19 IRQ_TYPE_EDGE_RISING>;
      };
    };
    spi {
      #address-cells = <1>;
      #size-cells = <0>;
      num-cs = <1>;

      l3g4200d: gyroscope@0 {
        compatible = "st,l3g4200d-gyro";
        st,drdy-int-pin = <2>;
        reg = <0>;
        vdd-supply = <&vcc_io>;
        vddio-supply = <&vcc_io>;
      };
    };
...
```
