## Documentation/devicetree/bindings/iio/proximity/semtech,sx9324.yaml
```yaml
# SPDX-License-Identifier: (GPL-2.0-only OR BSD-2-Clause)
%YAML 1.2
---
$id: http://devicetree.org/schemas/iio/proximity/semtech,sx9324.yaml#
$schema: http://devicetree.org/meta-schemas/core.yaml#

title: Semtech's SX9324 capacitive proximity sensor

maintainers:
  - Gwendal Grignou <gwendal@chromium.org>
  - Daniel Campello <campello@chromium.org>

description: |
  Semtech's SX9324 proximity sensor.

allOf:
  - $ref: /schemas/iio/iio.yaml#

properties:
  compatible:
    const: semtech,sx9324

  reg:
    maxItems: 1

  interrupts:
    description:
      Generated by device to announce preceding read request has finished
      and data is available or that a close/far proximity event has happened.
    maxItems: 1

  vdd-supply:
    description: Main power supply

  svdd-supply:
    description: Host interface power supply

  "#io-channel-cells":
    const: 1

  semtech,ph0-pin:
    $ref: /schemas/types.yaml#/definitions/uint32-array
    description: |
      Array of 3 entries. Index represent the id of the CS pin.
      Value indicates how each CS pin is used during phase 0.
      Each of the 3 pins have the following value -
      0 : unused (high impedance)
      1 : measured input
      2 : dynamic shield
      3 : grounded.
      For instance, CS0 measured, CS1 shield and CS2 ground is [1, 2, 3]
    items:
      enum: [ 0, 1, 2, 3 ]
    minItems: 3
    maxItems: 3

  semtech,ph1-pin:
    $ref: /schemas/types.yaml#/definitions/uint32-array
    description: Same as ph0-pin for phase 1.
    items:
      enum: [ 0, 1, 2, 3 ]
    minItems: 3
    maxItems: 3

  semtech,ph2-pin:
    $ref: /schemas/types.yaml#/definitions/uint32-array
    description: Same as ph0-pin for phase 2.
    items:
      enum: [ 0, 1, 2, 3 ]
    minItems: 3
    maxItems: 3

  semtech,ph3-pin:
    $ref: /schemas/types.yaml#/definitions/uint32-array
    description: Same as ph0-pin for phase 3.
    items:
      enum: [ 0, 1, 2, 3 ]
    minItems: 3
    maxItems: 3


  semtech,ph01-resolution:
    $ref: /schemas/types.yaml#/definitions/uint32
    enum: [8, 16, 32, 64, 128, 256, 512, 1024]
    description:
      Capacitance measurement resolution. For phase 0 and 1.
      Higher the number, higher the resolution.
    default: 128

  semtech,ph23-resolution:
    $ref: /schemas/types.yaml#/definitions/uint32
    enum: [8, 16, 32, 64, 128, 256, 512, 1024]
    description:
      Capacitance measurement resolution. For phase 2 and 3
    default: 128

  semtech,startup-sensor:
    $ref: /schemas/types.yaml#/definitions/uint32
    enum: [0, 1, 2, 3]
    default: 0
    description: |
      Phase used for start-up proximity detection.
      It is used when we enable a phase to remove static offset and measure
      only capacitance changes introduced by the user.

  semtech,ph01-proxraw-strength:
    $ref: /schemas/types.yaml#/definitions/uint32
    minimum: 0
    maximum: 7
    default: 1
    description:
      PROXRAW filter strength for phase 0 and 1. A value of 0 represents off,
      and other values represent 1-1/2^N.

  semtech,ph23-proxraw-strength:
    $ref: /schemas/types.yaml#/definitions/uint32
    minimum: 0
    maximum: 7
    default: 1
    description:
      Same as proxraw-strength01, for phase 2 and 3.

  semtech,avg-pos-strength:
    $ref: /schemas/types.yaml#/definitions/uint32
    enum: [0, 16, 64, 128, 256, 512, 1024, 4294967295]
    default: 16
    description: |
      Average positive filter strength. A value of 0 represents off and
      UINT_MAX (4294967295) represents infinite. Other values
      represent 1-1/N.

  semtech,cs-idle-sleep:
    description:
      State of CS pins during sleep mode and idle time.
    enum:
      - hi-z
      - gnd
      - vdd

  semtech,int-comp-resistor:
    description:
      Internal resistor setting for compensation.
    enum:
      - lowest
      - low
      - high
      - highest

  semtech,input-precharge-resistor-ohms:
    default: 4000
    multipleOf: 2000
    minimum: 0
    maximum: 30000
    description:
      Pre-charge input resistance in Ohm.

  semtech,input-analog-gain:
    $ref: /schemas/types.yaml#/definitions/uint32
    minimum: 0
    maximum: 3
    description: |
      Defines the input antenna analog gain
      0: x1.247
      1: x1 (default)
      2: x0.768
      3: x0.552

required:
  - compatible
  - reg
  - "#io-channel-cells"

unevaluatedProperties: false

examples:
  - |
    #include <dt-bindings/interrupt-controller/irq.h>
    i2c {
      #address-cells = <1>;
      #size-cells = <0>;
      proximity@28 {
        compatible = "semtech,sx9324";
        reg = <0x28>;
        interrupt-parent = <&pio>;
        interrupts = <5 IRQ_TYPE_LEVEL_LOW 5>;
        vdd-supply = <&pp3300_a>;
        svdd-supply = <&pp1800_prox>;
        #io-channel-cells = <1>;
        semtech,ph0-pin = <1 2 3>;
        semtech,ph1-pin = <3 2 1>;
        semtech,ph2-pin = <1 2 3>;
        semtech,ph3-pin = <3 2 1>;
        semtech,ph01-resolution = <256>;
        semtech,ph23-resolution = <256>;
        semtech,startup-sensor = <1>;
        semtech,ph01-proxraw-strength = <2>;
        semtech,ph23-proxraw-strength = <2>;
        semtech,avg-pos-strength = <64>;
        semtech,int-comp-resistor = "lowest";
        semtech,input-precharge-resistor-ohms = <2000>;
        semtech,cs-idle-sleep = "gnd";
      };
    };
```

## Documentation/devicetree/bindings/iio/proximity/semtech,sx9360.yaml
```yaml
# SPDX-License-Identifier: (GPL-2.0-only OR BSD-2-Clause)
%YAML 1.2
---
$id: http://devicetree.org/schemas/iio/proximity/semtech,sx9360.yaml#
$schema: http://devicetree.org/meta-schemas/core.yaml#

title: Semtech's SX9360 capacitive proximity sensor

maintainers:
  - Gwendal Grignou <gwendal@chromium.org>
  - Daniel Campello <campello@chromium.org>

description: |
  Semtech's SX9360 proximity sensor.

properties:
  compatible:
    const: semtech,sx9360

  reg:
    maxItems: 1

  interrupts:
    description:
      Generated by device to announce preceding read request has finished
      and data is available or that a close/far proximity event has happened.
    maxItems: 1

  vdd-supply:
    description: Main power supply

  svdd-supply:
    description: Host interface power supply

  "#io-channel-cells":
    const: 1

  semtech,resolution:
    $ref: /schemas/types.yaml#/definitions/uint32-array
    enum: [8, 16, 32, 64, 128, 256, 512, 1024]
    description:
      Capacitance measurement resolution. For both phases, "reference" and
      "measurement". Higher the number, higher the resolution.
    default: 128

  semtech,proxraw-strength:
    $ref: /schemas/types.yaml#/definitions/uint32
    minimum: 0
    maximum: 7
    default: 1
    description:
      PROXRAW filter strength for both phases. A value of 0 represents off,
      and other values represent 1-1/2^N.

  semtech,avg-pos-strength:
    $ref: /schemas/types.yaml#/definitions/uint32
    enum: [0, 16, 64, 128, 256, 512, 1024, 4294967295]
    default: 16
    description: |
      Average positive filter strength. A value of 0 represents off and
      UINT_MAX (4294967295) represents infinite. Other values
      represent 1-1/N.

required:
  - compatible
  - reg
  - "#io-channel-cells"

additionalProperties: false

examples:
  - |
    #include <dt-bindings/interrupt-controller/irq.h>
    i2c {
      #address-cells = <1>;
      #size-cells = <0>;
      proximity@28 {
        compatible = "semtech,sx9360";
        reg = <0x28>;
        interrupt-parent = <&pio>;
        interrupts = <5 IRQ_TYPE_LEVEL_LOW 5>;
        vdd-supply = <&pp3300_a>;
        svdd-supply = <&pp1800_prox>;
        #io-channel-cells = <1>;
        semtech,resolution = <256>;
        semtech,proxraw-strength = <2>;
        semtech,avg-pos-strength = <64>;
      };
    };
```

## Documentation/devicetree/bindings/iio/proximity/semtech,sx9500.yaml
```yaml
# SPDX-License-Identifier: (GPL-2.0 OR BSD-2-Clause)
%YAML 1.2
---
$id: http://devicetree.org/schemas/iio/proximity/semtech,sx9500.yaml#
$schema: http://devicetree.org/meta-schemas/core.yaml#

title: Semtech's SX9500 capacitive proximity button device

maintainers:
  - Jonathan Cameron <jic23@kernel.org>

properties:
  compatible:
    const: semtech,sx9500

  reg:
    maxItems: 1

  interrupts:
    maxItems: 1

  reset-gpios:
    description:
      GPIO connected to the active low reset pin.
    maxItems: 1

required:
  - compatible
  - reg
  - interrupts

additionalProperties: false

examples:
  - |
    #include <dt-bindings/interrupt-controller/irq.h>
    #include <dt-bindings/gpio/gpio.h>
    i2c {
        #address-cells = <1>;
        #size-cells = <0>;

        proximity@28 {
            compatible = "semtech,sx9500";
            reg = <0x28>;
            interrupt-parent = <&gpio2>;
            interrupts = <16 IRQ_TYPE_LEVEL_LOW>;
            reset-gpios = <&gpio2 10 GPIO_ACTIVE_LOW>;
        };
    };
...
```

## Documentation/devicetree/bindings/iio/proximity/sx9500.txt
```
Semtech's SX9500 capacitive proximity button device driver

Required properties:
	- compatible: must be "semtech,sx9500"
	- reg: i2c address where to find the device
	- interrupts : the sole interrupt generated by the device

	Refer to interrupt-controller/interrupts.txt for generic
	interrupt client node bindings.

Optional properties:
	- reset-gpios: Reference to the GPIO connected to the device's active
	  low reset pin.

Example:

sx9500@28 {
	compatible = "semtech,sx9500";
	reg = <0x28>;
	interrupt-parent = <&gpio2>;
	interrupts = <16 IRQ_TYPE_LEVEL_LOW>;
	reset-gpios = <&gpio2 10 GPIO_ACTIVE_LOW>;
};
```

## Documentation/devicetree/bindings/iio/proximity/tyhx,hx9023s.yaml
```yaml
# SPDX-License-Identifier: (GPL-2.0-only OR BSD-2-Clause)
%YAML 1.2
---
$id: http://devicetree.org/schemas/iio/proximity/tyhx,hx9023s.yaml#
$schema: http://devicetree.org/meta-schemas/core.yaml#

title: TYHX HX9023S capacitive proximity sensor

maintainers:
  - Yasin Lee <yasin.lee.x@gmail.com>

description: |
  TYHX HX9023S proximity sensor. Datasheet can be found here:
    http://www.tianyihexin.com/ueditor/php/upload/file/20240614/1718336303992081.pdf

properties:
  compatible:
    const: tyhx,hx9023s

  reg:
    maxItems: 1

  interrupts:
    description:
      Generated by device to announce preceding read request has finished
      and data is available or that a close/far proximity event has happened.
    maxItems: 1

  vdd-supply: true

  "#address-cells":
    const: 1

  "#size-cells":
    const: 0

patternProperties:
  "^channel@[0-4]$":
    $ref: /schemas/iio/adc/adc.yaml
    type: object
    unevaluatedProperties: false

    properties:
      reg:
        minimum: 0
        maximum: 4
        description: The channel number.

required:
  - compatible
  - reg
  - vdd-supply

unevaluatedProperties: false

examples:
  - |
    #include <dt-bindings/interrupt-controller/irq.h>
    i2c {
      #address-cells = <1>;
      #size-cells = <0>;
      proximity@2a {
        compatible = "tyhx,hx9023s";
        reg = <0x2a>;
        interrupt-parent = <&pio>;
        interrupts = <16 IRQ_TYPE_EDGE_FALLING>;
        vdd-supply = <&pp1800_prox>;

        #address-cells = <1>;
        #size-cells = <0>;

        channel@0 {
          reg = <0>;
          single-channel = <0>;
        };
        channel@1 {
          reg = <1>;
          single-channel = <1>;
        };
        channel@2 {
          reg = <2>;
          single-channel = <2>;
        };
        channel@3 {
          reg = <3>;
          diff-channels = <1 0>;
        };
        channel@4 {
          reg = <4>;
          diff-channels = <2 0>;
        };
      };
    };
```

## Documentation/devicetree/bindings/iio/proximity/vishay,vcnl3020.yaml
```yaml
# SPDX-License-Identifier: (GPL-2.0 OR BSD-2-Clause)
%YAML 1.2
---
$id: http://devicetree.org/schemas/iio/proximity/vishay,vcnl3020.yaml#
$schema: http://devicetree.org/meta-schemas/core.yaml#

title: Integrated Proximity Sensor With Infrared Emitter

maintainers:
  - Ivan Mikhaylov <i.mikhaylov@yadro.com>

description: |
  The VCNL3020 is a fully integrated proximity sensor. Fully integrated means
  that the infrared emitter is included in the package. It has 16-bit
  resolution. It includes a signal processing IC and features standard I2C
  communication interface. It features an interrupt function.

  Specifications about the devices can be found at:
  https://www.vishay.com/docs/84150/vcnl3020.pdf

properties:
  compatible:
    enum:
      - vishay,vcnl3020

  reg:
    maxItems: 1

  interrupts:
    maxItems: 1

  vdd-supply:
    description: Regulator that provides power to the sensor

  vddio-supply:
    description: Regulator that provides power to the bus

  vishay,led-current-microamp:
    description:
      The driver current for the LED used in proximity sensing.
    enum: [0, 10000, 20000, 30000, 40000, 50000, 60000, 70000, 80000, 90000,
          100000, 110000, 120000, 130000, 140000, 150000, 160000, 170000,
          180000, 190000, 200000]
    default: 20000

required:
  - compatible
  - reg

examples:
  - |
    i2c {

        #address-cells = <1>;
        #size-cells = <0>;

        proximity@13 {
              compatible = "vishay,vcnl3020";
              reg = <0x13>;
              vishay,led-current-microamp = <200000>;
        };
    };
```

## Documentation/devicetree/bindings/iio/proximity/vl53l0x.txt
```
ST VL53L0X ToF ranging sensor

Required properties:
	- compatible: must be "st,vl53l0x"
	- reg: i2c address where to find the device

Optional properties:
	- interrupts:	Interrupt for notifying that new measurement is ready.
			If no interrupt is specified, polling is used.

Example:

vl53l0x@29 {
	compatible = "st,vl53l0x";
	reg = <0x29>;
	interrupt-parent = <&gpio>;
	interrupts = <23 IRQ_TYPE_EDGE_FALLING>;
};
```

## Documentation/devicetree/bindings/iio/resolver/ad2s90.txt
```
Analog Devices AD2S90 Resolver-to-Digital Converter

https://www.analog.com/en/products/ad2s90.html

Required properties:
  - compatible: should be "adi,ad2s90"
  - reg: SPI chip select number for the device
  - spi-max-frequency: set maximum clock frequency, must be 830000
  - spi-cpol and spi-cpha:
        Either SPI mode (0,0) or (1,1) must be used, so specify none or both of
        spi-cpha, spi-cpol.

See for more details:
    Documentation/devicetree/bindings/spi/spi-bus.txt

Note about max frequency:
    Chip's max frequency, as specified in its datasheet, is 2Mhz. But a 600ns
    delay is expected between the application of a logic LO to CS and the
    application of SCLK, as also specified. And since the delay is not
    implemented in the spi code, to satisfy it, SCLK's period should be at most
    2 * 600ns, so the max frequency should be 1 / (2 * 6e-7), which gives
    roughly 830000Hz.

Example:
resolver@0 {
	compatible = "adi,ad2s90";
	reg = <0>;
	spi-max-frequency = <830000>;
	spi-cpol;
	spi-cpha;
};
```
