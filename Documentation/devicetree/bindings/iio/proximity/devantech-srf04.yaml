## Documentation/devicetree/bindings/iio/st-sensors.txt
```
STMicroelectronics MEMS sensors

The STMicroelectronics sensor devices are pretty straight-forward I2C or
SPI devices, all sharing the same device tree descriptions no matter what
type of sensor it is.

Required properties:
- compatible: see the list of valid compatible strings below
- reg: the I2C or SPI address the device will respond to

Optional properties:
- vdd-supply: an optional regulator that needs to be on to provide VDD
  power to the sensor.
- vddio-supply: an optional regulator that needs to be on to provide the
  VDD IO power to the sensor.
- st,drdy-int-pin: the pin on the package that will be used to signal
  "data ready" (valid values: 1 or 2). This property is not configurable
  on all sensors.
- drive-open-drain: the interrupt/data ready line will be configured
  as open drain, which is useful if several sensors share the same
  interrupt line. (This binding is taken from pinctrl/pinctrl-bindings.txt)
  This is a boolean property.

Sensors may also have applicable pin control settings, those use the
standard bindings from pinctrl/pinctrl-bindings.txt.

Valid compatible strings:

Accelerometers:
- st,lis3lv02d (deprecated, use st,lis3lv02dl-accel)
- st,lis302dl-spi (deprecated, use st,lis3lv02dl-accel)
- st,lis3lv02dl-accel
- st,lsm303dlh-accel
- st,lsm303dlhc-accel
- st,lis3dh-accel
- st,lsm330d-accel
- st,lsm330dl-accel
- st,lsm330dlc-accel
- st,lis331dl-accel
- st,lis331dlh-accel
- st,lsm303dl-accel
- st,lsm303dlm-accel
- st,lsm330-accel
- st,lsm303agr-accel
- st,lis2dh12-accel
- st,h3lis331dl-accel
- st,lng2dm-accel
- st,lis3l02dq
- st,lis2dw12
- st,lis3dhh
- st,lis3de
- st,lis2de12
- st,lis2hh12

Gyroscopes:
- st,l3g4200d-gyro
- st,lsm330d-gyro
- st,lsm330dl-gyro
- st,lsm330dlc-gyro
- st,l3gd20-gyro
- st,l3gd20h-gyro
- st,l3g4is-gyro
- st,lsm330-gyro
- st,lsm9ds0-gyro

Magnetometers:
- st,lsm303agr-magn
- st,lsm303dlh-magn
- st,lsm303dlhc-magn
- st,lsm303dlm-magn
- st,lis3mdl-magn
- st,lis2mdl
- st,lsm9ds1-magn

Pressure sensors:
- st,lps001wp-press
- st,lps25h-press
- st,lps331ap-press
- st,lps22hb-press
- st,lps33hw
- st,lps35hw
- st,lps22hh
```

## Documentation/devicetree/bindings/iio/stm/accel/st_acc33.txt
```
* st_acc33 driver for accel MEMS sensors

Required properties for all bus drivers:
- compatible: must be one of:
              "st,lis2dh_accel"
              "st,lis2dh12_accel"
              "st,lis3dh_accel"
              "st,lsm303agr_accel"
              "st,iis2dh_accel"

Required properties for the i2c bindings:
- reg: i2c slave address

Required properties for the spi bindings:
- reg:               the chipselect index
- spi-max-frequency: maximal bus speed, should be set to 1000000 unless
                     constrained by external circuitry

Optional properties for the spi bindings:
- spi-3wire:  use sensor spi interface with 3 wires.

Optional properties for all bus drivers:
- interrupts:   interrupt mapping for IRQ. It should be configured with
                flags IRQ_TYPE_LEVEL_HIGH.

                Refer to interrupt-controller/interrupts.txt for generic
                interrupt client node bindings.

- st,module_id: module identifier.
                If a sensor is supported by two different drivers (for example
                accel by this driver and magn by mag40 driver), module_id
                should be used by both drivers and should have the same id.
                This is used by user-space to identify which devices
                are part of the same module (particularly important for
                supporting multiple sensors of the same type).

Example for an spi device node:

lis2dh-accel@0 {
	compatible = "st,lis2dh_accel";
	reg = <0x0>;
	spi-max-frequency = <1000000>;
	interrupt-parent = <&gpio0>;
	interrupts = <0 IRQ_TYPE_LEVEL_HIGH>;
	st,module_id = <1>;
};
```

## Documentation/devicetree/bindings/iio/stm/accel/st_h3lis331dl.txt
```
* h3lis331dl driver for accel MEMS sensors

Required properties for the spi bindings:
- compatible:        must be one of:
                     "st,h3lis331dl"
                     "st,lis331dlh"

- reg:               the chipselect index

- spi-max-frequency: maximal bus speed, should be set to 10000000 unless
                     constrained by external circuitry

Optional properties:
- st,drdy-int-pin:  the pin on the package that will be used to signal
                    "data ready" (valid values: 1 or 2, default: 1).

- interrupts:       interrupt mapping for IRQ. It should be configured with
                    flags IRQ_TYPE_LEVEL_HIGH.

                    Refer to interrupt-controller/interrupts.txt for generic
                    interrupt client node bindings.

- drive-open-drain: interrupt pin open drain setting (valid values: 0 or 1,
                    default: 0).

Example for an i2c device node:

h3lis331dl@18 {
        compatible = "st,lis331dlh-accel";
        reg = <0x18>;
        interrupt-parent = <&gpio0>;
        interrupts = <0 IRQ_TYPE_LEVEL_HIGH>;
        st,drdy-int-pin = <1>;
};

Example for an spi device node:

h3lis331dl-accel@0 {
        compatible = "st,h3lis331dl";
        reg = <0x0>;
        spi-max-frequency = <1000000>;
        interrupt-parent = <&gpio0>;
        interrupts = <0 IRQ_TYPE_LEVEL_HIGH>;
        st,drdy-int-pin = <1>;
};
```
