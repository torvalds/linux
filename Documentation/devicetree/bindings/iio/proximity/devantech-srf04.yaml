## Documentation/devicetree/bindings/iio/proximity/devantech-srf04.yaml
```yaml
# SPDX-License-Identifier: GPL-2.0
%YAML 1.2
---
$id: http://devicetree.org/schemas/iio/proximity/devantech-srf04.yaml#
$schema: http://devicetree.org/meta-schemas/core.yaml#

title: Devantech SRF04 and Maxbotix mb1000 ultrasonic range finder

maintainers:
  - Andreas Klinger <ak@it-klinger.de>

description: |
  Bit-banging driver using two GPIOs:
  - trigger-gpio is raised by the driver to start sending out an ultrasonic
    burst
  - echo-gpio is held high by the sensor after sending ultrasonic burst
    until it is received once again

  Specifications about the devices can be found at:
  https://www.robot-electronics.co.uk/htm/srf04tech.htm

  https://www.maxbotix.com/documents/LV-MaxSonar-EZ_Datasheet.pdf

properties:
  compatible:
    enum:
      - devantech,srf04
      - maxbotix,mb1000
      - maxbotix,mb1010
      - maxbotix,mb1020
      - maxbotix,mb1030
      - maxbotix,mb1040

  trig-gpios:
    description:
      Definition of the GPIO for the triggering (output)
      This GPIO is set for about 10 us by the driver to tell the device it
      should initiate the measurement cycle.
      See Documentation/devicetree/bindings/gpio/gpio.txt for information
      on how to specify a consumer gpio.
    maxItems: 1

  echo-gpios:
    description:
      Definition of the GPIO for the echo (input)
      This GPIO is set by the device as soon as an ultrasonic burst is sent
      out and reset when the first echo is received.
      Thus this GPIO is set while the ultrasonic waves are doing one round
      trip.
      It needs to be an GPIO which is able to deliver an interrupt because
      the time between two interrupts is measured in the driver.
    maxItems: 1

  power-gpios:
    description:
      Definition of the GPIO for power management of connected peripheral
      (output).
      This GPIO can be used by the external hardware for power management.
      When the device gets suspended it's switched off and when it resumes
      it's switched on again. After some period of inactivity the driver
      get suspended automatically (autosuspend feature).
    maxItems: 1

  startup-time-ms:
    description:
      This is the startup time the device needs after a resume to be up and
      running.
    minimum: 0
    maximum: 1000
    default: 100

required:
  - compatible
  - trig-gpios
  - echo-gpios

additionalProperties: false

examples:
  - |
    #include <dt-bindings/gpio/gpio.h>
    proximity {
        compatible = "devantech,srf04";
        trig-gpios = <&gpio1 15 GPIO_ACTIVE_HIGH>;
        echo-gpios = <&gpio2  6 GPIO_ACTIVE_HIGH>;
    };
```

## Documentation/devicetree/bindings/iio/proximity/google,cros-ec-mkbp-proximity.yaml
```yaml
# SPDX-License-Identifier: (GPL-2.0 OR BSD-2-Clause)
%YAML 1.2
---

$id: http://devicetree.org/schemas/iio/proximity/google,cros-ec-mkbp-proximity.yaml#
$schema: http://devicetree.org/meta-schemas/core.yaml#

title: ChromeOS EC MKBP Proximity Sensor

maintainers:
  - Stephen Boyd <swboyd@chromium.org>
  - Benson Leung <bleung@chromium.org>
  - Enric Balletbo i Serra <enric.balletbo@collabora.com>

description: |
  Google's ChromeOS EC sometimes has the ability to detect user proximity.
  This is implemented on the EC as near/far logic and exposed to the OS
  via an MKBP switch bit.

properties:
  compatible:
    const: google,cros-ec-mkbp-proximity

  label:
    description: Name for proximity sensor

required:
  - compatible

additionalProperties: false

examples:
  - |
    proximity {
      compatible = "google,cros-ec-mkbp-proximity";
      label = "proximity-wifi-lte";
    };
```

## Documentation/devicetree/bindings/iio/proximity/maxbotix,mb1232.txt
```
* MaxBotix I2CXL-MaxSonar ultrasonic distance sensor of type  mb1202,
  mb1212, mb1222, mb1232, mb1242, mb7040 or mb7137 using the i2c interface
  for ranging

Required properties:
 - compatible:		"maxbotix,mb1202",
			"maxbotix,mb1212",
			"maxbotix,mb1222",
			"maxbotix,mb1232",
			"maxbotix,mb1242",
			"maxbotix,mb7040" or
			"maxbotix,mb7137"

 - reg:			i2c address of the device, see also i2c/i2c.txt

Optional properties:
 - interrupts:		Interrupt used to announce the preceding reading
			request has finished and that data is available.
			If no interrupt is specified the device driver
			falls back to wait a fixed amount of time until
			data can be retrieved.

Example:
proximity@70 {
	compatible = "maxbotix,mb1232";
	reg = <0x70>;
	interrupt-parent = <&gpio2>;
	interrupts = <2 IRQ_TYPE_EDGE_FALLING>;
};
```

## Documentation/devicetree/bindings/iio/proximity/maxbotix,mb1232.yaml
```yaml
# SPDX-License-Identifier: GPL-2.0
%YAML 1.2
---
$id: http://devicetree.org/schemas/iio/proximity/maxbotix,mb1232.yaml#
$schema: http://devicetree.org/meta-schemas/core.yaml#

title: MaxBotix I2CXL-MaxSonar ultrasonic distance sensor

maintainers:
  - Andreas Klinger <ak@it-klinger.de>

description: |
  MaxBotix I2CXL-MaxSonar ultrasonic distance sensor of type  mb1202,
  mb1212, mb1222, mb1232, mb1242, mb7040 or mb7137 using the i2c interface
  for ranging

  Specifications about the devices can be found at:
  https://www.maxbotix.com/documents/I2CXL-MaxSonar-EZ_Datasheet.pdf

properties:
  compatible:
    enum:
      - maxbotix,mb1202
      - maxbotix,mb1212
      - maxbotix,mb1222
      - maxbotix,mb1232
      - maxbotix,mb1242
      - maxbotix,mb7040
      - maxbotix,mb7137

  reg:
    maxItems: 1

  interrupts:
    description:
      Interrupt used to announce the preceding reading request has finished
      and that data is available.  If no interrupt is specified the device
      driver falls back to wait a fixed amount of time until data can be
      retrieved.
    maxItems: 1

required:
  - compatible
  - reg

additionalProperties: false

examples:
  - |
    #include <dt-bindings/interrupt-controller/irq.h>
    i2c {
      #address-cells = <1>;
      #size-cells = <0>;
      proximity@70 {
        compatible = "maxbotix,mb1232";
        reg = <0x70>;
        interrupt-parent = <&gpio2>;
        interrupts = <2 IRQ_TYPE_EDGE_FALLING>;
      };
    };
```

## Documentation/devicetree/bindings/iio/proximity/murata,irsd200.yaml
```yaml
# SPDX-License-Identifier: (GPL-2.0-only OR BSD-2-Clause)
%YAML 1.2
---
$id: http://devicetree.org/schemas/iio/proximity/murata,irsd200.yaml#
$schema: http://devicetree.org/meta-schemas/core.yaml#

title: Murata IRS-D200 PIR sensor

maintainers:
  - Waqar Hameed <waqar.hameed@axis.com>

description:
  PIR sensor for human detection.

properties:
  compatible:
    const: murata,irsd200

  reg:
    items:
      - enum:
          - 0x48
          - 0x49
        description: |
          When the AD pin is connected to GND, the slave address is 0x48.
          When the AD pin is connected to VDD, the slave address is 0x49.

  interrupts:
    maxItems: 1
    description:
      Type should be IRQ_TYPE_EDGE_RISING.

  vdd-supply:
    description:
      3.3 V supply voltage.

required:
  - compatible
  - reg
  - interrupts
  - vdd-supply

additionalProperties: false

examples:
  - |
    #include <dt-bindings/interrupt-controller/irq.h>

    i2c {
        #address-cells = <1>;
        #size-cells = <0>;

        proximity@48 {
            compatible = "murata,irsd200";
            reg = <0x48>;
            interrupts = <24 IRQ_TYPE_EDGE_RISING>;
            vdd-supply = <&regulator_3v3>;
        };
    };
...
```

## Documentation/devicetree/bindings/iio/proximity/nicera,d3323aa.yaml
```yaml
# SPDX-License-Identifier: (GPL-2.0-only OR BSD-2-Clause)
%YAML 1.2
---
$id: http://devicetree.org/schemas/iio/proximity/nicera,d3323aa.yaml#
$schema: http://devicetree.org/meta-schemas/core.yaml#

title: Nicera D3-323-AA PIR sensor

maintainers:
  - Waqar Hameed <waqar.hameed@axis.com>

description: |
  PIR sensor for human detection.
  Datasheet: https://www.endrich.com/Datenbl%C3%A4tter/Sensoren/D3-323-AA_e.pdf

properties:
  compatible:
    const: nicera,d3323aa

  vdd-supply:
    description:
      Supply voltage (1.8 to 5.5 V).

  vout-clk-gpios:
    maxItems: 1
    description:
      GPIO for clock and detection.
      After reset, the device signals with two falling edges on this pin that it
      is ready for configuration (within 1.2 s).
      During configuration, it is used as clock for data reading and writing (on
      data-gpios).
      After all this, when device is in operational mode, it signals on this pin
      for any detections.

  data-gpios:
    maxItems: 1
    description:
      GPIO for data reading and writing. This is denoted "DO (SI)" in datasheet.
      During configuration, this pin is used for writing and reading
      configuration data (together with vout-clk-gpios as clock).
      After this, during operational mode, the device will output serial data on
      this GPIO.

required:
  - compatible
  - vdd-supply
  - vout-clk-gpios
  - data-gpios

additionalProperties: false

examples:
  - |
    #include <dt-bindings/gpio/gpio.h>

    proximity {
        compatible = "nicera,d3323aa";
        vdd-supply = <&regulator_3v3>;
        vout-clk-gpios = <&gpio 78 GPIO_ACTIVE_HIGH>;
        data-gpios = <&gpio 76 GPIO_ACTIVE_HIGH>;
    };
...
```

## Documentation/devicetree/bindings/iio/proximity/parallax-ping.yaml
```yaml
# SPDX-License-Identifier: (GPL-2.0-or-later OR BSD-2-Clause)
%YAML 1.2
---
$id: http://devicetree.org/schemas/iio/proximity/parallax-ping.yaml#
$schema: http://devicetree.org/meta-schemas/core.yaml#

title: Parallax PING))) and LaserPING range finder

maintainers:
  - Andreas Klinger <ak@it-klinger.de>

description: |
  Bit-banging driver using one GPIO:
  - ping-gpios is raised by the driver to start measurement
  - direction of ping-gpio is then switched into input with an interrupt
    for receiving distance value as PWM signal

  Specifications about the devices can be found at:
  http://parallax.com/sites/default/files/downloads/28041-LaserPING-2m-Rangefinder-Guide.pdf
  http://parallax.com/sites/default/files/downloads/28015-PING-Documentation-v1.6.pdf

properties:
  compatible:
    enum:
      - parallax,ping
      - parallax,laserping

  ping-gpios:
    description:
      Definition of the GPIO for the triggering and echo (output and input)
      This GPIO is set for about 5 us by the driver to tell the device it
      should initiate the measurement cycle. Afterwards the GPIO is switched
      to input direction with an interrupt. The device sets it and the
      length of the input signal corresponds to the measured distance.
      It needs to be an GPIO which is able to deliver an interrupt because
      the time between two interrupts is measured in the driver.
      See Documentation/devicetree/bindings/gpio/gpio.txt for information
      on how to specify a consumer gpio.
    maxItems: 1

required:
  - compatible
  - ping-gpios

additionalProperties: false

examples:
  - |
    #include <dt-bindings/gpio/gpio.h>
    proximity {
        compatible = "parallax,laserping";
        ping-gpios = <&gpio0 26 GPIO_ACTIVE_HIGH>;
    };
```

## Documentation/devicetree/bindings/iio/proximity/rfdigital,rfd77402.yaml
```yaml
# SPDX-License-Identifier: (GPL-2.0 OR BSD-2-Clause)
%YAML 1.2
---
$id: http://devicetree.org/schemas/iio/proximity/rfdigital,rfd77402.yaml#
$schema: http://devicetree.org/meta-schemas/core.yaml#

title: RF Digital RFD77402 ToF sensor

maintainers:
  - Shrikant Raskar <raskar.shree97@gmail.com>

description:
  The RF Digital RFD77402 is a Time-of-Flight (ToF) proximity and distance
  sensor providing up to 200 mm range measurement over an I2C interface.

properties:
  compatible:
    const: rfdigital,rfd77402

  reg:
    maxItems: 1

  interrupts:
    maxItems: 1
    description:
      Interrupt asserted when a new distance measurement is available.

  vdd-supply:
    description: Regulator that provides power to the sensor.

required:
  - compatible
  - reg
  - vdd-supply

additionalProperties: false

examples:
  - |
    #include <dt-bindings/interrupt-controller/irq.h>
    i2c {
        #address-cells = <1>;
        #size-cells = <0>;

        proximity@4c {
            compatible = "rfdigital,rfd77402";
            reg = <0x4c>;
            vdd-supply = <&vdd_3v3>;
            interrupt-parent = <&gpio>;
            interrupts = <4 IRQ_TYPE_EDGE_FALLING>;
        };
    };
...
```

## Documentation/devicetree/bindings/iio/proximity/semtech,sx9310.yaml
```yaml
# SPDX-License-Identifier: (GPL-2.0-only OR BSD-2-Clause)
%YAML 1.2
---
$id: http://devicetree.org/schemas/iio/proximity/semtech,sx9310.yaml#
$schema: http://devicetree.org/meta-schemas/core.yaml#

title: Semtech's SX9310 capacitive proximity sensor

maintainers:
  - Daniel Campello <campello@chromium.org>

description: |
  Semtech's SX9310/SX9311 capacitive proximity/button solution.

  Specifications about the devices can be found at:
  https://www.semtech.com/products/smart-sensing/sar-sensors/sx9310

properties:
  compatible:
    enum:
      - semtech,sx9310
      - semtech,sx9311

  reg:
    maxItems: 1

  interrupts:
    description:
      The sole interrupt generated by the device used to announce the
      preceding reading request has finished and that data is
      available or that a close/far proximity event has happened.
    maxItems: 1

  vdd-supply:
    description: Main power supply

  svdd-supply:
    description: Host interface power supply

  "#io-channel-cells":
    const: 1

  semtech,cs0-ground:
    description: Indicates the CS0 sensor is connected to ground.
    type: boolean

  semtech,combined-sensors:
    $ref: /schemas/types.yaml#/definitions/uint32-array
    description: |
      List of which sensors are combined and represented by CS3.
      Possible values are -
      3        - CS3 (internal)
      0 1      - CS0 + CS1
      1 2      - CS1 + CS2 (default)
      0 1 2 3  - CS0 + CS1 + CS2 + CS3
    items:
      enum: [ 0, 1, 2, 3 ]
    minItems: 1
    maxItems: 4

  semtech,resolution:
    description:
      Capacitance measure resolution. Refer to datasheet for more details.
    enum:
      - coarsest
      - very-coarse
      - coarse
      - medium-coarse
      - medium
      - fine
      - very-fine
      - finest

  semtech,startup-sensor:
    $ref: /schemas/types.yaml#/definitions/uint32
    enum: [0, 1, 2, 3]
    default: 0
    description:
      Sensor used for start-up proximity detection. The combined
      sensor is represented by the value 3. This is used for initial
      compensation.

  semtech,proxraw-strength:
    $ref: /schemas/types.yaml#/definitions/uint32
    enum: [0, 2, 4, 8]
    default: 2
    description:
      PROXRAW filter strength. A value of 0 represents off, and other values
      represent 1-1/N.

  semtech,avg-pos-strength:
    $ref: /schemas/types.yaml#/definitions/uint32
    enum: [0, 16, 64, 128, 256, 512, 1024, 4294967295]
    default: 16
    description:
      Average positive filter strength. A value of 0 represents off and
      UINT_MAX (4294967295) represents infinite. Other values
      represent 1-1/N.

required:
  - compatible
  - reg
  - "#io-channel-cells"

additionalProperties: false

examples:
  - |
    #include <dt-bindings/interrupt-controller/irq.h>
    i2c {
      #address-cells = <1>;
      #size-cells = <0>;
      proximity@28 {
        compatible = "semtech,sx9310";
        reg = <0x28>;
        interrupt-parent = <&pio>;
        interrupts = <5 IRQ_TYPE_LEVEL_LOW 5>;
        vdd-supply = <&pp3300_a>;
        svdd-supply = <&pp1800_prox>;
        #io-channel-cells = <1>;
        semtech,cs0-ground;
        semtech,combined-sensors = <1 2 3>;
        semtech,resolution = "fine";
        semtech,startup-sensor = <1>;
        semtech,proxraw-strength = <2>;
        semtech,avg-pos-strength = <64>;
      };
    };
```
