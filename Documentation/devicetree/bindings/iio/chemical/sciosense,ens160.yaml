## Documentation/devicetree/bindings/iio/dac/adi,ad5064.yaml
```yaml
# SPDX-License-Identifier: (GPL-2.0 OR BSD-2-Clause)
%YAML 1.2
---
$id: http://devicetree.org/schemas/iio/dac/adi,ad5064.yaml#
$schema: http://devicetree.org/meta-schemas/core.yaml#

title: Analog Devices AD5064 and similar DACs

maintainers:
  - Lars-Peter Clausen <lars@metafoo.de>
  - Jonathan Cameron <jic23@kernel.org>

description: |
   A range of similar DAC devices with between 1 and 12 channels. Some parts
   have internal references, others require a single shared external reference
   and the remainder have a separate reference pin for each DAC.

properties:
  compatible:
    oneOf:
      - description: I2C devics
        enum:
          - adi,ad5024
          - adi,ad5025
          - adi,ad5044
          - adi,ad5045
          - adi,ad5064
          - adi,ad5064-1
          - adi,ad5065
          - adi,ad5628-1
          - adi,ad5628-2
          - adi,ad5648-1
          - adi,ad5648-2
          - adi,ad5666-1
          - adi,ad5666-2
          - adi,ad5668-1
          - adi,ad5668-2
          - adi,ad5668-3
      - description: SPI devices
        enum:
          - adi,ad5625
          - adi,ad5625r-1v25
          - adi,ad5625r-2v5
          - adi,ad5627
          - adi,ad5627r-1v25
          - adi,ad5627r-2v5
          - adi,ad5629-1
          - adi,ad5629-2
          - adi,ad5629-3
          - adi,ad5645r-1v25
          - adi,ad5645r-2v5
          - adi,ad5665
          - adi,ad5665r-1v25
          - adi,ad5665r-2v5
          - adi,ad5667
          - adi,ad5667r-1v25
          - adi,ad5667r-2v5
          - adi,ad5669-1
          - adi,ad5669-2
          - adi,ad5669-3
          - lltc,ltc2606
          - lltc,ltc2607
          - lltc,ltc2609
          - lltc,ltc2616
          - lltc,ltc2617
          - lltc,ltc2619
          - lltc,ltc2626
          - lltc,ltc2627
          - lltc,ltc2629
          - lltc,ltc2631-l12
          - lltc,ltc2631-h12
          - lltc,ltc2631-l10
          - lltc,ltc2631-h10
          - lltc,ltc2631-l8
          - lltc,ltc2631-h8
          - lltc,ltc2633-l12
          - lltc,ltc2633-h12
          - lltc,ltc2633-l10
          - lltc,ltc2633-h10
          - lltc,ltc2633-l8
          - lltc,ltc2633-h8
          - lltc,ltc2635-l12
          - lltc,ltc2635-h12
          - lltc,ltc2635-l10
          - lltc,ltc2635-h10
          - lltc,ltc2635-l8
          - lltc,ltc2635-h8

  reg:
    maxItems: 1

  vrefA-supply: true
  vrefB-supply: true
  vrefC-supply: true
  vrefD-supply: true
  vref-supply: true

required:
  - compatible
  - reg

allOf:
  - $ref: /schemas/spi/spi-peripheral-props.yaml#
  - # Shared external vref, no internal reference
    if:
      properties:
        compatible:
          contains:
            enum:
              - adi,ad5064-1
              - adi,ad5625
              - adi,ad5627
              - adi,ad5665
              - adi,ad5667
              - lltc,ltc2606
              - lltc,ltc2607
              - lltc,ltc2616
              - lltc,ltc2617
              - lltc,ltc2626
              - lltc,ltc2627
    then:
      properties:
        vref-supply: true
        vrefA-supply: false
        vrefB-supply: false
        vrefC-supply: false
        vrefD-supply: false
      required:
        - vref-supply
  - # Shared external vref, internal reference available
    if:
      properties:
        compatible:
          contains:
            enum:
              - adi,ad5625r-1v25
              - adi,ad5625r-2v5
              - adi,ad5627r-1v25
              - adi,ad5627r-2v5
              - adi,ad5628-1
              - adi,ad5628-2
              - adi,ad5629-1
              - adi,ad5629-2
              - adi,ad5629-3
              - adi,ad5645r-1v25
              - adi,ad5645r-2v5
              - adi,ad5647r-1v25
              - adi,ad5647r-2v5
              - adi,ad5648-1
              - adi,ad5648-2
              - adi,ad5665r-1v25
              - adi,ad5665r-2v5
              - adi,ad5666-1
              - adi,ad5666-2
              - adi,ad5667r-1v25
              - adi,ad5667r-2v5
              - adi,ad5668-1
              - adi,ad5668-2
              - adi,ad5668-3
              - adi,ad5669-1
              - adi,ad5669-2
              - adi,ad5669-3
              - lltc,ltc2631-l12
              - lltc,ltc2631-h12
              - lltc,ltc2631-l10
              - lltc,ltc2631-h10
              - lltc,ltc2631-l8
              - lltc,ltc2631-h8
              - lltc,ltc2633-l12
              - lltc,ltc2633-h12
              - lltc,ltc2633-l10
              - lltc,ltc2633-h10
              - lltc,ltc2633-l8
              - lltc,ltc2633-h8
              - lltc,ltc2635-l12
              - lltc,ltc2635-h12
              - lltc,ltc2635-l10
              - lltc,ltc2635-h10
              - lltc,ltc2635-l8
              - lltc,ltc2635-h8
    then:
      properties:
        vref-supply: true
        vrefA-supply: false
        vrefB-supply: false
        vrefC-supply: false
        vrefD-supply: false
  - # 4 input devices, separate vrefs, no internal reference
    if:
      properties:
        compatible:
          contains:
            enum:
              - adi,ad5024
              - adi,ad5044
              - adi,ad5064
              - lltc,ltc2609
              - lltc,ltc2619
              - lltc,ltc2629
    then:
      properties:
        vrefA-supply: true
        vrefB-supply: true
        vrefC-supply: true
        vrefD-supply: true
        vref-supply: false
      required:
        - vrefA-supply
        - vrefB-supply
        - vrefC-supply
        - vrefD-supply
  - # 2 input devices, separate vrefs, no internal reference
    if:
      properties:
        compatible:
          contains:
            enum:
              - adi,ad5025
              - adi,ad5045
              - adi,ad5065
    then:
      properties:
        vrefA-supply: true
        vrefB-supply: true
        vrefC-supply: false
        vrefD-supply: false
        vref-supply: false
      required:
        - vrefA-supply
        - vrefB-supply

unevaluatedProperties: false

examples:
  - |
    spi {
        #address-cells = <1>;
        #size-cells = <0>;
        dac@0 {
            reg = <0>;
            compatible = "adi,ad5625";
            vref-supply = <&dac_vref>;
        };
    };
  - |
    spi {
        #address-cells = <1>;
        #size-cells = <0>;
        dac@0 {
            reg = <0>;
            compatible = "adi,ad5625r-1v25";
        };
    };
  - |
    i2c {
        #address-cells = <1>;
        #size-cells = <0>;
        dac@42 {
            reg = <0x42>;
            compatible = "adi,ad5024";
            vrefA-supply = <&dac_vref>;
            vrefB-supply = <&dac_vref>;
            vrefC-supply = <&dac_vref2>;
            vrefD-supply = <&dac_vref2>;
        };
    };
...
```

## Documentation/devicetree/bindings/iio/dac/adi,ad5360.yaml
```yaml
# SPDX-License-Identifier: (GPL-2.0 OR BSD-2-Clause)
%YAML 1.2
---
$id: http://devicetree.org/schemas/iio/dac/adi,ad5360.yaml#
$schema: http://devicetree.org/meta-schemas/core.yaml#

title: Analog Devices AD5360 and similar DACs

maintainers:
  - Lars-Peter Clausen <lars@metafoo.de>
  - Jonathan Cameron <jic23@kernel.org>

properties:
  compatible:
    enum:
      - adi,ad5360
      - adi,ad5361
      - adi,ad5363
      - adi,ad5370
      - adi,ad5371
      - adi,ad5372
      - adi,ad5373

  reg:
    maxItems: 1

  vref0-supply: true
  vref1-supply: true
  vref2-supply: true

  spi-max-frequency: true

additionalProperties: false

required:
  - compatible
  - reg
  - vref0-supply
  - vref1-supply

allOf:
  - if:
      properties:
        compatible:
          contains:
            enum:
              - adi,ad5360
              - adi,ad5361
              - adi,ad5363
              - adi,ad5370
              - adi,ad5372
              - adi,ad5373
    then:
      properties:
        vref2-supply: false
  - if:
      properties:
        compatible:
          contains:
            enum:
              - adi,ad5371
    then:
      required:
        - vref2-supply

examples:
  - |
    spi {
        #address-cells = <1>;
        #size-cells = <0>;
        dac@0 {
            reg = <0>;
            compatible = "adi,ad5371";
            vref0-supply = <&dac_vref0>;
            vref1-supply = <&dac_vref1>;
            vref2-supply = <&dac_vref2>;
        };
    };
...
```

## Documentation/devicetree/bindings/iio/dac/adi,ad5380.yaml
```yaml
# SPDX-License-Identifier: (GPL-2.0 OR BSD-2-Clause)
%YAML 1.2
---
$id: http://devicetree.org/schemas/iio/dac/adi,ad5380.yaml#
$schema: http://devicetree.org/meta-schemas/core.yaml#

title: Analog Devices AD5380 and similar DACs

maintainers:
  - Lars-Peter Clausen <lars@metafoo.de>
  - Jonathan Cameron <jic23@kernel.org>

description: |
  DAC devices supporting both SPI and I2C interfaces.

properties:
  compatible:
    enum:
      - adi,ad5380-3
      - adi,ad5380-5
      - adi,ad5381-3
      - adi,ad5381-5
      - adi,ad5382-3
      - adi,ad5382-5
      - adi,ad5383-3
      - adi,ad5383-5
      - adi,ad5384-3
      - adi,ad5384-5
      - adi,ad5390-3
      - adi,ad5390-5
      - adi,ad5391-3
      - adi,ad5391-5
      - adi,ad5392-3
      - adi,ad5392-5

  reg:
    maxItems: 1

  vref-supply:
    description:
      If not supplied devices will use internal regulators.

required:
  - compatible
  - reg

allOf:
  - $ref: /schemas/spi/spi-peripheral-props.yaml#

unevaluatedProperties: false

examples:
  - |
    spi {
        #address-cells = <1>;
        #size-cells = <0>;
        dac@0 {
            reg = <0>;
            compatible = "adi,ad5390-5";
            vref-supply = <&dacvref>;
        };
    };
  - |
    i2c {
        #address-cells = <1>;
        #size-cells = <0>;
        dac@42 {
            reg = <0x42>;
            compatible = "adi,ad5380-3";
        };
    };
...
```

## Documentation/devicetree/bindings/iio/dac/adi,ad5421.yaml
```yaml
# SPDX-License-Identifier: (GPL-2.0 OR BSD-2-Clause)
%YAML 1.2
---
$id: http://devicetree.org/schemas/iio/dac/adi,ad5421.yaml#
$schema: http://devicetree.org/meta-schemas/core.yaml#

title: Analog Devices AD5421 DAC

maintainers:
  - Lars-Peter Clausen <lars@metafoo.de>
  - Jonathan Cameron <jic23@kernel.org>

description: |
  AD5421 is designed for us in loop-powered, 4 mA to 20 mA smart transmitter
  applications. It provides a 16-bit DAC, current amplifier, voltage regulator
  to drive the loop and a voltage reference.

properties:
  compatible:
    const: adi,ad5421

  reg:
    maxItems: 1

  interrupts:
    maxItems: 1
    description: Fault signal.

required:
  - compatible
  - reg

allOf:
  - $ref: /schemas/spi/spi-peripheral-props.yaml#

unevaluatedProperties: false

examples:
  - |
    #include <dt-bindings/interrupt-controller/irq.h>
    spi {
        #address-cells = <1>;
        #size-cells = <0>;

        dac@0 {
            compatible = "adi,ad5421";
            reg = <0>;
            spi-max-frequency = <30000000>;
            interrupts = <55 IRQ_TYPE_LEVEL_HIGH>;
        };
    };
...
```

## Documentation/devicetree/bindings/iio/dac/adi,ad5446.yaml
```yaml
# SPDX-License-Identifier: (GPL-2.0 OR BSD-2-Clause)
%YAML 1.2
---
$id: http://devicetree.org/schemas/iio/dac/adi,ad5446.yaml#
$schema: http://devicetree.org/meta-schemas/core.yaml#

title: Analog Devices AD5446 and similar DACs

maintainers:
  - Michael Hennerich <michael.hennerich@analog.com>
  - Nuno Sá <nuno.sa@analog.com>

description:
  Digital to Analog Converter devices supporting both SPI and I2C interfaces.
  These devices feature a range of resolutions from 8-bit to 16-bit.

properties:
  compatible:
    oneOf:
      - description: SPI DACs
        enum:
          - adi,ad5300
          - adi,ad5310
          - adi,ad5320
          - adi,ad5444
          - adi,ad5446
          - adi,ad5450
          - adi,ad5451
          - adi,ad5452
          - adi,ad5453
          - adi,ad5512a
          - adi,ad5541a
          - adi,ad5542
          - adi,ad5542a
          - adi,ad5543
          - adi,ad5553
          - adi,ad5600
          - adi,ad5601
          - adi,ad5611
          - adi,ad5621
          - adi,ad5641
          - adi,ad5620-2500
          - adi,ad5620-1250
          - adi,ad5640-2500
          - adi,ad5640-1250
          - adi,ad5660-2500
          - adi,ad5660-1250
          - adi,ad5662
          - ti,dac081s101
          - ti,dac101s101
          - ti,dac121s101
      - description: I2C DACs
        enum:
          - adi,ad5301
          - adi,ad5311
          - adi,ad5321
          - adi,ad5602
          - adi,ad5612
          - adi,ad5622

  reg:
    maxItems: 1

  vcc-supply:
    description:
      Reference voltage supply. If not supplied, devices with internal
      voltage reference will use that.

required:
  - compatible
  - reg

allOf:
  - if:
      properties:
        compatible:
          contains:
            enum:
              - adi,ad5300
              - adi,ad5310
              - adi,ad5320
              - adi,ad5444
              - adi,ad5446
              - adi,ad5450
              - adi,ad5451
              - adi,ad5452
              - adi,ad5453
              - adi,ad5512a
              - adi,ad5541a
              - adi,ad5542
              - adi,ad5542a
              - adi,ad5543
              - adi,ad5553
              - adi,ad5600
              - adi,ad5601
              - adi,ad5611
              - adi,ad5621
              - adi,ad5641
              - adi,ad5620-2500
              - adi,ad5620-1250
              - adi,ad5640-2500
              - adi,ad5640-1250
              - adi,ad5660-2500
              - adi,ad5660-1250
              - adi,ad5662
              - ti,dac081s101
              - ti,dac101s101
              - ti,dac121s101
    then:
      allOf:
        - $ref: /schemas/spi/spi-peripheral-props.yaml#

unevaluatedProperties: false

examples:
  - |
    spi {
        #address-cells = <1>;
        #size-cells = <0>;

        dac@0 {
            compatible = "adi,ad5446";
            reg = <0>;
            vcc-supply = <&dac_vref>;
        };
    };
  - |
    i2c {
        #address-cells = <1>;
        #size-cells = <0>;

        dac@42 {
            compatible = "adi,ad5622";
            reg = <0x42>;
            vcc-supply = <&dac_vref>;
        };
    };
...
```
