## Documentation/devicetree/bindings/iio/dac/adi,ad5449.yaml
```yaml
# SPDX-License-Identifier: (GPL-2.0 OR BSD-2-Clause)
%YAML 1.2
---
$id: http://devicetree.org/schemas/iio/dac/adi,ad5449.yaml#
$schema: http://devicetree.org/meta-schemas/core.yaml#

title: Analog Devices AD5449 and similar DACs

maintainers:
  - Lars-Peter Clausen <lars@metafoo.de>
  - Jonathan Cameron <jic23@kernel.org>

description:
  Family of multiplying DACs from Analog Devices

properties:
  compatible:
    enum:
      - adi,ad5415
      - adi,ad5426
      - adi,ad5429
      - adi,ad5432
      - adi,ad5439
      - adi,ad5443
      - adi,ad5449

  reg:
    maxItems: 1

  spi-max-frequency: true

  VREF-supply: true
  VREFA-supply: true
  VREFB-supply: true

additionalProperties: false

required:
  - compatible
  - reg

allOf:
  - if:
      properties:
        compatible:
          contains:
            enum:
              - adi,ad5415
              - adi,ad5426
              - adi,ad5432
    then:
      properties:
        VREF-supply: true
        VREFA-supply: false
        VREFB-supply: false
      required:
        - VREF-supply
  - if:
      properties:
        compatible:
          contains:
            enum:
              - adi,ad5429
              - adi,ad5439
              - adi,ad5449
    then:
      properties:
        VREF-supply: false
        VREFA-supply: true
        VREFB-supply: true
      required:
        - VREFA-supply
        - VREFB-supply

examples:
  - |
    spi {
        #address-cells = <1>;
        #size-cells = <0>;
        dac@0 {
            reg = <0>;
            compatible = "adi,ad5415";
            VREF-supply = <&dac_ref>;
        };
    };
  - |
    spi {
        #address-cells = <1>;
        #size-cells = <0>;
        dac@0 {
            reg = <0>;
            compatible = "adi,ad5429";
            VREFA-supply = <&dac_refA>;
            VREFB-supply = <&dac_refB>;
        };
    };
...
```

## Documentation/devicetree/bindings/iio/dac/adi,ad5504.yaml
```yaml
# SPDX-License-Identifier: (GPL-2.0 OR BSD-2-Clause)
%YAML 1.2
---
$id: http://devicetree.org/schemas/iio/dac/adi,ad5504.yaml#
$schema: http://devicetree.org/meta-schemas/core.yaml#

title: Analog Devices AD5501 and AD5504 DACs

maintainers:
  - Lars-Peter Clausen <lars@metafoo.de>
  - Jonathan Cameron <jic23@kernel.org>

description:
  High voltage (up to 60V) DACs with temperature sensor alarm function

properties:
  compatible:
    enum:
      - adi,ad5501
      - adi,ad5504

  reg:
    maxItems: 1

  interrupts:
    description: Used for temperature alarm.
    maxItems: 1

  vcc-supply: true

additionalProperties: false

required:
  - compatible
  - reg

examples:
  - |
    #include <dt-bindings/interrupt-controller/irq.h>
    spi {
        #address-cells = <1>;
        #size-cells = <0>;
        dac@0 {
            reg = <0>;
            compatible = "adi,ad5504";
            vcc-supply = <&dac_vcc>;
            interrupts = <55 IRQ_TYPE_EDGE_FALLING>;
        };
    };
...
```

## Documentation/devicetree/bindings/iio/dac/adi,ad5592r.yaml
```yaml
# SPDX-License-Identifier: (GPL-2.0 OR BSD-2-Clause)
%YAML 1.2
---
$id: http://devicetree.org/schemas/iio/dac/adi,ad5592r.yaml#
$schema: http://devicetree.org/meta-schemas/core.yaml#

title: Analog Devices AD5592R/AD5593R DAC/ADC

maintainers:
  - Michael Hennerich <michael.hennerich@analog.com>

properties:
  compatible:
    enum:
      - adi,ad5592r
      - adi,ad5593r

  reg:
    maxItems: 1

  spi-max-frequency:
    maximum: 30000000

  spi-cpol: true

  "#address-cells":
    const: 1

  "#size-cells":
    const: 0

  "#io-channel-cells":
    const: 1

  vref-supply:
    description: If not set internal 2.5V reference used.

  reset-gpios:
    maxItems: 1

  gpio-controller:
    description: Marks the device node as a GPIO controller.

  "#gpio-cells":
    const: 2
    description:
      The first cell is the GPIO number and the second cell specifies
      GPIO flags, as defined in <dt-bindings/gpio/gpio.h>.

required:
  - compatible
  - reg
  - "#address-cells"
  - "#size-cells"

allOf:
  - if:
      properties:
        compatible:
          contains:
            const: adi,ad5592r
    then:
      required:
        - spi-cpol
    else:
      properties:
        spi-cpol: false

additionalProperties: false

patternProperties:
  "^(channel@)[0-7]$":
    type: object
    description: Child node to describe a channel
    properties:
      reg:
        minimum: 0
        maximum: 7

      adi,mode:
        $ref: /schemas/types.yaml#/definitions/uint32
        enum: [0, 1, 2, 3, 8]
        description: |
          Mode or function of this channel.
          Macros specifying the valid values can be found in
          <dt-bindings/iio/adi,ad5592r.h>.

          The following values are currently supported:
          * CH_MODE_UNUSED (the pin is unused)
          * CH_MODE_ADC (the pin is ADC input)
          * CH_MODE_DAC (the pin is DAC output)
          * CH_MODE_DAC_AND_ADC (the pin is DAC output but can be monitored
            by an ADC, since there is no disadvantage this should be
            considered as the preferred DAC mode)
          * CH_MODE_GPIO (the pin is registered with GPIOLIB)

      adi,off-state:
        $ref: /schemas/types.yaml#/definitions/uint32
        enum: [0, 1, 2, 3]
        description: |
          State of this channel when unused or the device gets removed.
          Macros specifying the  valid values can be found in
          <dt-bindings/iio/adi,ad5592r.h>.
          * CH_OFFSTATE_PULLDOWN (the pin is pulled down)
          * CH_OFFSTATE_OUT_LOW  (the pin is output low)
          * CH_OFFSTATE_OUT_HIGH (the pin is output high)
          * CH_OFFSTATE_OUT_TRISTATE (the pin is tristated output)

    required:
      - reg
      - adi,mode

    additionalProperties: false

examples:
  - |
    #include <dt-bindings/iio/adi,ad5592r.h>
    spi {
        #address-cells = <1>;
        #size-cells = <0>;

        addac@0 {
            compatible = "adi,ad5592r";
            #size-cells = <0>;
            #address-cells = <1>;
            #gpio-cells = <2>;
            reg = <0>;

            spi-max-frequency = <1000000>;
            spi-cpol;

            vref-supply = <&vref>;
            reset-gpios = <&gpio0 86 0>;
            gpio-controller;

            channel@0 {
                reg = <0>;
                adi,mode = <CH_MODE_DAC>;
            };
            channel@1 {
                reg = <1>;
                adi,mode = <CH_MODE_ADC>;
            };
            channel@2 {
                reg = <2>;
                adi,mode = <CH_MODE_DAC_AND_ADC>;
            };
            channel@3 {
                reg = <3>;
                adi,mode = <CH_MODE_DAC_AND_ADC>;
                adi,off-state = <CH_OFFSTATE_PULLDOWN>;
            };
            channel@4 {
                reg = <4>;
                adi,mode = <CH_MODE_UNUSED>;
                adi,off-state = <CH_OFFSTATE_PULLDOWN>;
            };
            channel@5 {
                reg = <5>;
                adi,mode = <CH_MODE_GPIO>;
                adi,off-state = <CH_OFFSTATE_PULLDOWN>;
            };
            channel@6 {
                reg = <6>;
                adi,mode = <CH_MODE_GPIO>;
                adi,off-state = <CH_OFFSTATE_PULLDOWN>;
            };
            channel@7 {
                reg = <7>;
                adi,mode = <CH_MODE_GPIO>;
                adi,off-state = <CH_OFFSTATE_PULLDOWN>;
            };
        };
        ad5593r@10 {
            compatible = "adi,ad5593r";
            #size-cells = <0>;
            #address-cells = <1>;
            #gpio-cells = <2>;
            reg = <0x10>;
            gpio-controller;

            channel@0 {
                reg = <0>;
                adi,mode = <CH_MODE_DAC>;
                adi,off-state = <CH_OFFSTATE_PULLDOWN>;
            };
            channel@1 {
                reg = <1>;
                adi,mode = <CH_MODE_ADC>;
                adi,off-state = <CH_OFFSTATE_PULLDOWN>;
            };
            channel@2 {
                reg = <2>;
                adi,mode = <CH_MODE_DAC_AND_ADC>;
                adi,off-state = <CH_OFFSTATE_PULLDOWN>;
            };
            channel@6 {
                reg = <6>;
                adi,mode = <CH_MODE_GPIO>;
                adi,off-state = <CH_OFFSTATE_PULLDOWN>;
            };
        };
    };
...
```

## Documentation/devicetree/bindings/iio/dac/adi,ad5624r.yaml
```yaml
# SPDX-License-Identifier: (GPL-2.0 OR BSD-2-Clause)
%YAML 1.2
---
$id: http://devicetree.org/schemas/iio/dac/adi,ad5624r.yaml#
$schema: http://devicetree.org/meta-schemas/core.yaml#

title: Analog Devices AD5624r and similar DACs

maintainers:
  - Jonathan Cameron <jic23@kernel.org>

properties:
  compatible:
    enum:
      - adi,ad5624r3
      - adi,ad5644r3
      - adi,ad5664r3
      - adi,ad5624r5
      - adi,ad5644r5
      - adi,ad5664r5

  reg:
    maxItems: 1

  vref-supply:
    description: If not present, internal reference will be used.

required:
  - compatible
  - reg

allOf:
  - $ref: /schemas/spi/spi-peripheral-props.yaml#

unevaluatedProperties: false

examples:
  - |
    spi {
        #address-cells = <1>;
        #size-cells = <0>;
        dac@0 {
            reg = <0>;
            compatible = "adi,ad5624r3";
            vref-supply = <&vref>;
        };
    };
...
```

## Documentation/devicetree/bindings/iio/dac/adi,ad5706r.yaml
```yaml
# SPDX-License-Identifier: (GPL-2.0-only OR BSD-2-Clause)
%YAML 1.2
---
$id: http://devicetree.org/schemas/iio/dac/adi,ad5706r.yaml#
$schema: http://devicetree.org/meta-schemas/core.yaml#

title: Analog Devices AD5706R 4-Channel Current Output DAC

maintainers:
  - Alexis Czezar Torreno <alexisczezar.torreno@analog.com>

description: |
  The AD5706R is a 4-channel, 16-bit resolution, current output
  digital-to-analog converter (DAC) with programmable output current
  ranges (50mA, 150mA, 200mA, 300mA), an integrated 2.5V voltage
  reference, and load DAC, A/B toggle, and dither functions.

  Datasheet:
    https://www.analog.com/en/products/ad5706r.html

properties:
  compatible:
    enum:
      - adi,ad5706r

  reg:
    maxItems: 1

  avdd-supply:
    description: Analog power supply (2.9V to 3.6V).

  iovdd-supply:
    description: Logic power supply (1.14V to 1.89V).

  pvdd0-supply:
    description: Power supply for IDAC0 channel (1.65V to AVDD).

  pvdd1-supply:
    description: Power supply for IDAC1 channel (1.65V to AVDD).

  pvdd2-supply:
    description: Power supply for IDAC2 channel (1.65V to AVDD).

  pvdd3-supply:
    description: Power supply for IDAC3 channel (1.65V to AVDD).

  vref-supply:
    description:
      Optional external 2.5V voltage reference. If not provided, the
      internal 2.5V reference is used.

  pwms:
    maxItems: 1
    description:
      Optional PWM connected to the LDAC/TGP/DCK pin for hardware
      triggered DAC updates, toggle, or dither clock generation.

  reset-gpios:
    maxItems: 1
    description:
      GPIO connected to the active low RESET pin. If not provided,
      software reset is used.

  enable-gpios:
    maxItems: 1
    description:
      GPIO connected to the active low OUT_EN pin. Controls whether
      the current outputs are enabled or in high-Z/ground state.

required:
  - compatible
  - reg
  - avdd-supply
  - iovdd-supply

allOf:
  - $ref: /schemas/spi/spi-peripheral-props.yaml#

unevaluatedProperties: false

examples:
  - |
    #include <dt-bindings/gpio/gpio.h>

    spi {
        #address-cells = <1>;
        #size-cells = <0>;

        dac@0 {
            compatible = "adi,ad5706r";
            reg = <0>;
            avdd-supply = <&avdd>;
            iovdd-supply = <&iovdd>;
            pvdd0-supply = <&pvdd>;
            pvdd1-supply = <&pvdd>;
            pvdd2-supply = <&pvdd>;
            pvdd3-supply = <&pvdd>;
            vref-supply = <&vref>;
            spi-max-frequency = <50000000>;
            pwms = <&pwm0 0 1000000 0>;
            reset-gpios = <&gpio0 10 GPIO_ACTIVE_LOW>;
            enable-gpios = <&gpio0 12 GPIO_ACTIVE_LOW>;
        };
    };
...
```
