## Documentation/devicetree/bindings/iio/chemical/sciosense,ens160.yaml
```yaml
# SPDX-License-Identifier: (GPL-2.0 OR BSD-2-Clause)
%YAML 1.2
---
$id: http://devicetree.org/schemas/iio/chemical/sciosense,ens160.yaml#
$schema: http://devicetree.org/meta-schemas/core.yaml#

title: ScioSense ENS160 multi-gas sensor

maintainers:
  - Gustavo Silva <gustavograzs@gmail.com>

description: |
  Digital Multi-Gas Sensor for Monitoring Indoor Air Quality.

  Datasheet:
    https://www.sciosense.com/wp-content/uploads/2023/12/ENS160-Datasheet.pdf

properties:
  compatible:
    enum:
      - sciosense,ens160

  reg:
    maxItems: 1

  interrupts:
    maxItems: 1

  vdd-supply: true
  vddio-supply: true

required:
  - compatible
  - reg

allOf:
  - $ref: /schemas/spi/spi-peripheral-props.yaml#

unevaluatedProperties: false

examples:
  - |
    #include <dt-bindings/interrupt-controller/irq.h>
    i2c {
      #address-cells = <1>;
      #size-cells = <0>;

      gas-sensor@52 {
        compatible = "sciosense,ens160";
        reg = <0x52>;
        interrupt-parent = <&gpio0>;
        interrupts = <19 IRQ_TYPE_EDGE_FALLING>;
      };
    };
  - |
    #include <dt-bindings/interrupt-controller/irq.h>
    spi {
      #address-cells = <1>;
      #size-cells = <0>;

      gas-sensor@0 {
        compatible = "sciosense,ens160";
        reg = <0>;
        spi-max-frequency = <10000000>;
        interrupt-parent = <&gpio>;
        interrupts = <19 IRQ_TYPE_EDGE_FALLING>;
      };
    };

...
```

## Documentation/devicetree/bindings/iio/chemical/senseair,sunrise.yaml
```yaml
# SPDX-License-Identifier: (GPL-2.0 OR BSD-2-Clause)
%YAML 1.2
---
$id: http://devicetree.org/schemas/iio/chemical/senseair,sunrise.yaml#
$schema: http://devicetree.org/meta-schemas/core.yaml#

title: Senseair Sunrise 006-0-0007 CO2 Sensor

maintainers:
  - Jacopo Mondi <jacopo@jmondi.org>

description: |
  Senseair Sunrise 006-0-0007 is a NDIR CO2 sensor. It supports I2C or UART buses
  for communications and control.

  Datasheets:
    https://rmtplusstoragesenseair.blob.core.windows.net/docs/Dev/publicerat/PSP11704.pdf
    https://rmtplusstoragesenseair.blob.core.windows.net/docs/Dev/publicerat/PSH11649.pdf
    https://rmtplusstoragesenseair.blob.core.windows.net/docs/Dev/publicerat/TDE5531.pdf
    https://rmtplusstoragesenseair.blob.core.windows.net/docs/Market/publicerat/TDE7318.pdf

properties:
  compatible:
    const: senseair,sunrise-006-0-0007

  reg:
    maxItems: 1

  ndry-gpios:
    maxItems: 1
    description:
      Phandle to the GPIO line connected to the nDRY pin. Typically active low.

  en-gpios:
    maxItems: 1
    description:
      Phandle to the GPIO line connected to the EN pin. Typically active high.

required:
  - compatible
  - reg

additionalProperties: false

examples:
  - |
    i2c {
      #address-cells = <1>;
      #size-cells = <0>;

      co2-sensor@68 {
        compatible = "senseair,sunrise-006-0-0007";
        reg = <0x68>;
      };
    };
```

## Documentation/devicetree/bindings/iio/chemical/sensirion,scd30.yaml
```yaml
# SPDX-License-Identifier: (GPL-2.0 OR BSD-2-Clause)
%YAML 1.2
---
$id: http://devicetree.org/schemas/iio/chemical/sensirion,scd30.yaml#
$schema: http://devicetree.org/meta-schemas/core.yaml#

title: Sensirion SCD30 carbon dioxide sensor

maintainers:
  - Tomasz Duszynski <tomasz.duszynski@octakon.com>

description: |
  Air quality sensor capable of measuring co2 concentration, temperature
  and relative humidity.

properties:
  compatible:
    enum:
      - sensirion,scd30

  reg:
    maxItems: 1

  interrupts:
    maxItems: 1

  vdd-supply: true

  sensirion,sel-gpios:
    description: GPIO connected to the SEL line
    maxItems: 1

  sensirion,pwm-gpios:
    description: GPIO connected to the PWM line
    maxItems: 1

required:
  - compatible

additionalProperties: false

examples:
  - |
    # include <dt-bindings/interrupt-controller/irq.h>
    i2c {
      #address-cells = <1>;
      #size-cells = <0>;

      co2-sensor@61 {
        compatible = "sensirion,scd30";
        reg = <0x61>;
        vdd-supply = <&vdd>;
        interrupt-parent = <&gpio0>;
        interrupts = <0 IRQ_TYPE_LEVEL_HIGH>;
      };
    };
  - |
    # include <dt-bindings/interrupt-controller/irq.h>
    serial {
      co2-sensor {
        compatible = "sensirion,scd30";
        vdd-supply = <&vdd>;
        interrupt-parent = <&gpio0>;
        interrupts = <0 IRQ_TYPE_LEVEL_HIGH>;
      };
    };

...
```

## Documentation/devicetree/bindings/iio/chemical/sensirion,scd4x.yaml
```yaml
# SPDX-License-Identifier: (GPL-2.0 OR BSD-2-Clause)
%YAML 1.2
---
$id: http://devicetree.org/schemas/iio/chemical/sensirion,scd4x.yaml#
$schema: http://devicetree.org/meta-schemas/core.yaml#

title: Sensirion SCD4X carbon dioxide sensor

maintainers:
  - Roan van Dijk <roan@protonic.nl>

description: |
  Air quality sensor capable of measuring co2 concentration, temperature
  and relative humidity.

properties:
  compatible:
    enum:
      - sensirion,scd40
      - sensirion,scd41

  reg:
    maxItems: 1

  interrupts:
    maxItems: 1

  vdd-supply: true

required:
  - compatible
  - reg

additionalProperties: false

examples:
  - |
    i2c {
      #address-cells = <1>;
      #size-cells = <0>;

      co2-sensor@62 {
        compatible = "sensirion,scd41";
        reg = <0x62>;
      };
    };
```

## Documentation/devicetree/bindings/iio/chemical/sensirion,sgp30.txt
```
* Sensirion SGP30/SGPC3 multi-pixel Gas Sensor

Required properties:

  - compatible: must be one of
    "sensirion,sgp30"
    "sensirion,sgpc3"
  - reg: the I2C address of the sensor

Example:

gas@58 {
	compatible = "sensirion,sgp30";
	reg = <0x58>;
};
```

## Documentation/devicetree/bindings/iio/chemical/sensirion,sps30.txt
```
* Sensirion SPS30 particulate matter sensor

Required properties:
- compatible: must be "sensirion,sps30"
- reg: the I2C address of the sensor

Example:

sps30@69 {
	compatible = "sensirion,sps30";
	reg = <0x69>;
};
```

## Documentation/devicetree/bindings/iio/chemical/sensirion,sps30.yaml
```yaml
# SPDX-License-Identifier: GPL-2.0
%YAML 1.2
---
$id: http://devicetree.org/schemas/iio/chemical/sensirion,sps30.yaml#
$schema: http://devicetree.org/meta-schemas/core.yaml#

title: Sensirion SPS30 particulate matter sensor

maintainers:
  - Tomasz Duszynski <tduszyns@gmail.com>

description: |
  Air pollution sensor capable of measuring mass concentration of dust
  particles.

properties:
  compatible:
    enum:
      - sensirion,sps30
  reg:
    maxItems: 1

required:
  - compatible
  - reg

additionalProperties: false

examples:
  - |
    i2c {
      #address-cells = <1>;
      #size-cells = <0>;

      air-pollution-sensor@69 {
        compatible = "sensirion,sps30";
        reg = <0x69>;
      };
    };

...
```

## Documentation/devicetree/bindings/iio/chemical/winsen,mhz19b.yaml
```yaml
# SPDX-License-Identifier: (GPL-2.0 OR BSD-2-Clause)
%YAML 1.2
---
$id: http://devicetree.org/schemas/iio/chemical/winsen,mhz19b.yaml#
$schema: http://devicetree.org/meta-schemas/core.yaml#

title: MHZ19B CO2 sensor

maintainers:
  - Gyeyoung Baek <gye976@gmail.com>

properties:
  compatible:
    const: winsen,mhz19b

  vin-supply:
    description: Regulator that provides power to the sensor

required:
  - compatible
  - vin-supply

additionalProperties: false

examples:
  - |
    serial {
      co2-sensor {
        compatible = "winsen,mhz19b";
        vin-supply = <&vdd>;
      };
    };
...
```

## Documentation/devicetree/bindings/iio/common.yaml
```yaml
# SPDX-License-Identifier: (GPL-2.0 OR BSD-2-Clause)
%YAML 1.2
---
$id: http://devicetree.org/schemas/iio/common.yaml#
$schema: http://devicetree.org/meta-schemas/core.yaml#

title: Common properties for iio sensors

maintainers:
  - Jonathan Cameron <jic23@kernel.org>
  - Guido Günther <agx@sigxcpu.org>

description: |
  This document defines device tree properties common to several iio
  sensors. It doesn't constitue a device tree binding specification by itself but
  is meant to be referenced by device tree bindings.

  When referenced from sensor tree bindings the properties defined in this
  document are defined as follows. The sensor tree bindings are responsible for
  defining whether each property is required or optional.

properties:
  proximity-near-level:
    $ref: /schemas/types.yaml#/definitions/uint32
    description: |
      For proximity sensors whether an object can be considered near to the
      device depends on parameters like sensor position, covering glass and
      aperture. This value gives an indication to userspace for which
      sensor readings this is the case.

      Raw proximity values equal or above this level should be
      considered 'near' to the device (an object is near to the
      sensor).

...
```

## Documentation/devicetree/bindings/iio/dac/ad5592r.txt
```
Analog Devices AD5592R/AD5593R DAC/ADC device driver

Required properties for the AD5592R:
	- compatible: Must be "adi,ad5592r"
	- reg: SPI chip select number for the device
	- spi-max-frequency: Max SPI frequency to use (< 30000000)
	- spi-cpol: The AD5592R requires inverse clock polarity (CPOL) mode

Required properties for the AD5593R:
	- compatible: Must be "adi,ad5593r"
	- reg: I2C address of the device

Required properties for all supported chips:
	- #address-cells: Should be 1.
	- #size-cells: Should be 0.
	- channel nodes:
	  Each child node represents one channel and has the following
	  Required properties:
		* reg: Pin on which this channel is connected to.
		* adi,mode: Mode or function of this channel.
			    Macros specifying the valid values
			    can be found in <dt-bindings/iio/adi,ad5592r.h>.

			    The following values are currently supported:
				* CH_MODE_UNUSED (the pin is unused)
				* CH_MODE_ADC (the pin is ADC input)
				* CH_MODE_DAC (the pin is DAC output)
				* CH_MODE_DAC_AND_ADC (the pin is DAC output
					but can be monitored by an ADC, since
					there is no disadvantage this
					this should be considered as the
					preferred DAC mode)
				* CH_MODE_GPIO (the pin is registered
					with GPIOLIB)
	 Optional properties:
		* adi,off-state: State of this channel when unused or the
				 device gets removed. Macros specifying the
				 valid values can be found in
				 <dt-bindings/iio/adi,ad5592r.h>.

				* CH_OFFSTATE_PULLDOWN (the pin is pulled down)
				* CH_OFFSTATE_OUT_LOW  (the pin is output low)
				* CH_OFFSTATE_OUT_HIGH (the pin is output high)
				* CH_OFFSTATE_OUT_TRISTATE (the pin is
					tristated output)


Optional properties:
	- vref-supply: Phandle to the external reference voltage supply. This should
	  only be set if there is an external reference voltage connected to the VREF
	  pin. If the property is not set the internal 2.5V reference is used.
	- reset-gpios : GPIO spec for the RESET pin. If specified, it will be
	  asserted during driver probe.
	- gpio-controller: Marks the device node as a GPIO controller.
	- #gpio-cells: Should be 2. The first cell is the GPIO number and the second
	  cell specifies GPIO flags, as defined in <dt-bindings/gpio/gpio.h>.

AD5592R Example:

	#include <dt-bindings/iio/adi,ad5592r.h>

	vref: regulator-vref {
		compatible = "regulator-fixed";
		regulator-name = "vref-ad559x";
		regulator-min-microvolt = <3300000>;
		regulator-max-microvolt = <3300000>;
		regulator-always-on;
	};

	ad5592r@0 {
		#size-cells = <0>;
		#address-cells = <1>;
		#gpio-cells = <2>;
		compatible = "adi,ad5592r";
		reg = <0>;

		spi-max-frequency = <1000000>;
		spi-cpol;

		vref-supply = <&vref>; /* optional */
		reset-gpios = <&gpio0 86 0>;  /* optional */
		gpio-controller;

		channel@0 {
			reg = <0>;
			adi,mode = <CH_MODE_DAC>;
		};
		channel@1 {
			reg = <1>;
			adi,mode = <CH_MODE_ADC>;
		};
		channel@2 {
			reg = <2>;
			adi,mode = <CH_MODE_DAC_AND_ADC>;
		};
		channel@3 {
			reg = <3>;
			adi,mode = <CH_MODE_DAC_AND_ADC>;
			adi,off-state = <CH_OFFSTATE_PULLDOWN>;
		};
		channel@4 {
			reg = <4>;
			adi,mode = <CH_MODE_UNUSED>;
			adi,off-state = <CH_OFFSTATE_PULLDOWN>;
		};
		channel@5 {
			reg = <5>;
			adi,mode = <CH_MODE_GPIO>;
			adi,off-state = <CH_OFFSTATE_PULLDOWN>;
		};
		channel@6 {
			reg = <6>;
			adi,mode = <CH_MODE_GPIO>;
			adi,off-state = <CH_OFFSTATE_PULLDOWN>;
		};
		channel@7 {
			reg = <7>;
			adi,mode = <CH_MODE_GPIO>;
			adi,off-state = <CH_OFFSTATE_PULLDOWN>;
		};
	};

AD5593R Example:

	#include <dt-bindings/iio/adi,ad5592r.h>

	ad5593r@10 {
		#size-cells = <0>;
		#address-cells = <1>;
		#gpio-cells = <2>;
		compatible = "adi,ad5593r";
		reg = <0x10>;
		gpio-controller;

		channel@0 {
			reg = <0>;
			adi,mode = <CH_MODE_DAC>;
			adi,off-state = <CH_OFFSTATE_PULLDOWN>;
		};
		channel@1 {
			reg = <1>;
			adi,mode = <CH_MODE_ADC>;
			adi,off-state = <CH_OFFSTATE_PULLDOWN>;
		};
		channel@2 {
			reg = <2>;
			adi,mode = <CH_MODE_DAC_AND_ADC>;
			adi,off-state = <CH_OFFSTATE_PULLDOWN>;
		};
		channel@6 {
			reg = <6>;
			adi,mode = <CH_MODE_GPIO>;
			adi,off-state = <CH_OFFSTATE_PULLDOWN>;
		};
	};
```

## Documentation/devicetree/bindings/iio/dac/ad5755.txt
```
* Analog Devices AD5755 IIO Multi-Channel DAC Linux Driver

Required properties:
 - compatible: Has to contain one of the following:
	adi,ad5755
	adi,ad5755-1
	adi,ad5757
	adi,ad5735
	adi,ad5737

 - reg: spi chip select number for the device
 - spi-cpha or spi-cpol: is the only modes that is supported

Recommended properties:
 - spi-max-frequency: Definition as per
		Documentation/devicetree/bindings/spi/spi-bus.txt

Optional properties:
See include/dt-bindings/iio/ad5755.h
 - adi,ext-dc-dc-compenstation-resistor: boolean set if the hardware have an
					 external resistor and thereby bypasses
					 the internal compensation resistor.
 - adi,dc-dc-phase:
	Valid values for DC DC Phase control is:
	0: All dc-to-dc converters clock on the same edge.
	1: Channel A and Channel B clock on the same edge,
	   Channel C and Channel D clock on opposite edges.
	2: Channel A and Channel C clock on the same edge,
	   Channel B and Channel D clock on opposite edges.
	3: Channel A, Channel B, Channel C, and Channel D
	   clock 90 degrees out of phase from each other.
 - adi,dc-dc-freq-hz:
	Valid values for DC DC frequency is [Hz]:
	250000
	410000
	650000
 - adi,dc-dc-max-microvolt:
	Valid values for the maximum allowed Vboost voltage supplied by
	the dc-to-dc converter is:
	23000000
	24500000
	27000000
	29500000

Optional for every channel:
 - adi,mode:
	Valid values for DAC modes is:
	0: 0 V to 5 V voltage range.
	1: 0 V to 10 V voltage range.
	2: Plus minus 5 V voltage range.
	3: Plus minus 10 V voltage range.
	4: 4 mA to 20 mA current range.
	5: 0 mA to 20 mA current range.
	6: 0 mA to 24 mA current range.
 - adi,ext-current-sense-resistor: boolean set if the hardware a external
				   current sense resistor.
 - adi,enable-voltage-overrange: boolean enable voltage overrange
 - adi,slew: Array of slewrate settings should contain 3 fields:
	1: Should be either 0 or 1 in order to enable or disable slewrate.
	2: Slew rate settings:
		Valid values for the slew rate update frequency:
		64000
		32000
		16000
		8000
		4000
		2000
		1000
		500
		250
		125
		64
		32
		16
		8
		4
		0
	3: Slew step size:
		Valid values for the step size LSBs:
		1
		2
		4
		16
		32
		64
		128
		256

Example:
dac@0 {
	#address-cells = <1>;
	#size-cells = <0>;
	compatible = "adi,ad5755";
	reg = <0>;
	spi-max-frequency = <1000000>;
	spi-cpha;
	adi,dc-dc-phase = <0>;
	adi,dc-dc-freq-hz = <410000>;
	adi,dc-dc-max-microvolt = <23000000>;
	channel@0 {
		reg = <0>;
		adi,mode = <4>;
		adi,ext-current-sense-resistor;
		adi,slew = <0 64000 1>;
	};
	channel@1 {
		reg = <1>;
		adi,mode = <4>;
		adi,ext-current-sense-resistor;
		adi,slew = <0 64000 1>;
	};
	channel@2 {
		reg = <2>;
		adi,mode = <4>;
		adi,ext-current-sense-resistor;
		adi,slew = <0 64000 1>;
	};
	channel@3 {
		reg = <3>;
		adi,mode = <4>;
		adi,ext-current-sense-resistor;
		adi,slew = <0 64000 1>;
	};
};
```
