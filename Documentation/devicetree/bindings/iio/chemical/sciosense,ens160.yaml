## Documentation/devicetree/bindings/iio/dac/ad5758.txt
```
Analog Devices AD5758 DAC device driver

Required properties for the AD5758:
	- compatible: Must be "adi,ad5758"
	- reg: SPI chip select number for the device
	- spi-max-frequency: Max SPI frequency to use (< 50000000)
	- spi-cpha: is the only mode that is supported

Required properties:

 - adi,dc-dc-mode: Mode of operation of the dc-to-dc converter
		   Dynamic Power Control (DPC)
		   In this mode, the AD5758 circuitry senses the output
		   voltage and dynamically regulates the supply voltage,
		   VDPC+, to meet compliance requirements plus an optimized
		   headroom voltage for the output buffer.

		   Programmable Power Control (PPC)
		   In this mode, the VDPC+ voltage is user-programmable to
		   a fixed level that needs to accommodate the maximum output
		   load required.

		   The output of the DAC core is either converted to a
		   current or voltage output at the VIOUT pin. Only one mode
		   can be enabled at any one time.

		   The following values are currently supported:
			* 1: DPC current mode
			* 2: DPC voltage mode
			* 3: PPC current mode

 Depending on the selected output mode (voltage or current) one of the
 two properties must
 be present:

 - adi,range-microvolt: Voltage output range
		The array of voltage output ranges must contain two fields:
		* <0 5000000>: 0 V to 5 V voltage range
		* <0 10000000>: 0 V to 10 V voltage range
		* <(-5000000) 5000000>: ±5 V voltage range
		* <(-10000000) 10000000>: ±10 V voltage range
 - adi,range-microamp: Current output range
		The array of current output ranges must contain two fields:
		* <0 20000>: 0 mA to 20 mA current range
		* <0 24000>: 0 mA to 24 mA current range
		* <4 24000>: 4 mA to 20 mA current range
		* <(-20000) 20000>: ±20 mA current range
		* <(-24000) 24000>: ±24 mA current range
		* <(-1000) 22000>: −1 mA to +22 mA current range

Optional properties:

 - reset-gpios : GPIO spec for the RESET pin. If specified, it will be
		 asserted during driver probe.

 - adi,dc-dc-ilim-microamp: The dc-to-dc converter current limit
		   The following values are currently supported [uA]:
			* 150000
			* 200000
			* 250000
			* 300000
			* 350000
			* 400000

 - adi,slew-time-us: The time it takes for the output to reach the
 full scale [uS]
		     The supported range is between 133us up to 1023984375us

AD5758 Example:

	dac@0 {
		compatible = "adi,ad5758";
		reg = <0>;
		spi-max-frequency = <1000000>;
		spi-cpha;

		reset-gpios = <&gpio 22 0>;

		adi,dc-dc-mode = <2>;
		adi,range-microvolt = <0 10000000>;
		adi,dc-dc-ilim-microamp = <200000>;
		adi,slew-time-us = <125000>;
	};
```

## Documentation/devicetree/bindings/iio/dac/ad7303.txt
```
Analog Devices AD7303 DAC device driver

Required properties:
	- compatible: Must be "adi,ad7303"
	- reg: SPI chip select number for the device
	- spi-max-frequency: Max SPI frequency to use (< 30000000)
	- Vdd-supply: Phandle to the Vdd power supply

Optional properties:
	- REF-supply: Phandle to the external reference voltage supply. This should
	  only be set if there is an external reference voltage connected to the REF
	  pin. If the property is not set Vdd/2 is used as the reference voltage.

Example:

		ad7303@4 {
			compatible = "adi,ad7303";
			reg = <4>;
			spi-max-frequency = <10000000>;
			Vdd-supply = <&vdd_supply>;
			adi,use-external-reference;
			REF-supply = <&vref_supply>;
		};
```

## Documentation/devicetree/bindings/iio/dac/adi,ad3530r.yaml
```yaml
# SPDX-License-Identifier: (GPL-2.0-only OR BSD-2-Clause)
%YAML 1.2
---
$id: http://devicetree.org/schemas/iio/dac/adi,ad3530r.yaml#
$schema: http://devicetree.org/meta-schemas/core.yaml#

title: Analog Devices AD3530R and Similar DACs

maintainers:
  - Kim Seer Paller <kimseer.paller@analog.com>

description: |
  The AD3530/AD3530R (8-channel) and AD3531/AD3531R (4-channel) are low-power,
  16-bit, buffered voltage output digital-to-analog converters (DACs) with
  software-programmable gain controls, providing full-scale output spans of 2.5V
  or 5V for reference voltages of 2.5V. These devices operate from a single 2.7V
  to 5.5V supply and are guaranteed monotonic by design. The "R" variants
  include a 2.5V, 5ppm/°C internal reference, which is disabled by default.
  Datasheet can be found here:
  https://www.analog.com/media/en/technical-documentation/data-sheets/ad3530_ad530r.pdf
  https://www.analog.com/media/en/technical-documentation/data-sheets/ad3531-ad3531r.pdf

properties:
  compatible:
    enum:
      - adi,ad3530
      - adi,ad3530r
      - adi,ad3531
      - adi,ad3531r

  reg:
    maxItems: 1

  spi-max-frequency:
    maximum: 50000000

  vdd-supply:
    description: Power Supply Input.

  iovdd-supply:
    description: Digital Power Supply Input.

  io-channels:
    description:
      ADC channel used to monitor internal die temperature, output voltages, and
      current of a selected channel via the MUXOUT pin.
    maxItems: 1

  ref-supply:
    description:
      Reference Input/Output. The voltage at the REF pin sets the full-scale
      range of all channels. If not provided the internal reference is used and
      also provided on the VREF pin.

  reset-gpios:
    description:
      Active low signal that is falling edge sensitive. When it is deasserted,
      the digital core initialization is performed and all DAC registers except
      the Interface Configuration A register are reset to their default values.
    maxItems: 1

  ldac-gpios:
    description:
      LDAC pin to be used as a hardware trigger to update the DAC channels. If
      not present, the DAC channels are updated by Software LDAC.
    maxItems: 1

  adi,range-double:
    description:
      Configure the output range for all channels. If the property is present,
      the output will range from 0V to 2Vref. If the property is not present,
      the output will range from 0V to Vref.
    type: boolean

required:
  - compatible
  - reg
  - vdd-supply
  - iovdd-supply

allOf:
  - $ref: /schemas/spi/spi-peripheral-props.yaml#

unevaluatedProperties: false

examples:
  - |
    spi {
        #address-cells = <1>;
        #size-cells = <0>;
        dac@0 {
            compatible = "adi,ad3530r";
            reg = <0>;
            spi-max-frequency = <1000000>;

            vdd-supply = <&vdd>;
            iovdd-supply = <&iovdd>;
        };
    };
...
```

## Documentation/devicetree/bindings/iio/dac/adi,ad3552r.yaml
```yaml
# SPDX-License-Identifier: (GPL-2.0 OR BSD-2-Clause)
# Copyright 2020 Analog Devices Inc.
%YAML 1.2
---
$id: http://devicetree.org/schemas/iio/dac/adi,ad3552r.yaml#
$schema: http://devicetree.org/meta-schemas/core.yaml#

title: Analog Devices AD2552R DAC device driver

maintainers:
  - Nuno Sá <nuno.sa@analog.com>

description: |
  Bindings for the Analog Devices AD3552R DAC device and similar.
  Datasheet can be found here:
    https://www.analog.com/media/en/technical-documentation/data-sheets/ad3541r.pdf
    https://www.analog.com/media/en/technical-documentation/data-sheets/ad3542r.pdf
    https://www.analog.com/media/en/technical-documentation/data-sheets/ad3551r.pdf
    https://www.analog.com/media/en/technical-documentation/data-sheets/ad3552r.pdf

properties:
  compatible:
    enum:
      - adi,ad3541r
      - adi,ad3542r
      - adi,ad3551r
      - adi,ad3552r

  reg:
    maxItems: 1

  spi-max-frequency:
    maximum: 66000000

  reset-gpios:
    maxItems: 1

  ldac-gpios:
    description: |
      LDAC pin to be used as a hardware trigger to update the DAC channels.
    maxItems: 1

  vref-supply:
    description:
      The regulator to use as an external reference. If it does not exists the
      internal reference will be used. External reference must be 2.5V

  adi,vref-out-en:
    description: Vref I/O driven by internal vref to 2.5V. If not set, Vref pin
      will be floating.
    type: boolean

  adi,sdo-drive-strength:
    description: |
      Configure SDIO0 and SDIO1 strength levels:
        - 0: low SDO drive strength.
        - 1: medium low SDO drive strength.
        - 2: medium high SDO drive strength.
        - 3: high SDO drive strength
    $ref: /schemas/types.yaml#/definitions/uint32
    enum: [0, 1, 2, 3]

  io-backends:
    description: The iio backend reference.
      Device can be optionally connected to the "axi-ad3552r IP" fpga-based
      QSPI + DDR (Double Data Rate) controller to reach high speed transfers.
    maxItems: 1

  '#address-cells':
    const: 1

  '#size-cells':
    const: 0

patternProperties:
  "^channel@([0-1])$":
    type: object
    description: Configurations of the DAC Channels

    additionalProperties: false

    properties:
      reg:
        description: Channel number
        enum: [0, 1]

      adi,output-range-microvolt: true

      custom-output-range-config:
        type: object
        additionalProperties: false
        description: Configuration of custom range when
          adi,output-range-microvolt is not present.
          The formulas for calculation the output voltages are
            Vout_fs = 2.5 + [(GainN + Offset/1024) * 2.5 * Rfbx * 1.03]
            Vout_zs = 2.5 - [(GainP + Offset/1024) * 2.5 * Rfbx * 1.03]

        properties:
          adi,gain-offset:
            description: Gain offset used in the above formula
            $ref: /schemas/types.yaml#/definitions/int32
            maximum: 511
            minimum: -511

          adi,gain-scaling-p:
            description: GainP = 1 / ( 2 ^ adi,gain-scaling-p)
            $ref: /schemas/types.yaml#/definitions/uint32
            enum: [0, 1, 2, 3]

          adi,gain-scaling-n:
            description: GainN = 1 / ( 2 ^ adi,gain-scaling-n)
            $ref: /schemas/types.yaml#/definitions/uint32
            enum: [0, 1, 2, 3]

          adi,rfb-ohms:
            description: Feedback Resistor

        required:
          - adi,gain-offset
          - adi,gain-scaling-p
          - adi,gain-scaling-n
          - adi,rfb-ohms

    required:
      - reg

    oneOf:
      # If adi,output-range-microvolt is missing,
      # custom-output-range-config must be used
      - required:
          - adi,output-range-microvolt

      - required:
          - custom-output-range-config

allOf:
  - $ref: /schemas/spi/spi-peripheral-props.yaml#
  - if:
      properties:
        compatible:
          contains:
            enum:
              - adi,ad3541r
              - adi,ad3542r
    then:
      patternProperties:
        "^channel@([0-1])$":
          type: object
          properties:
            adi,output-range-microvolt:
              description: |
                Voltage output range of the channel as <minimum, maximum>
                Required connections:
                  Rfb1x for: 0 to 2.5 V; 0 to 3V; 0 to 5 V;
                  Rfb2x for: 0 to 10 V; -2.5 to 7.5V; -5 to 5 V;
              oneOf:
                - items:
                    - const: 0
                    - enum: [2500000, 3000000, 5000000, 10000000]
                - items:
                    - const: -2500000
                    - const: 7500000
                - items:
                    - const: -5000000
                    - const: 5000000

          required:
            - adi,output-range-microvolt

  - if:
      properties:
        compatible:
          contains:
            enum:
              - adi,ad3551r
              - adi,ad3552r
    then:
      patternProperties:
        "^channel@([0-1])$":
          type: object
          properties:
            adi,output-range-microvolt:
              description: |
                Voltage output range of the channel as <minimum, maximum>
                Required connections:
                  Rfb1x for: 0 to 2.5 V; 0 to 5 V;
                  Rfb2x for: 0 to 10 V; -5 to 5 V;
                  Rfb4x for: -10 to 10V
              oneOf:
                - items:
                    - const: 0
                    - enum: [2500000, 5000000, 10000000]
                - items:
                    - const: -5000000
                    - const: 5000000
                - items:
                    - const: -10000000
                    - const: 10000000

  - if:
      properties:
        compatible:
          contains:
            enum:
              - adi,ad3541r
              - adi,ad3551r
    then:
      properties:
        channel@1: false
        channel@0:
          properties:
            reg:
              const: 0

required:
  - compatible
  - reg
  - spi-max-frequency

additionalProperties: false

examples:
  - |
    spi {
        #address-cells = <1>;
        #size-cells = <0>;
        ad3552r@0 {
            compatible = "adi,ad3552r";
            reg = <0>;
            spi-max-frequency = <20000000>;
            #address-cells = <1>;
            #size-cells = <0>;
            channel@0 {
                reg = <0>;
                adi,output-range-microvolt = <0 10000000>;
            };
            channel@1 {
                reg = <1>;
                custom-output-range-config {
                    adi,gain-offset = <5>;
                    adi,gain-scaling-p = <1>;
                    adi,gain-scaling-n = <2>;
                    adi,rfb-ohms = <1>;
                };
            };
        };
    };
...
```
