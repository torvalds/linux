## Documentation/devicetree/bindings/iio/temperature/tmp007.txt
```
* TI TMP007 - IR thermopile sensor with integrated math engine

Link to datasheet: http://www.ti.com/lit/ds/symlink/tmp007.pdf

Required properties:

  - compatible: should be "ti,tmp007"
  - reg: the I2C address of the sensor (changeable via ADR pins)
		------------------------------
		|ADR1 | ADR0 | Device Address|
		------------------------------
		   0      0        0x40
		   0	  1	   0x41
		   0	 SDA       0x42
		   0     SCL       0x43
		   1      0        0x44
		   1      1        0x45
		   1	 SDA	   0x46
		   1     SCL       0x47

Optional properties:

  - interrupt-parent: should be the phandle for the interrupt controller

  - interrupts: interrupt mapping for GPIO IRQ (level active low)

Example:

tmp007@40 {
        compatible = "ti,tmp007";
        reg = <0x40>;
	interrupt-parent = <&gpio0>;
	interrupts = <5 0x08>;
};
```

## Documentation/devicetree/bindings/iio/temperature/tsys01.txt
```
* TSYS01 - Measurement Specialties temperature sensor

Required properties:

	- compatible: should be "meas,tsys01"
	- reg: I2C address of the sensor (changeable via CSB pin)

		------------------------
		| CSB | Device Address |
		------------------------
		   1         0x76
		   0	     0x77

Example:

tsys01@76 {
	compatible = "meas,tsys01";
	reg = <0x76>;
};
```

## Documentation/devicetree/bindings/iio/timer/stm32-lptimer-trigger.txt
```
STMicroelectronics STM32 Low-Power Timer Trigger

STM32 Low-Power Timer provides trigger source (LPTIM output) that can be used
by STM32 internal ADC and/or DAC.

Must be a sub-node of an STM32 Low-Power Timer device tree node.
See ../mfd/stm32-lptimer.txt for details about the parent node.

Required properties:
- compatible:		Must be "st,stm32-lptimer-trigger".
- reg:			Identify trigger hardware block. Must be 0, 1 or 2
			respectively for lptimer1, lptimer2 or lptimer3
			trigger output.

Example:
	timer@40002400 {
		compatible = "st,stm32-lptimer";
		...
		trigger@0 {
			compatible = "st,stm32-lptimer-trigger";
			reg = <0>;
		};
	};
```

## Documentation/devicetree/bindings/iio/timer/stm32-timer-trigger.txt
```
STMicroelectronics STM32 Timers IIO timer bindings

Must be a sub-node of an STM32 Timers device tree node.
See ../mfd/stm32-timers.txt for details about the parent node.

Required parameters:
- compatible:	Must be "st,stm32-timer-trigger".
- reg:		Identify trigger hardware block.

Example:
	timers@40010000 {
		#address-cells = <1>;
		#size-cells = <0>;
		compatible = "st,stm32-timers";
		reg = <0x40010000 0x400>;
		clocks = <&rcc 0 160>;
		clock-names = "clk_int";

		timer@0 {
			compatible = "st,stm32-timer-trigger";
			reg = <0>;
		};
	};
```

## Documentation/devicetree/bindings/incomplete-devices.yaml
```yaml
# SPDX-License-Identifier: GPL-2.0-only OR BSD-2-Clause
%YAML 1.2
---
$id: http://devicetree.org/schemas/incomplete-devices.yaml#
$schema: http://devicetree.org/meta-schemas/core.yaml#

title: Rejected, Legacy or Incomplete Devices

maintainers:
  - Rob Herring <robh@kernel.org>

description:
  Some devices will not or should not get a proper Devicetree bindings, but
  their compatibles are present in Linux drivers for various reasons.

  Examples are devices using ACPI PRP0001 with non-updatable firmware/ACPI
  tables or old PowerPC platforms without in-tree DTS.

  Following list of devices is an incomplete schema with a goal to pass DT schema
  checks on undocumented compatibles but also reject any DTS file using such
  un-approved compatible.

  Usage of any of following compatibles is not allowed in Devicetree sources,
  even if they come from immutable firmware.

properties:
  compatible:
    oneOf:
      - description:
          Rejected compatibles in Devicetree, but used in ACPI-based devices
          with non-updatable firmware/ACPI tables (via ACPI PRP0001)
        enum:
          - broadcom,bcm5241
          - ltr,ltrf216a

      - description: Legacy compatibles used on Macintosh devices
        enum:
          - AAPL,3500
          - AAPL,7500
          - AAPL,8500
          - AAPL,9500
          - AAPL,accelerometer_1
          - AAPL,e411
          - AAPL,Gossamer
          - AAPL,PowerBook1998
          - AAPL,ShinerESB
          - adm1030
          - amd-0137
          - B5221
          - bmac+
          - burgundy
          - cobalt
          - cy28508
          - daca
          - fcu
          - gatwick
          - gmac
          - heathrow
          - heathrow-ata
          - heathrow-media-bay
          - i2sbus
          - i2s-modem
          - iMac
          - K2-GMAC
          - k2-i2c
          - K2-Keylargo
          - K2-UATA
          - kauai-ata
          - Keylargo
          - keylargo-ata
          - keylargo-media-bay
          - lm87cimt
          - MAC,adm1030
          - MAC,ds1775
          - MacRISC
          - MacRISC2
          - MacRISC3
          - MacRISC4
          - max6690
          - ohare
          - ohare-media-bay
          - ohare-swim3
          - PowerBook1,1
          - PowerBook2,1
          - PowerBook2,2
          - PowerBook3,1
          - PowerBook3,2
          - PowerBook3,3
          - PowerBook3,4
          - PowerBook3,5
          - PowerBook4,1
          - PowerBook4,2
          - PowerBook4,3
          - PowerBook5,1
          - PowerBook5,2
          - PowerBook5,3
          - PowerBook5,4
          - PowerBook5,5
          - PowerBook5,6
          - PowerBook5,7
          - PowerBook5,8
          - PowerBook5,9
          - PowerBook6,3
          - PowerBook6,5
          - PowerBook6,7
          - PowerMac10,1
          - PowerMac10,2
          - PowerMac1,1
          - PowerMac11,2
          - PowerMac12,1
          - PowerMac2,1
          - PowerMac2,2
          - PowerMac3,1
          - PowerMac3,4
          - PowerMac3,5
          - PowerMac3,6
          - PowerMac4,1
          - PowerMac4,2
          - PowerMac4,4
          - PowerMac4,5
          - PowerMac7,2
          - PowerMac7,3
          - PowerMac8,1
          - PowerMac8,2
          - PowerMac9,1
          - paddington
          - RackMac1,1
          - RackMac1,2
          - RackMac3,1
          - screamer
          - shasta-ata
          - sms
          - smu-rpm-fans
          - smu-sat
          - smu-sensors
          - snapper
          - swim3
          - tumbler
          - u3-agp
          - u3-dart
          - u3-ht
          - u4-dart
          - u4-pcie
          - U4-pcie
          - uni-n-i2c
          - uni-north

      - description: Legacy compatibles used on other PowerPC devices
        enum:
          - 1682m-gizmo
          - 1682m-gpio
          - 1682m-rng
          - 1682m-sdc
          - amcc,ppc440epx-rng
          - amcc,ppc460ex-bcsr
          - amcc,ppc460ex-crypto
          - amcc,ppc460ex-rng
          - amcc,ppc460sx-crypto
          - amcc,ppc4xx-crypto
          - amcc,sata-460ex
          - CBEA,platform-open-pic
          - CBEA,platform-spider-pic
          - direct-mapped
          - display
          - gpio-mdio
          - hawk-bridge
          - hawk-pci
          - IBM,CBEA
          - IBM,lhca
          - IBM,lhea
          - IBM,lhea-ethernet
          - ibm,axon-msic
          - Momentum,Apache
          - Momentum,Maple
          - mai-logic,articia-s
          - mpc10x-pci
          - mpc5200b-fec-phy
          - mpc5200-serial
          - mpc5200-sram
          - nintendo,flipper
          - nintendo,flipper-exi
          - nintendo,flipper-pi
          - nintendo,flipper-pic
          - nintendo,hollywood
          - nintendo,hollywood-pic
          - nintendo,latte-exi
          - nintendo,latte-srnprot
          - ohci-be
          - ohci-bigendian
          - ohci-le
          - PA6T-1682M
          - pasemi,1682m-iob
          - pasemi,localbus
          - pasemi,localbus-nand
          - pasemi,nemo
          - pasemi,pwrficient
          - pasemi,pwrficient-rng
          - pasemi,rootbus
          - pasemi,sdc
          - soc
          - sony,ps3
          - sti,platform-spider-pic

      - description: Legacy compatibles used on SPARC devices
        enum:
          - bq4802
          - ds1287
          - i2cpcf,8584
          - isa-m5819p
          - isa-m5823p
          - m5819
          - qcn
          - sab82532
          - su
          - sun4v
          - SUNW,bbc-beep
          - SUNW,bbc-i2c
          - SUNW,CS4231
          - SUNW,ebus-pic16f747-env
          - SUNW,kt-cwq
          - SUNW,kt-mau
          - SUNW,n2-cwq
          - SUNW,n2-mau
          - SUNW,niusl
          - SUNW,smbus-beep
          - SUNW,sun4v-console
          - SUNW,sun4v-pci
          - SUNW,vf-cwq
          - SUNW,vf-mau

      - description: Incomplete and/or legacy compatibles for unknown devices
        enum:
          - electra-cf
          - i2cpcf,8584
          - virtio,uml

      - description: Linux kernel unit tests and sample code
        enum:
          - audio-graph-card2-custom-sample
          - compat1
          - compat2
          - compat3
          - gpio-mockup
          - gpio-simulator
          - gpio-virtuser
          - linux,spi-loopback-test
          - mailbox-test
          - regulator-virtual-consumer
          - test-device

      - description:
          Devices on MIPS platform, without any DTS users.  These are
          unlikely to get converted to DT schema.
        enum:
          - mti,ranchu

      - description:
          Devices on PowerPC platform, without any DTS users.  These are
          unlikely to get converted to DT schema.
        enum:
          - fujitsu,coral
          - fujitsu,lime
          - fujitsu,MB86276
          - fujitsu,MB86277
          - fujitsu,MB86293
          - fujitsu,MB86294
          - fujitsu,mint
          - ibm,axon-msic
          - ibm,pmemory
          - ibm,pmemory-v2
          - ibm,power-rng
          - ibm,ppc4xx-spi
          - ibm,sdram-4xx-ddr2
          - ibm,secureboot
          - ibm,secureboot-v1
          - ibm,secureboot-v2
          - ibm,secvar-backend
          - sgy,gpio-halt
          - wrs,epld-localbus

required:
  - compatible
  - broken-usage-of-incorrect-compatible

additionalProperties: false
```

## Documentation/devicetree/bindings/infiniband/hisilicon-hns-roce.txt
```
Hisilicon RoCE DT description

Hisilicon RoCE engine is a part of network subsystem.
It works depending on other part of network wubsytem, such as, gmac and
dsa fabric.

Additional properties are described here:

Required properties:
- compatible: Should contain "hisilicon,hns-roce-v1".
- reg: Physical base address of the RoCE driver and
length of memory mapped region.
- eth-handle: phandle, specifies a reference to a node
representing a ethernet device.
- dsaf-handle: phandle, specifies a reference to a node
representing a dsaf device.
- node_guid: a number that uniquely identifies a device or component
- #address-cells: must be 2
- #size-cells: must be 2
Optional properties:
- dma-coherent: Present if DMA operations are coherent.
- interrupt-parent: the interrupt parent of this device.
- interrupts: should contain 32 completion event irq,1 async event irq
and 1 event overflow irq.
- interrupt-names:should be one of 34 irqs for roce device
  - hns-roce-comp-0 ~ hns-roce-comp-31: 32 complete event irq
  - hns-roce-async: 1 async event irq
  - hns-roce-common: named common exception warning irq
Example:
	infiniband@c4000000 {
			compatible = "hisilicon,hns-roce-v1";
			reg = <0x0 0xc4000000 0x0 0x100000>;
			dma-coherent;
			eth-handle = <&eth2 &eth3 &eth4 &eth5 &eth6 &eth7>;
			dsaf-handle = <&soc0_dsa>;
			node-guid = [00 9A CD 00 00 01 02 03];
			#address-cells = <2>;
			#size-cells = <2>;
			interrupt-parent = <&mbigen_dsa>;
			interrupts = <722 1>,
					<723 1>,
					<724 1>,
					<725 1>,
					<726 1>,
					<727 1>,
					<728 1>,
					<729 1>,
					<730 1>,
					<731 1>,
					<732 1>,
					<733 1>,
					<734 1>,
					<735 1>,
					<736 1>,
					<737 1>,
					<738 1>,
					<739 1>,
					<740 1>,
					<741 1>,
					<742 1>,
					<743 1>,
					<744 1>,
					<745 1>,
					<746 1>,
					<747 1>,
					<748 1>,
					<749 1>,
					<750 1>,
					<751 1>,
					<752 1>,
					<753 1>,
					<785 1>,
					<754 4>;

			interrupt-names = "hns-roce-comp-0",
					"hns-roce-comp-1",
					"hns-roce-comp-2",
					"hns-roce-comp-3",
					"hns-roce-comp-4",
					"hns-roce-comp-5",
					"hns-roce-comp-6",
					"hns-roce-comp-7",
					"hns-roce-comp-8",
					"hns-roce-comp-9",
					"hns-roce-comp-10",
					"hns-roce-comp-11",
					"hns-roce-comp-12",
					"hns-roce-comp-13",
					"hns-roce-comp-14",
					"hns-roce-comp-15",
					"hns-roce-comp-16",
					"hns-roce-comp-17",
					"hns-roce-comp-18",
					"hns-roce-comp-19",
					"hns-roce-comp-20",
					"hns-roce-comp-21",
					"hns-roce-comp-22",
					"hns-roce-comp-23",
					"hns-roce-comp-24",
					"hns-roce-comp-25",
					"hns-roce-comp-26",
					"hns-roce-comp-27",
					"hns-roce-comp-28",
					"hns-roce-comp-29",
					"hns-roce-comp-30",
					"hns-roce-comp-31",
					"hns-roce-async",
					"hns-roce-common";
		};
```

## Documentation/devicetree/bindings/input/adafruit,seesaw-gamepad.yaml
```yaml
# SPDX-License-Identifier: (GPL-2.0-only OR BSD-2-Clause)
%YAML 1.2
---
$id: http://devicetree.org/schemas/input/adafruit,seesaw-gamepad.yaml#
$schema: http://devicetree.org/meta-schemas/core.yaml#

title: Adafruit Mini I2C Gamepad with seesaw

maintainers:
  - Anshul Dalal <anshulusr@gmail.com>

description: |
  Adafruit Mini I2C Gamepad

    +-----------------------------+
    |   ___                       |
    |  /   \               (X)    |
    | |  S  |  __   __  (Y)   (A) |
    |  \___/  |ST| |SE|    (B)    |
    |                             |
    +-----------------------------+

  S -> 10-bit precision bidirectional analog joystick
  ST -> Start
  SE -> Select
  X, A, B, Y -> Digital action buttons

  Datasheet: https://cdn-learn.adafruit.com/downloads/pdf/gamepad-qt.pdf
  Product page: https://www.adafruit.com/product/5743
  Arduino Driver: https://github.com/adafruit/Adafruit_Seesaw

properties:
  compatible:
    const: adafruit,seesaw-gamepad

  reg:
    maxItems: 1

  interrupts:
    maxItems: 1
    description:
      The gamepad's IRQ pin triggers a rising edge if interrupts are enabled.

required:
  - compatible
  - reg

additionalProperties: false

examples:
  - |
    #include <dt-bindings/interrupt-controller/irq.h>

    i2c {
        #address-cells = <1>;
        #size-cells = <0>;

        joystick@50 {
            compatible = "adafruit,seesaw-gamepad";
            interrupts = <18 IRQ_TYPE_EDGE_RISING>;
            reg = <0x50>;
        };
    };
```
