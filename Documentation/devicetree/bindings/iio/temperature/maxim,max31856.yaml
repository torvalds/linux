## Documentation/devicetree/bindings/iio/temperature/maxim,max31856.yaml
```yaml
# SPDX-License-Identifier: (GPL-2.0 OR BSD-2-Clause)
%YAML 1.2
---
$id: http://devicetree.org/schemas/iio/temperature/maxim,max31856.yaml#
$schema: http://devicetree.org/meta-schemas/core.yaml#

title: Maxim MAX31856 thermocouple support

maintainers:
  - Jonathan Cameron <jic23@kernel.org>

description: |
  https://datasheets.maximintegrated.com/en/ds/MAX31856.pdf

properties:
  compatible:
    const: maxim,max31856

  reg:
    maxItems: 1

  spi-max-frequency: true
  spi-cpha: true

  thermocouple-type:
    $ref: /schemas/types.yaml#/definitions/uint32
    description:
      Type of thermocouple (THERMOCOUPLE_TYPE_K if omitted).
      Use defines in dt-bindings/iio/temperature/thermocouple.h.
      Supported types are B, E, J, K, N, R, S, T.

required:
  - compatible
  - reg
  - spi-cpha

additionalProperties: false

examples:
  - |
    #include <dt-bindings/iio/temperature/thermocouple.h>
    spi {
        #address-cells = <1>;
        #size-cells = <0>;

        temp-sensor@0 {
            compatible = "maxim,max31856";
            reg = <0>;
            spi-max-frequency = <5000000>;
            spi-cpha;
            thermocouple-type = <THERMOCOUPLE_TYPE_K>;
        };
    };
...
```

## Documentation/devicetree/bindings/iio/temperature/maxim,max31865.yaml
```yaml
# SPDX-License-Identifier: (GPL-2.0 OR BSD-2-Clause)
%YAML 1.2
---
$id: http://devicetree.org/schemas/iio/temperature/maxim,max31865.yaml#
$schema: http://devicetree.org/meta-schemas/core.yaml#

title: Maxim MAX31865 Resistance Temperature Detector.

maintainers:
  - Navin Sankar Velliangiri <navin@linumiz.com>

description: |
  https://datasheets.maximintegrated.com/en/ds/MAX31865.pdf

properties:
  compatible:
    const: maxim,max31865

  reg:
    maxItems: 1

  maxim,3-wire:
    description:
      Identifies the number of wires used by the RTD. Setting this property
      enables 3-wire RTD connection. Else 2-wire or 4-wire RTD connection.
    type: boolean

  spi-max-frequency: true
  spi-cpha: true

required:
  - compatible
  - reg
  - spi-cpha

additionalProperties: false

examples:
  - |
    spi {
       #address-cells = <1>;
       #size-cells = <0>;

       temp_sensor@0 {
         compatible = "maxim,max31865";
         reg = <0>;
         spi-max-frequency = <400000>;
         spi-cpha;
         maxim,3-wire;
       };
    };
...
```

## Documentation/devicetree/bindings/iio/temperature/maxim_thermocouple.txt
```
Maxim thermocouple support

* https://datasheets.maximintegrated.com/en/ds/MAX6675.pdf
* https://datasheets.maximintegrated.com/en/ds/MAX31855.pdf

Required properties:

	- compatible: must be "maxim,max6675" or one of the following:
	   "maxim,max31855k", "maxim,max31855j", "maxim,max31855n",
	   "maxim,max31855s", "maxim,max31855t", "maxim,max31855e",
	   "maxim,max31855r"; the generic "max,max31855" is deprecated.
	- reg: SPI chip select number for the device
	- spi-max-frequency: must be 4300000
	- spi-cpha: must be defined for max6675 to enable SPI mode 1

	Refer to spi/spi-bus.txt for generic SPI slave bindings.

Example:

	max31855@0 {
		compatible = "maxim,max31855k";
		reg = <0>;
		spi-max-frequency = <4300000>;
	};
```

## Documentation/devicetree/bindings/iio/temperature/melexis,mlx90614.yaml
```yaml
# SPDX-License-Identifier: (GPL-2.0 OR BSD-2-Clause)
%YAML 1.2
---
$id: http://devicetree.org/schemas/iio/temperature/melexis,mlx90614.yaml#
$schema: http://devicetree.org/meta-schemas/core.yaml#

title: Melexis MLX90614/MLX90615 contactless IR temperature sensor

maintainers:
  - Peter Meerwald <pmeerw@pmeerw.net>
  - Crt Mori <cmo@melexis.com>

description: |
  http://melexis.com/Infrared-Thermometer-Sensors/Infrared-Thermometer-Sensors/MLX90614-615.aspx

properties:
  compatible:
    enum:
      - melexis,mlx90614
      - melexis,mlx90615

  reg:
    maxItems: 1

  wakeup-gpios:
    description:
      GPIO connected to the SDA line to hold low in order to wake up the
      device.  In normal operation, the GPIO is set as input and will
      not interfere in I2C communication.  There is no need for a GPIO
      driving the SCL line.  If no GPIO is given, power management is disabled.
    maxItems: 1

required:
  - compatible
  - reg

additionalProperties: false

examples:
  - |
    #include <dt-bindings/gpio/gpio.h>
    i2c {
        #address-cells = <1>;
        #size-cells = <0>;

        temp-sensor@5a {
            compatible = "melexis,mlx90614";
            reg = <0x5a>;
            wakeup-gpios = <&gpio0 2 GPIO_ACTIVE_HIGH>;
        };
    };
...
```

## Documentation/devicetree/bindings/iio/temperature/melexis,mlx90632.yaml
```yaml
# SPDX-License-Identifier: (GPL-2.0 OR BSD-2-Clause)
%YAML 1.2
---
$id: http://devicetree.org/schemas/iio/temperature/melexis,mlx90632.yaml#
$schema: http://devicetree.org/meta-schemas/core.yaml#

title: Melexis MLX90632 and MLX90635 contactless Infra Red temperature sensor

maintainers:
  - Crt Mori <cmo@melexis.com>

description: |
  https://www.melexis.com/en/documents/documentation/datasheets/datasheet-mlx90632

  There are various applications for the Infra Red contactless temperature
  sensor and MLX90632 is most suitable for consumer applications where
  measured object temperature is in range between -20 to 200 degrees
  Celsius with relative error of measurement below 1 degree Celsius in
  object temperature range for industrial applications. Since it can
  operate and measure ambient temperature in range of -20 to 85 degrees
  Celsius it is suitable also for outdoor use.

  Be aware that electronics surrounding the sensor can increase ambient
  temperature. MLX90632 can be calibrated to reduce the housing effect via
  already existing EEPROM parameters.

  Since measured object emissivity effects Infra Red energy emitted,
  emissivity should be set before requesting the object temperature.

  https://www.melexis.com/en/documents/documentation/datasheets/datasheet-mlx90635

  MLX90635 is most suitable for consumer applications where
  measured object temperature is in range between -20 to 100 degrees
  Celsius with relative error of measurement 2 degree Celsius in
  object temperature range for industrial applications, while just 0.2
  degree Celsius for human body measurement applications. Since it can
  operate and measure ambient temperature in range of -20 to 85 degrees
  Celsius it is suitable also for outdoor use.

  Since measured object emissivity effects Infra Red energy emitted,
  emissivity should be set before requesting the object temperature.

properties:
  compatible:
    enum:
      - melexis,mlx90632
      - melexis,mlx90635

  reg:
    maxItems: 1
    description: Default is 0x3a, but can be reprogrammed.

  vdd-supply:
    description: provide VDD power to the sensor.

required:
  - compatible
  - reg

additionalProperties: false

examples:
  - |
    i2c {
        #address-cells = <1>;
        #size-cells = <0>;

        temp-sensor@3a {
            compatible = "melexis,mlx90632";
            reg = <0x3a>;
            vdd-supply = <&ldo4_reg>;
        };
    };
...
```

## Documentation/devicetree/bindings/iio/temperature/microchip,mcp9600.yaml
```yaml
# SPDX-License-Identifier: (GPL-2.0 OR BSD-2-Clause)
%YAML 1.2
---
$id: http://devicetree.org/schemas/iio/temperature/microchip,mcp9600.yaml#
$schema: http://devicetree.org/meta-schemas/core.yaml#

title: Microchip MCP9600 and similar thermocouple EMF converters

maintainers:
  - Andrew Hepp <andrew.hepp@ahepp.dev>

description:
  https://ww1.microchip.com/downloads/en/DeviceDoc/MCP960X-Data-Sheet-20005426.pdf

properties:
  compatible:
    oneOf:
      - const: microchip,mcp9600
      - items:
          - const: microchip,mcp9601
          - const: microchip,mcp9600

  reg:
    maxItems: 1

  interrupts:
    minItems: 1
    maxItems: 6

  interrupt-names:
    minItems: 1
    maxItems: 6
    items:
      enum:
        - open-circuit
        - short-circuit
        - alert1
        - alert2
        - alert3
        - alert4

  thermocouple-type:
    $ref: /schemas/types.yaml#/definitions/uint32
    default: 3
    description:
      Type of thermocouple (THERMOCOUPLE_TYPE_K if omitted).
      Use defines in dt-bindings/iio/temperature/thermocouple.h.
      Supported types are B, E, J, K, N, R, S, T.

  microchip,vsense:
    type: boolean
    description:
      This flag indicates that the chip has been wired with VSENSE to
      enable open and short circuit detect.

  vdd-supply: true

allOf:
  - if:
      properties:
        compatible:
          not:
            contains:
              const: microchip,mcp9601
    then:
      properties:
        interrupts:
          minItems: 1
          maxItems: 4
        interrupt-names:
          minItems: 1
          maxItems: 4
          items:
            enum:
              - alert1
              - alert2
              - alert3
              - alert4
        microchip,vsense: false

required:
  - compatible
  - reg

additionalProperties: false

examples:
  - |
    #include <dt-bindings/iio/temperature/thermocouple.h>
    #include <dt-bindings/interrupt-controller/irq.h>
    i2c {
        #address-cells = <1>;
        #size-cells = <0>;

        temperature-sensor@60 {
            compatible = "microchip,mcp9600";
            reg = <0x60>;
            interrupt-parent = <&gpio>;
            interrupts = <25 IRQ_TYPE_EDGE_RISING>;
            interrupt-names = "alert1";
            thermocouple-type = <THERMOCOUPLE_TYPE_K>;
            vdd-supply = <&vdd>;
        };
    };
  - |
    #include <dt-bindings/interrupt-controller/irq.h>
    i2c {
        #address-cells = <1>;
        #size-cells = <0>;

        temperature-sensor@62 {
            compatible = "microchip,mcp9601", "microchip,mcp9600";
            reg = <0x62>;
            interrupt-parent = <&gpio>;
            interrupts = <22 IRQ_TYPE_EDGE_RISING>, <23 IRQ_TYPE_EDGE_RISING>;
            interrupt-names = "open-circuit", "short-circuit";
            vdd-supply = <&vdd>;
            microchip,vsense;
        };
    };
```

## Documentation/devicetree/bindings/iio/temperature/mlx90614.txt
```
* Melexis MLX90614 contactless IR temperature sensor

http://melexis.com/Infrared-Thermometer-Sensors/Infrared-Thermometer-Sensors/MLX90614-615.aspx

Required properties:

  - compatible: should be "melexis,mlx90614"
  - reg: the I2C address of the sensor

Optional properties:

  - wakeup-gpios: device tree identifier of the GPIO connected to the SDA line
      to hold low in order to wake up the device.  In yesrmal operation, the
      GPIO is set as input and will yest interfere in I2C communication.  There
      is yes need for a GPIO driving the SCL line.  If yes GPIO is given, power
      management is disabled.

Example:

mlx90614@5a {
	compatible = "melexis,mlx90614";
	reg = <0x5a>;
	wakeup-gpios = <&gpio0 2 GPIO_ACTIVE_HIGH>;
};
```

## Documentation/devicetree/bindings/iio/temperature/mlx90632.txt
```
* Melexis MLX90632 contactless Infra Red temperature sensor

Link to datasheet: https://www.melexis.com/en/documents/documentation/datasheets/datasheet-mlx90632

There are various applications for the Infra Red contactless temperature sensor
and MLX90632 is most suitable for consumer applications where measured object
temperature is in range between -20 to 200 degrees Celsius with relative error
of measurement below 1 degree Celsius in object temperature range for
industrial applications. Since it can operate and measure ambient temperature
in range of -20 to 85 degrees Celsius it is suitable also for outdoor use.

Be aware that electronics surrounding the sensor can increase ambient
temperature. MLX90632 can be calibrated to reduce the housing effect via
already existing EEPROM parameters.

Since measured object emissivity effects Infra Red energy emitted, emissivity
should be set before requesting the object temperature.

Required properties:
  - compatible: should be "melexis,mlx90632"
  - reg: the I2C address of the sensor (default 0x3a)

Example:

mlx90632@3a {
	compatible = "melexis,mlx90632";
	reg = <0x3a>;
};
```

## Documentation/devicetree/bindings/iio/temperature/ti,tmp006.yaml
```yaml
# SPDX-License-Identifier: (GPL-2.0 OR BSD-2-Clause)
%YAML 1.2
---
$id: http://devicetree.org/schemas/iio/temperature/ti,tmp006.yaml#
$schema: http://devicetree.org/meta-schemas/core.yaml#

title: TI TMP006 IR thermopile sensor

maintainers:
  - Peter Meerwald <pmeerw@pmeerw.net>

description: |
  TI TMP006 - Infrared Thermopile Sensor in Chip-Scale Package.
  https://cdn.sparkfun.com/datasheets/Sensors/Temp/tmp006.pdf

properties:
  compatible:
    const: ti,tmp006

  reg:
    maxItems: 1

  vdd-supply:
    description: provide VDD power to the sensor.

required:
  - compatible
  - reg

additionalProperties: false

examples:
  - |
    i2c {
        #address-cells = <1>;
        #size-cells = <0>;
        temperature-sensor@40 {
            compatible = "ti,tmp006";
            reg = <0x40>;
            vdd-supply = <&ldo4_reg>;
        };
    };
```

## Documentation/devicetree/bindings/iio/temperature/ti,tmp007.yaml
```yaml
# SPDX-License-Identifier: (GPL-2.0 OR BSD-2-Clause)
%YAML 1.2
---
$id: http://devicetree.org/schemas/iio/temperature/ti,tmp007.yaml#
$schema: http://devicetree.org/meta-schemas/core.yaml#

title: IR thermopile sensor with integrated math engine

maintainers:
  - Manivannan Sadhasivam <manivannanece23@gmail.com>

description: |
  http://www.ti.com/lit/ds/symlink/tmp007.pdf

properties:
  compatible:
    const: ti,tmp007

  reg:
    description: |
      The I2C address of the sensor (changeable via ADR pins)
      ------------------------------
      |ADR1 | ADR0 | Device Address|
      ------------------------------
         0      0        0x40
         0      1        0x41
         0     SDA       0x42
         0     SCL       0x43
         1      0        0x44
         1      1        0x45
         1     SDA       0x46
         1     SCL       0x47
    maxItems: 1

  interrupts:
    maxItems: 1

required:
  - compatible
  - reg

additionalProperties: false

examples:
  - |
    i2c {
        #address-cells = <1>;
        #size-cells = <0>;

        temp-sensor@40 {
            compatible = "ti,tmp007";
            reg = <0x40>;
            interrupt-parent = <&gpio0>;
            interrupts = <5 0x08>;
        };
    };
...
```

## Documentation/devicetree/bindings/iio/temperature/ti,tmp117.yaml
```yaml
# SPDX-License-Identifier: (GPL-2.0-only OR BSD-2-Clause)
%YAML 1.2
---
$id: http://devicetree.org/schemas/iio/temperature/ti,tmp117.yaml#
$schema: http://devicetree.org/meta-schemas/core.yaml#

title: TI TMP117 - Digital temperature sensor with integrated NV memory

description: |
    TI TMP116/117 - Digital temperature sensor with integrated NV memory that
    supports I2C interface.
      https://www.ti.com/lit/gpn/tmp116
      https://www.ti.com/lit/gpn/tmp117

maintainers:
  - Puranjay Mohan <puranjay12@gmail.com>

properties:
  compatible:
    enum:
      - ti,tmp116
      - ti,tmp117

  reg:
    maxItems: 1

  vcc-supply:
    description: provide VCC power to the sensor.

  label:
    description: Unique name to identify which device this is.

required:
  - compatible
  - reg
  - vcc-supply

additionalProperties: false

examples:
  - |
    i2c {
        #address-cells = <1>;
        #size-cells = <0>;

        tmp117@48 {
             compatible = "ti,tmp117";
             reg = <0x48>;
             vcc-supply = <&pmic_reg_3v3>;
        };
    };
```
