## Documentation/devicetree/bindings/input/adc-joystick.yaml
```yaml
# SPDX-License-Identifier: (GPL-2.0 OR BSD-2-Clause)
# Copyright 2019-2020 Artur Rojek
%YAML 1.2
---
$id: "http://devicetree.org/schemas/input/adc-joystick.yaml#"
$schema: "http://devicetree.org/meta-schemas/core.yaml#"

title: ADC attached joystick

maintainers:
  - Artur Rojek <contact@artur-rojek.eu>

description: >
  Bindings for joystick devices connected to ADC controllers supporting
  the Industrial I/O subsystem.

properties:
  compatible:
    const: adc-joystick

  io-channels:
    minItems: 1
    maxItems: 1024
    description: >
      List of phandle and IIO specifier pairs.
      Each pair defines one ADC channel to which a joystick axis is connected.
      See
      https://github.com/devicetree-org/dt-schema/blob/master/schemas/iio/iio-consumer.yaml
      for details.

  '#address-cells':
    const: 1

  '#size-cells':
    const: 0

required:
  - compatible
  - io-channels
  - '#address-cells'
  - '#size-cells'

additionalProperties: false

patternProperties:
  "^axis@[0-9a-f]+$":
    type: object
    description: >
      Represents a joystick axis bound to the given ADC channel.
      For each entry in the io-channels list, one axis subnode with a matching
      reg property must be specified.

    properties:
      reg:
        minimum: 0
        maximum: 1023
        description: Index of an io-channels list entry bound to this axis.

      linux,code:
        $ref: /schemas/types.yaml#/definitions/uint32
        description: EV_ABS specific event code generated by the axis.

      abs-range:
        allOf:
          - $ref: /schemas/types.yaml#/definitions/uint32-array
          - items:
              - description: minimum value
              - description: maximum value
        description: >
          Minimum and maximum values produced by the axis.
          For an ABS_X axis this will be the left-most and right-most
          inclination of the joystick. If min > max, it is left to userspace to
          treat the axis as inverted.
          This property is interpreted as two signed 32 bit values.

      abs-fuzz:
        $ref: /schemas/types.yaml#/definitions/uint32
        description: >
          Amount of noise in the input value.
          Omitting this property indicates the axis is precise.

      abs-flat:
        $ref: /schemas/types.yaml#/definitions/uint32
        description: >
          Axial "deadzone", or area around the center position, where the axis
          is considered to be at rest.
          Omitting this property indicates the axis always returns to exactly
          the center position.

    required:
      - reg
      - linux,code
      - abs-range

    additionalProperties: false

examples:
  - |
    #include <dt-bindings/iio/adc/ingenic,adc.h>
    #include <dt-bindings/input/input.h>

    joystick: adc-joystick {
      compatible = "adc-joystick";
      io-channels = <&adc INGENIC_ADC_TOUCH_XP>,
                    <&adc INGENIC_ADC_TOUCH_YP>;
      #address-cells = <1>;
      #size-cells = <0>;

      axis@0 {
              reg = <0>;
              linux,code = <ABS_X>;
              abs-range = <3300 0>;
              abs-fuzz = <4>;
              abs-flat = <200>;
      };
      axis@1 {
              reg = <1>;
              linux,code = <ABS_Y>;
              abs-range = <0 3300>;
              abs-fuzz = <4>;
              abs-flat = <200>;
      };
    };
```

## Documentation/devicetree/bindings/input/adc-keys.txt
```
ADC attached resistor ladder buttons
------------------------------------

Required properties:
 - compatible: "adc-keys"
 - io-channels: Phandle to an ADC channel
 - io-channel-names = "buttons";
 - keyup-threshold-microvolt: Voltage above or equal to which all the keys are
			      considered up.

Optional properties:
	- poll-interval: Poll interval time in milliseconds
	- autorepeat: Boolean, Enable auto repeat feature of Linux input
	  subsystem.

Each button (key) is represented as a sub-node of "adc-keys":

Required subnode-properties:
	- label: Descriptive name of the key.
	- linux,code: Keycode to emit.
	- press-threshold-microvolt: voltage above or equal to which this key is
				     considered pressed.

No two values of press-threshold-microvolt may be the same.
All values of press-threshold-microvolt must be less than
keyup-threshold-microvolt.

Example:

#include <dt-bindings/input/input.h>

	adc-keys {
		compatible = "adc-keys";
		io-channels = <&lradc 0>;
		io-channel-names = "buttons";
		keyup-threshold-microvolt = <2000000>;

		button-up {
			label = "Volume Up";
			linux,code = <KEY_VOLUMEUP>;
			press-threshold-microvolt = <1500000>;
		};

		button-down {
			label = "Volume Down";
			linux,code = <KEY_VOLUMEDOWN>;
			press-threshold-microvolt = <1000000>;
		};

		button-enter {
			label = "Enter";
			linux,code = <KEY_ENTER>;
			press-threshold-microvolt = <500000>;
		};
	};

+--------------------------------+------------------------+
| 2.000.000 <= value             | no key pressed         |
+--------------------------------+------------------------+
| 1.500.000 <= value < 2.000.000 | KEY_VOLUMEUP pressed   |
+--------------------------------+------------------------+
| 1.000.000 <= value < 1.500.000 | KEY_VOLUMEDOWN pressed |
+--------------------------------+------------------------+
|   500.000 <= value < 1.000.000 | KEY_ENTER pressed      |
+--------------------------------+------------------------+
|              value <   500.000 | no key pressed         |
+--------------------------------+------------------------+
```

## Documentation/devicetree/bindings/input/adc-keys.yaml
```yaml
# SPDX-License-Identifier: GPL-2.0
%YAML 1.2
---
$id: http://devicetree.org/schemas/input/adc-keys.yaml#
$schema: http://devicetree.org/meta-schemas/core.yaml#

title: ADC attached resistor ladder buttons

maintainers:
  - Alexandre Belloni <alexandre.belloni@bootlin.com>

allOf:
  - $ref: input.yaml#

properties:
  compatible:
    const: adc-keys

  io-channels:
    maxItems: 1

  io-channel-names:
    const: buttons

  keyup-threshold-microvolt:
    description:
      Voltage above or equal to which all the keys are considered up.

  poll-interval: true
  autorepeat: true

patternProperties:
  '^button-':
    type: object
    $ref: input.yaml#
    additionalProperties: false
    description:
      Each button (key) is represented as a sub-node.

    properties:
      label: true

      linux,code: true

      press-threshold-microvolt:
        description:
          Voltage above or equal to which this key is considered pressed. No
          two values of press-threshold-microvolt may be the same. All values
          of press-threshold-microvolt must be less than
          keyup-threshold-microvolt.

    required:
      - linux,code
      - press-threshold-microvolt

required:
  - compatible
  - io-channels
  - io-channel-names
  - keyup-threshold-microvolt

additionalProperties: false

examples:
  - |
    #include <dt-bindings/input/input.h>
    // +--------------------------------+------------------------+
    // | 2.000.000 <= value             | no key pressed         |
    // +--------------------------------+------------------------+
    // | 1.500.000 <= value < 2.000.000 | KEY_VOLUMEUP pressed   |
    // +--------------------------------+------------------------+
    // | 1.000.000 <= value < 1.500.000 | KEY_VOLUMEDOWN pressed |
    // +--------------------------------+------------------------+
    // |   500.000 <= value < 1.000.000 | KEY_ENTER pressed      |
    // +--------------------------------+------------------------+
    // |              value <   500.000 | no key pressed         |
    // +--------------------------------+------------------------+

    adc-keys {
        compatible = "adc-keys";
        io-channels = <&lradc 0>;
        io-channel-names = "buttons";
        keyup-threshold-microvolt = <2000000>;

        button-up {
            label = "Volume Up";
            linux,code = <KEY_VOLUMEUP>;
            press-threshold-microvolt = <1500000>;
        };

        button-down {
            label = "Volume Down";
            linux,code = <KEY_VOLUMEDOWN>;
            press-threshold-microvolt = <1000000>;
        };

        button-enter {
            label = "Enter";
            linux,code = <KEY_ENTER>;
            press-threshold-microvolt = <500000>;
        };
    };
...
```

## Documentation/devicetree/bindings/input/adi,adp5588.yaml
```yaml
# SPDX-License-Identifier: (GPL-2.0-only OR BSD-2-Clause)
%YAML 1.2
---
$id: http://devicetree.org/schemas/input/adi,adp5588.yaml#
$schema: http://devicetree.org/meta-schemas/core.yaml#

title: Analog Devices ADP5588 Keypad Controller

maintainers:
  - Nuno Sá <nuno.sa@analog.com>

description: |
  Analog Devices Mobile I/O Expander and QWERTY Keypad Controller
  https://www.analog.com/media/en/technical-documentation/data-sheets/ADP5588.pdf

allOf:
  - $ref: matrix-keymap.yaml#
  - $ref: input.yaml#

properties:
  compatible:
    enum:
      - adi,adp5587
      - adi,adp5588

  reg:
    maxItems: 1

  vcc-supply:
    description: Supply Voltage Input

  reset-gpios:
    description:
      If specified, it will be asserted during driver probe. As the line is
      active low, it should be marked GPIO_ACTIVE_LOW.
    maxItems: 1

  interrupts:
    maxItems: 1

  gpio-controller:
    description:
      This property applies if either keypad,num-rows lower than 8 or
      keypad,num-columns lower than 10.

  '#gpio-cells':
    const: 2

  interrupt-controller:
    description:
      This property applies if either keypad,num-rows lower than 8 or
      keypad,num-columns lower than 10. This property is optional if
      keypad,num-rows or keypad,num-columns are not specified as the
      device is then configured to be used purely for gpio during which
      interrupts may or may not be utilized.

  '#interrupt-cells':
    const: 2

  adi,unlock-keys:
    description:
      Specifies a maximum of 2 keys that can be used to unlock the keypad.
      If this property is set, the keyboard will be locked and only unlocked
      after these keys are pressed. If only one key is set, a double click is
      needed to unlock the keypad. The value of this property cannot be bigger
      or equal than keypad,num-rows * keypad,num-columns.
    $ref: /schemas/types.yaml#/definitions/uint32-array
    minItems: 1
    maxItems: 2

dependencies:
  keypad,num-rows:
    - linux,keymap
    - keypad,num-columns
  keypad,num-columns:
    - linux,keymap
    - keypad,num-rows
  linux,keymap:
    - keypad,num-rows
    - keypad,num-columns
    - interrupts
  interrupt-controller:
    - interrupts

required:
  - compatible
  - reg

unevaluatedProperties: false

examples:
  - |
    #include <dt-bindings/interrupt-controller/irq.h>
    #include <dt-bindings/input/input.h>
    #include <dt-bindings/gpio/gpio.h>
    i2c {
        #address-cells = <1>;
        #size-cells = <0>;

        keys@34 {
            compatible = "adi,adp5588";
            reg = <0x34>;

            vcc-supply = <&vcc>;
            interrupts = <21 IRQ_TYPE_EDGE_FALLING>;
            interrupt-parent = <&gpio>;
            reset-gpios = <&gpio 20 GPIO_ACTIVE_LOW>;

            keypad,num-rows = <1>;
            keypad,num-columns = <9>;
            linux,keymap = <
                MATRIX_KEY(0x00, 0x00, KEY_1)
                MATRIX_KEY(0x00, 0x01, KEY_2)
                MATRIX_KEY(0x00, 0x02, KEY_3)
                MATRIX_KEY(0x00, 0x03, KEY_4)
                MATRIX_KEY(0x00, 0x04, KEY_5)
                MATRIX_KEY(0x00, 0x05, KEY_6)
                MATRIX_KEY(0x00, 0x06, KEY_7)
                MATRIX_KEY(0x00, 0x07, KEY_8)
                MATRIX_KEY(0x00, 0x08, KEY_9)
            >;
        };
    };

  - |
    #include <dt-bindings/gpio/gpio.h>
    i2c {
        #address-cells = <1>;
        #size-cells = <0>;
        gpio@34 {
            compatible = "adi,adp5588";
            reg = <0x34>;

            #gpio-cells = <2>;
            gpio-controller;
        };
    };

...
```

## Documentation/devicetree/bindings/input/allwinner,sun4i-a10-lradc-keys.yaml
```yaml
# SPDX-License-Identifier: GPL-2.0
%YAML 1.2
---
$id: http://devicetree.org/schemas/input/allwinner,sun4i-a10-lradc-keys.yaml#
$schema: http://devicetree.org/meta-schemas/core.yaml#

title: Allwinner A10 LRADC

maintainers:
  - Chen-Yu Tsai <wens@csie.org>
  - Maxime Ripard <mripard@kernel.org>

properties:
  compatible:
    oneOf:
      - const: allwinner,sun4i-a10-lradc-keys
      - const: allwinner,sun8i-a83t-r-lradc
      - items:
          - enum:
              - allwinner,suniv-f1c100s-lradc
              - allwinner,sun50i-a64-lradc
          - const: allwinner,sun8i-a83t-r-lradc
      - const: allwinner,sun50i-r329-lradc
      - items:
          - enum:
              - allwinner,sun50i-h616-lradc
              - allwinner,sun20i-d1-lradc
          - const: allwinner,sun50i-r329-lradc

  reg:
    maxItems: 1

  clocks:
    maxItems: 1

  resets:
    maxItems: 1

  interrupts:
    maxItems: 1

  vref-supply:
    description:
      Regulator for the LRADC reference voltage

  wakeup-source: true

patternProperties:
  "^button-[0-9]+$":
    type: object
    $ref: input.yaml#
    properties:
      label:
        description: Descriptive name of the key

      linux,code: true

      channel:
        $ref: /schemas/types.yaml#/definitions/uint32
        enum: [0, 1]
        description: ADC Channel this key is attached to

      voltage:
        $ref: /schemas/types.yaml#/definitions/uint32
        description:
          Voltage in microvolts at LRADC input when this key is
          pressed

    required:
      - label
      - linux,code
      - channel
      - voltage

    additionalProperties: false

required:
  - compatible
  - reg
  - interrupts
  - vref-supply

if:
  properties:
    compatible:
      contains:
        enum:
          - allwinner,sun50i-r329-lradc

then:
  required:
    - clocks
    - resets

additionalProperties: false

examples:
  - |
    lradc: lradc@1c22800 {
        compatible = "allwinner,sun4i-a10-lradc-keys";
        reg = <0x01c22800 0x100>;
        interrupts = <31>;
        vref-supply = <&reg_vcc3v0>;

        button-191 {
            label = "Volume Up";
            linux,code = <115>;
            channel = <0>;
            voltage = <191274>;
        };

        button-392 {
            label = "Volume Down";
            linux,code = <114>;
            channel = <0>;
            voltage = <392644>;
        };
    };

...
```

## Documentation/devicetree/bindings/input/ariel-pwrbutton.yaml
```yaml
# SPDX-License-Identifier: (GPL-2.0-or-later OR BSD-2-Clause)
%YAML 1.2
---
$id: http://devicetree.org/schemas/input/ariel-pwrbutton.yaml#
$schema: http://devicetree.org/meta-schemas/core.yaml#

title: Dell Wyse 3020 a.k.a. "Ariel" Power Button

maintainers:
  - Lubomir Rintel <lkundrak@v3.sk>

description: |
  The ENE Embedded Controller on the Ariel board has an interface to the
  SPI bus that is capable of sending keyboard and mouse data. A single
  power button is attached to it. This binding describes this
  configuration.

allOf:
  - $ref: input.yaml#

properties:
  compatible:
    items:
      - const: dell,wyse-ariel-ec-input
      - const: ene,kb3930-input

  reg:
    maxItems: 1

  interrupts:
    maxItems: 1

  spi-max-frequency: true

required:
  - compatible
  - reg
  - interrupts

additionalProperties: false

examples:
  - |
    #include <dt-bindings/interrupt-controller/irq.h>

    spi {
        #address-cells = <1>;
        #size-cells = <0>;

        power-button@0 {
            compatible = "dell,wyse-ariel-ec-input", "ene,kb3930-input";
            reg = <0>;
            interrupt-parent = <&gpio>;
            interrupts = <60 IRQ_TYPE_EDGE_RISING>;
            spi-max-frequency = <33000000>;
        };
    };
```
