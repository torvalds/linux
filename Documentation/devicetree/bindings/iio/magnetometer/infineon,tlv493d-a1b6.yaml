## Documentation/devicetree/bindings/iio/magnetometer/infineon,tlv493d-a1b6.yaml
```yaml
# SPDX-License-Identifier: GPL-2.0-only OR BSD-2-Clause
%YAML 1.2
---
$id: http://devicetree.org/schemas/iio/magnetometer/infineon,tlv493d-a1b6.yaml#
$schema: http://devicetree.org/meta-schemas/core.yaml#

title: Infineon Technologies TLV493D Low-Power 3D Magnetic Sensor

maintainers:
  - Dixit Parmar <dixitparmar19@gmail.com>

properties:
  $nodename:
    pattern: '^magnetometer@[0-9a-f]+$'

  compatible:
    const: infineon,tlv493d-a1b6

  reg:
    maxItems: 1

  vdd-supply:
    description: 2.8V to 3.5V VDD supply

  interrupts:
    maxItems: 1

required:
  - compatible
  - reg
  - vdd-supply

additionalProperties: false

examples:
  - |
    i2c {
      #address-cells = <1>;
      #size-cells = <0>;
      magnetometer@5e {
        compatible = "infineon,tlv493d-a1b6";
        reg = <0x5e>;
        vdd-supply = <&hall_vcc>;
      };
    };
```

## Documentation/devicetree/bindings/iio/magnetometer/mag3110.txt
```
* FREESCALE MAG3110 magnetometer sensor

Required properties:

  - compatible : should be "fsl,mag3110"
  - reg : the I2C address of the magnetometer

Optional properties:

  - interrupts: the sole interrupt generated by the device

  Refer to interrupt-controller/interrupts.txt for generic interrupt client
  node bindings.

  - vdd-supply: phandle to the regulator that provides power to the sensor.
  - vddio-supply: phandle to the regulator that provides power to the sensor's IO.

Example:

magnetometer@e {
	compatible = "fsl,mag3110";
	reg = <0x0e>;
	pinctrl-names = "default";
	pinctrl-0 = <&pinctrl_i2c3_mag3110_int>;
	interrupt-parent = <&gpio3>;
	interrupts = <16 IRQ_TYPE_EDGE_RISING>;
};
```

## Documentation/devicetree/bindings/iio/magnetometer/memsic,mmc5983.yaml
```yaml
# SPDX-License-Identifier: (GPL-2.0 OR BSD-2-Clause)
%YAML 1.2
---
$id: http://devicetree.org/schemas/iio/magnetometer/memsic,mmc5983.yaml#
$schema: http://devicetree.org/meta-schemas/core.yaml#

title: MEMSIC MMC5983MA 3-axis magnetic sensor

maintainers:
  - Vladislav Kulikov <vlad.kulikov.c@gmail.com>

properties:
  compatible:
    const: memsic,mmc5983

  reg:
    maxItems: 1

  interrupts:
    maxItems: 1

  vdd-supply:
    description: Regulator that provides power to the sensor

  vddio-supply:
    description: Regulator that provides power to the digital interface and INT pin

required:
  - compatible
  - reg
  - vdd-supply

allOf:
  - $ref: /schemas/spi/spi-peripheral-props.yaml#

unevaluatedProperties: false

examples:
  - |
    i2c {
        #address-cells = <1>;
        #size-cells = <0>;

        magnetometer@30 {
            compatible = "memsic,mmc5983";
            reg = <0x30>;
            vdd-supply = <&vdd_3v3_reg>;
            vddio-supply = <&vdd_3v3_reg>;
        };
    };
  - |
    spi {
        #address-cells = <1>;
        #size-cells = <0>;

        magnetometer@0 {
            compatible = "memsic,mmc5983";
            reg = <0>;
            spi-max-frequency = <10000000>;
            vdd-supply = <&vdd_3v3_reg>;
            vddio-supply = <&vdd_3v3_reg>;
        };
    };
```

## Documentation/devicetree/bindings/iio/magnetometer/mmc35240.txt
```
* MEMSIC MMC35240 magnetometer sensor

Required properties:

  - compatible : should be "memsic,mmc35240"
  - reg : the I2C address of the magnetometer

Example:

mmc35240@30 {
        compatible = "memsic,mmc35240";
        reg = <0x30>;
};
```

## Documentation/devicetree/bindings/iio/magnetometer/pni,rm3100.txt
```
* PNI RM3100 3-axis magnetometer sensor

Required properties:

- compatible : should be "pni,rm3100"
- reg : the I2C address or SPI chip select number of the sensor.

Optional properties:

- interrupts: data ready (DRDY) from the chip.
  The interrupts can be triggered on level high.

Example:

rm3100: rm3100@20 {
	compatible = "pni,rm3100";
	reg = <0x20>;
	interrupt-parent = <&gpio0>;
	interrupts = <4 IRQ_TYPE_LEVEL_HIGH>;
};
```

## Documentation/devicetree/bindings/iio/magnetometer/pni,rm3100.yaml
```yaml
# SPDX-License-Identifier: (GPL-2.0 OR BSD-2-Clause)
%YAML 1.2
---
$id: http://devicetree.org/schemas/iio/magnetometer/pni,rm3100.yaml#
$schema: http://devicetree.org/meta-schemas/core.yaml#

title: PNI RM3100 3-axis magnetometer sensor

maintainers:
  - Song Qiang <songqiang1304521@gmail.com>

properties:
  compatible:
    const: pni,rm3100

  reg:
    maxItems: 1

  interrupts:
    maxItems: 1

additionalProperties: false

required:
  - compatible
  - reg

examples:
  - |
    #include <dt-bindings/interrupt-controller/irq.h>
    i2c {
        #address-cells = <1>;
        #size-cells = <0>;

        magnetometer@20 {
            compatible = "pni,rm3100";
            reg = <0x20>;
            interrupt-parent = <&gpio0>;
            interrupts = <4 IRQ_TYPE_LEVEL_HIGH>;
        };
    };
...
```

## Documentation/devicetree/bindings/iio/magnetometer/qstcorp,qmc5883l.yaml
```yaml
# SPDX-License-Identifier: (GPL-2.0 OR BSD-2-Clause)
%YAML 1.2
---
$id: http://devicetree.org/schemas/iio/magnetometer/qstcorp,qmc5883l.yaml#
$schema: http://devicetree.org/meta-schemas/core.yaml#

title: QST QMC5883L 3-Axis Magnetic Sensor

maintainers:
  - Siratul Islam <siratul.islam@linux.dev>

description: |
  QST QMC5883L 3-Axis Magnetic Sensor on I2C bus.
  https://www.qstcorp.com/upload/pdf/202512/13-52-04%20QMC5883L%20Datasheet%20Rev.%20B.pdf

properties:
  compatible:
    enum:
      - qstcorp,qmc5883l

  reg:
    maxItems: 1

  interrupts:
    maxItems: 1

  vdd-supply: true

  vddio-supply: true

additionalProperties: false

required:
  - compatible
  - reg
  - vdd-supply
  - vddio-supply

examples:
  - |
    i2c {
        #address-cells = <1>;
        #size-cells = <0>;

        magnetometer@d {
            compatible = "qstcorp,qmc5883l";
            reg = <0x0d>;
            vdd-supply = <&vdd_3v3_reg>;
            vddio-supply = <&vdd_3v3_reg>;
        };
    };
...
```

## Documentation/devicetree/bindings/iio/magnetometer/silabs,si7210.yaml
```yaml
# SPDX-License-Identifier: (GPL-2.0 OR BSD-2-Clause)
%YAML 1.2
---
$id: http://devicetree.org/schemas/iio/magnetometer/silabs,si7210.yaml#
$schema: http://devicetree.org/meta-schemas/core.yaml#

title: Si7210 magnetic position and temperature sensor

maintainers:
  - Antoni Pokusinski <apokusinski01@gmail.com>

description: |
  Silabs Si7210 I2C Hall effect magnetic position and temperature sensor.
  https://www.silabs.com/documents/public/data-sheets/si7210-datasheet.pdf

properties:
  compatible:
    const: silabs,si7210

  reg:
    maxItems: 1

  interrupts:
    maxItems: 1

  vdd-supply:
    description: Regulator that provides power to the sensor

required:
  - compatible
  - reg

additionalProperties: false

examples:
  - |
    #include <dt-bindings/interrupt-controller/irq.h>
    i2c {
        #address-cells = <1>;
        #size-cells = <0>;
        magnetometer@30 {
            compatible = "silabs,si7210";
            reg = <0x30>;
            interrupt-parent = <&gpio1>;
            interrupts = <4 IRQ_TYPE_EDGE_FALLING>;
            vdd-supply = <&vdd_3v3_reg>;
        };
    };
```

## Documentation/devicetree/bindings/iio/magnetometer/ti,tmag5273.yaml
```yaml
# SPDX-License-Identifier: (GPL-2.0 OR BSD-2-Clause)
%YAML 1.2
---
$id: http://devicetree.org/schemas/iio/magnetometer/ti,tmag5273.yaml#
$schema: http://devicetree.org/meta-schemas/core.yaml#

title: TI TMAG5273 Low-Power Linear 3D Hall-Effect Sensor

maintainers:
  - Gerald Loacker <gerald.loacker@wolfvision.net>

description:
  The TI TMAG5273 is a low-power linear 3D Hall-effect sensor. This device
  integrates three independent Hall-effect sensors in the X, Y, and Z axes.
  The device has an integrated temperature sensor available. The TMAG5273
  can be configured through the I2C interface to enable any combination of
  magnetic axes and temperature measurements. An integrated angle calculation
  engine (CORDIC) provides full 360° angular position information for both
  on-axis and off-axis angle measurement topologies. The angle calculation is
  performed using two user-selected magnetic axes.

properties:
  compatible:
    const: ti,tmag5273

  reg:
    maxItems: 1

  "#io-channel-cells":
    const: 1

  ti,angle-measurement:
    $ref: /schemas/types.yaml#/definitions/string
    description:
      Enables angle measurement in the selected plane.
      If not specified, "x-y" will be anables as default.
    enum:
      - off
      - x-y
      - y-z
      - x-z

  vcc-supply:
    description:
      A regulator providing 1.7 V to 3.6 V supply voltage on the VCC pin,
      typically 3.3 V.

  interrupts:
    description:
      The low active interrupt can be configured to be fixed width or latched.
      Interrupt events can be configured to be generated from magnetic
      thresholds or when a conversion is completed.
    maxItems: 1

required:
  - compatible
  - reg

additionalProperties: false

examples:
  - |
    i2c {
        #address-cells = <1>;
        #size-cells = <0>;

        magnetometer@35 {
            compatible = "ti,tmag5273";
            reg = <0x35>;
            #io-channel-cells = <1>;
            ti,angle-measurement = "x-z";
            vcc-supply = <&vcc3v3>;
        };
    };
...
```

## Documentation/devicetree/bindings/iio/magnetometer/voltafield,af8133j.yaml
```yaml
# SPDX-License-Identifier: (GPL-2.0 OR BSD-2-Clause)
%YAML 1.2
---
$id: http://devicetree.org/schemas/iio/magnetometer/voltafield,af8133j.yaml#
$schema: http://devicetree.org/meta-schemas/core.yaml#

title: Voltafield AF8133J magnetometer sensor

maintainers:
  - Ondřej Jirman <megi@xff.cz>

properties:
  compatible:
    const: voltafield,af8133j

  reg:
    maxItems: 1

  reset-gpios:
    description:
      A signal for active low reset input of the sensor. (optional; if not
      used, software reset over I2C will be used instead)

  avdd-supply:
    description:
      A regulator that provides AVDD power (Working power, usually 3.3V) to
      the sensor.

  dvdd-supply:
    description:
      A regulator that provides DVDD power (Digital IO power, 1.8V - AVDD)
      to the sensor.

  mount-matrix:
    description: An optional 3x3 mounting rotation matrix.

required:
  - compatible
  - reg
  - avdd-supply
  - dvdd-supply

additionalProperties: false

examples:
  - |
    #include <dt-bindings/interrupt-controller/irq.h>
    #include <dt-bindings/gpio/gpio.h>
    i2c {
        #address-cells = <1>;
        #size-cells = <0>;

        magnetometer@1c {
            compatible = "voltafield,af8133j";
            reg = <0x1c>;
            avdd-supply = <&reg_dldo1>;
            dvdd-supply = <&reg_dldo1>;
            reset-gpios = <&pio 1 1 GPIO_ACTIVE_LOW>;
        };
    };
```

## Documentation/devicetree/bindings/iio/magnetometer/yamaha,yas530.yaml
```yaml
# SPDX-License-Identifier: (GPL-2.0 OR BSD-2-Clause)
%YAML 1.2
---
$id: http://devicetree.org/schemas/iio/magnetometer/yamaha,yas530.yaml#
$schema: http://devicetree.org/meta-schemas/core.yaml#

title: Yamaha YAS530 family of magnetometer sensors

maintainers:
  - Linus Walleij <linus.walleij@linaro.org>

description:
  The Yamaha YAS530 magnetometers is a line of 3-axis magnetometers
  first introduced by Yamaha in 2009 with the YAS530. They are successors
  of Yamaha's first magnetometer YAS529. Over the years this magnetometer
  has been miniaturized and appeared in a number of different variants.

properties:
  $nodename:
    pattern: '^magnetometer@[0-9a-f]+$'

  compatible:
    items:
      - enum:
          - yamaha,yas530
          - yamaha,yas532
          - yamaha,yas533
          - yamaha,yas535
          - yamaha,yas536
          - yamaha,yas537
          - yamaha,yas539

  reg:
    maxItems: 1

  reset-gpios:
    maxItems: 1
    description: The YAS530 sensor has a RSTN pin used to reset
      the logic inside the sensor. This GPIO line should connect
      to that pin and be marked as GPIO_ACTIVE_LOW.

  interrupts:
    maxItems: 1
    description: Interrupt for INT pin for interrupt generation.
      The polarity, whether the interrupt is active on the rising
      or the falling edge, is software-configurable in the hardware.

  vdd-supply:
    description: An optional regulator providing core power supply
      on the VDD pin, typically 1.8 V or 3.0 V.

  iovdd-supply:
    description: An optional regulator providing I/O power supply
      for the I2C interface on the IOVDD pin, typically 1.8 V.

  mount-matrix:
    description: An optional 3x3 mounting rotation matrix.

allOf:
  - if:
      not:
        properties:
          compatible:
            items:
              const: yamaha,yas530
    then:
      properties:
        reset-gpios: false

  - if:
      properties:
        compatible:
          items:
            const: yamaha,yas539
    then:
      properties:
        interrupts: false

required:
  - compatible
  - reg

additionalProperties: false

examples:
  - |
    #include <dt-bindings/interrupt-controller/irq.h>
    #include <dt-bindings/gpio/gpio.h>
    i2c-0 {
        #address-cells = <1>;
        #size-cells = <0>;

        magnetometer@2e {
          compatible = "yamaha,yas530";
          reg = <0x2e>;
          vdd-supply = <&ldo1_reg>;
          iovdd-supply = <&ldo2_reg>;
          reset-gpios = <&gpio6 12 GPIO_ACTIVE_LOW>;
          interrupts = <&gpio6 13 IRQ_TYPE_EDGE_RISING>;
        };
    };

    i2c-1 {
        #address-cells = <1>;
        #size-cells = <0>;

        magnetometer@2e {
          compatible = "yamaha,yas539";
          reg = <0x2e>;
          vdd-supply = <&ldo1_reg>;
        };
    };
```

## Documentation/devicetree/bindings/iio/multiplexer/io-channel-mux.txt
```
I/O channel multiplexer bindings

If a multiplexer is used to select which hardware signal is fed to
e.g. an ADC channel, these bindings describe that situation.

Required properties:
- compatible : "io-channel-mux"
- io-channels : Channel node of the parent channel that has multiplexed
		input.
- io-channel-names : Should be "parent".
- #address-cells = <1>;
- #size-cells = <0>;
- mux-controls : Mux controller node to use for operating the mux
- channels : List of strings, labeling the mux controller states.

For each non-empty string in the channels property, an io-channel will
be created. The number of this io-channel is the same as the index into
the list of strings in the channels property, and also matches the mux
controller state. The mux controller state is described in
../mux/mux-controller.txt

Example:
	mux: mux-controller {
		compatible = "gpio-mux";
		#mux-control-cells = <0>;

		mux-gpios = <&pioA 0 GPIO_ACTIVE_HIGH>,
			    <&pioA 1 GPIO_ACTIVE_HIGH>;
	};

	adc-mux {
		compatible = "io-channel-mux";
		io-channels = <&adc 0>;
		io-channel-names = "parent";

		mux-controls = <&mux>;

		channels = "sync", "in", "system-regulator";
	};
```
