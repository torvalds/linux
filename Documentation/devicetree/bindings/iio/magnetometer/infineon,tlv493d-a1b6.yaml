## Documentation/devicetree/bindings/iio/multiplexer/io-channel-mux.yaml
```yaml
# SPDX-License-Identifier: GPL-2.0
%YAML 1.2
---
$id: http://devicetree.org/schemas/iio/multiplexer/io-channel-mux.yaml#
$schema: http://devicetree.org/meta-schemas/core.yaml#

title: I/O channel multiplexer bindings

maintainers:
  - Peter Rosin <peda@axentia.se>

description: |
  If a multiplexer is used to select which hardware signal is fed to
  e.g. an ADC channel, these bindings describe that situation.

  For each non-empty string in the channels property, an io-channel will be
  created. The number of this io-channel is the same as the index into the list
  of strings in the channels property, and also matches the mux controller
  state. The mux controller state is described in
  Documentation/devicetree/bindings/mux/mux-controller.yaml

properties:

  compatible:
    const: io-channel-mux

  io-channels:
    maxItems: 1
    description: Channel node of the parent channel that has multiplexed input.

  io-channel-names:
    const: parent

  mux-controls: true
  mux-control-names: true

  channels:
    $ref: /schemas/types.yaml#/definitions/string-array
    description:
      List of strings, labeling the mux controller states.

required:
  - compatible
  - io-channels
  - io-channel-names
  - mux-controls
  - channels

additionalProperties: false

examples:
  - |
    #include <dt-bindings/gpio/gpio.h>
    mux: mux-controller {
      compatible = "gpio-mux";
      #mux-control-cells = <0>;

      mux-gpios = <&pioA 0 GPIO_ACTIVE_HIGH>,
                  <&pioA 1 GPIO_ACTIVE_HIGH>;
    };

    adc-mux {
      compatible = "io-channel-mux";
      io-channels = <&adc 0>;
      io-channel-names = "parent";

      mux-controls = <&mux>;
      channels = "sync", "in", "system-regulator";
    };
...
```

## Documentation/devicetree/bindings/iio/potentiometer/ad5272.txt
```
* Analog Devices AD5272 digital potentiometer

The node for this device must be a child node of a I2C controller, hence
all mandatory properties for your controller must be specified. See directory:

        Documentation/devicetree/bindings/i2c

for more details.

Required properties:
	- compatible:  	Must be one of the following, depending on the model:
			adi,ad5272-020
			adi,ad5272-050
			adi,ad5272-100
			adi,ad5274-020
			adi,ad5274-100

Optional properties:
 - reset-gpios: GPIO specification for the RESET input. This is an
		active low signal to the AD5272.

Example:
ad5272: potentiometer@2f {
	reg = <0x2F>;
	compatible = "adi,ad5272-020";
	reset-gpios = <&gpio3 6 GPIO_ACTIVE_HIGH>;
};
```

## Documentation/devicetree/bindings/iio/potentiometer/adi,ad5272.yaml
```yaml
# SPDX-License-Identifier: (GPL-2.0 OR BSD-2-Clause)
%YAML 1.2
---
$id: http://devicetree.org/schemas/iio/potentiometer/adi,ad5272.yaml#
$schema: http://devicetree.org/meta-schemas/core.yaml#

title: Analog Devices AD5272 digital potentiometer

maintainers:
  - Phil Reid <preid@electromag.com.au>

description: |
  Datasheet: https://www.analog.com/en/products/ad5272.html

properties:
  compatible:
    enum:
      - adi,ad5272-020
      - adi,ad5272-050
      - adi,ad5272-100
      - adi,ad5274-020
      - adi,ad5274-100

  reg:
    maxItems: 1

  reset-gpios:
    maxItems: 1
    description:
      Active low signal to the AD5272 RESET input.

additionalProperties: false

required:
  - compatible
  - reg

examples:
  - |
    #include <dt-bindings/gpio/gpio.h>
    i2c {
        #address-cells = <1>;
        #size-cells = <0>;

        potentiometer@2f {
            compatible = "adi,ad5272-020";
            reg = <0x2f>;
            reset-gpios = <&gpio3 6 GPIO_ACTIVE_LOW>;
        };
    };
...
```

## Documentation/devicetree/bindings/iio/potentiometer/ds1803.txt
```
* Maxim Integrated DS1803 digital potentiometer driver

The node for this driver must be a child node of a I2C controller, hence
all mandatory properties for your controller must be specified. See directory:

        Documentation/devicetree/bindings/i2c

for more details.

Required properties:
	- compatible:  	Must be one of the following, depending on the
			model:
			"maxim,ds1803-010",
			"maxim,ds1803-050",
			"maxim,ds1803-100"

Example:
ds1803: ds1803@1 {
	reg = <0x28>;
	compatible = "maxim,ds1803-010";
};
```

## Documentation/devicetree/bindings/iio/potentiometer/max5432.yaml
```yaml
# SPDX-License-Identifier: GPL-2.0
%YAML 1.2
---
$id: http://devicetree.org/schemas/iio/potentiometer/max5432.yaml#
$schema: http://devicetree.org/meta-schemas/core.yaml#

title: Maxim Integrated MAX5432-MAX5435 Digital Potentiometers

maintainers:
  - Martin Kaiser <martin@kaiser.cx>

description: |
  Maxim Integrated MAX5432-MAX5435 Digital Potentiometers connected via I2C

  Datasheet:
    https://datasheets.maximintegrated.com/en/ds/MAX5432-MAX5435.pdf

properties:
  compatible:
    enum:
      - maxim,max5432
      - maxim,max5433
      - maxim,max5434
      - maxim,max5435

  reg:
    maxItems: 1

required:
  - compatible
  - reg

additionalProperties: false

examples:
  - |
    i2c {
      #address-cells = <1>;
      #size-cells = <0>;
      max5434@28 {
        compatible = "maxim,max5434";
        reg = <0x28>;
      };
    };
```

## Documentation/devicetree/bindings/iio/potentiometer/max5481.txt
```
* Maxim Linear-Taper Digital Potentiometer MAX5481-MAX5484

The node for this driver must be a child node of a SPI controller, hence
all mandatory properties described in

        Documentation/devicetree/bindings/spi/spi-bus.txt

must be specified.

Required properties:
	- compatible:  	Must be one of the following, depending on the
			model:
			"maxim,max5481"
			"maxim,max5482"
			"maxim,max5483"
			"maxim,max5484"

Example:
max548x: max548x@0 {
	compatible = "maxim,max5482";
	spi-max-frequency = <7000000>;
	reg = <0>; /* chip-select */
};
```

## Documentation/devicetree/bindings/iio/potentiometer/mcp41010.txt
```
* Microchip MCP41010/41050/41100/42010/42050/42100 Digital Potentiometer

Datasheet publicly available at:
http://ww1.microchip.com/downloads/en/devicedoc/11195c.pdf

The node for this driver must be a child node of a SPI controller, hence
all mandatory properties described in

        Documentation/devicetree/bindings/spi/spi-bus.txt

must be specified.

Required properties:
	- compatible:  	Must be one of the following, depending on the
			model:
			"microchip,mcp41010"
			"microchip,mcp41050"
			"microchip,mcp41100"
			"microchip,mcp42010"
			"microchip,mcp42050"
			"microchip,mcp42100"

Example:
potentiometer@0 {
	compatible = "microchip,mcp41010";
	reg = <0>;
	spi-max-frequency = <500000>;
};
```

## Documentation/devicetree/bindings/iio/potentiometer/mcp4131.txt
```
* Microchip MCP413X/414X/415X/416X/423X/424X/425X/426X Digital Potentiometer
  driver

The node for this driver must be a child node of a SPI controller, hence
all mandatory properties described in

        Documentation/devicetree/bindings/spi/spi-bus.txt

must be specified.

Required properties:
	- compatible:  	Must be one of the following, depending on the
			model:
			"microchip,mcp4131-502"
			"microchip,mcp4131-103"
			"microchip,mcp4131-503"
			"microchip,mcp4131-104"
			"microchip,mcp4132-502"
			"microchip,mcp4132-103"
			"microchip,mcp4132-503"
			"microchip,mcp4132-104"
			"microchip,mcp4141-502"
			"microchip,mcp4141-103"
			"microchip,mcp4141-503"
			"microchip,mcp4141-104"
			"microchip,mcp4142-502"
			"microchip,mcp4142-103"
			"microchip,mcp4142-503"
			"microchip,mcp4142-104"
			"microchip,mcp4151-502"
			"microchip,mcp4151-103"
			"microchip,mcp4151-503"
			"microchip,mcp4151-104"
			"microchip,mcp4152-502"
			"microchip,mcp4152-103"
			"microchip,mcp4152-503"
			"microchip,mcp4152-104"
			"microchip,mcp4161-502"
			"microchip,mcp4161-103"
			"microchip,mcp4161-503"
			"microchip,mcp4161-104"
			"microchip,mcp4162-502"
			"microchip,mcp4162-103"
			"microchip,mcp4162-503"
			"microchip,mcp4162-104"
			"microchip,mcp4231-502"
			"microchip,mcp4231-103"
			"microchip,mcp4231-503"
			"microchip,mcp4231-104"
			"microchip,mcp4232-502"
			"microchip,mcp4232-103"
			"microchip,mcp4232-503"
			"microchip,mcp4232-104"
			"microchip,mcp4241-502"
			"microchip,mcp4241-103"
			"microchip,mcp4241-503"
			"microchip,mcp4241-104"
			"microchip,mcp4242-502"
			"microchip,mcp4242-103"
			"microchip,mcp4242-503"
			"microchip,mcp4242-104"
			"microchip,mcp4251-502"
			"microchip,mcp4251-103"
			"microchip,mcp4251-503"
			"microchip,mcp4251-104"
			"microchip,mcp4252-502"
			"microchip,mcp4252-103"
			"microchip,mcp4252-503"
			"microchip,mcp4252-104"
			"microchip,mcp4261-502"
			"microchip,mcp4261-103"
			"microchip,mcp4261-503"
			"microchip,mcp4261-104"
			"microchip,mcp4262-502"
			"microchip,mcp4262-103"
			"microchip,mcp4262-503"
			"microchip,mcp4262-104"

Example:
mcp4131: mcp4131@0 {
	compatible = "mcp4131-502";
	reg = <0>;
	spi-max-frequency = <500000>;
};
```

## Documentation/devicetree/bindings/iio/potentiometer/microchip,mcp41010.yaml
```yaml
# SPDX-License-Identifier: (GPL-2.0 OR BSD-2-Clause)
%YAML 1.2
---
$id: http://devicetree.org/schemas/iio/potentiometer/microchip,mcp41010.yaml#
$schema: http://devicetree.org/meta-schemas/core.yaml#

title: Microchip MCP41010/41050/41100/42010/42050/42100 Digital Potentiometer

maintainers:
  - Chris Coffey <cmc@babblebit.net>

description: |
  Datasheet: https://ww1.microchip.com/downloads/en/devicedoc/11195c.pdf

properties:
  compatible:
    enum:
      - microchip,mcp41010
      - microchip,mcp41050
      - microchip,mcp41100
      - microchip,mcp42010
      - microchip,mcp42050
      - microchip,mcp42100

  reg:
    maxItems: 1

  spi-max-frequency: true

additionalProperties: false

required:
  - compatible
  - reg

examples:
  - |
    spi {
        #address-cells = <1>;
        #size-cells = <0>;

        potentiometer@0 {
            compatible = "microchip,mcp41010";
            reg = <0>;
            spi-max-frequency = <500000>;
        };
    };
...
```

## Documentation/devicetree/bindings/iio/potentiometer/microchip,mcp4131.yaml
```yaml
# SPDX-License-Identifier: (GPL-2.0 OR BSD-2-Clause)
%YAML 1.2
---
$id: http://devicetree.org/schemas/iio/potentiometer/microchip,mcp4131.yaml#
$schema: http://devicetree.org/meta-schemas/core.yaml#

title: Microchip MCP413X/414X/415X/416X/423X/424X/425X/426X Digital Potentiometer

maintainers:
  - Slawomir Stepien <sst@poczta.fm>

properties:
  compatible:
    enum:
      - microchip,mcp4131-103
      - microchip,mcp4131-104
      - microchip,mcp4131-502
      - microchip,mcp4131-503
      - microchip,mcp4132-103
      - microchip,mcp4132-104
      - microchip,mcp4132-502
      - microchip,mcp4132-503
      - microchip,mcp4141-103
      - microchip,mcp4141-104
      - microchip,mcp4141-502
      - microchip,mcp4141-503
      - microchip,mcp4142-103
      - microchip,mcp4142-104
      - microchip,mcp4142-502
      - microchip,mcp4142-503
      - microchip,mcp4151-103
      - microchip,mcp4151-104
      - microchip,mcp4151-502
      - microchip,mcp4151-503
      - microchip,mcp4152-103
      - microchip,mcp4152-104
      - microchip,mcp4152-502
      - microchip,mcp4152-503
      - microchip,mcp4161-103
      - microchip,mcp4161-104
      - microchip,mcp4161-502
      - microchip,mcp4161-503
      - microchip,mcp4162-103
      - microchip,mcp4162-104
      - microchip,mcp4162-502
      - microchip,mcp4162-503
      - microchip,mcp4231-103
      - microchip,mcp4231-104
      - microchip,mcp4231-502
      - microchip,mcp4231-503
      - microchip,mcp4232-103
      - microchip,mcp4232-104
      - microchip,mcp4232-502
      - microchip,mcp4232-503
      - microchip,mcp4241-103
      - microchip,mcp4241-104
      - microchip,mcp4241-502
      - microchip,mcp4241-503
      - microchip,mcp4242-103
      - microchip,mcp4242-104
      - microchip,mcp4242-502
      - microchip,mcp4242-503
      - microchip,mcp4251-103
      - microchip,mcp4251-104
      - microchip,mcp4251-502
      - microchip,mcp4251-503
      - microchip,mcp4252-103
      - microchip,mcp4252-104
      - microchip,mcp4252-502
      - microchip,mcp4252-503
      - microchip,mcp4261-103
      - microchip,mcp4261-104
      - microchip,mcp4261-502
      - microchip,mcp4261-503
      - microchip,mcp4262-103
      - microchip,mcp4262-104
      - microchip,mcp4262-502
      - microchip,mcp4262-503

  reg:
    maxItems: 1

  spi-max-frequency: true

additionalProperties: false

required:
  - compatible
  - reg

examples:
  - |
    spi {
        #address-cells = <1>;
        #size-cells = <0>;

        potentiometer@0 {
            compatible = "mcp4131-502";
            reg = <0>;
            spi-max-frequency = <500000>;
        };
    };
...
```

## Documentation/devicetree/bindings/iio/potentiometer/microchip,mcp4531.yaml
```yaml
# SPDX-License-Identifier: (GPL-2.0 OR BSD-2-Clause)
%YAML 1.2
---
$id: http://devicetree.org/schemas/iio/potentiometer/microchip,mcp4531.yaml#
$schema: http://devicetree.org/meta-schemas/core.yaml#

title: Microchip mcp4531 and similar potentiometers.

maintainers:
  - Peter Rosin <peda@axentia.se>

description: |
  Family of I2C digital potentiometer
  Datasheets at:
  * volatile https://ww1.microchip.com/downloads/en/DeviceDoc/22096b.pdf
  * non-volatile https://ww1.microchip.com/downloads/en/DeviceDoc/22107B.pdf
  Part numbers as follows: mcp4ABC-XXX where
  A =   5 (1 wiper), 6 (2 wipers)
  B =   3 (7-bit, volatile), 4 (7-bit, non-volatile),
        5 (8-bit, volatile), 6 (8-bit, non-volatile),
  C:    1 (potentiometer), 2 (rheostat)
  XXX = 502 (5 kOhms), 103 (10 kOhms), 503 (50 kOhms), 104 (100 kOhms)

properties:
  compatible:
    enum:
        # Ordering reflects part number + range, so 502 < 103 etc
      - microchip,mcp4531-502
      - microchip,mcp4531-103
      - microchip,mcp4531-503
      - microchip,mcp4531-104
      - microchip,mcp4532-502
      - microchip,mcp4532-103
      - microchip,mcp4532-503
      - microchip,mcp4532-104
      - microchip,mcp4541-502
      - microchip,mcp4541-103
      - microchip,mcp4541-503
      - microchip,mcp4541-104
      - microchip,mcp4542-502
      - microchip,mcp4542-103
      - microchip,mcp4542-503
      - microchip,mcp4542-104
      - microchip,mcp4551-502
      - microchip,mcp4551-103
      - microchip,mcp4551-503
      - microchip,mcp4551-104
      - microchip,mcp4552-502
      - microchip,mcp4552-103
      - microchip,mcp4552-503
      - microchip,mcp4552-104
      - microchip,mcp4561-502
      - microchip,mcp4561-103
      - microchip,mcp4561-503
      - microchip,mcp4561-104
      - microchip,mcp4562-502
      - microchip,mcp4562-103
      - microchip,mcp4562-503
      - microchip,mcp4562-104
      - microchip,mcp4631-502
      - microchip,mcp4631-103
      - microchip,mcp4631-503
      - microchip,mcp4631-104
      - microchip,mcp4632-502
      - microchip,mcp4632-103
      - microchip,mcp4632-503
      - microchip,mcp4632-104
      - microchip,mcp4641-502
      - microchip,mcp4641-103
      - microchip,mcp4641-503
      - microchip,mcp4641-104
      - microchip,mcp4642-502
      - microchip,mcp4642-103
      - microchip,mcp4642-503
      - microchip,mcp4642-104
      - microchip,mcp4651-502
      - microchip,mcp4651-103
      - microchip,mcp4651-503
      - microchip,mcp4651-104
      - microchip,mcp4652-502
      - microchip,mcp4652-103
      - microchip,mcp4652-503
      - microchip,mcp4652-104
      - microchip,mcp4661-502
      - microchip,mcp4661-103
      - microchip,mcp4661-503
      - microchip,mcp4661-104
      - microchip,mcp4662-502
      - microchip,mcp4662-103
      - microchip,mcp4662-503
      - microchip,mcp4662-104

  reg:
    maxItems: 1

  "#io-channel-cells":
    const: 1

required:
  - compatible
  - reg

additionalProperties: false

examples:
  - |
    i2c {
        #address-cells = <1>;
        #size-cells = <0>;
        dpot: dpot@28 {
            compatible = "microchip,mcp4651-104";
            reg = <0x28>;
            #io-channel-cells = <1>;
        };
    };
...
```
