## Documentation/devicetree/bindings/iio/potentiometer/renesas,x9250.yaml
```yaml
# SPDX-License-Identifier: (GPL-2.0-only OR BSD-2-Clause)
%YAML 1.2
---
$id: http://devicetree.org/schemas/iio/potentiometer/renesas,x9250.yaml#
$schema: http://devicetree.org/meta-schemas/core.yaml#

title: Renesas X9250 quad potentiometers

maintainers:
  - Herve Codina <herve.codina@bootlin.com>

description:
  The Renesas X9250 integrates four digitally controlled potentiometers.
  On each potentiometer, the X9250T has a 100 kOhms total resistance and the
  X9250U has a 50 kOhms total resistance.

allOf:
  - $ref: /schemas/spi/spi-peripheral-props.yaml

properties:
  compatible:
    enum:
      - renesas,x9250t
      - renesas,x9250u

  reg:
    maxItems: 1

  vcc-supply:
    description:
      Regulator for the VCC power supply.

  avp-supply:
    description:
      Regulator for the analog V+ power supply.

  avn-supply:
    description:
      Regulator for the analog V- power supply.

  '#io-channel-cells':
    const: 1

  spi-max-frequency:
    maximum: 2000000

  wp-gpios:
    maxItems: 1
    description:
      GPIO connected to the write-protect pin.

required:
  - compatible
  - reg
  - vcc-supply
  - avp-supply
  - avn-supply
  - '#io-channel-cells'

unevaluatedProperties: false

examples:
  - |
    #include <dt-bindings/gpio/gpio.h>
    spi {
        #address-cells = <1>;
        #size-cells = <0>;
        potentiometer@0 {
            compatible = "renesas,x9250t";
            reg = <0>;
            vcc-supply = <&vcc_regulator>;
            avp-supply = <&avp_regulator>;
            avn-supply = <&avp_regulator>;
            wp-gpios = <&gpio 1 GPIO_ACTIVE_LOW>;
            spi-max-frequency = <2000000>;
            #io-channel-cells = <1>;
        };
    };
```
