## Documentation/devicetree/bindings/input/qcom,spmi-haptics.yaml
```yaml
# SPDX-License-Identifier: GPL-2.0-only OR BSD-2-Clause
%YAML 1.2
---
$id: http://devicetree.org/schemas/input/qcom,spmi-haptics.yaml#
$schema: http://devicetree.org/meta-schemas/core.yaml#

title: Haptics device inside Qualcomm Technologies, Inc. PMIC

maintainers:
  - Fenglin Wu <fenglin.wu@oss.qualcomm.com>

description: |
  Certain Qualcomm PMICs integrate a haptics module, such as the HAP530_HV haptics
  module in the PMIH0108 PMIC, which drives an LRA (Linear Resonant Actuator) with
  an output voltage up to 10 V. Several play modes are supported in HAP530_HV:

    DIRECT_PLAY: The hardware outputs sinusoidal waveforms whose period is
      defined by qcom,lra-period-us and whose peak voltage is defined by
      qcom,vmax-microvolt. The driving amplitude can be scaled in the range
      [0, 255] via a single register byte.  Hardware-based LRA auto-resonance
      tracking is enabled by default in this mode, allowing the haptics engine
      to follow the actual resonant frequency of the LRA and update the driving
      period accordingly to achieve stronger vibration magnitude.

    FIFO: The hardware can play an arbitrary waveform composed of a sequence
      of 8-bit samples at a configurable play rate.  Samples are pre-filled
      into the internal FIFO memory of the haptics module and continuously
      replenished via the FIFO-empty IRQ until all samples have been played.
      An 8K-byte FIFO memory bank is available in the HAP530_HV haptics module,
      shared between the FIFO and PAT_MEM play modes. The memory partition
      between the two modes is configurable via registers, and FIFO mode always
      uses the 1st partition starting from offset 0.

    PAT_MEM: This mode is very similar to FIFO streaming mode but without the
      data refilling capability. It is designed mainly for short, latency-critical
      vibrations. The memory space for PAT_MEM mode must be reserved for dedicated
      usage, and the waveform data should be preloaded and remain unchanged
      thereafter. The haptics module can play the waveform data from the memory
      region specified by the PAT_MEM play start address and length registers.

    In either FIFO mode or PAT_MEM mode, the following play rates are supported:
      -- 0(T_LRA): each FIFO byte drives one full sinusoidal cycle with the
        period defined in qcom,lra-period-us.
      -- 1/2/3(T_LRA_DIV_2/4/8): each FIFO byte drives a half/quarter/eighth
        sinusoidal cycle with the period defined in qcom,lra-period-us.
      -- 4/5/6(T_LRA_X_2/4/8): each FIFO byte drives 2/4/8 sinusoidal cycles
        with the period defined in qcom,lra-period-us.
      -- 8/9/10/11/12/13(8KHz/16KHz/24KHz/32KHz/44.1KHz/48KHz): the FIFO
        data is treated as PCM samples and drives the output with an
        arbitrarily shaped waveform.  This mode is typically used to define
        custom driving waveforms for specific vibration effects such as fast
        attack, crisp brake, etc.

    The drive voltage in FIFO or PAT_MEM mode can exceed the value defined in
    qcom,vmax-microvolt to achieve a special vibration effect, but the waveform
    must be short enough to prevent the LRA from being damaged by operating at
    an overvoltage.

    Also, hardware-based LRA auto-resonance tracking is normally disabled in
    FIFO or PAT_MEM mode, as these modes are intended to drive arbitrary
    waveforms that may not follow the resonant frequency; autonomous hardware
    resonance correction would interfere with the intended output.

properties:
  compatible:
    items:
      - const: qcom,pmih0108-haptics
      - const: qcom,spmi-haptics

  reg:
    items:
      - description: HAP_CFG module base address
      - description: HAP_PTN module base address

  reg-names:
    items:
      - const: cfg
      - const: ptn

  interrupts:
    maxItems: 1

  interrupt-names:
    items:
      - const: fifo-empty

  qcom,vmax-microvolt:
    description:
      Maximum allowed output driving voltage in microvolts, must be a multiple
      of 50,000 uV. This is the peak driving voltage in DIRECT_PLAY mode,
      which outputs sinusoidal waveforms. The value should be equal to the
      square root of 2 times the Vrms voltage of the LRA.
    minimum: 50000
    maximum: 10000000
    multipleOf: 50000

  qcom,lra-period-us:
    description:
      LRA actuator initial resonance period in microseconds
      (1,000,000 / resonant_freq_hz).  Used to configure T_LRA-based play
      rates and the auto-resonance zero-crossing window. It could be also used
      as the initial period if the LRA wants to be driven off resonance.
    minimum: 5
    maximum: 20475
    multipleOf: 5

required:
  - compatible
  - reg
  - reg-names
  - interrupts
  - interrupt-names
  - qcom,vmax-microvolt
  - qcom,lra-period-us

additionalProperties: false
```

## Documentation/devicetree/bindings/input/samsung,s3c6410-keypad.yaml
```yaml
# SPDX-License-Identifier: GPL-2.0-only OR BSD-2-Clause
%YAML 1.2
---
$id: http://devicetree.org/schemas/input/samsung,s3c6410-keypad.yaml#
$schema: http://devicetree.org/meta-schemas/core.yaml#

title: Samsung SoC series Keypad Controller

description:
  Samsung SoC Keypad controller is used to interface a SoC with a matrix-type
  keypad device. The keypad controller supports multiple row and column lines.
  A key can be placed at each intersection of a unique row and a unique column.
  The keypad controller can sense a key-press and key-release and report the
  event using a interrupt to the cpu.

maintainers:
  - Krzysztof Kozlowski <krzk@kernel.org>

properties:
  compatible:
    enum:
      - samsung,s3c6410-keypad
      - samsung,s5pv210-keypad

  reg:
    maxItems: 1

  clocks:
    maxItems: 1

  clock-names:
    items:
      - const: keypad

  interrupts:
    maxItems: 1

  wakeup-source: true

  keypad,num-columns: true
  keypad,num-rows: true
  linux,keymap: true

  linux,input-no-autorepeat:
    type: boolean
    description:
      Do no enable autorepeat feature.

  linux,input-wakeup:
    type: boolean
    deprecated: true

  samsung,keypad-num-columns:
    $ref: /schemas/types.yaml#/definitions/uint32
    description:
      Number of column lines connected to the keypad controller.

  samsung,keypad-num-rows:
    $ref: /schemas/types.yaml#/definitions/uint32
    description:
      Number of row lines connected to the keypad controller.

patternProperties:
  '^key-[0-9a-z]+$':
    type: object
    $ref: input.yaml#
    additionalProperties: false
    description:
      Each key connected to the keypad controller is represented as a child
      node to the keypad controller device node.

    properties:
      keypad,column:
        $ref: /schemas/types.yaml#/definitions/uint32
        description: The column number to which the key is connected.

      keypad,row:
        $ref: /schemas/types.yaml#/definitions/uint32
        description: The row number to which the key is connected.

      linux,code: true

    required:
      - keypad,column
      - keypad,row
      - linux,code

dependencies:
  linux,keymap: [ "keypad,num-columns", "keypad,num-rows" ]

required:
  - compatible
  - reg
  - interrupts

allOf:
  - $ref: input.yaml#
  - $ref: matrix-keymap.yaml#
  - if:
      required:
        - linux,keymap
    then:
      properties:
        samsung,keypad-num-columns: false
        samsung,keypad-num-rows: false
      patternProperties:
        '^key-[0-9a-z]+$': false
    else:
      properties:
        keypad,num-columns: false
        keypad,num-rows: false
      required:
        - samsung,keypad-num-columns
        - samsung,keypad-num-rows

additionalProperties: false

examples:
  - |
    #include <dt-bindings/clock/exynos4.h>
    #include <dt-bindings/interrupt-controller/arm-gic.h>
    #include <dt-bindings/input/input.h>

    keypad1@100a0000 {
        compatible = "samsung,s5pv210-keypad";
        reg = <0x100a0000 0x100>;
        interrupts = <GIC_SPI 109 IRQ_TYPE_LEVEL_HIGH>;
        clocks = <&clock CLK_KEYIF>;
        clock-names = "keypad";

        samsung,keypad-num-rows = <2>;
        samsung,keypad-num-columns = <8>;
        linux,input-no-autorepeat;
        wakeup-source;

        key-1 {
            keypad,row = <0>;
            keypad,column = <3>;
            linux,code = <2>;
        };

        key-2 {
            keypad,row = <0>;
            keypad,column = <4>;
            linux,code = <3>;
        };
    };
  - |
    #include <dt-bindings/clock/exynos4.h>
    #include <dt-bindings/interrupt-controller/arm-gic.h>
    #include <dt-bindings/input/input.h>

    keypad2@100a0000 {
        compatible = "samsung,s5pv210-keypad";
        reg = <0x100a0000 0x100>;
        interrupts = <GIC_SPI 109 IRQ_TYPE_LEVEL_HIGH>;
        clocks = <&clock CLK_KEYIF>;
        clock-names = "keypad";

        keypad,num-rows = <2>;
        keypad,num-columns = <8>;
        linux,keymap = <
          MATRIX_KEY(0, 3, 2)
          MATRIX_KEY(0, 4, 3)
        >;
        linux,input-no-autorepeat;
        wakeup-source;
    };
```

## Documentation/devicetree/bindings/input/ti,omap4-keypad.yaml
```yaml
# SPDX-License-Identifier: (GPL-2.0-only OR BSD-2-Clause)
%YAML 1.2
---
$id: http://devicetree.org/schemas/input/ti,omap4-keypad.yaml#
$schema: http://devicetree.org/meta-schemas/core.yaml#

title: Texas Instruments Keypad Controller

maintainers:
  - Eduard Bostina <egbostina@gmail.com>

description:
  TI's Keypad controller is used to interface a SoC with a matrix-type
  keypad device. The keypad controller supports multiple row and column lines.
  A key can be placed at each intersection of a unique row and a unique column.
  The keypad controller can sense a key-press and key-release and report the
  event using a interrupt to the cpu.

allOf:
  - $ref: /schemas/input/matrix-keymap.yaml#

properties:
  compatible:
    const: ti,omap4-keypad

  reg:
    maxItems: 1

  reg-names:
    const: mpu

  interrupts:
    maxItems: 1

  linux,input-no-autorepeat:
    type: boolean
    description: Do not enable autorepeat feature.

required:
  - compatible
  - reg
  - interrupts
  - keypad,num-rows
  - keypad,num-columns
  - linux,keymap

unevaluatedProperties: false

examples:
  - |
    #include <dt-bindings/interrupt-controller/arm-gic.h>

    keypad@4ae1c000 {
        compatible = "ti,omap4-keypad";
        reg = <0x4ae1c000 0x400>;
        reg-names = "mpu";
        interrupts = <GIC_SPI 120 IRQ_TYPE_LEVEL_HIGH>;
        keypad,num-rows = <2>;
        keypad,num-columns = <8>;
        linux,keymap = <0x00000011   /* KEY_W */
                        0x0001001f>; /* KEY_S */
        linux,input-no-autorepeat;
    };
```

## Documentation/devicetree/bindings/input/ti,tps65217-pwrbutton.yaml
```yaml
# SPDX-License-Identifier: (GPL-2.0-only OR BSD-2-Clause)
%YAML 1.2
---
$id: http://devicetree.org/schemas/input/ti,tps65217-pwrbutton.yaml#
$schema: http://devicetree.org/meta-schemas/core.yaml#

title: Texas Instruments TPS65217 and TPS65218 Power Button

maintainers:
  - Eduard Bostina <egbostina@gmail.com>

description:
  This module is part of the TPS65217/TPS65218 PMIC. It provides a simple
  power button event via an interrupt.

properties:
  compatible:
    enum:
      - ti,tps65217-pwrbutton
      - ti,tps65218-pwrbutton

  interrupts:
    maxItems: 1

required:
  - compatible
  - interrupts

additionalProperties: false

examples:
  - |
    #include <dt-bindings/interrupt-controller/irq.h>
    pmic {
        #address-cells = <1>;
        #size-cells = <0>;

        power-button {
            compatible = "ti,tps65218-pwrbutton";
            interrupts = <3 IRQ_TYPE_EDGE_BOTH>;
        };
    };
```

## Documentation/devicetree/bindings/input/touchscreen/sis,9200-ts.yaml
```yaml
# SPDX-License-Identifier: (GPL-2.0-only OR BSD-2-Clause)
%YAML 1.2
---
$id: http://devicetree.org/schemas/input/touchscreen/sis,9200-ts.yaml#
$schema: http://devicetree.org/meta-schemas/core.yaml#

title: SiS 9200 Family I2C Touchscreen Controller

maintainers:
  - Mika Penttilä <mpenttil@redhat.com>

allOf:
  - $ref: touchscreen.yaml#

properties:
  compatible:
    const: sis,9200-ts

  reg:
    maxItems: 1

  interrupts:
    maxItems: 1

  attn-gpios:
    maxItems: 1
    description: GPIO pin used as the attention line

  reset-gpios:
    maxItems: 1
    description: GPIO pin used to reset the controller

  wakeup-source: true

required:
  - compatible
  - reg
  - interrupts

unevaluatedProperties: false

examples:
  - |
    #include <dt-bindings/gpio/gpio.h>
    #include <dt-bindings/interrupt-controller/irq.h>

    i2c {
        #address-cells = <1>;
        #size-cells = <0>;

        touchscreen@5c {
            compatible = "sis,9200-ts";
            reg = <0x5c>;
            pinctrl-names = "default";
            pinctrl-0 = <&pinctrl_sis>;
            interrupt-parent = <&gpio3>;
            interrupts = <19 IRQ_TYPE_EDGE_FALLING>;
            attn-gpios = <&gpio3 19 GPIO_ACTIVE_LOW>;
            reset-gpios = <&gpio2 30 GPIO_ACTIVE_LOW>;
        };
    };
```

## Documentation/devicetree/bindings/interconnect/qcom,kuno-rpmh.yaml
```yaml
# SPDX-License-Identifier: (GPL-2.0 OR BSD-2-Clause)
%YAML 1.2
---
$id: http://devicetree.org/schemas/interconnect/qcom,kuno-rpmh.yaml#
$schema: http://devicetree.org/meta-schemas/core.yaml#

title: Qualcomm RPMh Network-On-Chip Interconnect on Kuno SoC

maintainers:
  - Hardeep Sharma <hardeep.sharma@oss.qualcomm.com>

description: |
  RPMh interconnect providers support system bandwidth requirements through
  RPMh hardware accelerators known as Bus Clock Manager (BCM). The provider is
  able to communicate with the BCM through the Resource State Coordinator (RSC)
  associated with each execution environment. Provider nodes must point to at
  least one RPMh device child node pertaining to their RSC and each provider
  can map to multiple RPMh resources.

  See also: include/dt-bindings/interconnect/qcom,kuno.h

properties:
  compatible:
    enum:
      - qcom,kuno-aggre-noc
      - qcom,kuno-clk-virt
      - qcom,kuno-cnoc-main
      - qcom,kuno-dc-noc
      - qcom,kuno-mc-virt
      - qcom,kuno-mem-noc
      - qcom,kuno-pcie-anoc
      - qcom,kuno-system-noc

  reg:
    maxItems: 1

  clocks:
    minItems: 1
    maxItems: 2

required:
  - compatible

allOf:
  - $ref: qcom,rpmh-common.yaml#
  - if:
      properties:
        compatible:
          contains:
            enum:
              - qcom,kuno-clk-virt
              - qcom,kuno-mc-virt
    then:
      properties:
        reg: false
    else:
      required:
        - reg

  - if:
      properties:
        compatible:
          contains:
            const: qcom,kuno-aggre-noc
    then:
      properties:
        clocks:
          items:
            - description: System NoC USB SF AXI clock
            - description: IPA clock

  - if:
      properties:
        compatible:
          contains:
            const: qcom,kuno-system-noc
    then:
      properties:
        clocks:
          items:
            - description: IPA clock

  - if:
      properties:
        compatible:
          contains:
            enum:
              - qcom,kuno-aggre-noc
              - qcom,kuno-system-noc
    then:
      required:
        - clocks
    else:
      properties:
        clocks: false

unevaluatedProperties: false

examples:
  - |
    #include <dt-bindings/clock/qcom,kuno-gcc.h>
    #include <dt-bindings/clock/qcom,rpmh.h>

    clk_virt: interconnect-0 {
        compatible = "qcom,kuno-clk-virt";
        #interconnect-cells = <1>;
        qcom,bcm-voters = <&apps_bcm_voter>;
    };

    aggre_noc: interconnect@1640000 {
        compatible = "qcom,kuno-aggre-noc";
        reg = <0x01640000 0x33400>;
        clocks = <&gcc GCC_SYS_NOC_USB_SF_AXI_CLK>,
                 <&rpmhcc RPMH_IPA_CLK>;
        #interconnect-cells = <1>;
        qcom,bcm-voters = <&apps_bcm_voter>;
    };
...
```
