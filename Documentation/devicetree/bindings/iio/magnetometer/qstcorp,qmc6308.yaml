## Documentation/devicetree/bindings/leds/lacie,ns2-leds.yaml
```yaml
# SPDX-License-Identifier: GPL-2.0-only OR BSD-2-Clause
%YAML 1.2
---
$id: http://devicetree.org/schemas/leds/lacie,ns2-leds.yaml#
$schema: http://devicetree.org/meta-schemas/core.yaml#

title: Dual-GPIO LEDs found on Network Space v2 (and parents)

maintainers:
  - Simon Guinot <simon.guinot@sequanux.org>

description:
  The Network Space v2 dual-GPIO LED is wired to a CPLD. Three different LED
  modes are available, off, on and SATA activity blinking. The LED modes are
  controlled through two GPIOs (command and slow), each combination of values
  for the command/slow GPIOs corresponds to a LED mode.

properties:
  compatible:
    const: lacie,ns2-leds

additionalProperties:
  type: object
  $ref: common.yaml#
  unevaluatedProperties: false

  description: Each child node represents a single LED

  properties:
    cmd-gpio:
      maxItems: 1
      description: GPIO connected to the command LED output

    slow-gpio:
      maxItems: 1
      description: GPIO connected to the slow LED output

    num-modes:
      $ref: /schemas/types.yaml#/definitions/uint32
      description:
        Number of entries in modes-map.

    modes-map:
      $ref: /schemas/types.yaml#/definitions/uint32-matrix
      description:
        A mapping between LED modes (off, on or SATA activity blinking) and
        the corresponding cmd-gpio/slow-gpio values. All the GPIO values
        combinations should be given in order to avoid having an unknown
        mode at driver probe time.

      items:
        items:
          - description: LED mode
            enum: [0, 1, 2]
          - description: Command GPIO level
            enum: [0, 1]
          - description: Slow GPIO level
            enum: [0, 1]

  required:
    - cmd-gpio
    - slow-gpio
    - modes-map

required:
  - compatible

examples:
  - |
    #include <dt-bindings/leds/leds-ns2.h>

    led-controller {
        compatible = "lacie,ns2-leds";

        led-0 {
            label = "ns2:blue:sata";
            slow-gpio = <&gpio0 29 0>;
            cmd-gpio = <&gpio0 30 0>;
            modes-map = <NS_V2_LED_OFF  0 1
                         NS_V2_LED_ON   1 0
                         NS_V2_LED_ON   0 0
                         NS_V2_LED_SATA 1 1>;
        };
    };
...
```

## Documentation/devicetree/bindings/leds/motorola,cpcap-leds.yaml
```yaml
# SPDX-License-Identifier: (GPL-2.0 OR BSD-2-Clause)
%YAML 1.2
---
$id: http://devicetree.org/schemas/leds/motorola,cpcap-leds.yaml#
$schema: http://devicetree.org/meta-schemas/core.yaml#

title: Motorola CPCAP PMIC LEDs

maintainers:
  - Svyatoslav Ryhel <clamor95@gmail.com>

description:
  This module is part of the Motorola CPCAP MFD device. For more details
  see Documentation/devicetree/bindings/mfd/motorola,cpcap.yaml. LEDs are
  represented as sub-nodes of the PMIC node on the device tree.

allOf:
  - $ref: /schemas/leds/common.yaml#

properties:
  compatible:
    enum:
      - motorola,cpcap-led-adl # Display Lighting
      - motorola,cpcap-led-blue # Blue Triode
      - motorola,cpcap-led-bt # Bluetooth
      - motorola,cpcap-led-cf # Camera Flash
      - motorola,cpcap-led-cp # Camera Privacy LED
      - motorola,cpcap-led-green # Green Triode
      - motorola,cpcap-led-kl # Keyboard Lighting
      - motorola,cpcap-led-mdl # Main Display Lighting
      - motorola,cpcap-led-red # Red Triode

  vdd-supply: true

required:
  - compatible
  - label
  - vdd-supply

unevaluatedProperties: false

...
```
