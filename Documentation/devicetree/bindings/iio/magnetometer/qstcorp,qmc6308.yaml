## Documentation/devicetree/bindings/interrupt-controller/amazon,al-fic.yaml
```yaml
# SPDX-License-Identifier: (GPL-2.0-only OR BSD-2-Clause)
%YAML 1.2
---
$id: http://devicetree.org/schemas/interrupt-controller/amazon,al-fic.yaml#
$schema: http://devicetree.org/meta-schemas/core.yaml#

title: Amazon Annapurna Labs Fabric Interrupt Controller

maintainers:
  - Talel Shenhar <talel@amazon.com>

properties:
  compatible:
    const: amazon,al-fic

  reg:
    maxItems: 1

  interrupt-controller: true

  '#interrupt-cells':
    const: 2

  interrupts:
    maxItems: 1

  amazon,al-fic-mask:
    $ref: /schemas/types.yaml#/definitions/string
    description:
      Selects which of the controller's severity outputs this group drives,
      and thus which mask register the driver programs. A group has one cause
      register and three severity outputs - info, error and fatal - each
      gated by its own mask register. Each output is aggregated into a
      separate interrupt tree, and a group belongs to exactly one of them.
      The error and fatal outputs exist only on controller revisions that
      implement them; earlier revisions provide the info output only.
    enum: [info, error, fatal]
    default: info

required:
  - compatible
  - reg
  - interrupt-controller
  - '#interrupt-cells'
  - interrupts

additionalProperties: false

examples:
  - |
    #include <dt-bindings/interrupt-controller/arm-gic.h>

    interrupt-controller@fd8a8500 {
        compatible = "amazon,al-fic";
        reg = <0xfd8a8500 0x40>;
        interrupt-controller;
        #interrupt-cells = <2>;
        interrupts = <GIC_SPI 0x0 IRQ_TYPE_LEVEL_HIGH>;
        amazon,al-fic-mask = "error";
    };
```

## Documentation/devicetree/bindings/interrupt-controller/xlnx,versal-net-smmu-csr.yaml
```yaml
# SPDX-License-Identifier: (GPL-2.0-only OR BSD-2-Clause)
%YAML 1.2
---
$id: http://devicetree.org/schemas/interrupt-controller/xlnx,versal-net-smmu-csr.yaml#
$schema: http://devicetree.org/meta-schemas/core.yaml#

title: Xilinx Versal NET SMMU CSR Interrupt Controller

maintainers:
  - Anirudha Sarangi <anirudha.sarangi@amd.com>
  - Tushar Nimkar <tushar.nimkar@amd.com>

description: |
  The Versal NET platform includes a Xilinx-specific SMMU CSR (Control and
  Status Register) block that acts as an intermediate interrupt controller
  for ARM SMMUv3.

  The block provides registers to enable, disable and clear the
  standard SMMUv3 interrupt sources (EVENTQ, CMDQ_SYNC, GERROR and PRIQ)
  before forwarding them to the parent interrupt controller,
  typically a GIC.

  The controller receives one parent interrupt and demultiplexes CSR
  status bits into the following child interrupt identifiers
    0 - EVENTQ
    1 - CMDQ_SYNC
    2 - GERROR (GLOBAL)
    3 - PRIQ

allOf:
  - $ref: /schemas/interrupt-controller.yaml#

properties:
  compatible:
    const: xlnx,versal-net-smmu-csr

  reg:
    maxItems: 1

  interrupt-controller: true

  "#interrupt-cells":
    const: 1
    description: |
     Single cell containing the child interrupt identifier
      0 - EVENTQ
      1 - CMDQ_SYNC
      2 - GERROR (GLOBAL)
      3 - PRIQ

  interrupts:
    maxItems: 1

required:
  - compatible
  - reg
  - interrupt-controller
  - "#interrupt-cells"
  - interrupts

additionalProperties: false

examples:
  - |
    #include <dt-bindings/interrupt-controller/arm-gic.h>
    #include <dt-bindings/interrupt-controller/irq.h>

    interrupt-controller@eca10000 {
        compatible = "xlnx,versal-net-smmu-csr";
        reg = <0xeca10000 0x1000>;
        interrupt-controller;
        #interrupt-cells = <1>;
        interrupt-parent = <&gic>;
        interrupts = <GIC_SPI 169 IRQ_TYPE_LEVEL_HIGH>;
    };
```

## Documentation/devicetree/bindings/iommu/brcm,bcm2712-iommu.yaml
```yaml
# SPDX-License-Identifier: (GPL-2.0-only OR BSD-2-Clause)
%YAML 1.2
---
$id: http://devicetree.org/schemas/iommu/brcm,bcm2712-iommu.yaml#
$schema: http://devicetree.org/meta-schemas/core.yaml#

title: Broadcom BCM2712 IOMMU

maintainers:
  - Daniel Drake <dan@reactivated.net>
  - Florian Fainelli <florian.fainelli@broadcom.com>
  - Jim Quinlan <james.quinlan@broadcom.com>

description:
  The BCM2712 SoC features multiple independent IOMMU instances providing
  address translation for multimedia hardware blocks, such as the VC6 display
  pipeline, camera receivers, and ISP. Each IOMMU has its own page tables,
  control registers, and local TLB, and is additionally linked to a centralized
  L2 TLB (IOMMUC).

properties:
  compatible:
    const: brcm,bcm2712-iommu

  reg:
    maxItems: 1

  '#iommu-cells':
    const: 0

  brcm,iommu-cache:
    $ref: /schemas/types.yaml#/definitions/phandle
    description:
      Phandle to the shared IOMMU cache (IOMMUC). Each IOMMU instance caches
      translated descriptors in this centralized L2 TLB cache block and must
      trigger cache invalidation commands on it when updating or unmapping page
      table entries.

required:
  - compatible
  - reg
  - '#iommu-cells'
  - brcm,iommu-cache

additionalProperties: false

examples:
  - |
    iommu@5200 {
        compatible = "brcm,bcm2712-iommu";
        reg = <0x5200 0x80>;
        brcm,iommu-cache = <&iommuc>;
        #iommu-cells = <0>;
    };
```

## Documentation/devicetree/bindings/iommu/brcm,bcm2712-iommuc.yaml
```yaml
# SPDX-License-Identifier: (GPL-2.0-only OR BSD-2-Clause)
%YAML 1.2
---
$id: http://devicetree.org/schemas/iommu/brcm,bcm2712-iommuc.yaml#
$schema: http://devicetree.org/meta-schemas/core.yaml#

title: Broadcom BCM2712 Shared IOMMU Cache (IOMMUC)

maintainers:
  - Daniel Drake <dan@reactivated.net>
  - Florian Fainelli <florian.fainelli@broadcom.com>
  - Jim Quinlan <james.quinlan@broadcom.com>

description:
  The BCM2712 IOMMUC is a centralized Translation Lookaside Buffer (TLB) cache
  which accelerates address translation across the SoC's IOMMU devices. If an
  address mapping is not found in the IOMMU's local TLB cache, then this
  IOMMUC is consulted as a L2 TLB. The SoC includes a single IOMMUC which is
  shared between all IOMMUs, and it must be explicitly invalidated when
  modifying or unmapping IOMMU page tables.

properties:
  compatible:
    const: brcm,bcm2712-iommuc

  reg:
    maxItems: 1

required:
  - compatible
  - reg

additionalProperties: false

examples:
  - |
    iommuc@5b00 {
        compatible = "brcm,bcm2712-iommuc";
        reg = <0x5b00 0x80>;
    };
```

## Documentation/devicetree/bindings/iommu/ti,omap-iommu.yaml
```yaml
# SPDX-License-Identifier: (GPL-2.0 OR BSD-2-Clause)
%YAML 1.2
---
$id: http://devicetree.org/schemas/iommu/ti,omap-iommu.yaml#
$schema: http://devicetree.org/meta-schemas/core.yaml#

title: OMAP2+ IOMMU

maintainers:
  - Bhargav Joshi <j.bhargav.u@gmail.com>

properties:
  compatible:
    enum:
      - ti,omap2-iommu
      - ti,omap4-iommu
      - ti,dra7-dsp-iommu
      - ti,dra7-iommu

  reg:
    maxItems: 1

  interrupts:
    maxItems: 1

  '#iommu-cells':
    const: 0

  ti,#tlb-entries:
    description: Number of entries in the translation look-aside buffer.
    $ref: /schemas/types.yaml#/definitions/uint32
    enum: [8, 32]
    default: 32

  ti,iommu-bus-err-back:
    description:
      Indicates the IOMMU instance supports throwing back a bus error response
      on MMU faults.
    type: boolean

  ti,syscon-mmuconfig:
    description:
      Pair of the phandle to the DSP_SYSTEM syscon node that
      contains the additional control register for enabling the MMU, and the
      MMU instance number (0-indexed) within the sub-system. The instance number
      should be 0 for DSP MDMA MMUs and 1 for DSP EDMA MMUs.
    $ref: /schemas/types.yaml#/definitions/phandle-array
    maxItems: 1
    items:
      items:
        - description: phandle to the DSP_SYSTEM syscon node
        - description: MMU instance number
          enum: [0, 1]

  ti,hwmods:
    description: Name of the hwmod associated with the IOMMU instance
    $ref: /schemas/types.yaml#/definitions/string
    deprecated: true

required:
  - compatible
  - reg
  - '#iommu-cells'
  - interrupts

allOf:
  - if:
      properties:
        compatible:
          contains:
            const: ti,dra7-dsp-iommu
    then:
      required:
        - ti,syscon-mmuconfig
    else:
      properties:
        ti,syscon-mmuconfig: false

additionalProperties: false

examples:
  - |
    mmu@480bd400 {
        #iommu-cells = <0>;
        compatible = "ti,omap2-iommu";
        reg = <0x480bd400 0x80>;
        interrupts = <24>;
        ti,hwmods = "mmu_isp";
        ti,#tlb-entries = <8>;
    };

  - |
    #include <dt-bindings/interrupt-controller/arm-gic.h>

    mmu@41501000 {
        compatible = "ti,dra7-dsp-iommu";
        reg = <0x41501000 0x100>;
        interrupts = <GIC_SPI 146 IRQ_TYPE_LEVEL_HIGH>;
        ti,hwmods = "mmu0_dsp2";
        #iommu-cells = <0>;
        ti,syscon-mmuconfig = <&dsp2_system 0x0>;
    };

  - |
    #include <dt-bindings/interrupt-controller/arm-gic.h>

    mmu@41502000 {
        compatible = "ti,dra7-dsp-iommu";
        reg = <0x41502000 0x100>;
        interrupts = <GIC_SPI 147 IRQ_TYPE_LEVEL_HIGH>;
        ti,hwmods = "mmu1_dsp2";
        #iommu-cells = <0>;
        ti,syscon-mmuconfig = <&dsp2_system 0x1>;
    };
```

## Documentation/devicetree/bindings/leds/adi,ltc3208.yaml
```yaml
# SPDX-License-Identifier: (GPL-2.0-only OR BSD-2-Clause)
# Copyright (c) 2026 Analog Devices, Inc.
%YAML 1.2
---
$id: http://devicetree.org/schemas/leds/adi,ltc3208.yaml#
$schema: http://devicetree.org/meta-schemas/core.yaml#

title: LTC3208 Multidisplay LED Controller from Linear Technologies (Now Analog Devices)

maintainers:
  - Jan Carlo Roleda <jancarlo.roleda@analog.com>

description:
  The LTC3208 is a multidisplay LED controller that can support up to 1A to all
  connected LEDs.

  The datasheet for this device can be found in
  https://www.analog.com/en/products/ltc3208.html

properties:
  compatible:
    const: adi,ltc3208

  reg:
    maxItems: 1

  "#address-cells":
    const: 1

  "#size-cells":
    const: 0

  adi,disable-camhl-pin:
    type: boolean
    description:
      Configures whether the external CAMHL pin is disabled.
      If disabled then the output pins associated with CAM will always select
      the CAM register's high half-byte brightness.

  adi,cfg-enrgbs-pin:
    type: boolean
    description:
      Configures which channel the ENRGBS pin toggles when it receives a signal.
      ENRGBS pin controls the SUB channel's output pins if this is set,
      or RGB channel's output pins if this is unset.

  adi,disable-rgb-aux4-dropout:
    type: boolean
    description:
      Configures the RGB and AUX4 dropout signals to be disabled.

  adi,aux1-channel:
    $ref: /schemas/types.yaml#/definitions/string
    description:
      LED Channel that the AUX1 output pin mirrors its brightness level from.
    enum: [aux, main, sub, cam]
    default: aux

  adi,aux2-channel:
    $ref: /schemas/types.yaml#/definitions/string
    description:
      LED Channel that the AUX2 output pin mirrors its brightness level from.
    enum: [aux, main, sub, cam]
    default: aux

  adi,aux3-channel:
    $ref: /schemas/types.yaml#/definitions/string
    description:
      LED Channel that the AUX3 output pin mirrors its brightness level from.
    enum: [aux, main, sub, cam]
    default: aux

  adi,aux4-channel:
    $ref: /schemas/types.yaml#/definitions/string
    description:
      LED Channel that the AUX4 output pin mirrors its brightness level from.
    enum: [aux, main, sub, cam]
    default: aux

patternProperties:
  "^led@[0-7]$":
    type: object
    $ref: /schemas/leds/common.yaml#
    unevaluatedProperties: false
    properties:
      reg:
        description:
          LED Channel Number. each channel maps to a specific channel group used
          to configure the brightness level of the output pins corresponding to
          the channel.
        enum:
          - 0 # Main Channel (8-bit brightness)
          - 1 # Sub Channel (8-bit brightness)
          - 2 # AUX Channel (4-bit brightness)
          - 3 # Camera Channel, Low-side byte (4-bit brightness)
          - 4 # Camera Channel, High-side byte (4-bit brightness)
          - 5 # Red Channel (4-bit brightness)
          - 6 # Blue Channel (4-bit brightness)
          - 7 # Green Channel (4-bit brightness)
    required:
      - reg

required:
  - compatible
  - reg
  - "#address-cells"
  - "#size-cells"

additionalProperties: false

examples:
  - |
    #include <dt-bindings/leds/common.h>
    i2c {
      #address-cells = <1>;
      #size-cells = <0>;

      led-controller@1b {
        compatible = "adi,ltc3208";
        reg = <0x1b>;
        #address-cells = <1>;
        #size-cells = <0>;
        adi,disable-camhl-pin;
        adi,cfg-enrgbs-pin;
        adi,disable-rgb-aux4-dropout;

        /* MAIN */
        led@0 {
          reg = <0>;
          function = LED_FUNCTION_ACTIVITY;
          color = <LED_COLOR_ID_WHITE>;
        };

        /* SUB */
        led@1 {
          reg = <1>;
          function = LED_FUNCTION_ACTIVITY;
          color = <LED_COLOR_ID_WHITE>;
        };

        /* AUX */
        led@2 {
          reg = <2>;
          function = LED_FUNCTION_ACTIVITY;
          color = <LED_COLOR_ID_WHITE>;
        };

        /* CAMLO */
        led@3 {
          reg = <3>;
          function = LED_FUNCTION_FLASH;
          color = <LED_COLOR_ID_WHITE>;
        };

        /* CAMHI */
        led@4 {
          reg = <4>;
          function = LED_FUNCTION_FLASH;
          color = <LED_COLOR_ID_WHITE>;
        };

        /* RED */
        led@5 {
          reg = <5>;
          function = LED_FUNCTION_INDICATOR;
          color = <LED_COLOR_ID_RED>;
        };

        /* BLUE */
        led@6 {
          reg = <6>;
          function = LED_FUNCTION_INDICATOR;
          color = <LED_COLOR_ID_BLUE>;
        };

        /* GREEN */
        led@7 {
          reg = <7>;
          function = LED_FUNCTION_INDICATOR;
          color = <LED_COLOR_ID_GREEN>;
        };
      };
    };
```
