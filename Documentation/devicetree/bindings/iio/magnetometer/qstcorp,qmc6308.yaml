## Documentation/devicetree/bindings/leds/adi,ltc3220.yaml
```yaml
# SPDX-License-Identifier: (GPL-2.0-only OR BSD-2-Clause)
%YAML 1.2
---
$id: http://devicetree.org/schemas/leds/adi,ltc3220.yaml#
$schema: http://devicetree.org/meta-schemas/core.yaml#

title: Analog Devices LTC3220 LED Driver

maintainers:
  - Edelweise Escala <edelweise.escala@analog.com>

description: >
  The LTC3220 is a multi-display LED driver, which contains a high-efficiency,
  low-noise charge pump to provide power to up to 18 LED current sources.
  The LEDs are individually configurable to 64-step linear brightness control,
  blinking and gradation control via 2-wire I2C interface.

  For more product information please see the link below
    https://www.analog.com/en/products/ltc3220.html

properties:
  compatible:
    const: adi,ltc3220

  reg:
    maxItems: 1

  '#address-cells':
    const: 1

  '#size-cells':
    const: 0

  reset-gpios:
    maxItems: 1

patternProperties:
  '^led@([1-9a-f]|1[0-2])$':
    type: object
    $ref: /schemas/leds/common.yaml#
    unevaluatedProperties: false
    properties:
      reg:
        description:
          Output channel for the LED (1-18 maps to LED outputs D1-D18).
          Unit-address must be in hexadecimal (1-12 hex = 1-18 decimal).
          For aggregated LED control, define only one LED node with reg = <0x1>
          and use led-sources to list all controlled outputs. Only reg 1 should
          be present when using led-sources.
        items:
          - minimum: 1
            maximum: 18

    required:
      - reg

    if:
      required:
        - led-sources
    then:
      properties:
        reg:
          items:
            - const: 1

required:
  - compatible
  - reg
  - '#address-cells'
  - '#size-cells'

additionalProperties: false

examples:
  - |
    // Independent LEDs
    #include <dt-bindings/gpio/gpio.h>
    #include <dt-bindings/leds/common.h>

    i2c {
        #address-cells = <1>;
        #size-cells = <0>;

        led-controller@1c {
            compatible = "adi,ltc3220";
            reg = <0x1c>;
            #address-cells = <1>;
            #size-cells = <0>;
            reset-gpios = <&gpio 17 GPIO_ACTIVE_LOW>;

            led@1 {
                reg = <0x1>;
                function = LED_FUNCTION_INDICATOR;
                function-enumerator = <1>;
            };

            led@2 {
                reg = <0x2>;
                function = LED_FUNCTION_INDICATOR;
                function-enumerator = <2>;
            };

            led@3 {
                reg = <0x3>;
                function = LED_FUNCTION_INDICATOR;
                function-enumerator = <3>;
            };
        };
    };

  - |
    // Aggregated LED
    #include <dt-bindings/leds/common.h>

    i2c {
        #address-cells = <1>;
        #size-cells = <0>;

        led-controller@1c {
            compatible = "adi,ltc3220";
            reg = <0x1c>;
            #address-cells = <1>;
            #size-cells = <0>;

            led@1 {
                reg = <0x1>;
                led-sources = <0x1 0x2 0x3 0x4 0x5 0x6 0x7 0x8 0x9 0xa 0xb 0xc 0xd 0xe 0xf 0x10 0x11 0x12>;
                function = LED_FUNCTION_BACKLIGHT;
            };
        };
    };

...
```

## Documentation/devicetree/bindings/leds/backlight/ti,lm3533-backlight.yaml
```yaml
# SPDX-License-Identifier: (GPL-2.0-only OR BSD-2-Clause)
%YAML 1.2
---
$id: http://devicetree.org/schemas/leds/backlight/ti,lm3533-backlight.yaml#
$schema: http://devicetree.org/meta-schemas/core.yaml#

title: TI LM3533 high voltage series LED strings

description:
  This is part of the TI LM3533 MFD device. It represents two high voltage series
  LED strings for display backlight controlled by the TI LM3533.

maintainers:
  - Svyatoslav Ryhel <clamor95@gmail.com>

allOf:
  - $ref: /schemas/leds/backlight/common.yaml#

properties:
  compatible:
    const: ti,lm3533-backlight

  reg:
    description: Control bank selection (0 = bank A, 1 = bank B).
    maximum: 1

  led-max-microamp:
    description: maximum current in uA with a 800 uA step.
    minimum: 5000
    maximum: 29800
    default: 5000

  led-sources:
    description: |
      HVLED strings associated with this control bank:
        0 - HVLED1
        1 - HVLED2
    minItems: 1
    maxItems: 2
    items:
      maximum: 1

  ti,pwm-config-mask:
    $ref: /schemas/types.yaml#/definitions/uint32
    description: |
      Control Bank PWM Configuration Register mask that allows to configure
      PWM input in Zones 0-4
      BIT(0) - PWM Input is enabled
      BIT(1) - PWM Input is enabled in Zone 0
      BIT(2) - PWM Input is enabled in Zone 1
      BIT(3) - PWM Input is enabled in Zone 2
      BIT(4) - PWM Input is enabled in Zone 3
      BIT(5) - PWM Input is enabled in Zone 4
    default: 0

  ti,linear-mapping-mode:
    description:
      Enable linear mapping mode. If disabled, then it will use exponential
      mapping mode in which the ramp up/down appears to have a more uniform
      transition to the human eye.
    type: boolean

required:
  - compatible
  - reg

unevaluatedProperties: false

# see ti,lm3533.yaml for an example
```

## Documentation/devicetree/bindings/leds/backlight/ti,tps65217.yaml
```yaml
# SPDX-License-Identifier: (GPL-2.0-only OR BSD-2-Clause)
%YAML 1.2
---
$id: http://devicetree.org/schemas/leds/backlight/ti,tps65217.yaml#
$schema: http://devicetree.org/meta-schemas/core.yaml#

title: TPS65217 family of regulators

maintainers:
  - Eduard Bostina <egbostina@gmail.com>

description:
  The TPS65217 chip contains a boost converter and current sinks which can be
  used to drive LEDs for use as backlights.

properties:
  compatible:
    const: ti,tps65217

  reg:
    maxItems: 1
    description: I2C slave address

  interrupts:
    maxItems: 1

  interrupt-controller: true

  "#interrupt-cells":
    const: 1

  ti,pmic-shutdown-controller:
    type: boolean
    description:
      Set the PMIC to shutdown on PWR_EN toggle.

  backlight:
    type: object
    additionalProperties: false
    description:
      Node for specifying WLED1 and WLED2 lines in TPS65217.

    properties:
      isel:
        $ref: /schemas/types.yaml#/definitions/uint32
        enum: [1, 2]
        description: |
          Selection bit. Valid values:
            1 - ISEL1 (low-level)
            2 - ISEL2 (high-level)

      fdim:
        $ref: /schemas/types.yaml#/definitions/uint32
        enum: [100, 200, 500, 1000]
        description:
          PWM dimming frequency in Hz.

      default-brightness:
        $ref: /schemas/types.yaml#/definitions/uint32
        minimum: 0
        maximum: 100

    required:
      - isel
      - fdim
      - default-brightness

  regulators:
    type: object
    additionalProperties: false
    description:
      List of child nodes that specify the regulator initialization data.
      Not all regulators for the given device need to be present.

    patternProperties:
      "^(dcdc[1-3]|ldo[1-4])$":
        type: object
        $ref: /schemas/regulator/regulator.yaml#
        unevaluatedProperties: false

  charger:
    $ref: /schemas/power/supply/tps65217-charger.yaml#
    unevaluatedProperties: false

  pwrbutton:
    $ref: /schemas/input/ti,tps65217-pwrbutton.yaml#
    unevaluatedProperties: false

required:
  - compatible
  - reg

additionalProperties: false

examples:
  - |
    i2c {
        #address-cells = <1>;
        #size-cells = <0>;

        pmic@24 {
            compatible = "ti,tps65217";
            reg = <0x24>;
            interrupt-controller;
            #interrupt-cells = <1>;
            ti,pmic-shutdown-controller;

            backlight {
                isel = <1>;   /* 1 - ISET1, 2 ISET2 */
                fdim = <100>; /* TPS65217_BL_FDIM_100HZ */
                default-brightness = <50>;
            };

            charger {
                compatible = "ti,tps65217-charger";
                interrupts = <0>, <1>;
                interrupt-names = "USB", "AC";
            };

            pwrbutton {
                compatible = "ti,tps65217-pwrbutton";
                interrupts = <2>;
            };

            regulators {
                dcdc1 {
                    regulator-name = "vdds_dpr";
                    regulator-always-on;
                };

                dcdc2 {
                    regulator-name = "vdd_mpu";
                    regulator-min-microvolt = <925000>;
                    regulator-max-microvolt = <1351500>;
                    regulator-boot-on;
                    regulator-always-on;
                };

                dcdc3 {
                    regulator-name = "vdd_core";
                    regulator-min-microvolt = <925000>;
                    regulator-max-microvolt = <1150000>;
                    regulator-boot-on;
                    regulator-always-on;
                };

                ldo1 {
                    regulator-name = "vio,vrtc,vdds";
                    regulator-always-on;
                };

                ldo2 {
                    regulator-name = "vdd_3v3aux";
                    regulator-always-on;
                };

                ldo3 {
                    regulator-name = "vdd_1v8";
                    regulator-min-microvolt = <1800000>;
                    regulator-max-microvolt = <1800000>;
                    regulator-always-on;
                };

                ldo4 {
                    regulator-name = "vdd_3v3a";
                    regulator-always-on;
                };
            };
        };
    };
```

## Documentation/devicetree/bindings/leds/brcm,bcm6358-leds.yaml
```yaml
# SPDX-License-Identifier: (GPL-2.0 OR BSD-2-Clause)
%YAML 1.2
---
$id: http://devicetree.org/schemas/leds/brcm,bcm6358-leds.yaml#
$schema: http://devicetree.org/meta-schemas/core.yaml#

title: LEDs connected to Broadcom BCM6358 controller

description: |
  This controller is present on BCM6358 and BCM6368.
  In these SoCs there are Serial LEDs (LEDs connected to a 74x164 controller),
  which can either be controlled by software (exporting the 74x164 as spi-gpio.
  See Documentation/devicetree/bindings/gpio/fairchild,74hc595.yaml), or
  by hardware using this driver.

maintainers:
  - Álvaro Fernández Rojas <noltari@gmail.com>

properties:
  compatible:
    const: brcm,bcm6358-leds

  reg:
    maxItems: 1

  "#address-cells":
    const: 1

  "#size-cells":
    const: 0

  brcm,clk-div:
    description: SCK signal divider.
    default: 1
    $ref: /schemas/types.yaml#/definitions/uint32
    enum: [1, 2, 4, 8]

  brcm,clk-dat-low:
    description: Makes clock and data signals active low.
    type: boolean

patternProperties:
  "^led@1?[0-9a-f]$":
    type: object
    $ref: common.yaml#
    unevaluatedProperties: false
    description: Each LED is represented as a sub-node of
      this device.

    properties:
      reg:
        description: LED pin number (0 to 31).
        maxItems: 1

    required:
      - reg

required:
  - compatible
  - reg
  - "#address-cells"
  - "#size-cells"

additionalProperties: false

examples:
  - |
    #include <dt-bindings/leds/common.h>
    led-controller@fffe00d0 {
        compatible = "brcm,bcm6358-leds";
        #address-cells = <1>;
        #size-cells = <0>;
        reg = <0xfffe00d0 0x8>;

        led@0 {
            reg = <0>;
            active-low;
            label = "white:alarm";
        };
        led@2 {
            reg = <2>;
            active-low;
            label = "white:tv";
        };
        led@3 {
            reg = <3>;
            active-low;
            label = "white:tel";
        };
        led@4 {
            reg = <4>;
            active-low;
            label = "white:adsl";
        };
    };
...
```

## Documentation/devicetree/bindings/leds/lacie,netxbig-leds.yaml
```yaml
# SPDX-License-Identifier: (GPL-2.0-only OR BSD-2-Clause)
%YAML 1.2
---
$id: http://devicetree.org/schemas/leds/lacie,netxbig-leds.yaml#
$schema: http://devicetree.org/meta-schemas/core.yaml#

title: LaCie/Seagate netxbig CPLD LEDs

maintainers:
  - Simon Guinot <simon.guinot@sequanux.org>

description: |
  Binding for the CPLD LEDs (GPIO extension bus) found on some LaCie/Seagate
  boards (Example: 2Big/5Big Network v2, 2Big NAS).

properties:
  compatible:
    const: lacie,netxbig-leds

  gpio-ext:
    description: Phandle for the gpio-ext bus.
    $ref: /schemas/types.yaml#/definitions/phandle

  timers:
    description:
      Timer array. Each timer entry is represented by three integers -
      Mode (gpio-ext bus), delay_on and delay_off.
    $ref: /schemas/types.yaml#/definitions/uint32-array

patternProperties:
  "^led-[a-z0-9]+$":
    type: object
    $ref: common.yaml#
    unevaluatedProperties: false

    properties:
      mode-addr:
        description: Mode register address on gpio-ext bus.
        $ref: /schemas/types.yaml#/definitions/uint32

      mode-val:
        description:
          Mode to value mapping. Each entry is represented by two integers -
          a mode and the corresponding value on the gpio-ext bus.
        $ref: /schemas/types.yaml#/definitions/uint32-array

      bright-addr:
        description: Brightness register address on gpio-ext bus.
        $ref: /schemas/types.yaml#/definitions/uint32

      max-brightness:
        description: Maximum brightness value.
        $ref: /schemas/types.yaml#/definitions/uint32

    required:
      - mode-addr
      - mode-val
      - bright-addr
      - max-brightness

required:
  - compatible
  - gpio-ext

additionalProperties: false

examples:
  - |
    #include <dt-bindings/leds/leds-netxbig.h>

    leds {
        compatible = "lacie,netxbig-leds";

        gpio-ext = <&netxbig_gpio_ext>;

        timers = <NETXBIG_LED_TIMER1 500 500
                  NETXBIG_LED_TIMER2 500 1000>;

        led-0 {
            label = "netxbig:blue:power";
            mode-addr = <0>;
            mode-val = <NETXBIG_LED_OFF 0
                        NETXBIG_LED_ON 1
                        NETXBIG_LED_TIMER1 3
                        NETXBIG_LED_TIMER2 7>;
            bright-addr = <1>;
            max-brightness = <7>;
        };
        led-1 {
            label = "netxbig:red:power";
            mode-addr = <0>;
            mode-val = <NETXBIG_LED_OFF 0
                        NETXBIG_LED_ON 2
                        NETXBIG_LED_TIMER1 4>;
            bright-addr = <1>;
            max-brightness = <7>;
        };
        led-2 {
            label = "netxbig:blue:sata0";
            mode-addr = <3>;
            mode-val = <NETXBIG_LED_OFF 0
                        NETXBIG_LED_ON 7
                        NETXBIG_LED_SATA 1
                        NETXBIG_LED_TIMER1 3>;
            bright-addr = <2>;
            max-brightness = <7>;
        };
        led-3 {
            label = "netxbig:red:sata0";
            mode-addr = <3>;
            mode-val = <NETXBIG_LED_OFF 0
                        NETXBIG_LED_ON 2
                        NETXBIG_LED_TIMER1 4>;
            bright-addr = <2>;
            max-brightness = <7>;
        };
        led-4 {
            label = "netxbig:blue:sata1";
            mode-addr = <4>;
            mode-val = <NETXBIG_LED_OFF 0
                        NETXBIG_LED_ON 7
                        NETXBIG_LED_SATA 1
                        NETXBIG_LED_TIMER1 3>;
            bright-addr = <2>;
            max-brightness = <7>;
        };
        led-5 {
            label = "netxbig:red:sata1";
            mode-addr = <4>;
            mode-val = <NETXBIG_LED_OFF 0
                        NETXBIG_LED_ON 2
                        NETXBIG_LED_TIMER1 4>;
            bright-addr = <2>;
            max-brightness = <7>;
        };
    };
```
