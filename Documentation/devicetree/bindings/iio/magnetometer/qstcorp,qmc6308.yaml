## Documentation/devicetree/bindings/iio/magnetometer/qstcorp,qmc6308.yaml
```yaml
# SPDX-License-Identifier: (GPL-2.0-only OR BSD-2-Clause)
%YAML 1.2
---
$id: http://devicetree.org/schemas/iio/magnetometer/qstcorp,qmc6308.yaml#
$schema: http://devicetree.org/meta-schemas/core.yaml#

title: QST QMC6308 3-Axis Magnetic Sensor

maintainers:
  - Jorijn van der Graaf <jorijnvdgraaf@catcrafts.net>

description:
  QST QMC6308 3-axis anisotropic magnetoresistive (AMR) magnetic sensor
  on I2C bus, with a single supply and no interrupt pin.
  https://qstcorp.com/upload/pdf/202202/13-52-15%20QMC6308%20Datasheet%20Rev.%20F(1).pdf

properties:
  compatible:
    const: qstcorp,qmc6308

  reg:
    maxItems: 1

  vdd-supply: true

  mount-matrix: true

required:
  - compatible
  - reg
  - vdd-supply

additionalProperties: false

examples:
  - |
    i2c {
        #address-cells = <1>;
        #size-cells = <0>;

        magnetometer@2c {
            compatible = "qstcorp,qmc6308";
            reg = <0x2c>;
            vdd-supply = <&vdd_1v8_reg>;
        };
    };
...
```

## Documentation/devicetree/bindings/iio/proximity/pulsedlight,lidar-lite-v2.yaml
```yaml
# SPDX-License-Identifier: (GPL-2.0-only OR BSD-2-Clause)
%YAML 1.2
---
$id: http://devicetree.org/schemas/iio/proximity/pulsedlight,lidar-lite-v2.yaml#
$schema: http://devicetree.org/meta-schemas/core.yaml#

title: Pulsedlight/Garmin LIDAR-Lite range-finding sensors

maintainers:
  - Matt Ranostay <matt@ranostay.sg>
  - Rodrigo Gobbi <rodrigo.gobbi.7@gmail.com>

description: |
  This binding covers the I2C interface of the Pulsedlight/Garmin
  LIDAR-Lite v2 and v3 laser rangefinders.

  Besides I2C, the mode control pin can also trigger acquisitions and
  report the measured distance through a PWM signal, without using I2C
  at all. That usage is bidirectional and non-cyclic, and is not
  described by this binding. The same pin can also be used, while I2C
  remains the active interface, as a plain status output signalling
  when an acquisition has completed.

  Datasheets:
    https://static.garmin.com/pumac/LIDAR_Lite_v3_Operation_Manual_and_Technical_Specifications.pdf
    https://github.com/PulsedLight3D/LIDAR-Lite-Documentation/blob/master/Docs/LIDAR-Lite-v2-Docs.pdf

properties:
  compatible:
    oneOf:
      - items:
          - enum:
              - grmn,lidar-lite-v3
          - const: pulsedlight,lidar-lite-v2
      - const: pulsedlight,lidar-lite-v2

  reg:
    maxItems: 1

  powerdown-gpios:
    description: GPIO that can be driven low to shut off power to the device.
    maxItems: 1

  vdd-supply: true

  interrupts:
    description:
      Mode control pin used as a status output, driven while the device is
      busy performing an acquisition. Can be used to signal completion
      instead of polling over I2C.
    maxItems: 1

required:
  - compatible
  - reg
  - vdd-supply

additionalProperties: false

examples:
  - |
    i2c {
        #address-cells = <1>;
        #size-cells = <0>;
        lidar@62 {
            compatible = "grmn,lidar-lite-v3", "pulsedlight,lidar-lite-v2";
            reg = <0x62>;
            vdd-supply = <&vdd_5v0>;
        };
    };
...
```

## Documentation/devicetree/bindings/iio/proximity/st,vl53l0x.yaml
```yaml
# SPDX-License-Identifier: (GPL-2.0 OR BSD-2-Clause)
%YAML 1.2
---
$id: http://devicetree.org/schemas/iio/proximity/st,vl53l0x.yaml#
$schema: http://devicetree.org/meta-schemas/core.yaml#

title: ST VL53L0X/VL53L1X ToF ranging sensor

maintainers:
  - Song Qiang <songqiang1304521@gmail.com>
  - Siratul Islam <siratul.islam@linux.dev>

properties:
  compatible:
    enum:
      - st,vl53l0x
      - st,vl53l1x

  reg:
    maxItems: 1

  interrupts:
    maxItems: 1

  reset-gpios:
    maxItems: 1
    description:
      Phandle to the XSHUT GPIO. Used for hardware reset.

  vdd-supply: true

required:
  - compatible
  - reg

allOf:
  - if:
      properties:
        compatible:
          contains:
            const: st,vl53l1x
    then:
      required:
        - vdd-supply

additionalProperties: false

examples:
  - |
    #include <dt-bindings/interrupt-controller/irq.h>
    i2c {
        #address-cells = <1>;
        #size-cells = <0>;

        proximity@29 {
            compatible = "st,vl53l1x";
            reg = <0x29>;
            vdd-supply = <&reg_3v3>;
            interrupt-parent = <&gpio>;
            interrupts = <23 IRQ_TYPE_EDGE_FALLING>;
        };
    };
...
```

## Documentation/devicetree/bindings/infiniband/hisilicon,hns-roce-v1.yaml
```yaml
# SPDX-License-Identifier: (GPL-2.0-only OR BSD-2-Clause)
%YAML 1.2
---
$id: http://devicetree.org/schemas/infiniband/hisilicon,hns-roce-v1.yaml#
$schema: http://devicetree.org/meta-schemas/core.yaml#

title: Hisilicon HNS RoCE

maintainers:
  - Chengchang Tang <tangchengchang@huawei.com>
  - Junxian Huang <huangjunxian6@hisilicon.com>

description:
  Hisilicon RoCE engine is a part of network subsystem. It works depending on
  other part of network subsystem, such as gmac and dsa fabric.

properties:
  compatible:
    const: hisilicon,hns-roce-v1

  reg:
    maxItems: 1

  '#address-cells':
    const: 2

  '#size-cells':
    const: 2

  dma-coherent: true

  interrupts:
    items:
      - description: Completion event IRQ
      - description: Completion event IRQ
      - description: Completion event IRQ
      - description: Completion event IRQ
      - description: Completion event IRQ
      - description: Completion event IRQ
      - description: Completion event IRQ
      - description: Completion event IRQ
      - description: Completion event IRQ
      - description: Completion event IRQ
      - description: Completion event IRQ
      - description: Completion event IRQ
      - description: Completion event IRQ
      - description: Completion event IRQ
      - description: Completion event IRQ
      - description: Completion event IRQ
      - description: Completion event IRQ
      - description: Completion event IRQ
      - description: Completion event IRQ
      - description: Completion event IRQ
      - description: Completion event IRQ
      - description: Completion event IRQ
      - description: Completion event IRQ
      - description: Completion event IRQ
      - description: Completion event IRQ
      - description: Completion event IRQ
      - description: Completion event IRQ
      - description: Completion event IRQ
      - description: Completion event IRQ
      - description: Completion event IRQ
      - description: Completion event IRQ
      - description: Completion event IRQ
      - description: Async event IRQ
      - description: Event overflow IRQ

  interrupt-names:
    items:
      - const: hns-roce-comp-0
      - const: hns-roce-comp-1
      - const: hns-roce-comp-2
      - const: hns-roce-comp-3
      - const: hns-roce-comp-4
      - const: hns-roce-comp-5
      - const: hns-roce-comp-6
      - const: hns-roce-comp-7
      - const: hns-roce-comp-8
      - const: hns-roce-comp-9
      - const: hns-roce-comp-10
      - const: hns-roce-comp-11
      - const: hns-roce-comp-12
      - const: hns-roce-comp-13
      - const: hns-roce-comp-14
      - const: hns-roce-comp-15
      - const: hns-roce-comp-16
      - const: hns-roce-comp-17
      - const: hns-roce-comp-18
      - const: hns-roce-comp-19
      - const: hns-roce-comp-20
      - const: hns-roce-comp-21
      - const: hns-roce-comp-22
      - const: hns-roce-comp-23
      - const: hns-roce-comp-24
      - const: hns-roce-comp-25
      - const: hns-roce-comp-26
      - const: hns-roce-comp-27
      - const: hns-roce-comp-28
      - const: hns-roce-comp-29
      - const: hns-roce-comp-30
      - const: hns-roce-comp-31
      - const: hns-roce-async
      - const: hns-roce-common

  eth-handle:
    description: References to one or more Ethernet devices.
    $ref: /schemas/types.yaml#/definitions/phandle-array
    items:
      maxItems: 1

  dsaf-handle:
    description: Reference to a dsaf device.
    $ref: /schemas/types.yaml#/definitions/phandle

  node-guid:
    description: A number that uniquely identifies a device or component.
    $ref: /schemas/types.yaml#/definitions/uint8-array

required:
  - compatible
  - reg
  - '#address-cells'
  - '#size-cells'
  - eth-handle
  - dsaf-handle
  - node-guid

additionalProperties: false

examples:
  - |
    soc {
        #address-cells = <2>;
        #size-cells = <2>;

        infiniband@c4000000 {
            compatible = "hisilicon,hns-roce-v1";
            reg = <0x0 0xc4000000 0x0 0x100000>;
            #address-cells = <2>;
            #size-cells = <2>;
            dma-coherent;
            eth-handle = <&eth2 &eth3 &eth4 &eth5 &eth6 &eth7>;
            dsaf-handle = <&soc0_dsa>;
            node-guid = [00 9A CD 00 00 01 02 03];
            interrupts = <722 1>, <723 1>, <724 1>, <725 1>,
                         <726 1>, <727 1>, <728 1>, <729 1>,
                         <730 1>, <731 1>, <732 1>, <733 1>,
                         <734 1>, <735 1>, <736 1>, <737 1>,
                         <738 1>, <739 1>, <740 1>, <741 1>,
                         <742 1>, <743 1>, <744 1>, <745 1>,
                         <746 1>, <747 1>, <748 1>, <749 1>,
                         <750 1>, <751 1>, <752 1>, <753 1>,
                         <785 1>, <754 4>;
            interrupt-names = "hns-roce-comp-0", "hns-roce-comp-1",
                              "hns-roce-comp-2", "hns-roce-comp-3",
                              "hns-roce-comp-4", "hns-roce-comp-5",
                              "hns-roce-comp-6", "hns-roce-comp-7",
                              "hns-roce-comp-8", "hns-roce-comp-9",
                              "hns-roce-comp-10", "hns-roce-comp-11",
                              "hns-roce-comp-12", "hns-roce-comp-13",
                              "hns-roce-comp-14", "hns-roce-comp-15",
                              "hns-roce-comp-16", "hns-roce-comp-17",
                              "hns-roce-comp-18", "hns-roce-comp-19",
                              "hns-roce-comp-20", "hns-roce-comp-21",
                              "hns-roce-comp-22", "hns-roce-comp-23",
                              "hns-roce-comp-24", "hns-roce-comp-25",
                              "hns-roce-comp-26", "hns-roce-comp-27",
                              "hns-roce-comp-28", "hns-roce-comp-29",
                              "hns-roce-comp-30", "hns-roce-comp-31",
                              "hns-roce-async", "hns-roce-common";
        };
    };
```

## Documentation/devicetree/bindings/input/adi,ad7147_captouch.yaml
```yaml
# SPDX-License-Identifier: (GPL-2.0-only OR BSD-2-Clause)
%YAML 1.2
---
$id: http://devicetree.org/schemas/input/adi,ad7147_captouch.yaml#
$schema: http://devicetree.org/meta-schemas/core.yaml#

title: Analog Devices AD7147 CapTouch Programmable Controller

maintainers:
  - Michael Hennerich <michael.hennerich@analog.com>

properties:
  compatible:
    const: adi,ad7147_captouch

  reg:
    maxItems: 1

  interrupts:
    maxItems: 1

  vcc-supply: true

required:
  - compatible
  - reg
  - interrupts

additionalProperties: false

examples:
  - |
    #include <dt-bindings/interrupt-controller/irq.h>

    i2c {
        #address-cells = <1>;
        #size-cells = <0>;

        touch@2c {
            compatible = "adi,ad7147_captouch";
            reg = <0x2c>;
            interrupt-parent = <&tlmm>;
            interrupts = <96 IRQ_TYPE_EDGE_FALLING>;
            vcc-supply = <&vreg_l18a_2p85>;
        };
    };

...
```

## Documentation/devicetree/bindings/input/motorola,cpcap-pwrbutton.yaml
```yaml
# SPDX-License-Identifier: (GPL-2.0 OR BSD-2-Clause)
%YAML 1.2
---
$id: http://devicetree.org/schemas/input/motorola,cpcap-pwrbutton.yaml#
$schema: http://devicetree.org/meta-schemas/core.yaml#

title: Motorola CPCAP PMIC power key

maintainers:
  - Svyatoslav Ryhel <clamor95@gmail.com>

description:
  This module is part of the Motorola CPCAP MFD device. For more details
  see Documentation/devicetree/bindings/mfd/motorola,cpcap.yaml. The
  power key is represented as a sub-node of the PMIC node on the device
  tree.

properties:
  compatible:
    const: motorola,cpcap-pwrbutton

  interrupts:
    items:
      - description: CPCAP's ON interrupt

required:
  - compatible
  - interrupts

additionalProperties: false

...
```
