## Documentation/devicetree/bindings/iio/adc/ti-adc12138.txt
```
* Texas Instruments' ADC12130/ADC12132/ADC12138

Required properties:
 - compatible: Should be one of
	* "ti,adc12130"
	* "ti,adc12132"
	* "ti,adc12138"
 - reg: SPI chip select number for the device
 - interrupts: Should contain interrupt for EOC (end of conversion)
 - clocks: phandle to conversion clock input
 - spi-max-frequency: Definision as per
	Documentation/devicetree/bindings/spi/spi-bus.txt
 - vref-p-supply: The regulator supply for positive analog voltage reference

Optional properties:
 - vref-n-supply: The regulator supply for negative analog voltage reference
	(Note that this must not go below GND or exceed vref-p)
	If not specified, this is assumed to be analog ground.
 - ti,acquisition-time: The number of conversion clock periods for the S/H's
	acquisition time.  Should be one of 6, 10, 18, 34.  If not specified,
	default value of 10 is used.
	For high source impedances, this value can be increased to 18 or 34.
	For less ADC accuracy and/or slower CCLK frequencies this value may be
	decreased to 6.  See section 6.0 INPUT SOURCE RESISTANCE in the
	datasheet for details.

Example:
adc@0 {
	compatible = "ti,adc12138";
	reg = <0>;
	interrupts = <28 IRQ_TYPE_EDGE_RISING>;
	interrupt-parent = <&gpio1>;
	clocks = <&cclk>;
	vref-p-supply = <&ldo4_reg>;
	spi-max-frequency = <5000000>;
	ti,acquisition-time = <6>;
};
```

## Documentation/devicetree/bindings/iio/adc/ti-adc128s052.txt
```
* Texas Instruments' ADC128S052, ADC122S021 and ADC124S021 ADC chip

Required properties:
 - compatible: Should be one of:
   - "ti,adc128s052"
   - "ti,adc122s021"
   - "ti,adc122s051"
   - "ti,adc122s101"
   - "ti,adc124s021"
   - "ti,adc124s051"
   - "ti,adc124s101"
 - reg: spi chip select number for the device
 - vref-supply: The regulator supply for ADC reference voltage

Recommended properties:
 - spi-max-frequency: Definition as per
		Documentation/devicetree/bindings/spi/spi-bus.txt

Example:
adc@0 {
	compatible = "ti,adc128s052";
	reg = <0>;
	vref-supply = <&vdd_supply>;
	spi-max-frequency = <1000000>;
};
```

## Documentation/devicetree/bindings/iio/adc/ti-adc161s626.txt
```
* Texas Instruments ADC141S626 and ADC161S626 chips

Required properties:
 - compatible: Should be "ti,adc141s626" or "ti,adc161s626"
 - reg: spi chip select number for the device

Recommended properties:
 - spi-max-frequency: Definition as per
		Documentation/devicetree/bindings/spi/spi-bus.txt

Example:
adc@0 {
	compatible = "ti,adc161s626";
	reg = <0>;
	spi-max-frequency = <4300000>;
};
```

## Documentation/devicetree/bindings/iio/adc/ti-ads124s08.txt
```
* Texas Instruments' ads124s08 and ads124s06 ADC chip

Required properties:
 - compatible :
	"ti,ads124s08"
	"ti,ads124s06"
 - reg : spi chip select number for the device

Recommended properties:
 - spi-max-frequency : Definition as per
		Documentation/devicetree/bindings/spi/spi-bus.txt
 - spi-cpha : Definition as per
		Documentation/devicetree/bindings/spi/spi-bus.txt

Optional properties:
 - reset-gpios : GPIO pin used to reset the device.

Example:
adc@0 {
	compatible = "ti,ads124s08";
	reg = <0>;
	spi-max-frequency = <1000000>;
	spi-cpha;
	reset-gpios = <&gpio1 16 GPIO_ACTIVE_LOW>;
};
```

## Documentation/devicetree/bindings/iio/adc/ti-ads7950.txt
```
* Texas Instruments ADS7950 family of A/DC chips

Required properties:
 - compatible: Must be one of "ti,ads7950", "ti,ads7951", "ti,ads7952",
   "ti,ads7953", "ti,ads7954", "ti,ads7955", "ti,ads7956", "ti,ads7957",
   "ti,ads7958", "ti,ads7959", "ti,ads7960", or "ti,ads7961"
 - reg: SPI chip select number for the device
 - #io-channel-cells: Must be 1 as per ../iio-bindings.txt
 - vref-supply: phandle to a regulator node that supplies the 2.5V or 5V
   reference voltage

Recommended properties:
 - spi-max-frequency: Definition as per
		Documentation/devicetree/bindings/spi/spi-bus.txt

Example:
adc@0 {
	compatible = "ti,ads7957";
	reg = <0>;
	#io-channel-cells = <1>;
	vref-supply = <&refin_supply>;
	spi-max-frequency = <10000000>;
};
```

## Documentation/devicetree/bindings/iio/adc/ti-ads8344.txt
```
* Texas Instruments ADS8344 A/DC chip

Required properties:
 - compatible: Must be "ti,ads8344"
 - reg: SPI chip select number for the device
 - vref-supply: phandle to a regulator node that supplies the
   reference voltage

Recommended properties:
 - spi-max-frequency: Definition as per
		Documentation/devicetree/bindings/spi/spi-bus.txt

Example:
adc@0 {
	compatible = "ti,ads8344";
	reg = <0>;
	vref-supply = <&refin_supply>;
	spi-max-frequency = <10000000>;
};
```

## Documentation/devicetree/bindings/iio/adc/ti-ads8688.txt
```
* Texas Instruments' ADS8684 and ADS8688 ADC chip

Required properties:
 - compatible: Should be "ti,ads8684" or "ti,ads8688"
 - reg: spi chip select number for the device

Recommended properties:
 - spi-max-frequency: Definition as per
		Documentation/devicetree/bindings/spi/spi-bus.txt

Optional properties:
 - vref-supply: The regulator supply for ADC reference voltage

Example:
adc@0 {
	compatible = "ti,ads8688";
	reg = <0>;
	vref-supply = <&vdd_supply>;
	spi-max-frequency = <1000000>;
};
```

## Documentation/devicetree/bindings/iio/adc/ti-tlc4541.txt
```
* Texas Instruments' TLC4541

Required properties:
 - compatible: Should be one of
	* "ti,tlc4541"
	* "ti,tlc3541"
	- reg: SPI chip select number for the device
 - vref-supply: The regulator supply for ADC reference voltage
 - spi-max-frequency: Max SPI frequency to use (<= 200000)

Example:
adc@0 {
	compatible = "ti,tlc4541";
	reg = <0>;
	vref-supply = <&vdd_supply>;
	spi-max-frequency = <200000>;
};
```

## Documentation/devicetree/bindings/iio/adc/twl4030-madc.txt
```
* TWL4030 Monitoring Analog to Digital Converter (MADC)

The MADC subsystem in the TWL4030 consists of a 10-bit ADC
combined with a 16-input analog multiplexer.

Required properties:
  - compatible: Should contain "ti,twl4030-madc".
  - interrupts: IRQ line for the MADC submodule.
  - #io-channel-cells: Should be set to <1>.

Optional properties:
  - ti,system-uses-second-madc-irq: boolean, set if the second madc irq register
				    should be used, which is intended to be used
				    by Co-Processors (e.g. a modem).

Example:

&twl {
	madc {
		compatible = "ti,twl4030-madc";
		interrupts = <3>;
		#io-channel-cells = <1>;
	};
};
```

## Documentation/devicetree/bindings/iio/adc/vf610-adc.txt
```
Freescale vf610 Analog to Digital Converter bindings

The devicetree bindings are for the new ADC driver written for
vf610/i.MX6slx and upward SoCs from Freescale.

Required properties:
- compatible: Should contain "fsl,vf610-adc"
- reg: Offset and length of the register set for the device
- interrupts: Should contain the interrupt for the device
- clocks: The clock is needed by the ADC controller, ADC clock source is ipg clock.
- clock-names: Must contain "adc", matching entry in the clocks property.
- vref-supply: The regulator supply ADC reference voltage.

Recommended properties:
- fsl,adck-max-frequency: Maximum frequencies according to datasheets operating
  requirements. Three values are required, depending on conversion mode:
  - Frequency in normal mode (ADLPC=0, ADHSC=0)
  - Frequency in high-speed mode (ADLPC=0, ADHSC=1)
  - Frequency in low-power mode (ADLPC=1, ADHSC=0)
- min-sample-time: Minimum sampling time in nanoseconds. This value has
  to be chosen according to the conversion mode and the connected analog
  source resistance (R_as) and capacitance (C_as). Refer the datasheet's
  operating requirements. A safe default across a wide range of R_as and
  C_as as well as conversion modes is 1000ns.

Example:
adc0: adc@4003b000 {
	compatible = "fsl,vf610-adc";
	reg = <0x4003b000 0x1000>;
	interrupts = <0 53 0x04>;
	clocks = <&clks VF610_CLK_ADC0>;
	clock-names = "adc";
	fsl,adck-max-frequency = <30000000>, <40000000>,
				<20000000>;
	vref-supply = <&reg_vcc_3v3_mcu>;
};
```

## Documentation/devicetree/bindings/iio/adc/x-powers,axp209-adc.yaml
```yaml
# SPDX-License-Identifier: (GPL-2.0 OR BSD-2-Clause)
%YAML 1.2
---
$id: http://devicetree.org/schemas/iio/adc/x-powers,axp209-adc.yaml#
$schema: http://devicetree.org/meta-schemas/core.yaml#

title: X-Powers AXP ADC bindings

maintainers:
  - Chen-Yu Tsai <wens@csie.org>

description: |
  ADC is frequently used as a provider to consumers of the ADC channels.
  Device is a child of an axp209 multifunction device
  ADC channels and their indexes per variant:

  AXP209
  ------
   0 | acin_v
   1 | acin_i
   2 | vbus_v
   3 | vbus_i
   4 | pmic_temp
   5 | gpio0_v
   6 | gpio1_v
   7 | ipsout_v
   8 | batt_v
   9 | batt_chrg_i
  10 | batt_dischrg_i

  AXP22x
  ------
   0 | pmic_temp
   1 | batt_v
   2 | batt_chrg_i
   3 | batt_dischrg_i

  AXP813
  ------
   0 | pmic_temp
   1 | gpio0_v
   2 | batt_v
   3 | batt_chrg_i
   4 | batt_dischrg_i


properties:
  compatible:
    oneOf:
      - const: x-powers,axp209-adc
      - const: x-powers,axp221-adc
      - const: x-powers,axp813-adc

      - items:
          - const: x-powers,axp803-adc
          - const: x-powers,axp813-adc

  "#io-channel-cells":
    const: 1

additionalProperties: false

examples:
  - |
    axp221 {
        adc {
            compatible = "x-powers,axp221-adc";
            #io-channel-cells = <1>;
        };
    };
...
```

## Documentation/devicetree/bindings/iio/adc/xilinx-xadc.txt
```
Xilinx XADC device driver

This binding document describes the bindings for the Xilinx 7 Series XADC as well
as the UltraScale/UltraScale+ System Monitor.

The Xilinx XADC is an ADC that can be found in the Series 7 FPGAs from Xilinx.
The XADC has a DRP interface for communication. Currently two different
frontends for the DRP interface exist. One that is only available on the ZYNQ
family as a hardmacro in the SoC portion of the ZYNQ. The other one is available
on all series 7 platforms and is a softmacro with a AXI interface. This binding
document describes the bindings for both of them since the bindings are very
similar.

The Xilinx System Monitor is an ADC that is found in the UltraScale and
UltraScale+ FPGAs from Xilinx. The System Monitor provides a DRP interface for
communication. Xilinx provides a standard IP core that can be used to access the
System Monitor through an AXI interface in the FPGA fabric. This IP core is
called the Xilinx System Management Wizard. This document describes the bindings
for this IP.

Required properties:
	- compatible: Should be one of
		* "xlnx,zynq-xadc-1.00.a": When using the ZYNQ device
		  configuration interface to interface to the XADC hardmacro.
		* "xlnx,axi-xadc-1.00.a": When using the axi-xadc pcore to
		  interface to the XADC hardmacro.
		* "xlnx,system-management-wiz-1.3": When using the
		  Xilinx System Management Wizard fabric IP core to access the
		  UltraScale and UltraScale+ System Monitor.
	- reg: Address and length of the register set for the device
	- interrupts: Interrupt for the XADC control interface.
	- clocks: When using the ZYNQ this must be the ZYNQ PCAP clock,
	  when using the axi-xadc or the axi-system-management-wizard this must be
	  the clock that provides the clock to the AXI bus interface of the core.

Optional properties:
	- xlnx,external-mux:
		* "none": No external multiplexer is used, this is the default
		  if the property is omitted.
		* "single": External multiplexer mode is used with one
		   multiplexer.
		* "dual": External multiplexer mode is used with two
		  multiplexers for simultaneous sampling.
	- xlnx,external-mux-channel: Configures which pair of pins is used to
	  sample data in external mux mode.
	  Valid values for single external multiplexer mode are:
		0: VP/VN
		1: VAUXP[0]/VAUXN[0]
		2: VAUXP[1]/VAUXN[1]
		...
		16: VAUXP[15]/VAUXN[15]
	  Valid values for dual external multiplexer mode are:
		1: VAUXP[0]/VAUXN[0] - VAUXP[8]/VAUXN[8]
		2: VAUXP[1]/VAUXN[1] - VAUXP[9]/VAUXN[9]
		...
		8: VAUXP[7]/VAUXN[7] - VAUXP[15]/VAUXN[15]

	  This property needs to be present if the device is configured for
	  external multiplexer mode (either single or dual). If the device is
	  not using external multiplexer mode the property is ignored.
	- xnlx,channels: List of external channels that are connected to the ADC
	  Required properties:
		* #address-cells: Should be 1.
		* #size-cells: Should be 0.

	  The child nodes of this node represent the external channels which are
	  connected to the ADC. If the property is no present no external
	  channels will be assumed to be connected.

	  Each child node represents one channel and has the following
	  properties:
		Required properties:
			* reg: Pair of pins the channel is connected to.
				0: VP/VN
				1: VAUXP[0]/VAUXN[0]
				2: VAUXP[1]/VAUXN[1]
				...
				16: VAUXP[15]/VAUXN[15]
			  Note each channel number should only be used at most
			  once.
		Optional properties:
			* xlnx,bipolar: If set the channel is used in bipolar
			  mode.


Examples:
	xadc@f8007100 {
		compatible = "xlnx,zynq-xadc-1.00.a";
		reg = <0xf8007100 0x20>;
		interrupts = <0 7 4>;
		interrupt-parent = <&gic>;
		clocks = <&pcap_clk>;

		xlnx,channels {
			#address-cells = <1>;
			#size-cells = <0>;
			channel@0 {
				reg = <0>;
			};
			channel@1 {
				reg = <1>;
			};
			channel@8 {
				reg = <8>;
			};
		};
	};

	xadc@43200000 {
		compatible = "xlnx,axi-xadc-1.00.a";
		reg = <0x43200000 0x1000>;
		interrupts = <0 53 4>;
		interrupt-parent = <&gic>;
		clocks = <&fpga1_clk>;

		xlnx,channels {
			#address-cells = <1>;
			#size-cells = <0>;
			channel@0 {
				reg = <0>;
				xlnx,bipolar;
			};
		};
	};

	adc@80000000 {
		compatible = "xlnx,system-management-wiz-1.3";
		reg = <0x80000000 0x1000>;
		interrupts = <0 81 4>;
		interrupt-parent = <&gic>;
		clocks = <&fpga1_clk>;

		xlnx,channels {
			#address-cells = <1>;
			#size-cells = <0>;
			channel@0 {
				reg = <0>;
				xlnx,bipolar;
			};
		};
	};
```
