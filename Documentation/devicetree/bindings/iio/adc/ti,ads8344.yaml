## Documentation/devicetree/bindings/iio/adc/ti,ads8344.yaml
```yaml
# SPDX-License-Identifier: (GPL-2.0 OR BSD-2-Clause)
%YAML 1.2
---
$id: http://devicetree.org/schemas/iio/adc/ti,ads8344.yaml#
$schema: http://devicetree.org/meta-schemas/core.yaml#

title: Texas Instruments ADS8344 ADC

maintainers:
  - Gregory Clement <gregory.clement@bootlin.com>

description: |
  16bit 8-channel ADC with single ended inputs.

properties:
  compatible:
    const: ti,ads8344

  reg:
    maxItems: 1

  spi-max-frequency: true

  vref-supply:
    description: Supply the 2.5V or 5V reference voltage

  "#io-channel-cells":
    const: 1

required:
  - compatible
  - reg
  - vref-supply

additionalProperties: false

examples:
  - |
    spi {
        #address-cells = <1>;
        #size-cells = <0>;

        adc@0 {
            compatible = "ti,ads8344";
            reg = <0>;
            vref-supply = <&refin_supply>;
            spi-max-frequency = <10000000>;
            #io-channel-cells = <1>;
        };
    };
...
```

## Documentation/devicetree/bindings/iio/adc/ti,ads8688.yaml
```yaml
# SPDX-License-Identifier: (GPL-2.0 OR BSD-2-Clause)
%YAML 1.2
---
$id: http://devicetree.org/schemas/iio/adc/ti,ads8688.yaml#
$schema: http://devicetree.org/meta-schemas/core.yaml#

title: Texas Instruments' ADS8684 and ADS8688 ADC chip

maintainers:
  - Sean Nyekjaer <sean@geanix.com>

description: |
   SPI 16bit ADCs with 4/8 channels.

properties:
  compatible:
    enum:
      - ti,ads8684
      - ti,ads8688

  reg:
    maxItems: 1

  vref-supply:
    description: Optional external reference.  If not supplied, assume
      REFSEL input tied low to enable the internal reference.

  spi-max-frequency: true

required:
  - compatible
  - reg

additionalProperties: false

examples:
  - |
    spi {
        #address-cells = <1>;
        #size-cells = <0>;

        adc@0 {
            compatible = "ti,ads8688";
            reg = <0>;
            vref-supply = <&vdd_supply>;
            spi-max-frequency = <1000000>;
        };
    };
...
```

## Documentation/devicetree/bindings/iio/adc/ti,am3359-adc.yaml
```yaml
# SPDX-License-Identifier: (GPL-2.0-only OR BSD-2-Clause)
%YAML 1.2
---
$id: http://devicetree.org/schemas/iio/adc/ti,am3359-adc.yaml#
$schema: http://devicetree.org/meta-schemas/core.yaml#

title: TI AM3359 ADC

maintainers:
  - Miquel Raynal <miquel.raynal@bootlin.com>

properties:
  compatible:
    oneOf:
      - enum:
          - ti,am3359-adc
          - ti,am4372-adc
      - items:
          - enum:
              - ti,am654-adc
          - const: ti,am3359-adc

  '#io-channel-cells':
    const: 1

  ti,adc-channels:
    description: List of analog inputs available for ADC. AIN0 = 0, AIN1 = 1 and
      so on until AIN7 = 7.
    $ref: /schemas/types.yaml#/definitions/uint32-array
    minItems: 1
    maxItems: 8

  ti,chan-step-opendelay:
    description: List of open delays for each channel of ADC in the order of
      ti,adc-channels. The value corresponds to the number of ADC clock cycles
      to wait after applying the step configuration registers and before sending
      the start of ADC conversion. Maximum value is 0x3FFFF.
    $ref: /schemas/types.yaml#/definitions/uint32-array
    minItems: 1
    maxItems: 8

  ti,chan-step-sampledelay:
    description: List of sample delays for each channel of ADC in the order of
      ti,adc-channels. The value corresponds to the number of ADC clock cycles
      to sample (to hold start of conversion high). Maximum value is 0xFF.
    $ref: /schemas/types.yaml#/definitions/uint32-array
    minItems: 1
    maxItems: 8

  ti,chan-step-avg:
    description: Number of averages to be performed for each channel of ADC. If
      average is 16 (this is also the maximum) then input is sampled 16 times
      and averaged to get more accurate value. This increases the time taken by
      ADC to generate a sample. Maximum value is 16.
    $ref: /schemas/types.yaml#/definitions/uint32-array
    minItems: 1
    maxItems: 8

required:
  - compatible
  - '#io-channel-cells'
  - ti,adc-channels

additionalProperties: false

examples:
  - |
    adc {
        compatible = "ti,am3359-adc";
        #io-channel-cells = <1>;
        ti,adc-channels = <4 5 6 7>;
        ti,chan-step-opendelay = <0x098 0x3ffff 0x098 0x0>;
        ti,chan-step-sampledelay = <0xff 0x0 0xf 0x0>;
        ti,chan-step-avg = <16 2 4 8>;
    };
```

## Documentation/devicetree/bindings/iio/adc/ti,lmp92064.yaml
```yaml
# SPDX-License-Identifier: (GPL-2.0 OR BSD-2-Clause)
%YAML 1.2
---
$id: http://devicetree.org/schemas/iio/adc/ti,lmp92064.yaml#
$schema: http://devicetree.org/meta-schemas/core.yaml#

title: Texas Instruments LMP92064 Precision Current and Voltage Sensor.

maintainers:
  - Leonard Göhrs <l.goehrs@pengutronix.de>

description: |
  The LMP92064 is a two channel ADC intended for combined voltage and current
  measurements.

  The device contains two ADCs to allow simultaneous sampling of voltage and
  current and thus of instantaneous power consumption.

properties:
  compatible:
    enum:
      - ti,lmp92064

  reg:
    maxItems: 1

  vdd-supply:
    description: Regulator that provides power to the main part of the chip

  vdig-supply:
    description: |
      Regulator that provides power to the digital I/O part of the chip

  shunt-resistor-micro-ohms:
    description: |
      Value of the shunt resistor (in µΩ) connected between INCP and INCN,
      across which current is measured. Used to provide correct scaling of the
      raw ADC measurement.

  reset-gpios:
    maxItems: 1

required:
  - compatible
  - reg
  - shunt-resistor-micro-ohms

allOf:
  - $ref: /schemas/spi/spi-peripheral-props.yaml#

unevaluatedProperties: false

examples:
  - |
    #include <dt-bindings/gpio/gpio.h>
    spi {
        #address-cells = <1>;
        #size-cells = <0>;

        adc@0 {
            compatible = "ti,lmp92064";
            reg = <0>;
            vdd-supply = <&vdd>;
            vdig-supply = <&vdd>;
            spi-max-frequency = <20000000>;
            shunt-resistor-micro-ohms = <15000>;
            reset-gpios = <&gpio1 16 GPIO_ACTIVE_HIGH>;
        };
    };
...
```

## Documentation/devicetree/bindings/iio/adc/ti,palmas-gpadc.yaml
```yaml
# SPDX-License-Identifier: (GPL-2.0 OR BSD-2-Clause)
%YAML 1.2
---
$id: http://devicetree.org/schemas/iio/adc/ti,palmas-gpadc.yaml#
$schema: http://devicetree.org/meta-schemas/core.yaml#

title: Palmas general purpose ADC IP block

maintainers:
  - Tony Lindgren <tony@atomide.com>

description: |
  This ADC is often used to provide channels via the io-channels
  consumer framework.
  Channels list:
    0 battery type
    1 battery temp NTC (optional current source)
    2 GP
    3 temp (with ext. diode, optional current source)
    4 GP
    5 GP
    6 VBAT_SENSE
    7 VCC_SENSE
    8 Backup Battery voltage
    9 external charger (VCHG)
    10 VBUS
    11 DC-DC current probe (how does this work?)
    12 internal die temp
    13 internal die temp
    14 USB ID pin voltage
    15 test network

properties:
  compatible:
    const: ti,palmas-gpadc

  interrupts:
    minItems: 1
    maxItems: 3

  "#io-channel-cells":
    const: 1

  ti,channel0-current-microamp:
    description: Channel 0 current in uA.
    enum:
      - 0
      - 5
      - 15
      - 20

  ti,channel3-current-microamp:
    description: Channel 3 current in uA.
    enum:
      - 0
      - 10
      - 400
      - 800

  ti,enable-extended-delay:
    $ref: /schemas/types.yaml#/definitions/flag
    description: Enable extended delay.

additionalProperties: false

required:
  - compatible
  - "#io-channel-cells"

...
```

## Documentation/devicetree/bindings/iio/adc/ti,tlc4541.yaml
```yaml
# SPDX-License-Identifier: (GPL-2.0 OR BSD-2-Clause)
%YAML 1.2
---
$id: http://devicetree.org/schemas/iio/adc/ti,tlc4541.yaml#
$schema: http://devicetree.org/meta-schemas/core.yaml#

title: Texas Instruments TLC4541 and similar ADCs

maintainers:
  - Phil Reid <preid@electromag.com.au>

description: |
  14/16bit single channel ADC with SPI interface.

properties:
  compatible:
    enum:
      - ti,tlc3541
      - ti,tlc4541

  reg:
    maxItems: 1

  spi-max-frequency: true

  vref-supply: true

  "#io-channel-cells":
    const: 1

required:
  - compatible
  - reg
  - vref-supply

additionalProperties: false

examples:
  - |
    spi {
        #address-cells = <1>;
        #size-cells = <0>;

        adc@0 {
            compatible = "ti,tlc4541";
            reg = <0>;
            vref-supply = <&vdd_supply>;
            spi-max-frequency = <200000>;
            #io-channel-cells = <1>;
        };
    };
...
```

## Documentation/devicetree/bindings/iio/adc/ti,tsc2046.yaml
```yaml
# SPDX-License-Identifier: (GPL-2.0 OR BSD-2-Clause)
%YAML 1.2
---
$id: http://devicetree.org/schemas/iio/adc/ti,tsc2046.yaml#
$schema: http://devicetree.org/meta-schemas/core.yaml#

title: Texas Instruments TSC2046 touch screen controller.

maintainers:
  - Oleksij Rempel <o.rempel@pengutronix.de>

description: |
  TSC2046 is a touch screen controller with 8 channels ADC.

properties:
  compatible:
    enum:
      - ti,tsc2046e-adc

  reg:
    maxItems: 1

  interrupts:
    maxItems: 1

  vref-supply:
    description: Optional supply of the reference voltage

  "#io-channel-cells":
    const: 1

  '#address-cells':
    const: 1

  '#size-cells':
    const: 0

required:
  - compatible
  - reg

patternProperties:
  "^channel@[0-7]$":
    $ref: adc.yaml
    type: object

    properties:
      reg:
        description: |
          The channel number. It can have up to 8 channels
        items:
          minimum: 0
          maximum: 7

      settling-time-us: true
      oversampling-ratio: true

    required:
      - reg

    additionalProperties: false

allOf:
  - $ref: /schemas/spi/spi-peripheral-props.yaml#

unevaluatedProperties: false

examples:
  - |
    #include <dt-bindings/interrupt-controller/irq.h>
    spi {
        #address-cells = <1>;
        #size-cells = <0>;

        adc@0 {
            compatible = "ti,tsc2046e-adc";
            reg = <0>;
            spi-max-frequency = <1000000>;
            interrupts-extended = <&gpio3 20 IRQ_TYPE_LEVEL_LOW>;
            #io-channel-cells = <1>;

            #address-cells = <1>;
            #size-cells = <0>;

            channel@0 {
                reg = <0>;
            };
            channel@1 {
                reg = <1>;
                settling-time-us = <700>;
                oversampling-ratio = <5>;
            };
            channel@2 {
                reg = <2>;
            };
            channel@3 {
                reg = <3>;
                settling-time-us = <700>;
                oversampling-ratio = <5>;
            };
            channel@4 {
                reg = <4>;
                settling-time-us = <700>;
                oversampling-ratio = <5>;
            };
            channel@5 {
                reg = <5>;
                settling-time-us = <700>;
                oversampling-ratio = <5>;
            };
            channel@6 {
                reg = <6>;
            };
            channel@7 {
                reg = <7>;
            };
        };
    };
...
```

## Documentation/devicetree/bindings/iio/adc/ti,twl4030-madc.yaml
```yaml
# SPDX-License-Identifier: (GPL-2.0 OR BSD-2-Clause)
%YAML 1.2
---
$id: http://devicetree.org/schemas/iio/adc/ti,twl4030-madc.yaml#
$schema: http://devicetree.org/meta-schemas/core.yaml#

title: MADC subsystem in the TWL4030 power module

maintainers:
  - Sebastian Reichel <sre@kernel.org>

description:
  The MADC subsystem in the TWL4030 consists of a 10-bit ADC
  combined with a 16-input analog multiplexer.

properties:
  compatible:
    const: ti,twl4030-madc

  interrupts:
    maxItems: 1

  ti,system-uses-second-madc-irq:
    type: boolean
    description:
      Set if the second madc irq register should be used, which is intended
      to be used  by Co-Processors (e.g. a modem).

  "#io-channel-cells":
    const: 1

required:
  - compatible
  - interrupts
  - "#io-channel-cells"

additionalProperties: false

examples:
  - |
    twl {
        madc {
            compatible = "ti,twl4030-madc";
            interrupts = <3>;
            #io-channel-cells = <1>;
        };
    };
...
```

## Documentation/devicetree/bindings/iio/adc/ti,twl6030-gpadc.yaml
```yaml
# SPDX-License-Identifier: (GPL-2.0 OR BSD-2-Clause)
%YAML 1.2
---
$id: http://devicetree.org/schemas/iio/adc/ti,twl6030-gpadc.yaml#
$schema: http://devicetree.org/meta-schemas/core.yaml#

title: GPADC subsystem in the TWL6030 power module

maintainers:
  - Andreas Kemnade <andreas@kemnade.info>

description:
  The GPADC subsystem in the TWL603X consists of a 10-bit ADC
  combined with a 15-input analog multiplexer in the TWL6030 resp. a
  19-input analog muliplexer in the TWL6032.

properties:
  compatible:
    enum:
      - ti,twl6030-gpadc
      - ti,twl6032-gpadc

  interrupts:
    maxItems: 1

  "#io-channel-cells":
    const: 1

required:
  - compatible
  - interrupts
  - "#io-channel-cells"

additionalProperties: false

examples:
  - |
    gpadc {
        compatible = "ti,twl6030-gpadc";
        interrupts = <3>;
        #io-channel-cells = <1>;
    };
...
```

## Documentation/devicetree/bindings/iio/adc/ti-adc0832.txt
```
* Texas Instruments' ADC0831/ADC0832/ADC0832/ADC0838

Required properties:
 - compatible: Should be one of
	* "ti,adc0831"
	* "ti,adc0832"
	* "ti,adc0834"
	* "ti,adc0838"
 - reg: spi chip select number for the device
 - vref-supply: The regulator supply for ADC reference voltage
 - spi-max-frequency: Max SPI frequency to use (< 400000)

Example:
adc@0 {
	compatible = "ti,adc0832";
	reg = <0>;
	vref-supply = <&vdd_supply>;
	spi-max-frequency = <200000>;
};
```

## Documentation/devicetree/bindings/iio/adc/ti-adc084s021.txt
```
* Texas Instruments' ADC084S021

Required properties:
 - compatible        : Must be "ti,adc084s021"
 - reg               : SPI chip select number for the device
 - vref-supply       : The regulator supply for ADC reference voltage
 - spi-cpol          : Per spi-bus bindings
 - spi-cpha          : Per spi-bus bindings
 - spi-max-frequency : Per spi-bus bindings

Example:
adc@0 {
	compatible = "ti,adc084s021";
	reg = <0>;
	vref-supply = <&adc_vref>;
	spi-cpol;
	spi-cpha;
	spi-max-frequency = <16000000>;
};
```

## Documentation/devicetree/bindings/iio/adc/ti-adc108s102.txt
```
* Texas Instruments' ADC108S102 and ADC128S102 ADC chip

Required properties:
 - compatible: Should be "ti,adc108s102"
 - reg: spi chip select number for the device
 - vref-supply: The regulator supply for ADC reference voltage

Recommended properties:
 - spi-max-frequency: Definition as per
		Documentation/devicetree/bindings/spi/spi-bus.txt

Example:
adc@0 {
	compatible = "ti,adc108s102";
	reg = <0>;
	vref-supply = <&vdd_supply>;
	spi-max-frequency = <1000000>;
};
```
