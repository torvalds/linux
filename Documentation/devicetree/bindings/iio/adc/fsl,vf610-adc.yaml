## Documentation/devicetree/bindings/iio/adc/fsl,vf610-adc.yaml
```yaml
# SPDX-License-Identifier: (GPL-2.0 OR BSD-2-Clause)
%YAML 1.2
---
$id: http://devicetree.org/schemas/iio/adc/fsl,vf610-adc.yaml#
$schema: http://devicetree.org/meta-schemas/core.yaml#

title: ADC found on Freescale vf610 and similar SoCs

maintainers:
  - Fugang Duan <fugang.duan@nxp.com>

description:
  ADCs found on vf610/i.MX6slx and upward SoCs from Freescale.

properties:
  compatible:
    const: fsl,vf610-adc

  reg:
    maxItems: 1

  interrupts:
    maxItems: 1

  clocks:
    description: ADC source clock (ipg clock)
    maxItems: 1

  clock-names:
    const: adc

  vref-supply:
    description: ADC reference voltage supply.

  fsl,adck-max-frequency:
    $ref: /schemas/types.yaml#/definitions/uint32-array
    minItems: 3
    maxItems: 3
    description: |
      Maximum frequencies from datasheet operating requirements.
      Three values necessary to cover the 3 conversion modes.
      * Frequency in normal mode (ADLPC=0, ADHSC=0)
      * Frequency in high-speed mode (ADLPC=0, ADHSC=1)
      * Frequency in low-power mode (ADLPC=1, ADHSC=0)

  min-sample-time:
    $ref: /schemas/types.yaml#/definitions/uint32
    description:
      Minimum sampling time in nanoseconds. This value has
      to be chosen according to the conversion mode and the connected analog
      source resistance (R_as) and capacitance (C_as). Refer the datasheet's
      operating requirements. A safe default across a wide range of R_as and
      C_as as well as conversion modes is 1000ns.

  "#io-channel-cells":
    const: 1

required:
  - compatible
  - reg
  - interrupts
  - clocks
  - clock-names
  - vref-supply

additionalProperties: false

examples:
  - |
    #include <dt-bindings/clock/vf610-clock.h>
    adc@4003b000 {
        compatible = "fsl,vf610-adc";
        reg = <0x4003b000 0x1000>;
        interrupts = <0 53 0x04>;
        clocks = <&clks VF610_CLK_ADC0>;
        clock-names = "adc";
        fsl,adck-max-frequency = <30000000>, <40000000>, <20000000>;
        vref-supply = <&reg_vcc_3v3_mcu>;
        min-sample-time = <10000>;
    };
...
```

## Documentation/devicetree/bindings/iio/adc/gehc,pmc-adc.yaml
```yaml
# SPDX-License-Identifier: (GPL-2.0 OR BSD-2-Clause)
%YAML 1.2
---
$id: http://devicetree.org/schemas/iio/adc/gehc,pmc-adc.yaml#
$schema: http://devicetree.org/meta-schemas/core.yaml#

title: GE HealthCare PMC Analog to Digital Converter (ADC)

maintainers:
  - Herve Codina <herve.codina@bootlin.com>

description:
  The GE HealthCare PMC ADC is a 16-Channel (voltage and current), 16-Bit ADC
  with an I2C Interface.

properties:
  compatible:
    const: gehc,pmc-adc

  reg:
    maxItems: 1

  vdd-supply:
    description:
      Regulator for the VDD power supply.

  vdda-supply:
    description:
      Regulator for the VDD analog (VDDA) power supply.

  vddio-supply:
    description:
      Regulator for the VDD IO (VDDIO) power supply.

  vref-supply:
    description:
      Regulator for the voltage reference power supply.

  clocks:
    maxItems: 1
    description:
      The component uses an external oscillator (osc) if an external oscillator
      is connected to its clock pins. Otherwise, it uses an internal reference
      clock.

  clock-names:
    items:
      - const: osc

  "#io-channel-cells":
    const: 2
    description: |
      The first cell is the channel type (dt-bindings/iio/adc/gehc,pmc-adc.h
      defines these values):
       - 0: voltage
       - 1: current
      The second cell is the channel number from 0 to 15.

required:
  - compatible
  - reg
  - vdd-supply
  - vdda-supply
  - vddio-supply
  - vref-supply
  - '#io-channel-cells'

additionalProperties: false

examples:
  - |
    i2c {
        #address-cells = <1>;
        #size-cells = <0>;

        adc@14 {
            compatible = "gehc,pmc-adc";
            reg = <0x14>;
            vdd-supply = <&reg_vdd>;
            vdda-supply = <&reg_vdda>;
            vddio-supply = <&reg_vddio>;
            vref-supply = <&reg_vref>;
            #io-channel-cells = <2>;
        };
    };
...
```

## Documentation/devicetree/bindings/iio/adc/gpio-muxadc.txt
```
GPIO-controlled Multiplexers (MUX) A/D Converter bindings

Required properties:
- compatible: should be "gpio-muxadc" or others like below
   - "sgm3699": for a quad, bidirectional, single-pole/double-throw (SPDT) CMOS analog switch.
   - "sgm48752": for a dual, bidirectional, double-pole/double-throw (DPDT) CMOS analog switch.
- io-channels: Channel node of the parent channel that has multiplexed input.
- switch-gpios: Digital control pins to connect the parent adc channel(saradc) to the input adc channel(muxadc).
- labels: The string list for each muxadc channel that should be placed in order.

Example:
        muxadc {
                compatible = "sgm48752";
                io-channels = <&saradc 4>, <&saradc 5>;
                switch-gpios = <&gpio1 RK_PA0 GPIO_ACTIVE_HIGH>,
                               <&gpio1 RK_PA1 GPIO_ACTIVE_HIGH>;
                labels = "wheel_vpropi_r_adc", "wheel_vpropi_l_adc",
                         "fan_opa_adc", "mid_opa_adc",
                         "pump_opa_adc", "side_opa_adc",
                         "dc24vdet_adc", "collision_det_adc_lidar";
                pinctrl-names = "default";
                pinctrl-0 = <&switch_gpios>;
                status = "okay";
        };
```

## Documentation/devicetree/bindings/iio/adc/hi8435.txt
```
Holt Integrated Circuits HI-8435 threshold detector bindings

Required properties:
 - compatible: should be "holt,hi8435"
 - reg: spi chip select number for the device

Recommended properties:
 - spi-max-frequency: definition as per
		Documentation/devicetree/bindings/spi/spi-bus.txt

Optional properties:
 - gpios: GPIO used for controlling the reset pin

Example:
sensor@0 {
	compatible = "holt,hi8435";
	reg = <0>;
	gpios = <&gpio6 1 0>;

	spi-max-frequency = <1000000>;
};
```

## Documentation/devicetree/bindings/iio/adc/holt,hi8435.yaml
```yaml
# SPDX-License-Identifier: (GPL-2.0-only OR BSD-2-Clause)
%YAML 1.2
---
$id: http://devicetree.org/schemas/iio/adc/holt,hi8435.yaml#
$schema: http://devicetree.org/meta-schemas/core.yaml#

title: Holt Integrated Circuits HI-8435 SPI threshold detector

maintainers:
  - Vladimir Barinov <vladimir.barinov@cogentembedded.com>

description: |
  Datasheet: http://www.holtic.com/documents/427-hi-8435_v-rev-lpdf.do

properties:
  compatible:
    const: holt,hi8435

  reg:
    maxItems: 1

  gpios:
    description:
      GPIO used for controlling the reset pin
    maxItems: 1

  "#io-channel-cells":
    const: 1

required:
  - compatible
  - reg

allOf:
  - $ref: /schemas/spi/spi-peripheral-props.yaml#

unevaluatedProperties: false

examples:
  - |
    spi {
        #address-cells = <1>;
        #size-cells = <0>;
        threshold-detector@0 {
            compatible = "holt,hi8435";
            reg = <0>;
            gpios = <&gpio6 1 0>;
            spi-max-frequency = <1000000>;
        };
    };
...
```

## Documentation/devicetree/bindings/iio/adc/imx7d-adc.txt
```
Freescale imx7d ADC bindings

The devicetree bindings are for the ADC driver written for
imx7d SoC.

Required properties:
- compatible: Should be "fsl,imx7d-adc"
- reg: Offset and length of the register set for the ADC device
- interrupts: The interrupt number for the ADC device
- clocks: The root clock of the ADC controller
- clock-names: Must contain "adc", matching entry in the clocks property
- vref-supply: The regulator supply ADC reference voltage

Example:
adc1: adc@30610000 {
	compatible = "fsl,imx7d-adc";
	reg = <0x30610000 0x10000>;
	interrupts = <GIC_SPI 98 IRQ_TYPE_LEVEL_HIGH>;
	clocks = <&clks IMX7D_ADC_ROOT_CLK>;
	clock-names = "adc";
	vref-supply = <&reg_vcc_3v3_mcu>;
};
```

## Documentation/devicetree/bindings/iio/adc/ingenic,adc.txt
```
* Ingenic JZ47xx ADC controller IIO bindings

Required properties:

- compatible: Should be one of:
  * ingenic,jz4725b-adc
  * ingenic,jz4740-adc
  * ingenic,jz4770-adc
- reg: ADC controller registers location and length.
- clocks: phandle to the SoC's ADC clock.
- clock-names: Must be set to "adc".
- #io-channel-cells: Must be set to <1> to indicate channels are selected
  by index.

ADC clients must use the format described in iio-bindings.txt, giving
a phandle and IIO specifier pair ("io-channels") to the ADC controller.

Example:

#include <dt-bindings/iio/adc/ingenic,adc.h>

adc: adc@10070000 {
	compatible = "ingenic,jz4740-adc";
	#io-channel-cells = <1>;

	reg = <0x10070000 0x30>;

	clocks = <&cgu JZ4740_CLK_ADC>;
	clock-names = "adc";

	interrupt-parent = <&intc>;
	interrupts = <18>;
};

adc-keys {
	...
	compatible = "adc-keys";
	io-channels = <&adc INGENIC_ADC_AUX>;
	io-channel-names = "buttons";
	...
};

battery {
	...
	compatible = "ingenic,jz4740-battery";
	io-channels = <&adc INGENIC_ADC_BATTERY>;
	io-channel-names = "battery";
	...
};
```

## Documentation/devicetree/bindings/iio/adc/ingenic,adc.yaml
```yaml
# SPDX-License-Identifier: (GPL-2.0 OR BSD-2-Clause)
# Copyright 2019-2020 Artur Rojek
%YAML 1.2
---
$id: "http://devicetree.org/schemas/iio/adc/ingenic,adc.yaml#"
$schema: "http://devicetree.org/meta-schemas/core.yaml#"

title: Ingenic JZ47xx ADC controller IIO

maintainers:
  - Artur Rojek <contact@artur-rojek.eu>

description: >
  Industrial I/O subsystem bindings for ADC controller found in
  Ingenic JZ47xx SoCs.

  ADC clients must use the format described in
  https://github.com/devicetree-org/dt-schema/blob/master/schemas/iio/iio-consumer.yaml,
  giving a phandle and IIO specifier pair ("io-channels") to the ADC controller.

properties:
  compatible:
    enum:
      - ingenic,jz4725b-adc
      - ingenic,jz4740-adc
      - ingenic,jz4760-adc
      - ingenic,jz4760b-adc
      - ingenic,jz4770-adc

  '#io-channel-cells':
    const: 1
    description:
      Must be set to <1> to indicate channels are selected by index.

  reg:
    maxItems: 1

  clocks:
    maxItems: 1

  clock-names:
    items:
      - const: adc

  interrupts:
    maxItems: 1

  ingenic,use-internal-divider:
    description:
      If present, battery voltage is read from the VBAT_IR pin, which has an
      internal 1/4 divider. If absent, it is read through the VBAT_ER pin,
      which does not have such a divider.
    type: boolean

if:
  not:
    properties:
      compatible:
        contains:
          const: ingenic,jz4760b-adc
then:
  properties:
    ingenic,use-internal-divider: false

required:
  - compatible
  - '#io-channel-cells'
  - reg
  - clocks
  - clock-names
  - interrupts

additionalProperties: false

examples:
  - |
    #include <dt-bindings/clock/ingenic,jz4740-cgu.h>
    #include <dt-bindings/iio/adc/ingenic,adc.h>

    adc@10070000 {
            compatible = "ingenic,jz4740-adc";
            #io-channel-cells = <1>;

            reg = <0x10070000 0x30>;

            clocks = <&cgu JZ4740_CLK_ADC>;
            clock-names = "adc";

            interrupt-parent = <&intc>;
            interrupts = <18>;
    };
```

## Documentation/devicetree/bindings/iio/adc/lltc,ltc2496.yaml
```yaml
# SPDX-License-Identifier: (GPL-2.0 OR BSD-2-Clause)
%YAML 1.2
---
$id: http://devicetree.org/schemas/iio/adc/lltc,ltc2496.yaml#
$schema: http://devicetree.org/meta-schemas/core.yaml#

title: Linear Technology / Analog Devices LTC2496 ADC

maintainers:
  - Lars-Peter Clausen <lars@metafoo.de>
  - Michael Hennerich <Michael.Hennerich@analog.com>

properties:
  compatible:
    enum:
      - lltc,ltc2496

  vref-supply:
    description: Power supply for the reference voltage

  reg:
    maxItems: 1

required:
  - compatible
  - vref-supply
  - reg

allOf:
  - $ref: /schemas/spi/spi-peripheral-props.yaml#

unevaluatedProperties: false

examples:
  - |
    spi {
        #address-cells = <1>;
        #size-cells = <0>;

        adc@0 {
            compatible = "lltc,ltc2496";
            reg = <0>;
            vref-supply = <&ltc2496_reg>;
            spi-max-frequency = <2000000>;
        };
    };
```

## Documentation/devicetree/bindings/iio/adc/lltc,ltc2497.yaml
```yaml
# SPDX-License-Identifier: (GPL-2.0 OR BSD-2-Clause)
%YAML 1.2
---
$id: http://devicetree.org/schemas/iio/adc/lltc,ltc2497.yaml#
$schema: http://devicetree.org/meta-schemas/core.yaml#

title: Linear Technology / Analog Devices LTC2497 and LTC2309 ADC

maintainers:
  - Michael Hennerich <michael.hennerich@analog.com>
  - Liam Beguin <liambeguin@gmail.com>

description: |
  LTC2309:
    low noise, low power, 8-channel, 12-bit successive approximation ADC with an
    I2C compatible serial interface.

    https://www.analog.com/media/en/technical-documentation/data-sheets/2309fd.pdf

  LTC2497:
  LTC2499:
    16bit ADC supporting up to 16 single ended or 8 differential inputs.
    I2C interface.

    https://www.analog.com/media/en/technical-documentation/data-sheets/2497fb.pdf
    https://www.analog.com/media/en/technical-documentation/data-sheets/2499fe.pdf

properties:
  compatible:
    enum:
      - lltc,ltc2309
      - lltc,ltc2497
      - lltc,ltc2499

  reg: true
  vref-supply: true
  "#io-channel-cells":
    const: 1

required:
  - compatible
  - reg
  - vref-supply

additionalProperties: false

examples:
  - |
    i2c {
        #address-cells = <1>;
        #size-cells = <0>;

        adc@76 {
            compatible = "lltc,ltc2497";
            reg = <0x76>;
            vref-supply = <&ltc2497_reg>;
            #io-channel-cells = <1>;
        };
    };
...
```

## Documentation/devicetree/bindings/iio/adc/lpc1850-adc.txt
```
NXP LPC1850 ADC bindings

Required properties:
- compatible: Should be "nxp,lpc1850-adc"
- reg: Offset and length of the register set for the ADC device
- interrupts: The interrupt number for the ADC device
- clocks: The root clock of the ADC controller
- vref-supply: The regulator supply ADC reference voltage
- resets: phandle to reset controller and line specifier

Example:

adc0: adc@400e3000 {
	compatible = "nxp,lpc1850-adc";
	reg = <0x400e3000 0x1000>;
	interrupts = <17>;
	clocks = <&ccu1 CLK_APB3_ADC0>;
	vref-supply = <&reg_vdda>;
	resets = <&rgu 40>;
	status = "disabled";
};
```

## Documentation/devicetree/bindings/iio/adc/lpc32xx-adc.txt
```
* NXP LPC32xx SoC ADC controller

Required properties:
- compatible: must be "nxp,lpc3220-adc"
- reg: physical base address of the controller and length of memory mapped
  region.
- interrupts: The ADC interrupt

Optional:
 - vref-supply: The regulator supply ADC reference voltage, optional
   for legacy reason, but highly encouraging to us in new device tree

Example:

	adc@40048000 {
		compatible = "nxp,lpc3220-adc";
		reg = <0x40048000 0x1000>;
		interrupt-parent = <&mic>;
		interrupts = <39 0>;
		vref-supply = <&vcc>;
	};
```

## Documentation/devicetree/bindings/iio/adc/ltc2497.txt
```
* Linear Technology / Analog Devices LTC2497 ADC

Required properties:
 - compatible: Must be "lltc,ltc2497"
 - reg: Must contain the ADC I2C address
 - vref-supply: The regulator supply for ADC reference voltage

Example:
	ltc2497: adc@76 {
		compatible = "lltc,ltc2497";
		reg = <0x76>;
		vref-supply = <&ltc2497_reg>;
	};
```
