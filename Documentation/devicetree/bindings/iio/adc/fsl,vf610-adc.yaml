## Documentation/devicetree/bindings/iio/adc/marvell,berlin2-adc.yaml
```yaml
# SPDX-License-Identifier: (GPL-2.0 OR BSD-2-Clause)
%YAML 1.2
---
$id: http://devicetree.org/schemas/iio/adc/marvell,berlin2-adc.yaml#
$schema: http://devicetree.org/meta-schemas/core.yaml#

title: Berlin 2 Analog to Digital Converter (ADC)

maintainers:
  - Antoine Tenart <antoine.tenart@free-electrons.com>

description:
  The Berlin ADC has 8 channels, with one connected to a temperature sensor.
  It is part of the system controller register set. The ADC node should be a
  sub-node of the system controller node.

properties:
  compatible:
    const: marvell,berlin2-adc

  interrupts:
    minItems: 2
    maxItems: 2

  interrupt-names:
    items:
      - const: adc
      - const: tsen

  "#io-channel-cells":
    const: 1

required:
  - compatible
  - interrupts
  - interrupt-names

additionalProperties: false

examples:
  - |
    sysctrl {
        adc {
            compatible = "marvell,berlin2-adc";
            interrupt-parent = <&sic>;
            interrupts = <12>, <14>;
            interrupt-names = "adc", "tsen";
        };
    };
...
```

## Documentation/devicetree/bindings/iio/adc/max1027-adc.txt
```
* Maxim 1027/1029/1031 Analog to Digital Converter (ADC)

Required properties:
  - compatible: Should be "maxim,max1027" or "maxim,max1029" or "maxim,max1031"
  - reg: SPI chip select number for the device
  - interrupts: IRQ line for the ADC
  see: Documentation/devicetree/bindings/interrupt-controller/interrupts.txt

Recommended properties:
- spi-max-frequency: Definition as per
                     Documentation/devicetree/bindings/spi/spi-bus.txt

Example:
adc@0 {
	compatible = "maxim,max1027";
	reg = <0>;
	interrupt-parent = <&gpio5>;
	interrupts = <15 IRQ_TYPE_EDGE_RISING>;
	spi-max-frequency = <1000000>;
};
```

## Documentation/devicetree/bindings/iio/adc/max11100.txt
```
* Maxim max11100 Analog to Digital Converter (ADC)

Required properties:
  - compatible: Should be "maxim,max11100"
  - reg: the adc unit address
  - vref-supply: phandle to the regulator that provides reference voltage

Optional properties:
  - spi-max-frequency: SPI maximum frequency

Example:

max11100: adc@0 {
        compatible = "maxim,max11100";
        reg = <0>;
        vref-supply = <&adc0_vref>;
        spi-max-frequency = <240000>;
};
```

## Documentation/devicetree/bindings/iio/adc/max1118.txt
```
* MAX1117/MAX1118/MAX1119 8-bit, dual-channel ADCs

Required properties:
 - compatible: Should be one of
	* "maxim,max1117"
	* "maxim,max1118"
	* "maxim,max1119"
 - reg: spi chip select number for the device
 - (max1118 only) vref-supply: The regulator supply for ADC reference voltage

Recommended properties:
 - spi-max-frequency: Definition as per
		Documentation/devicetree/bindings/spi/spi-bus.txt

Example:
adc@0 {
	compatible = "maxim,max1118";
	reg = <0>;
	vref-supply = <&vdd_supply>;
	spi-max-frequency = <1000000>;
};
```

## Documentation/devicetree/bindings/iio/adc/max1363.txt
```
* Maxim 1x3x/136x/116xx Analog to Digital Converter (ADC)

The node for this driver must be a child node of a I2C controller, hence
all mandatory properties for your controller must be specified. See directory:

        Documentation/devicetree/bindings/i2c

for more details.

Required properties:
  - compatible: Should be one of
		"maxim,max1361"
		"maxim,max1362"
		"maxim,max1363"
		"maxim,max1364"
		"maxim,max1036"
		"maxim,max1037"
		"maxim,max1038"
		"maxim,max1039"
		"maxim,max1136"
		"maxim,max1137"
		"maxim,max1138"
		"maxim,max1139"
		"maxim,max1236"
		"maxim,max1237"
		"maxim,max1238"
		"maxim,max1239"
		"maxim,max11600"
		"maxim,max11601"
		"maxim,max11602"
		"maxim,max11603"
		"maxim,max11604"
		"maxim,max11605"
		"maxim,max11606"
		"maxim,max11607"
		"maxim,max11608"
		"maxim,max11609"
		"maxim,max11610"
		"maxim,max11611"
		"maxim,max11612"
		"maxim,max11613"
		"maxim,max11614"
		"maxim,max11615"
		"maxim,max11616"
		"maxim,max11617"
		"maxim,max11644"
		"maxim,max11645"
		"maxim,max11646"
		"maxim,max11647"
  - reg: Should contain the ADC I2C address

Optional properties:
  - vcc-supply: phandle to the regulator that provides power to the ADC.
  - vref-supply: phandle to the regulator for ADC reference voltage.
  - interrupts: IRQ line for the ADC. If not used the driver will use
    polling.

Example:
adc: max11644@36 {
	compatible = "maxim,max11644";
	reg = <0x36>;
	vref-supply = <&adc_vref>;
};
```

## Documentation/devicetree/bindings/iio/adc/max9611.txt
```
* Maxim max9611/max9612 current sense amplifier with 12-bits ADC interface

Maxim max9611/max9612 is an high-side current sense amplifier with integrated
12-bits ADC communicating over I2c bus.
The device node for this driver shall be a child of a I2c controller.

Required properties
  - compatible: Should be "maxim,max9611" or "maxim,max9612"
  - reg: The 7-bits long I2c address of the device
  - shunt-resistor-micro-ohms: Value, in micro Ohms, of the current sense shunt
			        resistor

Example:

&i2c4 {
	csa: adc@7c {
		compatible = "maxim,max9611";
		reg = <0x7c>;

		shunt-resistor-micro-ohms = <5000>;
	};
};

This device node describes a current sense amplifier sitting on I2c4 bus
with address 0x7c (read address is 0xf9, write address is 0xf8).
A sense resistor of 0,005 Ohm is installed between RS+ and RS- current-sensing
inputs.
```

## Documentation/devicetree/bindings/iio/adc/maxim,max1027.yaml
```yaml
# SPDX-License-Identifier: (GPL-2.0 OR BSD-2-Clause)
%YAML 1.2
---
$id: http://devicetree.org/schemas/iio/adc/maxim,max1027.yaml#
$schema: http://devicetree.org/meta-schemas/core.yaml#

title: Maxim MAX1027 and similar ADCs

maintainers:
  - Miquel Raynal <miquel.raynal@bootlin.com>
  - Philippe Reynes <tremyfr@yahoo.fr>

description: |
  300ks/s SPI ADCs with temperature sensors.

properties:
  compatible:
    enum:
        # 10-bit 8 channels
      - maxim,max1027
        # 10-bit 12 channels
      - maxim,max1029
        # 10-bit 16 channels
      - maxim,max1031
         # 12-bit 8 channels
      - maxim,max1227
         # 12-bit 12 channels
      - maxim,max1229
         # 12-bit 16 channels
      - maxim,max1231

  reg:
    maxItems: 1

  interrupts:
    maxItems: 1

  spi-max-frequency:
    maximum: 10000000

  "#io-channel-cells":
    const: 1

required:
  - compatible
  - reg

allOf:
  - $ref: /schemas/spi/spi-peripheral-props.yaml#

unevaluatedProperties: false

examples:
  - |
    #include <dt-bindings/interrupt-controller/irq.h>
    spi {
        #address-cells = <1>;
        #size-cells = <0>;
        maxadc: adc@0 {
            compatible = "maxim,max1027";
            reg = <0>;
            #io-channel-cells = <1>;
            interrupt-parent = <&gpio5>;
            interrupts = <15 IRQ_TYPE_EDGE_RISING>;
            spi-max-frequency = <1000000>;
        };
    };
...
```

## Documentation/devicetree/bindings/iio/adc/maxim,max11100.yaml
```yaml
# SPDX-License-Identifier: (GPL-2.0 OR BSD-2-Clause)
%YAML 1.2
---
$id: http://devicetree.org/schemas/iio/adc/maxim,max11100.yaml#
$schema: http://devicetree.org/meta-schemas/core.yaml#

title: Maxim MAX11100 ADC

maintainers:
  - Jacopo Mondi <jacopo@jmondi.org>

description: |
    Single channel 16 bit ADC with SPI interface.

properties:
  compatible:
    const: maxim,max11100

  reg:
    maxItems: 1

  vref-supply:
    description: External reference, needed to establish input scaling.

  spi-max-frequency:
    minimum: 100000
    maximum: 4800000

required:
  - compatible
  - reg
  - vref-supply

allOf:
  - $ref: /schemas/spi/spi-peripheral-props.yaml#

unevaluatedProperties: false

examples:
  - |
    spi {
        #address-cells = <1>;
        #size-cells = <0>;

        adc@0 {
            compatible = "maxim,max11100";
            reg = <0>;
            vref-supply = <&adc_vref>;
            spi-max-frequency = <240000>;
        };
    };
...
```

## Documentation/devicetree/bindings/iio/adc/maxim,max1118.yaml
```yaml
# SPDX-License-Identifier: (GPL-2.0 OR BSD-2-Clause)
%YAML 1.2
---
$id: http://devicetree.org/schemas/iio/adc/maxim,max1118.yaml#
$schema: http://devicetree.org/meta-schemas/core.yaml#

title: Maxim MAX1118 and similar ADCs

maintainers:
  - Akinobu Mita <akinobu.mita@gmail.com>

description: |
    Dual channel 8bit ADCs.

properties:
  compatible:
    enum:
      - maxim,max1117
      - maxim,max1118
      - maxim,max1119

  reg:
    maxItems: 1

  spi-max-frequency:
    maximum: 5000000

  vref-supply:
    description: External reference, needed to establish input scaling

if:
  properties:
    compatible:
      contains:
        const: maxim,max1118
then:
  required:
    - vref-supply
else:
  properties:
    vref-supply: false

required:
  - compatible
  - reg

additionalProperties: false

examples:
  - |
    spi {
        #address-cells = <1>;
        #size-cells = <0>;

        adc@0 {
            compatible = "maxim,max1118";
            reg = <0>;
            vref-supply = <&adc_vref>;
            spi-max-frequency = <1000000>;
        };
    };
...
```

## Documentation/devicetree/bindings/iio/adc/maxim,max11205.yaml
```yaml
# SPDX-License-Identifier: (GPL-2.0 OR BSD-2-Clause)
%YAML 1.2
---
$id: http://devicetree.org/schemas/iio/adc/maxim,max11205.yaml#
$schema: http://devicetree.org/meta-schemas/core.yaml#

title: Maxim MAX11205 ADC

maintainers:
  - Ramona Bolboaca <ramona.bolboaca@analog.com>

description: |
  The MAX11205 is an ultra-low-power (< 300FA max active current),
  high-resolution, serial-output ADC.

  https://datasheets.maximintegrated.com/en/ds/MAX11205.pdf

allOf:
  - $ref: /schemas/spi/spi-peripheral-props.yaml#

properties:
  compatible:
    enum:
      - maxim,max11205a
      - maxim,max11205b

  reg:
    maxItems: 1

  interrupts:
    maxItems: 1

  spi-max-frequency:
    maximum: 5000000

  spi-cpha: true

  vref-supply:
    description:
      The regulator supply for the ADC reference voltage. This is a differential
      reference. It is equal to the V_REFP - V_REFN. The maximum value is 3.6V.

required:
  - compatible
  - reg
  - interrupts
  - spi-max-frequency
  - spi-cpha
  - vref-supply

unevaluatedProperties: false

examples:
  - |
    #include <dt-bindings/interrupt-controller/irq.h>
    spi {
        #address-cells = <1>;
        #size-cells = <0>;
        adc@0 {
            compatible = "maxim,max11205a";
            reg = <0>;
            spi-max-frequency = <5000000>;
            spi-cpha;
            interrupt-parent = <&gpio>;
            interrupts = <19 IRQ_TYPE_EDGE_FALLING>;
            vref-supply = <&max11205_vref>;
        };
    };
...
```

## Documentation/devicetree/bindings/iio/adc/maxim,max1238.yaml
```yaml
# SPDX-License-Identifier: (GPL-2.0 OR BSD-2-Clause)
%YAML 1.2
---
$id: http://devicetree.org/schemas/iio/adc/maxim,max1238.yaml#
$schema: http://devicetree.org/meta-schemas/core.yaml#

title: Maxim MAX1238 and similar ADCs

maintainers:
  - Jonathan Cameron <jic23@kernel.org>

description: |
  Family of simple ADCs with i2c inteface and internal references.

properties:
  compatible:
    enum:
      - maxim,max1036
      - maxim,max1037
      - maxim,max1038
      - maxim,max1039
      - maxim,max1136
      - maxim,max1137
      - maxim,max1138
      - maxim,max1139
      - maxim,max1236
      - maxim,max1237
      - maxim,max1238
      - maxim,max1239
      - maxim,max11600
      - maxim,max11601
      - maxim,max11602
      - maxim,max11603
      - maxim,max11604
      - maxim,max11605
      - maxim,max11606
      - maxim,max11607
      - maxim,max11608
      - maxim,max11609
      - maxim,max11610
      - maxim,max11611
      - maxim,max11612
      - maxim,max11613
      - maxim,max11614
      - maxim,max11615
      - maxim,max11616
      - maxim,max11617
      - maxim,max11644
      - maxim,max11645
      - maxim,max11646
      - maxim,max11647

  reg:
    maxItems: 1

  vcc-supply: true
  vref-supply:
    description: Optional external reference.  If not supplied, internal
      reference will be used.

required:
  - compatible
  - reg

additionalProperties: false

examples:
  - |
    i2c {
        #address-cells = <1>;
        #size-cells = <0>;

        adc@36 {
            compatible = "maxim,max1238";
            reg = <0x36>;
        };
    };
...
```

## Documentation/devicetree/bindings/iio/adc/maxim,max1241.yaml
```yaml
# SPDX-License-Identifier: (GPL-2.0 OR BSD-2-Clause)
# Copyright 2020 Alexandru Lazar
%YAML 1.2
---
$id: http://devicetree.org/schemas/iio/adc/maxim,max1241.yaml#
$schema: http://devicetree.org/meta-schemas/core.yaml#

title: Maxim MAX1241 12-bit, single-channel analog to digital converter

maintainers:
  - Alexandru Lazar <alazar@startmail.com>

description: |
  Bindings for the max1241 12-bit, single-channel ADC device. Datasheet
  can be found at:
    https://datasheets.maximintegrated.com/en/ds/MAX1240-MAX1241.pdf

properties:
  compatible:
    enum:
      - maxim,max1241

  reg:
    maxItems: 1

  vdd-supply:
    description:
      Device tree identifier of the regulator that powers the ADC.

  vref-supply:
    description:
      Device tree identifier of the regulator that provides the external
      reference voltage.

  shutdown-gpios:
    description:
      GPIO spec for the GPIO pin connected to the ADC's /SHDN pin. If
      specified, the /SHDN pin will be asserted between conversions,
      thus enabling power-down mode.
    maxItems: 1

required:
  - compatible
  - reg
  - vdd-supply
  - vref-supply

examples:
  - |
    #include <dt-bindings/gpio/gpio.h>
    spi {
      #address-cells = <1>;
      #size-cells = <0>;

        adc@0 {
            compatible = "maxim,max1241";
            reg = <0>;
            vdd-supply = <&adc_vdd>;
            vref-supply = <&adc_vref>;
            spi-max-frequency = <1000000>;
            shutdown-gpios = <&gpio 26 1>;
        };
    };
```
