## Documentation/devicetree/bindings/iio/adc/adi,ad7780.txt
```
* Analog Devices AD7170/AD7171/AD7780/AD7781

Data sheets:

- AD7170:
	* https://www.analog.com/media/en/technical-documentation/data-sheets/AD7170.pdf
- AD7171:
	* https://www.analog.com/media/en/technical-documentation/data-sheets/AD7171.pdf
- AD7780:
	* https://www.analog.com/media/en/technical-documentation/data-sheets/ad7780.pdf
- AD7781:
	* https://www.analog.com/media/en/technical-documentation/data-sheets/AD7781.pdf

Required properties:

- compatible: should be one of
	* "adi,ad7170"
	* "adi,ad7171"
	* "adi,ad7780"
	* "adi,ad7781"
- reg: spi chip select number for the device
- vref-supply: the regulator supply for the ADC reference voltage

Optional properties:

- powerdown-gpios:  must be the device tree identifier of the PDRST pin. If
		    specified, it will be asserted during driver probe. As the
		    line is active high, it should be marked GPIO_ACTIVE_HIGH.
- adi,gain-gpios:   must be the device tree identifier of the GAIN pin. Only for
		    the ad778x chips. If specified, it will be asserted during
		    driver probe. As the line is active low, it should be marked
		    GPIO_ACTIVE_LOW.
- adi,filter-gpios: must be the device tree identifier of the FILTER pin. Only
		    for the ad778x chips. If specified, it will be asserted
		    during driver probe. As the line is active low, it should be
		    marked GPIO_ACTIVE_LOW.

Example:

adc@0 {
	compatible =  "adi,ad7780";
	reg =	      <0>;
	vref-supply = <&vdd_supply>

	powerdown-gpios  = <&gpio 12 GPIO_ACTIVE_HIGH>;
	adi,gain-gpios   = <&gpio  5 GPIO_ACTIVE_LOW>;
	adi,filter-gpios = <&gpio 15 GPIO_ACTIVE_LOW>;
};
```

## Documentation/devicetree/bindings/iio/adc/adi,ad7780.yaml
```yaml
# SPDX-License-Identifier: GPL-2.0
%YAML 1.2
---
$id: http://devicetree.org/schemas/iio/adc/adi,ad7780.yaml#
$schema: http://devicetree.org/meta-schemas/core.yaml#

title: Analog Devices AD7170/AD7171/AD7780/AD7781 analog to digital converters

maintainers:
  - Michael Hennerich <michael.hennerich@analog.com>

description: |
  The ad7780 is a sigma-delta analog to digital converter. This driver provides
  reading voltage values and status bits from both the ad778x and ad717x series.
  Its interface also allows writing on the FILTER and GAIN GPIO pins on the
  ad778x.

  Specifications on the converters can be found at:
    AD7170:
      https://www.analog.com/media/en/technical-documentation/data-sheets/AD7170.pdf
    AD7171:
      https://www.analog.com/media/en/technical-documentation/data-sheets/AD7171.pdf
    AD7780:
      https://www.analog.com/media/en/technical-documentation/data-sheets/ad7780.pdf
    AD7781:
      https://www.analog.com/media/en/technical-documentation/data-sheets/AD7781.pdf

properties:
  compatible:
    enum:
      - adi,ad7170
      - adi,ad7171
      - adi,ad7780
      - adi,ad7781

  reg:
    maxItems: 1

  avdd-supply:
    description:
      The regulator supply for the ADC reference voltage.

  powerdown-gpios:
    description:
      Must be the device tree identifier of the PDRST pin. If
      specified, it will be asserted during driver probe. As the
      line is active high, it should be marked GPIO_ACTIVE_HIGH.
    maxItems: 1

  adi,gain-gpios:
    description:
      Must be the device tree identifier of the GAIN pin. Only for
      the ad778x chips. If specified, it will be asserted during
      driver probe. As the line is active low, it should be marked
      GPIO_ACTIVE_LOW.
    maxItems: 1

  adi,filter-gpios:
    description:
      Must be the device tree identifier of the FILTER pin. Only
      for the ad778x chips. If specified, it will be asserted
      during driver probe. As the line is active low, it should be
      marked GPIO_ACTIVE_LOW.
    maxItems: 1

required:
  - compatible
  - reg

additionalProperties: false

examples:
  - |
    #include <dt-bindings/gpio/gpio.h>
    spi {
        #address-cells = <1>;
        #size-cells = <0>;

        adc@0 {
            compatible = "adi,ad7780";
            reg = <0>;

            avdd-supply = <&vdd_supply>;
            powerdown-gpios = <&gpio0 12 GPIO_ACTIVE_HIGH>;
            adi,gain-gpios = <&gpio1  5 GPIO_ACTIVE_LOW>;
            adi,filter-gpios = <&gpio2 15 GPIO_ACTIVE_LOW>;
        };
    };
```

## Documentation/devicetree/bindings/iio/adc/adi,ad7923.yaml
```yaml
# SPDX-License-Identifier: (GPL-2.0-only OR BSD-2-Clause)
%YAML 1.2
---
$id: http://devicetree.org/schemas/iio/adc/adi,ad7923.yaml#
$schema: http://devicetree.org/meta-schemas/core.yaml#

title: Analog Devices AD7923 and similars with 4 and 8 Channel ADCs.

maintainers:
  - Michael Hennerich <michael.hennerich@analog.com>
  - Patrick Vasseur <patrick.vasseur@c-s.fr>

description: |
  Analog Devices AD7904, AD7914, AD7923, AD7924 4 Channel ADCs, and AD7908,
   AD7918, AD7928 8 Channels ADCs.

  Specifications about the part can be found at:
    https://www.analog.com/media/en/technical-documentation/data-sheets/AD7923.pdf
    https://www.analog.com/media/en/technical-documentation/data-sheets/AD7904_7914_7924.pdf
    https://www.analog.com/media/en/technical-documentation/data-sheets/AD7908_7918_7928.pdf

properties:
  compatible:
    enum:
      - adi,ad7904
      - adi,ad7914
      - adi,ad7923
      - adi,ad7924
      - adi,ad7908
      - adi,ad7918
      - adi,ad7928

  reg:
    maxItems: 1

  refin-supply:
    description: |
      The regulator supply for ADC reference voltage.

  '#address-cells':
    const: 1

  '#size-cells':
    const: 0

required:
  - compatible
  - reg

unevaluatedProperties: false

examples:
  - |
    spi {
      #address-cells = <1>;
      #size-cells = <0>;

      ad7928: adc@0 {
        compatible = "adi,ad7928";
        reg = <0>;
        spi-max-frequency = <25000000>;
        refin-supply = <&adc_vref>;

        #address-cells = <1>;
        #size-cells = <0>;
      };
    };
```

## Documentation/devicetree/bindings/iio/adc/adi,ad7944.yaml
```yaml
# SPDX-License-Identifier: (GPL-2.0-only OR BSD-2-Clause)
%YAML 1.2
---
$id: http://devicetree.org/schemas/iio/adc/adi,ad7944.yaml#
$schema: http://devicetree.org/meta-schemas/core.yaml#

title: Analog Devices PulSAR LFCSP Analog to Digital Converters

maintainers:
  - Michael Hennerich <Michael.Hennerich@analog.com>
  - Nuno Sá <nuno.sa@analog.com>

description: |
  A family of pin-compatible single channel differential analog to digital
  converters with SPI support in a LFCSP package.

  * https://www.analog.com/en/products/ad7944.html
  * https://www.analog.com/en/products/ad7985.html
  * https://www.analog.com/en/products/ad7986.html

$ref: /schemas/spi/spi-peripheral-props.yaml#

properties:
  compatible:
    enum:
      - adi,ad7944
      - adi,ad7985
      - adi,ad7986

  reg:
    maxItems: 1

  spi-max-frequency:
    maximum: 111111111

  spi-cpol: true
  spi-cpha: true

  adi,spi-mode:
    $ref: /schemas/types.yaml#/definitions/string
    enum: [ single, chain ]
    description: |
      This property indicates the SPI wiring configuration.

      When this property is omitted, it is assumed that the device is using what
      the datasheet calls "4-wire mode". This is the conventional SPI mode used
      when there are multiple devices on the same bus. In this mode, the CNV
      line is used to initiate the conversion and the SDI line is connected to
      CS on the SPI controller.

      When this property is present, it indicates that the device is using one
      of the following alternative wiring configurations:

      * single: The datasheet calls this "3-wire mode". (NOTE: The datasheet's
        definition of 3-wire mode is NOT at all related to the standard
        spi-3wire property!) This mode is often used when the ADC is the only
        device on the bus. In this mode, SDI is tied to VIO, and the CNV line
        can be connected to the CS line of the SPI controller or to a GPIO, in
        which case the CS line of the controller is unused.
      * chain: The datasheet calls this "chain mode". This mode is used to save
        on wiring when multiple ADCs are used. In this mode, the SDI line of
        one chip is tied to the SDO of the next chip in the chain and the SDI of
        the last chip in the chain is tied to GND. Only the first chip in the
        chain is connected to the SPI bus. The CNV line of all chips are tied
        together. The CS line of the SPI controller can be used as the CNV line
        only if it is active high.

  '#daisy-chained-devices': true

  avdd-supply:
    description: A 2.5V supply that powers the analog circuitry.

  dvdd-supply:
    description: A 2.5V supply that powers the digital circuitry.

  vio-supply:
    description:
      A 1.8V to 2.7V supply for the digital inputs and outputs.

  bvdd-supply:
    description:
      A voltage supply for the buffered power. When using an external reference
      without an internal buffer (PDREF high, REFIN low), this should be
      connected to the same supply as ref-supply. Otherwise, when using an
      internal reference or an external reference with an internal buffer, this
      is connected to a 5V supply.

  ref-supply:
    description:
      Voltage regulator for the external reference voltage (REF). This property
      is omitted when using an internal reference.

  refin-supply:
    description:
      Voltage regulator for the reference buffer input (REFIN). When using an
      external buffer with internal reference, this should be connected to a
      1.2V external reference voltage supply. Otherwise, this property is
      omitted.

  cnv-gpios:
    description:
      The Convert Input (CNV). This input has multiple functions. It initiates
      the conversions and selects the SPI mode of the device (chain or CS). In
      'single' mode, this property is omitted if the CNV pin is connected to the
      CS line of the SPI controller.
    maxItems: 1

  turbo-gpios:
    description:
      GPIO connected to the TURBO line. If omitted, it is assumed that the TURBO
      line is hard-wired and the state is determined by the adi,always-turbo
      property.
    maxItems: 1

  adi,always-turbo:
    type: boolean
    description:
      When present, this property indicates that the TURBO line is hard-wired
      and the state is always high. If neither this property nor turbo-gpios is
      present, the TURBO line is assumed to be hard-wired and the state is
      always low.

  interrupts:
    description:
      The SDO pin can also function as a busy indicator. This node should be
      connected to an interrupt that is triggered when the SDO line goes low
      while the SDI line is high and the CNV line is low ('single' mode) or the
      SDI line is low and the CNV line is high ('multi' mode); or when the SDO
      line goes high while the SDI and CNV lines are high (chain mode),
    maxItems: 1

required:
  - compatible
  - reg
  - avdd-supply
  - dvdd-supply
  - vio-supply
  - bvdd-supply

allOf:
  # ref-supply and refin-supply are mutually exclusive (neither is also valid)
  - if:
      required:
        - ref-supply
    then:
      properties:
        refin-supply: false
  - if:
      required:
        - refin-supply
    then:
      properties:
        ref-supply: false
  # in '4-wire' mode, cnv-gpios is required, for other modes it is optional
  - if:
      not:
        required:
          - adi,spi-mode
    then:
      required:
        - cnv-gpios
  # chain mode has lower SCLK max rate and doesn't work when TURBO is enabled
  - if:
      required:
        - adi,spi-mode
      properties:
        adi,spi-mode:
          const: chain
    then:
      properties:
        spi-max-frequency:
          maximum: 90909090
        adi,always-turbo: false
      required:
        - '#daisy-chained-devices'
    else:
      properties:
        '#daisy-chained-devices': false
  # turbo-gpios and adi,always-turbo are mutually exclusive
  - if:
      required:
        - turbo-gpios
    then:
      properties:
        adi,always-turbo: false
  - if:
      required:
        - adi,always-turbo
    then:
      properties:
        turbo-gpios: false

unevaluatedProperties: false

examples:
  - |
    #include <dt-bindings/gpio/gpio.h>
    spi {
        #address-cells = <1>;
        #size-cells = <0>;
        adc@0 {
            compatible = "adi,ad7944";
            reg = <0>;
            spi-cpha;
            spi-max-frequency = <111111111>;
            avdd-supply = <&supply_2_5V>;
            dvdd-supply = <&supply_2_5V>;
            vio-supply = <&supply_1_8V>;
            bvdd-supply = <&supply_5V>;
            cnv-gpios = <&gpio 0 GPIO_ACTIVE_HIGH>;
            turbo-gpios = <&gpio 1 GPIO_ACTIVE_HIGH>;
        };
    };
```

## Documentation/devicetree/bindings/iio/adc/adi,ad7949.yaml
```yaml
# SPDX-License-Identifier: GPL-2.0
%YAML 1.2
---
$id: http://devicetree.org/schemas/iio/adc/adi,ad7949.yaml#
$schema: http://devicetree.org/meta-schemas/core.yaml#

title: Analog Devices AD7949/AD7682/AD7689 analog to digital converters

maintainers:
  - Charles-Antoine Couret <charles-antoine.couret@essensium.com>

description: |
  Specifications on the converters can be found at:
    AD7949:
      https://www.analog.com/media/en/technical-documentation/data-sheets/AD7949.pdf
    AD7682/AD7698:
      https://www.analog.com/media/en/technical-documentation/data-sheets/AD7682_7689.pdf

properties:
  compatible:
    enum:
      - adi,ad7682
      - adi,ad7689
      - adi,ad7949

  reg:
    maxItems: 1

  vrefin-supply:
    description:
      Buffered ADC reference voltage supply.

  vref-supply:
    description:
      Unbuffered ADC reference voltage supply.

  adi,internal-ref-microvolt:
    description: |
      Internal reference voltage selection in microvolts.

      If no internal reference is specified, the channel will default to the
      external reference defined by vrefin-supply (or vref-supply).
      vrefin-supply will take precedence over vref-supply if both are defined.

      If no supplies are defined, the reference selection will default to
      4096mV internal reference.

    enum: [2500000, 4096000]
    default: 4096000


  '#io-channel-cells':
    const: 1

  '#address-cells':
    const: 1

  '#size-cells':
    const: 0

required:
  - compatible
  - reg

allOf:
  - $ref: /schemas/spi/spi-peripheral-props.yaml#

unevaluatedProperties: false

examples:
  - |
    spi {
        #address-cells = <1>;
        #size-cells = <0>;

        adc@0 {
            #address-cells = <1>;
            #size-cells = <0>;

            compatible = "adi,ad7949";
            reg = <0>;
            vref-supply = <&vdd_supply>;
        };

        adc@1 {
            #address-cells = <1>;
            #size-cells = <0>;

            compatible = "adi,ad7949";
            reg = <1>;
            vrefin-supply = <&vdd_supply>;
        };

        adc@2 {
            #address-cells = <1>;
            #size-cells = <0>;

            compatible = "adi,ad7949";
            reg = <2>;
            adi,internal-ref-microvolt = <4096000>;
        };
    };
...
```
