## Documentation/devicetree/bindings/iio/adc/adi,ad7625.yaml
```yaml
# SPDX-License-Identifier: (GPL-2.0-only OR BSD-2-Clause)
%YAML 1.2
---
$id: http://devicetree.org/schemas/iio/adc/adi,ad7625.yaml#
$schema: http://devicetree.org/meta-schemas/core.yaml#

title: Analog Devices Fast PulSAR Analog to Digital Converters

maintainers:
  - Michael Hennerich <Michael.Hennerich@analog.com>
  - Nuno Sá <nuno.sa@analog.com>

description: |
  A family of single channel differential analog to digital converters.

  * https://www.analog.com/en/products/ad7625.html
  * https://www.analog.com/en/products/ad7626.html
  * https://www.analog.com/en/products/ad7960.html
  * https://www.analog.com/en/products/ad7961.html

properties:
  compatible:
    enum:
      - adi,ad7625
      - adi,ad7626
      - adi,ad7960
      - adi,ad7961

  vdd1-supply: true
  vdd2-supply: true
  vio-supply: true

  ref-supply:
    description:
      Voltage regulator for the external reference voltage (REF).

  refin-supply:
    description:
      Voltage regulator for the reference buffer input (REFIN).

  clocks:
    description:
      The clock connected to the CLK pins, gated by the clk_gate PWM.
    maxItems: 1

  pwms:
    items:
      - description: PWM connected to the CNV input on the ADC.
      - description: PWM that gates the clock connected to the ADC's CLK input.

  pwm-names:
    items:
      - const: cnv
      - const: clk_gate

  io-backends:
    description:
      The AXI ADC IP block connected to the D+/- and DCO+/- lines of the
      ADC. An example backend can be found at
      http://analogdevicesinc.github.io/hdl/projects/pulsar_lvds/index.html.
    maxItems: 1

  adi,no-dco:
    $ref: /schemas/types.yaml#/definitions/flag
    description:
      Indicates the wiring of the DCO+/- lines. If true, then they are
      grounded and the device is in self-clocked mode. If this is not
      present, then the device is in echoed clock mode.

  adi,en0-always-on:
    $ref: /schemas/types.yaml#/definitions/flag
    description:
      Indicates if EN0 is hard-wired to the high state. If neither this
      nor en0-gpios are present, then EN0 is hard-wired low.

  adi,en1-always-on:
    $ref: /schemas/types.yaml#/definitions/flag
    description:
      Indicates if EN1 is hard-wired to the high state. If neither this
      nor en1-gpios are present, then EN1 is hard-wired low.

  adi,en2-always-on:
    $ref: /schemas/types.yaml#/definitions/flag
    description:
      Indicates if EN2 is hard-wired to the high state. If neither this
      nor en2-gpios are present, then EN2 is hard-wired low.

  adi,en3-always-on:
    $ref: /schemas/types.yaml#/definitions/flag
    description:
      Indicates if EN3 is hard-wired to the high state. If neither this
      nor en3-gpios are present, then EN3 is hard-wired low.

  en0-gpios:
    description:
      Configurable EN0 pin.

  en1-gpios:
    description:
      Configurable EN1 pin.

  en2-gpios:
    description:
      Configurable EN2 pin.

  en3-gpios:
    description:
      Configurable EN3 pin.

required:
  - compatible
  - vdd1-supply
  - vdd2-supply
  - vio-supply
  - clocks
  - pwms
  - pwm-names
  - io-backends

allOf:
  - if:
      required:
        - ref-supply
    then:
      properties:
        refin-supply: false
  - if:
      required:
        - refin-supply
    then:
      properties:
        ref-supply: false
  - if:
      properties:
        compatible:
          contains:
            enum:
              - adi,ad7625
              - adi,ad7626
    then:
      properties:
        en2-gpios: false
        en3-gpios: false
        adi,en2-always-on: false
        adi,en3-always-on: false

  - if:
      properties:
        compatible:
          contains:
            enum:
              - adi,ad7960
              - adi,ad7961
    then:
      # ad796x parts must have one of the two supplies
      oneOf:
        - required: [ref-supply]
        - required: [refin-supply]

additionalProperties: false

examples:
  - |
    #include <dt-bindings/gpio/gpio.h>
    adc {
        compatible = "adi,ad7625";
        vdd1-supply = <&supply_5V>;
        vdd2-supply = <&supply_2_5V>;
        vio-supply = <&supply_2_5V>;
        io-backends = <&axi_adc>;
        clocks = <&ref_clk>;
        pwms = <&axi_pwm_gen 0 0>, <&axi_pwm_gen 1 0>;
        pwm-names = "cnv", "clk_gate";
        en0-gpios = <&gpio0 86 GPIO_ACTIVE_HIGH>;
        en1-gpios = <&gpio0 87 GPIO_ACTIVE_HIGH>;
    };
```

## Documentation/devicetree/bindings/iio/adc/adi,ad7768-1.txt
```
Analog Devices AD7768-1 ADC device driver

Required properties for the AD7768-1:

- compatible: Must be "adi,ad7768-1"
- reg: SPI chip select number for the device
- spi-max-frequency: Max SPI frequency to use
	see: Documentation/devicetree/bindings/spi/spi-bus.txt
- clocks: phandle to the master clock (mclk)
	see: Documentation/devicetree/bindings/clock/clock-bindings.txt
- clock-names: Must be "mclk".
- interrupts: IRQ line for the ADC
	see: Documentation/devicetree/bindings/interrupt-controller/interrupts.txt
- vref-supply: vref supply can be used as reference for conversion
- adi,sync-in-gpios: must be the device tree identifier of the SYNC-IN pin. Enables
	synchronization of multiple devices that require simultaneous sampling.
	A pulse is always required if the configuration is changed in any way, for example
	if the filter decimation rate changes. As the line is active low, it should
	be marked GPIO_ACTIVE_LOW.

Optional properties:

 - reset-gpios : GPIO spec for the RESET pin. If specified, it will be asserted during
	driver probe. As the line is active low, it should be marked GPIO_ACTIVE_LOW.

Example:

	adc@0 {
		compatible = "adi,ad7768-1";
		reg = <0>;
		spi-max-frequency = <2000000>;
		spi-cpol;
		spi-cpha;
		vref-supply = <&adc_vref>;
		interrupts = <25 IRQ_TYPE_EDGE_RISING>;
		interrupt-parent = <&gpio>;
		adi,sync-in-gpios = <&gpio 22 GPIO_ACTIVE_LOW>;
		reset-gpios = <&gpio 27 GPIO_ACTIVE_LOW>;
		clocks = <&ad7768_mclk>;
		clock-names = "mclk";
	};
```

## Documentation/devicetree/bindings/iio/adc/adi,ad7768-1.yaml
```yaml
# SPDX-License-Identifier: GPL-2.0
%YAML 1.2
---
$id: http://devicetree.org/schemas/iio/adc/adi,ad7768-1.yaml#
$schema: http://devicetree.org/meta-schemas/core.yaml#

title: Analog Devices AD7768-1 ADC family

maintainers:
  - Michael Hennerich <michael.hennerich@analog.com>

description: |
  Analog Devices AD7768-1 24-Bit Single Channel Low Power sigma-delta ADC family

  https://www.analog.com/media/en/technical-documentation/data-sheets/ad7768-1.pdf
  https://www.analog.com/media/en/technical-documentation/data-sheets/adaq7767-1.pdf
  https://www.analog.com/media/en/technical-documentation/data-sheets/adaq7768-1.pdf
  https://www.analog.com/media/en/technical-documentation/data-sheets/adaq7769-1.pdf

properties:
  compatible:
    enum:
      - adi,ad7768-1
      - adi,adaq7767-1
      - adi,adaq7768-1
      - adi,adaq7769-1

  reg:
    maxItems: 1

  clocks:
    maxItems: 1

  clock-names:
    const: mclk

  trigger-sources:
    $ref: /schemas/types.yaml#/definitions/phandle-array
    minItems: 1
    maxItems: 2
    description: |
      A list of phandles referencing trigger source providers. Each entry
      represents a trigger source for the ADC:

        - First entry specifies the device responsible for driving the
          synchronization (SYNC_IN) pin, as an alternative to adi,sync-in-gpios.
          This can be a `gpio-trigger` or another `ad7768-1` device. If the
          device's own SYNC_OUT pin is internally connected to its SYNC_IN pin,
          reference the device itself or omit this property.
        - Second entry optionally defines a GPIO3 pin used as a START signal trigger.

      Use the accompanying trigger source cell to identify the type of each entry.

  interrupts:
    description:
      DRDY (Data Ready) pin, which signals conversion results are available.
    maxItems: 1

  '#address-cells':
    const: 1

  '#size-cells':
    const: 0

  vref-supply:
    description:
      ADC reference voltage supply

  adi,aaf-gain-bp:
    description: |
       Specifies the gain applied by the Analog Anti-Aliasing Filter (AAF)
       to the ADC input in basis points (one hundredth of a percent).
       The hardware gain is determined by which input pin(s) the signal goes
       through into the AAF. The possible connections are:
       * For the ADAQ7767-1: Input connected to IN1±, IN2± or IN3±.
       * For the ADAQ7769-1: OUT_PGA pin connected to IN1_AAF+, IN2_AAF+,
         or IN3_AAF+.
    enum: [1430, 3640, 10000]
    default: 10000

  pga-gpios:
    description:
      GAIN 0, GAIN1 and GAIN2 pins for gain selection. For devices that have
      PGA configuration input pins, pga-gpios must be defined.
    minItems: 3
    maxItems: 3

  adi,sync-in-gpios:
    maxItems: 1
    description:
      Enables synchronization of multiple devices that require simultaneous
      sampling. A pulse is always required if the configuration is changed
      in any way, for example if the filter decimation rate changes.
      As the line is active low, it should be marked GPIO_ACTIVE_LOW.

  regulators:
    type: object
    description:
      list of regulators provided by this controller.

    properties:
      vcm-output:
        $ref: /schemas/regulator/regulator.yaml#
        type: object
        unevaluatedProperties: false

    additionalProperties: false

  reset-gpios:
    maxItems: 1

  spi-cpol: true

  spi-cpha: true

  "#io-channel-cells":
    const: 1

  "#trigger-source-cells":
    description: |
      Cell indicates the trigger output signal: 0 = SYNC_OUT, 1 = GPIO3,
      2 = DRDY.

      For better readability, macros for these values are available in
      dt-bindings/iio/adc/adi,ad7768-1.h.
    const: 1

  gpio-controller: true

  "#gpio-cells":
    const: 2
    description: |
      The first cell is for the GPIO number: 0 to 3.
      The second cell takes standard GPIO flags.

required:
  - compatible
  - reg
  - clocks
  - clock-names
  - vref-supply
  - spi-cpol
  - spi-cpha

dependencies:
  adi,sync-in-gpios:
    not:
      required:
        - trigger-sources
  trigger-sources:
    not:
      required:
        - adi,sync-in-gpios

patternProperties:
  "^channel@([0-9]|1[0-5])$":
    type: object
    description: |
      Represents the external channels which are connected to the device.

    properties:
      reg:
        maxItems: 1
        description: |
          The channel number.

      label:
        description: |
          Unique name to identify which channel this is.
    required:
      - reg
    additionalProperties: false

allOf:
  - $ref: /schemas/spi/spi-peripheral-props.yaml#

  # AAF Gain property only applies to ADAQ7767-1 and ADAQ7769-1 devices
  - if:
      properties:
        compatible:
          contains:
            enum:
              - adi,adaq7767-1
              - adi,adaq7769-1
    then:
      required:
        - adi,aaf-gain-bp
    else:
      properties:
        adi,aaf-gain-bp: false

  - if:
      properties:
        compatible:
          contains:
            enum:
              - adi,adaq7768-1
              - adi,adaq7769-1
    then:
      required:
        - pga-gpios
    else:
      properties:
        pga-gpios: false

unevaluatedProperties: false

examples:
  - |
    #include <dt-bindings/interrupt-controller/irq.h>
    #include <dt-bindings/gpio/gpio.h>
    spi {
        #address-cells = <1>;
        #size-cells = <0>;

        adc@0 {
            compatible = "adi,ad7768-1";
            reg = <0>;
            spi-max-frequency = <2000000>;
            spi-cpol;
            spi-cpha;
            gpio-controller;
            #gpio-cells = <2>;
            vref-supply = <&adc_vref>;
            interrupts = <25 IRQ_TYPE_EDGE_RISING>;
            interrupt-parent = <&gpio>;
            adi,sync-in-gpios = <&gpio 22 GPIO_ACTIVE_LOW>;
            reset-gpios = <&gpio 27 GPIO_ACTIVE_LOW>;
            clocks = <&ad7768_mclk>;
            clock-names = "mclk";

            #address-cells = <1>;
            #size-cells = <0>;

            channel@0 {
                reg = <0>;
                label = "channel_0";
            };

            regulators {
              vcm_reg: vcm-output {
                regulator-name = "ad7768-1-vcm";
              };
            };
        };
    };
...
```

## Documentation/devicetree/bindings/iio/adc/adi,ad7779.yaml
```yaml
# SPDX-License-Identifier: (GPL-2.0-only OR BSD-2-Clause)
%YAML 1.2
---
$id: http://devicetree.org/schemas/iio/adc/adi,ad7779.yaml#
$schema: http://devicetree.org/meta-schemas/core.yaml#

title: Analog Devices AD777X family 8-Channel, 24-Bit, Simultaneous Sampling ADCs

maintainers:
  - Ramona Nechita <ramona.nechita@analog.com>

description: |
  The AD777X family consist of 8-channel, simultaneous sampling analog-to-
  digital converter (ADC). Eight full Σ-Δ ADCs are on-chip. The
  AD7771 provides an ultralow input current to allow direct sensor
  connection. Each input channel has a programmable gain stage
  allowing gains of 1, 2, 4, and 8 to map lower amplitude sensor
  outputs into the full-scale ADC input range, maximizing the
  dynamic range of the signal chain.

  https://www.analog.com/media/en/technical-documentation/data-sheets/ad7770.pdf
  https://www.analog.com/media/en/technical-documentation/data-sheets/ad7771.pdf
  https://www.analog.com/media/en/technical-documentation/data-sheets/ad7779.pdf

$ref: /schemas/spi/spi-peripheral-props.yaml#

properties:
  compatible:
    enum:
      - adi,ad7770
      - adi,ad7771
      - adi,ad7779

  reg:
    maxItems: 1

  '#address-cells':
    const: 1

  '#size-cells':
    const: 0

  clocks:
    maxItems: 1

  avdd1-supply:
    description: Front-End analog supply AVDD1. Can be used as conversion ref.

  avdd2-supply:
    description: AVDD2 Analog Supply from 2.2 V to 3.6 V.

  avdd4-supply:
    description: AVDD4 SAR Analog Supply and Reference Source.

  interrupts:
    minItems: 1
    items:
      - description: |
          adc_rdy: Interrupt line for DRDY signal which indicates the end of
          conversion independently of the interface selected to read back the
          Σ-∆ conversion.
      - description: |
          Alert: The chip includes self diagnostic features to guarantee the
          correct operation. If an error is detected, the ALERT pin is pulled
          high to generate an external interruption to the controller.

  interrupt-names:
    minItems: 1
    maxItems: 2
    items:
      enum:
        - adc_rdy
        - alert

  start-gpios:
    description:
      Pin that controls start synchronization pulse.
    maxItems: 1

  reset-gpios:
    maxItems: 1

required:
  - compatible
  - reg
  - clocks
  - interrupts

unevaluatedProperties: false

examples:
  - |
    #include <dt-bindings/gpio/gpio.h>
    #include <dt-bindings/interrupt-controller/irq.h>
    spi {
        #address-cells = <1>;
        #size-cells = <0>;

        adc@0 {
          compatible = "adi,ad7779";
          reg = <0>;
          start-gpios = <&gpio0 87 GPIO_ACTIVE_LOW>;
          reset-gpios = <&gpio0 93 GPIO_ACTIVE_LOW>;
          interrupt-parent = <&intc>;
          interrupts = <0 56 IRQ_TYPE_LEVEL_HIGH>;
          interrupt-names = "adc_rdy";
          clocks = <&adc_clk>;
        };
    };
...
```
