## Documentation/devicetree/bindings/iio/adc/adi,ad799x.yaml
```yaml
# SPDX-License-Identifier: GPL-2.0
%YAML 1.2
---
$id: http://devicetree.org/schemas/iio/adc/adi,ad799x.yaml#
$schema: http://devicetree.org/meta-schemas/core.yaml#

title: Analog Devices AD799x analog to digital converters

maintainers:
  - Michael Hennerich <Michael.Hennerich@analog.com>

description: |
    Support for Analog Devices AD7991, AD7992, AD7993, AD7994, AD7995, AD7997, AD7998,
    AD7999 and similar analog to digital converters.
    Specifications on the converters can be found at:
    AD7991, AD7995, AD7999:
      https://www.analog.com/media/en/technical-documentation/data-sheets/AD7991_7995_7999.pdf
    AD7992:
      https://www.analog.com/media/en/technical-documentation/data-sheets/AD7992.pdf
    AD7993, AD7994:
      https://www.analog.com/media/en/technical-documentation/data-sheets/AD7993_7994.pdf
    AD7997, AD7998:
      https://www.analog.com/media/en/technical-documentation/data-sheets/AD7997_7998.pdf

properties:
  compatible:
    enum:
      - adi,ad7991
      - adi,ad7992
      - adi,ad7993
      - adi,ad7994
      - adi,ad7995
      - adi,ad7997
      - adi,ad7998
      - adi,ad7999

  reg:
    maxItems: 1

  interrupts:
    maxItems: 1

  vcc-supply:
    description:
      ADC power supply

  vref-supply:
    description:
      ADC reference voltage supply, optional for AD7991, AD7995 and AD7999

required:
  - compatible
  - reg

additionalProperties: false

examples:
  - |
    i2c {
      #address-cells = <1>;
      #size-cells = <0>;

       adc1: adc@28 {
               reg = <0x28>;
               compatible = "adi,ad7991";
               interrupts = <13 2>;
               interrupt-parent = <&gpio6>;

               vcc-supply = <&vcc_3v3>;
               vref-supply = <&adc_vref>;
        };
    };
...
```

## Documentation/devicetree/bindings/iio/adc/adi,ad9467.yaml
```yaml
# SPDX-License-Identifier: (GPL-2.0-only OR BSD-2-Clause)
%YAML 1.2
---
$id: http://devicetree.org/schemas/iio/adc/adi,ad9467.yaml#
$schema: http://devicetree.org/meta-schemas/core.yaml#

title: Analog Devices AD9467 and similar High-Speed ADCs

maintainers:
  - Michael Hennerich <michael.hennerich@analog.com>

description: |
  The AD9467 and the parts similar with it, are high-speed analog-to-digital
  converters (ADCs), operating in the range of 100 to 500 mega samples
  per second (MSPS). Some parts support higher MSPS and some
  lower MSPS, suitable for the intended application of each part.

  All the parts support the register map described by Application Note AN-877
   https://www.analog.com/media/en/technical-documentation/application-notes/AN-877.pdf

  https://www.analog.com/media/en/technical-documentation/data-sheets/AD9265.pdf
  https://www.analog.com/media/en/technical-documentation/data-sheets/AD9434.pdf
  https://www.analog.com/media/en/technical-documentation/data-sheets/AD9467.pdf

properties:
  compatible:
    enum:
      - adi,ad9265
      - adi,ad9434
      - adi,ad9467

  reg:
    maxItems: 1

  clocks:
    maxItems: 1

  clock-names:
    items:
      - const: adc-clk

  powerdown-gpios:
    description:
      Pin that controls the powerdown mode of the device.
    maxItems: 1

  reset-gpios:
    description:
      Reset pin for the device.
    maxItems: 1

required:
  - compatible
  - reg
  - clocks
  - clock-names

additionalProperties: false

examples:
  - |
    spi {
        #address-cells = <1>;
        #size-cells = <0>;

        adc@0 {
            compatible = "adi,ad9467";
            reg = <0>;
            clocks = <&adc_clk>;
            clock-names = "adc-clk";
        };
    };
...
```

## Documentation/devicetree/bindings/iio/adc/adi,ade9000.yaml
```yaml
# SPDX-License-Identifier: (GPL-2.0 OR BSD-2-Clause)
# Copyright 2025 Analog Devices Inc.
%YAML 1.2
---
$id: http://devicetree.org/schemas/iio/adc/adi,ade9000.yaml#
$schema: http://devicetree.org/meta-schemas/core.yaml#

title: Analog Devices ADE9000 High Performance, Polyphase Energy Metering

maintainers:
  - Antoniu Miclaus <antoniu.miclaus@analog.com>

description: |
  The ADE9000 is a highly accurate, fully integrated, multiphase energy and power
  quality monitoring device. Superior analog performance and a digital signal
  processing (DSP) core enable accurate energy monitoring over a wide dynamic
  range. An integrated high end reference ensures low drift over temperature
  with a combined drift of less than ±25 ppm/°C maximum for the entire channel
  including a programmable gain amplifier (PGA) and an analog-to-digital
  converter (ADC).

  https://www.analog.com/media/en/technical-documentation/data-sheets/ADE9000.pdf

$ref: /schemas/spi/spi-peripheral-props.yaml#

properties:
  compatible:
    enum:
      - adi,ade9000

  reg:
    maxItems: 1

  spi-max-frequency:
    maximum: 20000000

  interrupts:
    maxItems: 3

  interrupt-names:
    items:
      enum: [irq0, irq1, dready]
    minItems: 1
    maxItems: 3

  reset-gpios:
    description:
      Must be the device tree identifier of the RESET pin. As the line is
      active low, it should be marked GPIO_ACTIVE_LOW.
    maxItems: 1

  vdd-supply: true

  vref-supply: true

  clocks:
    description: External clock source when not using crystal
    maxItems: 1


  "#clock-cells":
    description:
      ADE9000 can provide clock output via CLKOUT pin with external buffer.
    const: 0

required:
  - compatible
  - reg
  - vdd-supply

unevaluatedProperties: false

examples:
  - |
    #include <dt-bindings/gpio/gpio.h>
    #include <dt-bindings/interrupt-controller/irq.h>

    spi {
      #address-cells = <1>;
      #size-cells = <0>;

      adc@0 {
          compatible = "adi,ade9000";
          reg = <0>;
          spi-max-frequency = <7000000>;

          #clock-cells = <0>;
          reset-gpios = <&gpio 4 GPIO_ACTIVE_LOW>;
          interrupts = <2 IRQ_TYPE_EDGE_FALLING>, <3 IRQ_TYPE_EDGE_FALLING>, <4 IRQ_TYPE_EDGE_FALLING>;
          interrupt-names = "irq0", "irq1", "dready";
          interrupt-parent = <&gpio>;
          clocks = <&ext_clock_24576khz>;
          vdd-supply = <&vdd_reg>;
      };
    };
```

## Documentation/devicetree/bindings/iio/adc/adi,axi-adc.yaml
```yaml
# SPDX-License-Identifier: (GPL-2.0-only OR BSD-2-Clause)
%YAML 1.2
---
$id: http://devicetree.org/schemas/iio/adc/adi,axi-adc.yaml#
$schema: http://devicetree.org/meta-schemas/core.yaml#

title: Analog Devices AXI ADC IP core

maintainers:
  - Michael Hennerich <michael.hennerich@analog.com>

description: |
  Analog Devices Generic AXI ADC IP core for interfacing an ADC device
  with a high speed serial (JESD204B/C) or source synchronous parallel
  interface (LVDS/CMOS).
  Usually, some other interface type (i.e SPI) is used as a control
  interface for the actual ADC, while this IP core will interface
  to the data-lines of the ADC and handle the streaming of data into
  memory via DMA.
  In some cases, the AXI ADC interface is used to perform specialized
  operation to a particular ADC, e.g access the physical bus through
  specific registers to write ADC registers.
  In this case, we use a different compatible which indicates the target
  IP core's name.
  The following IP is currently supported:
    - AXI AD7606x: specialized version of the IP core for all the chips from
      the ad7606 family.

  https://wiki.analog.com/resources/fpga/docs/axi_adc_ip
  https://analogdevicesinc.github.io/hdl/library/axi_ad408x/index.html
  https://analogdevicesinc.github.io/hdl/library/axi_ad485x/index.html
  http://analogdevicesinc.github.io/hdl/library/axi_ad7606x/index.html

properties:
  compatible:
    enum:
      - adi,axi-adc-10.0.a
      - adi,axi-ad408x
      - adi,axi-ad7606x
      - adi,axi-ad485x

  reg:
    maxItems: 1

  clocks:
    maxItems: 1

  dmas:
    maxItems: 1

  dma-names:
    items:
      - const: rx

  adi,adc-dev:
    $ref: /schemas/types.yaml#/definitions/phandle
    description:
      A reference to a the actual ADC to which this FPGA ADC interfaces to.
    deprecated: true

  '#io-backend-cells':
    const: 0

  '#address-cells':
    const: 1

  '#size-cells':
    const: 0

patternProperties:
  "^adc@[0-9a-f]+$":
    type: object
    properties:
      reg:
        maxItems: 1
    additionalProperties: true
    required:
      - compatible
      - reg

required:
  - compatible
  - dmas
  - reg
  - clocks

allOf:
  - if:
      properties:
        compatible:
          not:
            contains:
              const: adi,axi-ad7606x
    then:
      properties:
        '#address-cells': false
        '#size-cells': false
      patternProperties:
        "^adc@[0-9a-f]+$": false

additionalProperties: false

examples:
  - |
    adc@44a00000 {
        compatible = "adi,axi-adc-10.0.a";
        reg = <0x44a00000 0x10000>;
        dmas = <&rx_dma 0>;
        dma-names = "rx";
        clocks = <&axi_clk>;
        #io-backend-cells = <0>;
    };
  - |
    #include <dt-bindings/gpio/gpio.h>
    parallel_bus_controller@44a00000 {
        compatible = "adi,axi-ad7606x";
        reg = <0x44a00000 0x10000>;
        dmas = <&rx_dma 0>;
        dma-names = "rx";
        clocks = <&ext_clk>;
        #address-cells = <1>;
        #size-cells = <0>;

        adc@0 {
            compatible = "adi,ad7606b";
            reg = <0>;
            pwms = <&axi_pwm_gen 0 0>;
            pwm-names = "convst1";
            avcc-supply = <&adc_vref>;
            vdrive-supply = <&vdd_supply>;
            reset-gpios = <&gpio0 91 GPIO_ACTIVE_HIGH>;
            standby-gpios = <&gpio0 90 GPIO_ACTIVE_LOW>;
            adi,range-gpios = <&gpio0 89 GPIO_ACTIVE_HIGH>;
            adi,oversampling-ratio-gpios = <&gpio0 88 GPIO_ACTIVE_HIGH
                            &gpio0 87 GPIO_ACTIVE_HIGH
                            &gpio0 86 GPIO_ACTIVE_HIGH>;
            io-backends = <&parallel_bus_controller>;
        };
    };
...
```

## Documentation/devicetree/bindings/iio/adc/adi,max11410.yaml
```yaml
# SPDX-License-Identifier: (GPL-2.0 OR BSD-2-Clause)
# Copyright 2022 Analog Devices Inc.
%YAML 1.2
---
$id: http://devicetree.org/schemas/iio/adc/adi,max11410.yaml#
$schema: http://devicetree.org/meta-schemas/core.yaml#

title: Analog Devices MAX11410 ADC device driver

maintainers:
  - Ibrahim Tilki <Ibrahim.Tilki@analog.com>

description: |
  Bindings for the Analog Devices MAX11410 ADC device. Datasheet can be
  found here:
    https://datasheets.maximintegrated.com/en/ds/MAX11410.pdf

properties:
  compatible:
    enum:
      - adi,max11410

  reg:
    maxItems: 1

  interrupts:
    minItems: 1
    maxItems: 2

  interrupt-names:
    description: Name of the gpio pin of max11410 used for IRQ
    minItems: 1
    items:
      - enum: [gpio0, gpio1]
      - const: gpio1

  '#address-cells':
    const: 1

  '#size-cells':
    const: 0

  avdd-supply:
    description: Optional avdd supply. Used as reference when no explicit reference supplied.

  vref0p-supply:
    description: vref0p supply can be used as reference for conversion.

  vref1p-supply:
    description: vref1p supply can be used as reference for conversion.

  vref2p-supply:
    description: vref2p supply can be used as reference for conversion.

  vref0n-supply:
    description: vref0n supply can be used as reference for conversion.

  vref1n-supply:
    description: vref1n supply can be used as reference for conversion.

  vref2n-supply:
    description: vref2n supply can be used as reference for conversion.

  spi-max-frequency:
    maximum: 8000000

patternProperties:
  "^channel(@[0-9])?$":
    $ref: adc.yaml
    type: object
    description: Represents the external channels which are connected to the ADC.

    properties:
      reg:
        description: The channel number in single-ended mode.
        minimum: 0
        maximum: 9

      adi,reference:
        description: |
          Select the reference source to use when converting on
          the specific channel. Valid values are:
          0: VREF0P/VREF0N
          1: VREF1P/VREF1N
          2: VREF2P/VREF2N
          3: AVDD/AGND
          4: VREF0P/AGND
          5: VREF1P/AGND
          6: VREF2P/AGND
          If this field is left empty, AVDD/AGND is selected.
        $ref: /schemas/types.yaml#/definitions/uint32
        enum: [0, 1, 2, 3, 4, 5, 6]
        default: 3

      adi,input-mode:
        description: |
          Select signal path of input channels. Valid values are:
          0: Buffered, low-power, unity-gain path (default)
          1: Bypass path
          2: PGA path
        $ref: /schemas/types.yaml#/definitions/uint32
        enum: [0, 1, 2]
        default: 0

      diff-channels: true

      bipolar: true

      settling-time-us: true

      adi,buffered-vrefp:
        description: Enable buffered mode for positive reference.
        type: boolean

      adi,buffered-vrefn:
        description: Enable buffered mode for negative reference.
        type: boolean

    required:
      - reg

    additionalProperties: false

required:
  - compatible
  - reg

allOf:
  - $ref: /schemas/spi/spi-peripheral-props.yaml#

unevaluatedProperties: false

examples:
  - |
    #include <dt-bindings/interrupt-controller/irq.h>
    spi {
        #address-cells = <1>;
        #size-cells = <0>;

        adc@0 {
            reg = <0>;
            compatible = "adi,max11410";
            spi-max-frequency = <8000000>;

            interrupt-parent = <&gpio>;
            interrupts = <25 IRQ_TYPE_EDGE_FALLING>;
            interrupt-names = "gpio1";

            avdd-supply = <&adc_avdd>;

            vref1p-supply = <&adc_vref1p>;
            vref1n-supply = <&adc_vref1n>;

            #address-cells = <1>;
            #size-cells = <0>;

            channel@0 {
                reg = <0>;
            };

            channel@1 {
                reg = <1>;
                diff-channels = <2 3>;
                adi,reference = <1>;
                bipolar;
                settling-time-us = <100000>;
            };

            channel@2 {
                reg = <2>;
                diff-channels = <7 9>;
                adi,reference = <5>;
                adi,input-mode = <2>;
                settling-time-us = <50000>;
            };
        };
    };
```
