## Documentation/devicetree/bindings/iio/adc/adi,ad7292.yaml
```yaml
# SPDX-License-Identifier: (GPL-2.0-only OR BSD-2-Clause)
%YAML 1.2
---
$id: http://devicetree.org/schemas/iio/adc/adi,ad7292.yaml#
$schema: http://devicetree.org/meta-schemas/core.yaml#

title: Analog Devices AD7292 10-Bit Monitor and Control System

maintainers:
  - Marcelo Schmitt <marcelo.schmitt1@gmail.com>

description: |
  Analog Devices AD7292 10-Bit Monitor and Control System with ADC, DACs,
  Temperature Sensor, and GPIOs

  Specifications about the part can be found at:
    https://www.analog.com/media/en/technical-documentation/data-sheets/ad7292.pdf

properties:
  compatible:
    enum:
      - adi,ad7292

  reg:
    maxItems: 1

  vref-supply:
    description: |
      The regulator supply for ADC and DAC reference voltage.

  spi-cpha: true

  spi-max-frequency: true

  '#address-cells':
    const: 1

  '#size-cells':
    const: 0

required:
  - compatible
  - reg
  - spi-cpha

patternProperties:
  "^channel@[0-7]$":
    type: object
    description: |
      Represents the external channels which are connected to the ADC.
      See Documentation/devicetree/bindings/iio/adc/adc.txt.

    properties:
      reg:
        description: |
          The channel number. It can have up to 8 channels numbered from 0 to 7.
        items:
          - minimum: 0
            maximum: 7

      diff-channels:
        description: see Documentation/devicetree/bindings/iio/adc/adc.txt
        maxItems: 1

    required:
      - reg

additionalProperties: false

examples:
  - |
    spi {
      #address-cells = <1>;
      #size-cells = <0>;

      ad7292: adc@0 {
        compatible = "adi,ad7292";
        reg = <0>;
        spi-max-frequency = <25000000>;
        vref-supply = <&adc_vref>;
        spi-cpha;

        #address-cells = <1>;
        #size-cells = <0>;

        channel@0 {
          reg = <0>;
          diff-channels = <0 1>;
        };
        channel@2 {
          reg = <2>;
        };
        channel@3 {
          reg = <3>;
        };
        channel@4 {
          reg = <4>;
        };
        channel@5 {
          reg = <5>;
        };
        channel@6 {
          reg = <6>;
        };
        channel@7 {
          reg = <7>;
        };
      };
    };
```

## Documentation/devicetree/bindings/iio/adc/adi,ad7298.yaml
```yaml
# SPDX-License-Identifier: (GPL-2.0 OR BSD-2-Clause)
# Copyright 2019 Analog Devices Inc.
%YAML 1.2
---
$id: http://devicetree.org/schemas/iio/adc/adi,ad7298.yaml#
$schema: http://devicetree.org/meta-schemas/core.yaml#

title: Analog Devices AD7298 ADC

maintainers:
  - Michael Hennerich <michael.hennerich@analog.com>

description: |
  Bindings for the Analog Devices AD7298 ADC device. Datasheet can be
  found here:
    https://www.analog.com/en/products/ad7298.html

properties:
  compatible:
    const: adi,ad7298

  reg:
    maxItems: 1

  vref-supply: true
  vdd-supply: true
  spi-max-frequency: true

required:
  - compatible
  - reg

additionalProperties: false

examples:
  - |
    spi {
      #address-cells = <1>;
      #size-cells = <0>;

      adc@0 {
        compatible = "adi,ad7298";
        reg = <0>;
        spi-max-frequency = <5000000>;
        vref-supply = <&adc_vref>;
      };
    };
...
```

## Documentation/devicetree/bindings/iio/adc/adi,ad7380.yaml
```yaml
# SPDX-License-Identifier: (GPL-2.0-only OR BSD-2-Clause)
%YAML 1.2
---
$id: http://devicetree.org/schemas/iio/adc/adi,ad7380.yaml#
$schema: http://devicetree.org/meta-schemas/core.yaml#

title: Analog Devices Simultaneous Sampling Analog to Digital Converters

maintainers:
  - Michael Hennerich <Michael.Hennerich@analog.com>
  - Nuno Sá <nuno.sa@analog.com>

description: |
  * https://www.analog.com/en/products/ad7380.html
  * https://www.analog.com/en/products/ad7381.html
  * https://www.analog.com/en/products/ad7383.html
  * https://www.analog.com/en/products/ad7384.html
  * https://www.analog.com/en/products/ad7386.html
  * https://www.analog.com/en/products/ad7387.html
  * https://www.analog.com/en/products/ad7388.html
  * https://www.analog.com/en/products/ad7380-4.html
  * https://www.analog.com/en/products/ad7381-4.html
  * https://www.analog.com/en/products/ad7383-4.html
  * https://www.analog.com/en/products/ad7384-4.html
  * https://www.analog.com/en/products/ad7386-4.html
  * https://www.analog.com/en/products/ad7387-4.html
  * https://www.analog.com/en/products/ad7388-4.html
  * https://www.analog.com/en/products/adaq4370-4.html
  * https://www.analog.com/en/products/adaq4380-4.html
  * https://www.analog.com/en/products/adaq4381-4.html


$ref: /schemas/spi/spi-peripheral-props.yaml#

properties:
  compatible:
    enum:
      - adi,ad7380
      - adi,ad7381
      - adi,ad7383
      - adi,ad7384
      - adi,ad7386
      - adi,ad7387
      - adi,ad7388
      - adi,ad7380-4
      - adi,ad7381-4
      - adi,ad7383-4
      - adi,ad7384-4
      - adi,ad7386-4
      - adi,ad7387-4
      - adi,ad7388-4
      - adi,adaq4370-4
      - adi,adaq4380-4
      - adi,adaq4381-4

  reg:
    maxItems: 1

  spi-max-frequency:
    maximum: 80000000
  spi-cpol: true
  spi-cpha: true

  vcc-supply:
    description: A 3V to 3.6V supply that powers the chip.

  vlogic-supply:
    description:
      A 1.65V to 3.6V supply for the logic pins.

  refio-supply:
    description:
      A 2.5V to 3.3V supply for the external reference voltage. When omitted,
      the internal 2.5V reference is used.

  refin-supply:
    description:
      A 2.5V to 3.3V supply for external reference voltage, for ad7380-4 only.
      For adaq devices, a 5V supply voltage. A 3.3V internal reference is
      derived from it. Connect to vs-p-supply for normal operation.

  vs-p-supply:
    description:
      Amplifiers positive supply.

  vs-n-supply:
    description:
      Amplifiers negative supply.

  ldo-supply:
    description:
      LDO supply. Connect to vs-p-supply or a 3.6 to 5.5 V supply.

  aina-supply:
    description:
      The common mode voltage supply for the AINA- pin on pseudo-differential
      chips.

  ainb-supply:
    description:
      The common mode voltage supply for the AINB- pin on pseudo-differential
      chips.

  ainc-supply:
    description:
      The common mode voltage supply for the AINC- pin on pseudo-differential
      chips.

  aind-supply:
    description:
      The common mode voltage supply for the AIND- pin on pseudo-differential
      chips.

  interrupts:
    description:
      When the device is using 1-wire mode, this property is used to optionally
      specify the ALERT interrupt.
    maxItems: 1

  "#address-cells":
    const: 1

  "#size-cells":
    const: 0

required:
  - compatible
  - reg
  - vcc-supply
  - vlogic-supply

patternProperties:
  "^channel@[0-3]$":
    $ref: adc.yaml
    type: object

    properties:
      reg:
        description:
          The channel number. From 0 to 3 corresponding to channels A,B,C,D
        minimum: 0
        maximum: 3

      adi,gain-milli:
        description:
          The hardware gain applied to the ADC input (in milli units).
          If not present, default to 1000 (no actual gain applied).
          Refer to the typical connection diagrams section of the datasheet for
          pin wiring.
        $ref: /schemas/types.yaml#/definitions/uint16
        enum: [300, 600, 1000, 1600]
        default: 1000

    required:
      - reg

    additionalProperties: false

unevaluatedProperties: false

allOf:
  # pseudo-differential chips require common mode voltage supplies,
  # true differential chips don't use them
  - if:
      properties:
        compatible:
          enum:
            - adi,ad7383
            - adi,ad7384
            - adi,ad7383-4
            - adi,ad7384-4
    then:
      required:
        - aina-supply
        - ainb-supply
    else:
      properties:
        aina-supply: false
        ainb-supply: false
  - if:
      properties:
        compatible:
          enum:
            - adi,ad7383-4
            - adi,ad7384-4
    then:
      required:
        - ainc-supply
        - aind-supply
    else:
      properties:
        ainc-supply: false
        aind-supply: false

  # ad7380-4 uses refin-supply as external reference.
  # adaq devices use internal reference only, derived from refin-supply
  # All other chips from ad738x family use refio as optional external reference.
  # When refio-supply is omitted, internal reference is used.
  - if:
      properties:
        compatible:
          enum:
            - adi,ad7380-4
            - adi,adaq4370-4
            - adi,adaq4380-4
            - adi,adaq4381-4
    then:
      properties:
        refio-supply: false
      required:
        - refin-supply
    else:
      properties:
        refin-supply: false

  # adaq devices need more supplies and using channel to declare gain property
  # only applies to adaq devices
  - if:
      properties:
        compatible:
          enum:
            - adi,adaq4370-4
            - adi,adaq4380-4
            - adi,adaq4381-4
    then:
      required:
        - vs-p-supply
        - vs-n-supply
        - ldo-supply
    else:
      properties:
        vs-p-supply: false
        vs-n-supply: false
        ldo-supply: false
      patternProperties:
        "^channel@[0-3]$": false

examples:
  - |
    #include <dt-bindings/interrupt-controller/irq.h>

    spi {
        #address-cells = <1>;
        #size-cells = <0>;

        adc@0 {
            compatible = "adi,ad7380";
            reg = <0>;

            spi-cpol;
            spi-cpha;
            spi-max-frequency = <80000000>;

            interrupts = <27 IRQ_TYPE_EDGE_FALLING>;
            interrupt-parent = <&gpio0>;

            vcc-supply = <&supply_3_3V>;
            vlogic-supply = <&supply_3_3V>;
            refio-supply = <&supply_2_5V>;
        };
    };

  - |
    #include <dt-bindings/interrupt-controller/irq.h>

    spi {
        #address-cells = <1>;
        #size-cells = <0>;

        adc@0 {
            compatible = "adi,adaq4380-4";
            reg = <0>;

            spi-cpol;
            spi-cpha;
            spi-max-frequency = <80000000>;

            interrupts = <27 IRQ_TYPE_EDGE_FALLING>;
            interrupt-parent = <&gpio0>;

            vcc-supply = <&supply_3_3V>;
            vlogic-supply = <&supply_3_3V>;
            refin-supply = <&supply_5V>;
            vs-p-supply = <&supply_5V>;
            vs-n-supply = <&supply_0V>;
            ldo-supply = <&supply_5V>;

            #address-cells = <1>;
            #size-cells = <0>;

            channel@0 {
                reg = <0>;
                adi,gain-milli = /bits/ 16 <300>;
            };

            channel@2 {
                reg = <2>;
                adi,gain-milli = /bits/ 16 <600>;
            };

            channel@3 {
                reg = <3>;
                adi,gain-milli = /bits/ 16 <1000>;
            };
        };
    };
```

## Documentation/devicetree/bindings/iio/adc/adi,ad7405.yaml
```yaml
# SPDX-License-Identifier: (GPL-2.0-only OR BSD-2-Clause)
# Copyright 2025 Analog Devices Inc.
%YAML 1.2
---
$id: http://devicetree.org/schemas/iio/adc/adi,ad7405.yaml#
$schema: http://devicetree.org/meta-schemas/core.yaml#

title: Analog Devices AD7405 family

maintainers:
  - Dragos Bogdan <dragos.bogdan@analog.com>
  - Pop Ioan Daniel <pop.ioan-daniel@analog.com>

description: |
  Analog Devices AD7405 is a high performance isolated ADC, 1-channel,
  16-bit with a second-order Σ-Δ modulator that converts an analog input signal
  into a high speed, single-bit data stream.

  https://www.analog.com/media/en/technical-documentation/data-sheets/ad7405.pdf
  https://www.analog.com/media/en/technical-documentation/data-sheets/adum7701.pdf
  https://www.analog.com/media/en/technical-documentation/data-sheets/adum7702.pdf
  https://www.analog.com/media/en/technical-documentation/data-sheets/ADuM7703.pdf

properties:
  compatible:
    enum:
      - adi,ad7405
      - adi,adum7701
      - adi,adum7702
      - adi,adum7703

  clocks:
    maxItems: 1

  vdd1-supply: true

  vdd2-supply: true

  io-backends:
    maxItems: 1

required:
  - compatible
  - clocks
  - vdd1-supply
  - vdd2-supply
  - io-backends

additionalProperties: false

examples:
  - |
    adc {
        compatible = "adi,ad7405";
        clocks = <&axi_clk_gen 0>;
        vdd1-supply = <&vdd1>;
        vdd2-supply = <&vdd2>;
        io-backends = <&axi_adc>;
    };
...
```
