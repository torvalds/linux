## Documentation/devicetree/bindings/iio/adc/adi,max14001.yaml
```yaml
# SPDX-License-Identifier: (GPL-2.0 OR BSD-2-Clause)
# Copyright 2023-2025 Analog Devices Inc.
# Copyright 2023 Kim Seer Paller
# Copyright 2025 Marilene Andrade Garcia
%YAML 1.2
---
$id: http://devicetree.org/schemas/iio/adc/adi,max14001.yaml#
$schema: http://devicetree.org/meta-schemas/core.yaml#

title: Analog Devices MAX14001-MAX14002 ADC

maintainers:
  - Kim Seer Paller <kimseer.paller@analog.com>
  - Marilene Andrade Garcia <marilene.agarcia@gmail.com>

description: |
    Single channel 10 bit ADC with SPI interface.
    Datasheet can be found here
      https://www.analog.com/media/en/technical-documentation/data-sheets/MAX14001-MAX14002.pdf

$ref: /schemas/spi/spi-peripheral-props.yaml#

properties:
  compatible:
    oneOf:
      - const: adi,max14002
      - items:
          - const: adi,max14001
          - const: adi,max14002

  reg:
    maxItems: 1

  spi-max-frequency:
    maximum: 5000000

  vdd-supply:
    description:
      Isolated DC-DC power supply input voltage.

  vddl-supply:
    description:
      Logic power supply.

  refin-supply:
    description:
      ADC voltage reference supply.

  interrupts:
    minItems: 1
    items:
      - description: |
          cout: comparator output signal that asserts high on the COUT pin
          when ADC readings exceed the upper threshold and low when readings
          fall below the lower threshold.
      - description: |
          fault: when fault reporting is enabled, the FAULT pin is asserted
          low whenever one of the monitored fault conditions occurs.

  interrupt-names:
    minItems: 1
    items:
      - const: cout
      - const: fault

required:
  - compatible
  - reg
  - vdd-supply
  - vddl-supply

unevaluatedProperties: false

examples:
  - |
    spi {
      #address-cells = <1>;
      #size-cells = <0>;

      adc@0 {
        compatible = "adi,max14001", "adi,max14002";
        reg = <0>;
        spi-max-frequency = <5000000>;
        spi-lsb-first;
        vdd-supply = <&vdd>;
        vddl-supply = <&vddl>;
      };
    };
...
```

## Documentation/devicetree/bindings/iio/adc/allwinner,sun20i-d1-gpadc.yaml
```yaml
# SPDX-License-Identifier: (GPL-2.0-only OR BSD-2-Clause)
%YAML 1.2
---
$id: http://devicetree.org/schemas/iio/adc/allwinner,sun20i-d1-gpadc.yaml#
$schema: http://devicetree.org/meta-schemas/core.yaml#

title: Allwinner D1 General Purpose ADC

maintainers:
  - Maksim Kiselev <bigunclemax@gmail.com>

properties:
  compatible:
    enum:
      - allwinner,sun20i-d1-gpadc

  "#io-channel-cells":
    const: 1

  "#address-cells":
    const: 1

  "#size-cells":
    const: 0

  clocks:
    maxItems: 1

  interrupts:
    maxItems: 1

  reg:
    maxItems: 1

  resets:
    maxItems: 1

patternProperties:
  "^channel@[0-9a-f]+$":
    $ref: adc.yaml
    type: object
    description:
      Represents the internal channels of the ADC.

    properties:
      reg:
        items:
          minimum: 0
          maximum: 15

    required:
      - reg

    unevaluatedProperties: false

required:
  - "#io-channel-cells"
  - clocks
  - compatible
  - interrupts
  - reg
  - resets

additionalProperties: false

examples:
  - |
    #include <dt-bindings/clock/sun20i-d1-ccu.h>
    #include <dt-bindings/reset/sun20i-d1-ccu.h>
    #include <dt-bindings/interrupt-controller/irq.h>

    gpadc: adc@2009000 {
        compatible = "allwinner,sun20i-d1-gpadc";
        reg = <0x2009000 0x400>;
        clocks = <&ccu CLK_BUS_GPADC>;
        resets = <&ccu RST_BUS_GPADC>;
        interrupts = <73 IRQ_TYPE_LEVEL_HIGH>;
        #io-channel-cells = <1>;

        #address-cells = <1>;
        #size-cells = <0>;

        channel@0 {
            reg = <0>;
        };

        channel@1 {
            reg = <1>;
        };
    };
...
```

## Documentation/devicetree/bindings/iio/adc/allwinner,sun8i-a33-ths.yaml
```yaml
# SPDX-License-Identifier: GPL-2.0
%YAML 1.2
---
$id: http://devicetree.org/schemas/iio/adc/allwinner,sun8i-a33-ths.yaml#
$schema: http://devicetree.org/meta-schemas/core.yaml#

title: Allwinner A33 Thermal Sensor Device Tree Bindings

maintainers:
  - Chen-Yu Tsai <wens@csie.org>
  - Maxime Ripard <mripard@kernel.org>

properties:
  "#io-channel-cells":
    const: 0

  "#thermal-sensor-cells":
    const: 0

  compatible:
    const: allwinner,sun8i-a33-ths

  reg:
    maxItems: 1

required:
  - "#io-channel-cells"
  - "#thermal-sensor-cells"
  - compatible
  - reg

additionalProperties: false

examples:
  - |
    ths: ths@1c25000 {
        compatible = "allwinner,sun8i-a33-ths";
        reg = <0x01c25000 0x100>;
        #thermal-sensor-cells = <0>;
        #io-channel-cells = <0>;
    };

...
```

## Documentation/devicetree/bindings/iio/adc/amlogic,meson-saradc.txt
```
* Amlogic Meson SAR (Successive Approximation Register) A/D converter

Required properties:
- compatible:	depending on the SoC this should be one of:
			- "amlogic,meson8-saradc" for Meson8
			- "amlogic,meson8b-saradc" for Meson8b
			- "amlogic,meson8m2-saradc" for Meson8m2
			- "amlogic,meson-gxbb-saradc" for GXBB
			- "amlogic,meson-gxl-saradc" for GXL
			- "amlogic,meson-gxm-saradc" for GXM
			- "amlogic,meson-axg-saradc" for AXG
			- "amlogic,meson-g12a-saradc" for AXG
		along with the generic "amlogic,meson-saradc"
- reg:		the physical base address and length of the registers
- interrupts:	the interrupt indicating end of sampling
- clocks:	phandle and clock identifier (see clock-names)
- clock-names:	mandatory clocks:
			- "clkin" for the reference clock (typically XTAL)
			- "core" for the SAR ADC core clock
		optional clocks:
			- "adc_clk" for the ADC (sampling) clock
			- "adc_sel" for the ADC (sampling) clock mux
- vref-supply:	the regulator supply for the ADC reference voltage
- #io-channel-cells: must be 1, see ../iio-bindings.txt

Optional properties:
- amlogic,hhi-sysctrl:	phandle to the syscon which contains the 5th bit
			of the TSC (temperature sensor coefficient) on
			Meson8b and Meson8m2 (which used to calibrate the
			temperature sensor)
- nvmem-cells:		phandle to the temperature_calib eFuse cells
- nvmem-cell-names:	if present (to enable the temperature sensor
			calibration) this must contain "temperature_calib"


Example:
	saradc: adc@8680 {
		compatible = "amlogic,meson-gxl-saradc", "amlogic,meson-saradc";
		#io-channel-cells = <1>;
		reg = <0x0 0x8680 0x0 0x34>;
		interrupts = <GIC_SPI 73 IRQ_TYPE_EDGE_RISING>;
		clocks = <&xtal>,
			 <&clkc CLKID_SAR_ADC>,
			 <&clkc CLKID_SANA>,
			 <&clkc CLKID_SAR_ADC_CLK>,
			 <&clkc CLKID_SAR_ADC_SEL>;
		clock-names = "clkin", "core", "sana", "adc_clk", "adc_sel";
	};
```
