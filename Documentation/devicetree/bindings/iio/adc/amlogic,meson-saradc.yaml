## Documentation/devicetree/bindings/iio/adc/amlogic,meson-saradc.yaml
```yaml
# SPDX-License-Identifier: (GPL-2.0 OR BSD-2-Clause)
%YAML 1.2
---
$id: http://devicetree.org/schemas/iio/adc/amlogic,meson-saradc.yaml#
$schema: http://devicetree.org/meta-schemas/core.yaml#

title: Amlogic Meson SAR (Successive Approximation Register) A/D converter

maintainers:
  - Martin Blumenstingl <martin.blumenstingl@googlemail.com>

description:
  Binding covers a range of ADCs found on Amlogic Meson SoCs.

properties:
  compatible:
    oneOf:
      - const: amlogic,meson-saradc
      - items:
          - enum:
              - amlogic,meson8-saradc
              - amlogic,meson8b-saradc
              - amlogic,meson8m2-saradc
              - amlogic,meson-gxbb-saradc
              - amlogic,meson-gxl-saradc
              - amlogic,meson-gxm-saradc
              - amlogic,meson-axg-saradc
              - amlogic,meson-g12a-saradc
          - const: amlogic,meson-saradc

  reg:
    maxItems: 1

  interrupts:
    description: Interrupt indicates end of sampling.
    maxItems: 1

  clocks:
    minItems: 2
    maxItems: 4

  clock-names:
    minItems: 2
    items:
      - const: clkin
      - const: core
      - const: adc_clk
      - const: adc_sel

  vref-supply: true

  "#io-channel-cells":
    const: 1

  amlogic,hhi-sysctrl:
    $ref: /schemas/types.yaml#/definitions/phandle
    description:
      Syscon which contains the 5th bit of the TSC (temperature sensor
      coefficient) on Meson8b and Meson8m2 (which used to calibrate the
      temperature sensor)

  nvmem-cells:
    description: phandle to the temperature_calib eFuse cells
    maxItems: 1

  nvmem-cell-names:
    const: temperature_calib

  power-domains:
    maxItems: 1

allOf:
  - if:
      properties:
        compatible:
          contains:
            enum:
              - amlogic,meson8-saradc
              - amlogic,meson8b-saradc
              - amlogic,meson8m2-saradc
    then:
      properties:
        clocks:
          maxItems: 2
        clock-names:
          maxItems: 2
    else:
      properties:
        nvmem-cells: false
        mvmem-cel-names: false
        clocks:
          minItems: 4
        clock-names:
          minItems: 4

  - if:
      properties:
        compatible:
          contains:
            enum:
              - amlogic,meson8b-saradc
              - amlogic,meson8m2-saradc
    then:
      properties:
        amlogic,hhi-sysctrl: true
    else:
      properties:
        amlogic,hhi-sysctrl: false

required:
  - compatible
  - reg
  - interrupts
  - clocks
  - clock-names
  - "#io-channel-cells"

additionalProperties: false

examples:
  - |
    #include <dt-bindings/interrupt-controller/irq.h>
    #include <dt-bindings/clock/gxbb-clkc.h>
    #include <dt-bindings/interrupt-controller/arm-gic.h>
    soc {
        #address-cells = <2>;
        #size-cells = <2>;
        adc@8680 {
            compatible = "amlogic,meson-gxl-saradc", "amlogic,meson-saradc";
            #io-channel-cells = <1>;
            reg = <0x0 0x8680 0x0 0x34>;
            interrupts = <GIC_SPI 73 IRQ_TYPE_EDGE_RISING>;
            clocks = <&xtal>,
                <&clkc CLKID_SAR_ADC>,
                <&clkc CLKID_SAR_ADC_CLK>,
                <&clkc CLKID_SAR_ADC_SEL>;
            clock-names = "clkin", "core", "adc_clk", "adc_sel";
        };
        adc@9680 {
            compatible = "amlogic,meson8b-saradc", "amlogic,meson-saradc";
            #io-channel-cells = <1>;
            reg = <0x0 0x9680 0x0 0x34>;
            interrupts = <GIC_SPI 73 IRQ_TYPE_EDGE_RISING>;
            clocks = <&xtal>, <&clkc CLKID_SAR_ADC>;
            clock-names = "clkin", "core";
            nvmem-cells = <&tsens_caldata>;
            nvmem-cell-names = "temperature_calib";
            amlogic,hhi-sysctrl = <&hhi>;
        };
    };
...
```

## Documentation/devicetree/bindings/iio/adc/aspeed,ast2400-adc.yaml
```yaml
# SPDX-License-Identifier: (GPL-2.0 OR BSD-2-Clause)
%YAML 1.2
---
$id: http://devicetree.org/schemas/iio/adc/aspeed,ast2400-adc.yaml#
$schema: http://devicetree.org/meta-schemas/core.yaml#

title: ADC that forms part of an ASPEED server management processor.

maintainers:
  - Joel Stanley <joel@jms.id.au>

description:
  This device is a 10-bit converter for 16 voltage channels.  All inputs are
  single ended.

properties:
  compatible:
    enum:
      - aspeed,ast2400-adc
      - aspeed,ast2500-adc

  reg:
    maxItems: 1

  clocks:
    maxItems: 1
    description:
      Input clock used to derive the sample clock. Expected to be the
      SoC's APB clock.

  resets:
    maxItems: 1

  "#io-channel-cells":
    const: 1

required:
  - compatible
  - reg
  - clocks
  - resets
  - "#io-channel-cells"

additionalProperties: false

examples:
  - |
    #include <dt-bindings/clock/aspeed-clock.h>
    adc@1e6e9000 {
        compatible = "aspeed,ast2400-adc";
        reg = <0x1e6e9000 0xb0>;
        clocks = <&syscon ASPEED_CLK_APB>;
        resets = <&syscon ASPEED_RESET_ADC>;
        #io-channel-cells = <1>;
    };
...
```

## Documentation/devicetree/bindings/iio/adc/aspeed,ast2600-adc.yaml
```yaml
# SPDX-License-Identifier: (GPL-2.0 OR BSD-2-Clause)
%YAML 1.2
---
$id: http://devicetree.org/schemas/iio/adc/aspeed,ast2600-adc.yaml#
$schema: http://devicetree.org/meta-schemas/core.yaml#

title: ADC that forms part of an ASPEED server management processor.

maintainers:
  - Billy Tsai <billy_tsai@aspeedtech.com>

description: |
  • 10-bits resolution for 16 voltage channels.
  • The device split into two individual engine and each contains 8 voltage
  channels.
  • Channel scanning can be non-continuous.
  • Programmable ADC clock frequency.
  • Programmable upper and lower threshold for each channels.
  • Interrupt when larger or less than threshold for each channels.
  • Support hysteresis for each channels.
  • Built-in a compensating method.
  • Built-in a register to trim internal reference voltage.
  • Internal or External reference voltage.
  • Support 2 Internal reference voltage 1.2v or 2.5v.
  • Integrate dividing circuit for battery sensing.

properties:
  compatible:
    enum:
      - aspeed,ast2600-adc0
      - aspeed,ast2600-adc1
    description:
      Their trimming data, which is used to calibrate internal reference volage,
      locates in different address of OTP.

  reg:
    maxItems: 1

  clocks:
    maxItems: 1
    description:
      Input clock used to derive the sample clock. Expected to be the
      SoC's APB clock.

  resets:
    maxItems: 1

  "#io-channel-cells":
    const: 1

  vref-supply:
    description:
      The external regulator supply ADC reference voltage.

  aspeed,int-vref-microvolt:
    enum: [1200000, 2500000]
    description:
      ADC internal reference voltage in microvolts.

  aspeed,battery-sensing:
    type: boolean
    description:
      Inform the driver that last channel will be used to sensor battery.

required:
  - compatible
  - reg
  - clocks
  - resets
  - "#io-channel-cells"

additionalProperties: false

examples:
  - |
    #include <dt-bindings/clock/ast2600-clock.h>
    adc0: adc@1e6e9000 {
        compatible = "aspeed,ast2600-adc0";
        reg = <0x1e6e9000 0x100>;
        clocks = <&syscon ASPEED_CLK_APB2>;
        resets = <&syscon ASPEED_RESET_ADC>;
        #io-channel-cells = <1>;
        aspeed,int-vref-microvolt = <2500000>;
    };
    adc1: adc@1e6e9100 {
        compatible = "aspeed,ast2600-adc1";
        reg = <0x1e6e9100 0x100>;
        clocks = <&syscon ASPEED_CLK_APB2>;
        resets = <&syscon ASPEED_RESET_ADC>;
        #io-channel-cells = <1>;
        aspeed,int-vref-microvolt = <2500000>;
    };
...
```

## Documentation/devicetree/bindings/iio/adc/aspeed_adc.txt
```
Aspeed ADC

This device is a 10-bit converter for 16 voltage channels.  All inputs are
single ended.

Required properties:
- compatible: Should be "aspeed,ast2400-adc" or "aspeed,ast2500-adc"
- reg: memory window mapping address and length
- clocks: Input clock used to derive the sample clock. Expected to be the
          SoC's APB clock.
- resets: Reset controller phandle
- #io-channel-cells: Must be set to <1> to indicate channels are selected
                     by index.

Example:
	adc@1e6e9000 {
		compatible = "aspeed,ast2400-adc";
		reg = <0x1e6e9000 0xb0>;
		clocks = <&syscon ASPEED_CLK_APB>;
		resets = <&syscon ASPEED_RESET_ADC>;
		#io-channel-cells = <1>;
	};
```

## Documentation/devicetree/bindings/iio/adc/at91-sama5d2_adc.txt
```
* AT91 SAMA5D2 Analog to Digital Converter (ADC)

Required properties:
  - compatible: Should be "atmel,sama5d2-adc".
  - reg: Should contain ADC registers location and length.
  - interrupts: Should contain the IRQ line for the ADC.
  - clocks: phandle to device clock.
  - clock-names: Must be "adc_clk".
  - vref-supply: Supply used as reference for conversions.
  - vddana-supply: Supply for the adc device.
  - atmel,min-sample-rate-hz: Minimum sampling rate, it depends on SoC.
  - atmel,max-sample-rate-hz: Maximum sampling rate, it depends on SoC.
  - atmel,startup-time-ms: Startup time expressed in ms, it depends on SoC.
  - atmel,trigger-edge-type: One of possible edge types for the ADTRG hardware
  trigger pin. When the specific edge type is detected, the conversion will
  start. Possible values are rising, falling, or both.
  This property uses the IRQ edge types values: IRQ_TYPE_EDGE_RISING ,
  IRQ_TYPE_EDGE_FALLING or IRQ_TYPE_EDGE_BOTH

Example:

adc: adc@fc030000 {
	compatible = "atmel,sama5d2-adc";
	reg = <0xfc030000 0x100>;
	interrupts = <40 IRQ_TYPE_LEVEL_HIGH 7>;
	clocks = <&adc_clk>;
	clock-names = "adc_clk";
	atmel,min-sample-rate-hz = <200000>;
	atmel,max-sample-rate-hz = <20000000>;
	atmel,startup-time-ms = <4>;
	vddana-supply = <&vdd_3v3_lp_reg>;
	vref-supply = <&vdd_3v3_lp_reg>;
	atmel,trigger-edge-type = <IRQ_TYPE_EDGE_BOTH>;
}
```

## Documentation/devicetree/bindings/iio/adc/at91_adc.txt
```
* AT91's Analog to Digital Converter (ADC)

Required properties:
  - compatible: Should be "atmel,<chip>-adc"
    <chip> can be "at91sam9260", "at91sam9g45" or "at91sam9x5"
  - reg: Should contain ADC registers location and length
  - interrupts: Should contain the IRQ line for the ADC
  - clock-names: tuple listing input clock names.
	Required elements: "adc_clk", "adc_op_clk".
  - clocks: phandles to input clocks.
  - atmel,adc-channels-used: Bitmask of the channels muxed and enabled for this
    device
  - atmel,adc-startup-time: Startup Time of the ADC in microseconds as
    defined in the datasheet
  - atmel,adc-vref: Reference voltage in millivolts for the conversions
  - atmel,adc-res: List of resolutions in bits supported by the ADC. List size
		   must be two at least.
  - atmel,adc-res-names: Contains one identifier string for each resolution
			 in atmel,adc-res property. "lowres" and "highres"
			 identifiers are required.

Optional properties:
  - atmel,adc-use-external-triggers: Boolean to enable the external triggers
  - atmel,adc-use-res: String corresponding to an identifier from
		       atmel,adc-res-names property. If not specified, the highest
		       resolution will be used.
  - atmel,adc-sleep-mode: Boolean to enable sleep mode when no conversion
  - atmel,adc-sample-hold-time: Sample and Hold Time in microseconds
  - atmel,adc-ts-wires: Number of touchscreen wires. Should be 4 or 5. If this
                        value is set, then the adc driver will enable touchscreen
                        support.
    NOTE: when adc touchscreen is enabled, the adc hardware trigger will be
          disabled. Since touchscreen will occupy the trigger register.
  - atmel,adc-ts-pressure-threshold: a pressure threshold for touchscreen. It
                                     makes touch detection more precise.

Optional trigger Nodes:
  - Required properties:
    * trigger-name: Name of the trigger exposed to the user
    * trigger-value: Value to put in the Trigger register
      to activate this trigger
  - Optional properties:
    * trigger-external: Is the trigger an external trigger?

Examples:
adc0: adc@fffb0000 {
	#address-cells = <1>;
	#size-cells = <0>;
	compatible = "atmel,at91sam9260-adc";
	reg = <0xfffb0000 0x100>;
	interrupts = <20 IRQ_TYPE_LEVEL_HIGH 0>;
	clocks = <&adc_clk>, <&adc_op_clk>;
	clock-names = "adc_clk", "adc_op_clk";
	atmel,adc-channels-used = <0xff>;
	atmel,adc-startup-time = <40>;
	atmel,adc-use-external-triggers;
	atmel,adc-vref = <3300>;
	atmel,adc-res = <8 10>;
	atmel,adc-res-names = "lowres", "highres";
	atmel,adc-use-res = "lowres";

	trigger0 {
		trigger-name = "external-rising";
		trigger-value = <0x1>;
		trigger-external;
	};
	trigger1 {
		trigger-name = "external-falling";
		trigger-value = <0x2>;
		trigger-external;
	};

	trigger2 {
		trigger-name = "external-any";
		trigger-value = <0x3>;
		trigger-external;
	};

	trigger3 {
		trigger-name = "continuous";
		trigger-value = <0x6>;
	};
};
```

## Documentation/devicetree/bindings/iio/adc/atmel,sama5d2-adc.yaml
```yaml
# SPDX-License-Identifier: (GPL-2.0 OR BSD-2-Clause)
%YAML 1.2
---
$id: http://devicetree.org/schemas/iio/adc/atmel,sama5d2-adc.yaml#
$schema: http://devicetree.org/meta-schemas/core.yaml#

title: AT91 SAMA5D2 Analog to Digital Converter (ADC)

maintainers:
  - Eugen Hristev <eugen.hristev@microchip.com>

properties:
  compatible:
    enum:
      - atmel,sama5d2-adc
      - microchip,sam9x60-adc
      - microchip,sama7g5-adc

  reg:
    maxItems: 1

  interrupts:
    maxItems: 1

  clocks:
    maxItems: 1

  clock-names:
    const: adc_clk

  vref-supply: true
  vddana-supply: true

  atmel,min-sample-rate-hz:
    description: Minimum sampling rate, it depends on SoC.

  atmel,max-sample-rate-hz:
    description: Maximum sampling rate, it depends on SoC.

  atmel,startup-time-ms:
    description: Startup time expressed in ms, it depends on SoC.

  atmel,trigger-edge-type:
    $ref: /schemas/types.yaml#/definitions/uint32
    description:
      One of possible edge types for the ADTRG hardware trigger pin.
      When the specific edge type is detected, the conversion will
      start. Should be one of IRQ_TYPE_EDGE_RISING, IRQ_TYPE_EDGE_FALLING
      or IRQ_TYPE_EDGE_BOTH.
    enum: [1, 2, 3]

  dmas:
    maxItems: 1

  dma-names:
    const: rx

  "#io-channel-cells":
    const: 1

additionalProperties: false

required:
  - compatible
  - reg
  - interrupts
  - clocks
  - clock-names
  - vref-supply
  - vddana-supply
  - atmel,min-sample-rate-hz
  - atmel,max-sample-rate-hz
  - atmel,startup-time-ms

examples:
  - |
    #include <dt-bindings/dma/at91.h>
    #include <dt-bindings/interrupt-controller/irq.h>
    soc {
        #address-cells = <1>;
        #size-cells = <1>;

        adc@fc030000 {
            compatible = "atmel,sama5d2-adc";
            reg = <0xfc030000 0x100>;
            interrupts = <40 IRQ_TYPE_LEVEL_HIGH 7>;
            clocks = <&adc_clk>;
            clock-names = "adc_clk";
            atmel,min-sample-rate-hz = <200000>;
            atmel,max-sample-rate-hz = <20000000>;
            atmel,startup-time-ms = <4>;
            vddana-supply = <&vdd_3v3_lp_reg>;
            vref-supply = <&vdd_3v3_lp_reg>;
            atmel,trigger-edge-type = <IRQ_TYPE_EDGE_BOTH>;
            dmas = <&dma0 (AT91_XDMAC_DT_MEM_IF(0) | AT91_XDMAC_DT_PER_IF(1) | AT91_XDMAC_DT_PERID(25))>;
            dma-names = "rx";
            #io-channel-cells = <1>;
        };
    };
...
```
