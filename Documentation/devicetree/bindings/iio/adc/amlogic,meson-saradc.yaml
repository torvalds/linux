## Documentation/devicetree/bindings/iio/adc/atmel,sama9260-adc.yaml
```yaml
# SPDX-License-Identifier: (GPL-2.0 OR BSD-2-Clause)
%YAML 1.2
---
$id: http://devicetree.org/schemas/iio/adc/atmel,sama9260-adc.yaml#
$schema: http://devicetree.org/meta-schemas/core.yaml#

title: AT91 sama9260 and similar Analog to Digital Converter (ADC)

maintainers:
  - Alexandre Belloni <alexandre.belloni@bootlin.com>

properties:
  compatible:
    enum:
      - atmel,at91sam9260-adc
      - atmel,at91sam9rl-adc
      - atmel,at91sam9g45-adc
      - atmel,at91sam9x5-adc
      - atmel,at91sama5d3-adc

  reg:
    maxItems: 1

  interrupts:
    maxItems: 1

  clocks:
    minItems: 2
    maxItems: 2

  clock-names:
    items:
      - const: adc_clk
      - const: adc_op_clk

  atmel,adc-channels-used:
    $ref: /schemas/types.yaml#/definitions/uint32
    description: Bitmask of the channels muxed and enabled for this device

  atmel,adc-startup-time:
    $ref: /schemas/types.yaml#/definitions/uint32
    description:
      Startup Time of the ADC in microseconds as defined in the datasheet

  atmel,adc-vref:
    $ref: /schemas/types.yaml#/definitions/uint32
    description: Reference voltage in millivolts for the conversions

  atmel,adc-use-external-triggers:
    $ref: /schemas/types.yaml#/definitions/flag
    description: Enable the external triggers

  atmel,adc-use-res:
    $ref: /schemas/types.yaml#/definitions/string
    description:
      String corresponding to an identifier from atmel,adc-res-names property.
      If not specified, the highest resolution will be used.
    enum:
      - lowres
      - highres

  atmel,adc-sleep-mode:
    $ref: /schemas/types.yaml#/definitions/flag
    description: Enable sleep mode when no conversion

  atmel,adc-sample-hold-time:
    $ref: /schemas/types.yaml#/definitions/uint32
    description: Sample and Hold Time in microseconds

  atmel,adc-ts-wires:
    $ref: /schemas/types.yaml#/definitions/uint32
    description: |
      Number of touchscreen wires. Must be set to enable touchscreen.
      NOTE: when adc touchscreen is enabled, the adc hardware trigger will be
      disabled. Since touchscreen will occupy the trigger register.
    enum:
      - 4
      - 5

  atmel,adc-ts-pressure-threshold:
    $ref: /schemas/types.yaml#/definitions/uint32
    description:
      Pressure threshold for touchscreen.

  "#io-channel-cells":
    const: 1

additionalProperties: false

required:
  - compatible
  - reg
  - interrupts
  - clocks
  - clock-names
  - atmel,adc-channels-used
  - atmel,adc-startup-time
  - atmel,adc-vref

examples:
  - |
    #include <dt-bindings/dma/at91.h>
    #include <dt-bindings/interrupt-controller/irq.h>
    soc {
        #address-cells = <1>;
        #size-cells = <1>;

        adc@fffb0000 {
            compatible = "atmel,at91sam9260-adc";
            reg = <0xfffb0000 0x100>;
            interrupts = <20 IRQ_TYPE_LEVEL_HIGH 0>;
            clocks = <&adc_clk>, <&adc_op_clk>;
            clock-names = "adc_clk", "adc_op_clk";
            atmel,adc-channels-used = <0xff>;
            atmel,adc-startup-time = <40>;
            atmel,adc-use-external-triggers;
            atmel,adc-vref = <3300>;
            atmel,adc-use-res = "lowres";
        };
    };
...
```

## Documentation/devicetree/bindings/iio/adc/avia-hx711.txt
```
* AVIA HX711 ADC chip for weight cells
  Bit-banging driver

Required properties:
 - compatible:	Should be "avia,hx711"
 - sck-gpios:	Definition of the GPIO for the clock
 - dout-gpios:	Definition of the GPIO for data-out
		See Documentation/devicetree/bindings/gpio/gpio.txt
 - avdd-supply:	Definition of the regulator used as analog supply

Optional properties:
 - clock-frequency:	Frequency of PD_SCK in Hz
			Minimum value allowed is 10 kHz because of maximum
			high time of 50 microseconds.

Example:
weight {
	compatible = "avia,hx711";
	sck-gpios = <&gpio3 10 GPIO_ACTIVE_HIGH>;
	dout-gpios = <&gpio0 7 GPIO_ACTIVE_HIGH>;
	avdd-suppy = <&avdd>;
	clock-frequency = <100000>;
};
```

## Documentation/devicetree/bindings/iio/adc/avia-hx711.yaml
```yaml
# SPDX-License-Identifier: GPL-2.0
%YAML 1.2
---
$id: http://devicetree.org/schemas/iio/adc/avia-hx711.yaml#
$schema: http://devicetree.org/meta-schemas/core.yaml#

title: AVIA HX711 ADC chip for weight cells

maintainers:
  - Andreas Klinger <ak@it-klinger.de>

description: |
  The HX711 is a 24-bit ADC with selectable gain (32/64/128) and two
  differential input channels. Channel A supports gain 64 and 128;
  channel B supports gain 32.

properties:
  compatible:
    enum:
      - avia,hx711

  sck-gpios:
    description:
      GPIO for the clock output (PD_SCK in the datasheet).
    maxItems: 1

  dout-gpios:
    description:
      GPIO for the data output from the sensor (DOUT in the datasheet).
    maxItems: 1

  avdd-supply:
    description:
      Analog supply voltage (AVDD).

  vsup-supply:
    description:
      Supply voltage for the on-chip regulator (VSUP).

  dvdd-supply:
    description:
      Digital supply voltage (DVDD). On the HX711, DVDD is a
      board-supplied digital rail; it was missing from the original
      binding. On the HX710B, DVDD must be greater than or equal to
      AVDD; when DVDD is a battery rail and AVDD is a regulated supply,
      one channel monitors the DVDD-AVDD difference for battery level
      detection.

  rate-gpios:
    description:
      GPIO connected to the RATE pin. When driven low the output data
      rate is 10 SPS; when driven high it is 80 SPS. If omitted the
      RATE pin state is determined by the board wiring.
    maxItems: 1

  clock-frequency:
    description:
      Controls the SCK bit-bang timing. The value is used to derive the
      delay between SCK edges; keep the SCK high time below 60 us to
      avoid triggering chip power-down mode.
    minimum: 20000
    maximum: 2500000
    default: 400000

required:
  - compatible
  - sck-gpios
  - dout-gpios
  - avdd-supply

additionalProperties: false

examples:
  - |
    #include <dt-bindings/gpio/gpio.h>
    weight {
        compatible = "avia,hx711";
        sck-gpios = <&gpio3 10 GPIO_ACTIVE_HIGH>;
        dout-gpios = <&gpio0 7 GPIO_ACTIVE_HIGH>;
        rate-gpios = <&gpio0 9 GPIO_ACTIVE_HIGH>;
        avdd-supply = <&avdd>;
        clock-frequency = <100000>;
    };
```

## Documentation/devicetree/bindings/iio/adc/axp20x_adc.txt
```
* X-Powers AXP ADC bindings

Required properties:
  - compatible: should be one of:
    - "x-powers,axp209-adc",
    - "x-powers,axp221-adc",
    - "x-powers,axp813-adc",
  - #io-channel-cells: should be 1,

Example:

&axp22x {
	adc {
		compatible = "x-powers,axp221-adc";
		#io-channel-cells = <1>;
	};
};

ADC channels and their indexes per variant:

AXP209
------
 0 | acin_v
 1 | acin_i
 2 | vbus_v
 3 | vbus_i
 4 | pmic_temp
 5 | gpio0_v
 6 | gpio1_v
 7 | ipsout_v
 8 | batt_v
 9 | batt_chrg_i
10 | batt_dischrg_i

AXP22x
------
 0 | pmic_temp
 1 | batt_v
 2 | batt_chrg_i
 3 | batt_dischrg_i

AXP813
------
 0 | pmic_temp
 1 | gpio0_v
 2 | batt_v
 3 | batt_chrg_i
 4 | batt_dischrg_i
```

## Documentation/devicetree/bindings/iio/adc/berlin2_adc.txt
```
* Berlin Analog to Digital Converter (ADC)

The Berlin ADC has 8 channels, with one connected to a temperature sensor.
It is part of the system controller register set. The ADC yesde should be a
sub-yesde of the system controller yesde.

Required properties:
- compatible: must be "marvell,berlin2-adc"
- interrupts: the interrupts for the ADC and the temperature sensor
- interrupt-names: should be "adc" and "tsen"

Example:

adc: adc {
	compatible = "marvell,berlin2-adc";
	interrupt-parent = <&sic>;
	interrupts = <12>, <14>;
	interrupt-names = "adc", "tsen";
};
```

## Documentation/devicetree/bindings/iio/adc/brcm,iproc-static-adc.txt
```
* Broadcom's IPROC Static ADC controller

Broadcom iProc ADC controller has 8 channels 10bit ADC.
Allows user to convert analog input voltage values to digital.

Required properties:

- compatible: Must be "brcm,iproc-static-adc"

- adc-syscon: Handler of syscon node defining physical base address of the
  controller and length of memory mapped region.

- #io-channel-cells = <1>; As ADC has multiple outputs
  refer to Documentation/devicetree/bindings/iio/iio-bindings.txt for details.

- io-channel-ranges:
  refer to Documentation/devicetree/bindings/iio/iio-bindings.txt for details.

- clocks: Clock used for this block.

- clock-names: Clock name should be given as tsc_clk.

- interrupts: interrupt line number.

For example:

	ts_adc_syscon: ts_adc_syscon@180a6000 {
		compatible = "brcm,iproc-ts-adc-syscon","syscon";
		reg = <0x180a6000 0xc30>;
	};

	adc: adc@180a6000 {
		compatible = "brcm,iproc-static-adc";
		adc-syscon = <&ts_adc_syscon>;
		#io-channel-cells = <1>;
		io-channel-ranges;
		clocks = <&asiu_clks BCM_CYGNUS_ASIU_ADC_CLK>;
		clock-names = "tsc_clk";
		interrupts = <GIC_SPI 164 IRQ_TYPE_LEVEL_HIGH>;
	};
```

## Documentation/devicetree/bindings/iio/adc/brcm,iproc-static-adc.yaml
```yaml
# SPDX-License-Identifier: (GPL-2.0 OR BSD-2-Clause)
%YAML 1.2
---
$id: http://devicetree.org/schemas/iio/adc/brcm,iproc-static-adc.yaml#
$schema: http://devicetree.org/meta-schemas/core.yaml#

title: Broadcom's IPROC Static ADC controller

maintainers:
  - Raveendra Padasalagi <raveendra.padasalagi@broadcom.com>

description: |
  Broadcom iProc ADC controller has 8 10bit channels

properties:
  compatible:
    const: brcm,iproc-static-adc

  adc-syscon:
    $ref: /schemas/types.yaml#/definitions/phandle
    description:
      syscon node defining physical base address of the controller and length
      of memory mapped region.

  "#io-channel-cells":
    const: 1

  clocks:
    maxItems: 1

  clock-names:
    const: tsc_clk

  interrupts:
    maxItems: 1

additionalProperties: false

required:
  - compatible
  - adc-syscon
  - "#io-channel-cells"
  - clocks
  - clock-names
  - interrupts

examples:
  - |
    #include <dt-bindings/clock/bcm-cygnus.h>
    #include <dt-bindings/interrupt-controller/arm-gic.h>
    #include <dt-bindings/interrupt-controller/irq.h>
    soc {
        #address-cells = <1>;
        #size-cells = <1>;

        adc {
            compatible = "brcm,iproc-static-adc";
            adc-syscon = <&ts_adc_syscon>;
            #io-channel-cells = <1>;
            clocks = <&asiu_clks BCM_CYGNUS_ASIU_ADC_CLK>;
            clock-names = "tsc_clk";
            interrupts = <GIC_SPI 164 IRQ_TYPE_LEVEL_HIGH>;
        };
    };
...
```

## Documentation/devicetree/bindings/iio/adc/cc10001_adc.txt
```
* Cosmic Circuits - Analog to Digital Converter (CC-10001-ADC)

Required properties:
  - compatible: Should be "cosmic,10001-adc"
  - reg: Should contain adc registers location and length.
  - clock-names: Should contain "adc".
  - clocks: Should contain a clock specifier for each entry in clock-names
  - vref-supply: The regulator supply ADC reference voltage.

Optional properties:
  - adc-reserved-channels: Bitmask of reserved channels,
    i.e. channels that cannot be used by the OS.

Example:
adc: adc@18101600 {
	compatible = "cosmic,10001-adc";
	reg = <0x18101600 0x24>;
	adc-reserved-channels = <0x2>;
	clocks = <&adc_clk>;
	clock-names = "adc";
	vref-supply = <&reg_1v8>;
};
```

## Documentation/devicetree/bindings/iio/adc/cirrus,ep9301-adc.yaml
```yaml
# SPDX-License-Identifier: (GPL-2.0 OR BSD-2-Clause)
%YAML 1.2
---
$id: http://devicetree.org/schemas/iio/adc/cirrus,ep9301-adc.yaml#
$schema: http://devicetree.org/meta-schemas/core.yaml#

title: Cirrus Logic EP930x internal ADC

description: |
  Cirrus Logic EP9301/EP9302 SoCs' internal ADC block.

  User's manual:
  https://cdn.embeddedts.com/resource-attachments/ts-7000_ep9301-ug.pdf

maintainers:
  - Alexander Sverdlin <alexander.sverdlin@gmail.com>

properties:
  compatible:
    const: cirrus,ep9301-adc

  reg:
    maxItems: 1

  clocks:
    maxItems: 1

  interrupts:
    maxItems: 1

required:
  - compatible
  - reg
  - clocks

additionalProperties: false

examples:
  - |
    adc: adc@80900000 {
        compatible = "cirrus,ep9301-adc";
        reg = <0x80900000 0x28>;
        clocks = <&syscon 24>;
        interrupt-parent = <&vic1>;
        interrupts = <30>;
    };
...
```

## Documentation/devicetree/bindings/iio/adc/cosmic,10001-adc.yaml
```yaml
# SPDX-License-Identifier: (GPL-2.0 OR BSD-2-Clause)
%YAML 1.2
---
$id: http://devicetree.org/schemas/iio/adc/cosmic,10001-adc.yaml#
$schema: http://devicetree.org/meta-schemas/core.yaml#

title: Cosmic Circuits CC-10001 ADC

maintainers:
  - Jonathan Cameron <jic23@kernel.org>

description:
  Cosmic Circuits 10001 10-bit ADC device.

properties:
  compatible:
    const: cosmic,10001-adc

  reg:
    maxItems: 1

  adc-reserved-channels:
    $ref: /schemas/types.yaml#/definitions/uint32
    description:
       Bitmask of reserved channels, i.e. channels that cannot be
       used by the OS.

  clocks:
    maxItems: 1

  clock-names:
    const: adc

  vref-supply: true

  "#io-channel-cells":
    const: 1


required:
  - compatible
  - reg
  - clocks
  - clock-names
  - vref-supply

additionalProperties: false

examples:
  - |
    adc@18101600 {
        compatible = "cosmic,10001-adc";
        reg = <0x18101600 0x24>;
        adc-reserved-channels = <0x2>;
        clocks = <&adc_clk>;
        clock-names = "adc";
        vref-supply = <&reg_1v8>;
    };
...
```

## Documentation/devicetree/bindings/iio/adc/cpcap-adc.txt
```
Motorola CPCAP PMIC ADC binding

Required properties:
- compatible: Should be "motorola,cpcap-adc" or "motorola,mapphone-cpcap-adc"
- interrupts: The interrupt number for the ADC device
- interrupt-names: Should be "adcdone"
- #io-channel-cells: Number of cells in an IIO specifier

Example:

cpcap_adc: adc {
	compatible = "motorola,mapphone-cpcap-adc";
	interrupt-parent = <&cpcap>;
	interrupts = <8 IRQ_TYPE_NONE>;
	interrupt-names = "adcdone";
	#io-channel-cells = <1>;
};
```

## Documentation/devicetree/bindings/iio/adc/da9150-gpadc.txt
```
Dialog Semiconductor DA9150 IIO GPADC bindings

Required properties:
- compatible: "dlg,da9150-gpadc" for DA9150 IIO GPADC
- #io-channel-cells: Should be set to <1>
  (See Documentation/devicetree/bindings/iio/iio-bindings.txt for further info)

For further information on GPADC channels, see device datasheet.


Example:

	gpadc: da9150-gpadc {
		compatible = "dlg,da9150-gpadc";
		#io-channel-cells = <1>;
	};
```

## Documentation/devicetree/bindings/iio/adc/dlg,da9150-gpadc.yaml
```yaml
# SPDX-License-Identifier: (GPL-2.0 OR BSD-2-Clause)
%YAML 1.2
---
$id: http://devicetree.org/schemas/iio/adc/dlg,da9150-gpadc.yaml#
$schema: http://devicetree.org/meta-schemas/core.yaml#

title: Dialog Semiconductor DA9150 IIO GPADC

maintainers:
  - Adam Thomson <Adam.Thomson.Opensource@diasemi.com>

description:
  This patch adds support for general purpose ADC within the
  DA9150 Charger & Fuel-Gauge IC.

properties:
  compatible:
    const: dlg,da9150-gpadc

  "#io-channel-cells":
    const: 1

required:
  - compatible
  - "#io-channel-cells"

additionalProperties: false

examples:
  - |
    adc {
        compatible = "dlg,da9150-gpadc";
        #io-channel-cells = <1>;
    };
...
```
