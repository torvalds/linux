## Documentation/devicetree/bindings/iio/adc/envelope-detector.txt
```
Bindings for ADC envelope detector using a DAC and a comparator

The DAC is used to find the peak level of an alternating voltage input
signal by a binary search using the output of a comparator wired to
an interrupt pin. Like so:
                          _
                         | \
    input +------>-------|+ \
                         |   \
           .-------.     |    }---.
           |       |     |   /    |
           |    dac|-->--|- /     |
           |       |     |_/      |
           |       |              |
           |       |              |
           |    irq|------<-------'
           |       |
           '-------'

Required properties:
- compatible: Should be "axentia,tse850-envelope-detector"
- io-channels: Channel node of the dac to be used for comparator input.
- io-channel-names: Should be "dac".
- interrupt specification for one client interrupt,
  see ../../interrupt-controller/interrupts.txt for details.
- interrupt-names: Should be "comp".

Example:

	&i2c {
		dpot: mcp4651-104@28 {
			compatible = "microchip,mcp4651-104";
			reg = <0x28>;
			#io-channel-cells = <1>;
		};
	};

	dac: dac {
		compatible = "dpot-dac";
		vref-supply = <&reg_3v3>;
		io-channels = <&dpot 0>;
		io-channel-names = "dpot";
		#io-channel-cells = <1>;
	};

	envelope-detector {
		compatible = "axentia,tse850-envelope-detector";
		io-channels = <&dac 0>;
		io-channel-names = "dac";

		interrupt-parent = <&gpio>;
		interrupts = <3 IRQ_TYPE_EDGE_FALLING>;
		interrupt-names = "comp";
	};
```

## Documentation/devicetree/bindings/iio/adc/envelope-detector.yaml
```yaml
# SPDX-License-Identifier: (GPL-2.0 OR BSD-2-Clause)
%YAML 1.2
---
$id: http://devicetree.org/schemas/iio/adc/envelope-detector.yaml#
$schema: http://devicetree.org/meta-schemas/core.yaml#

title: ADC envelope detector using a DAC and a comparator

maintainers:
  - Peter Rosin <peda@axentia.se>

description: |
  The DAC is used to find the peak level of an alternating voltage input
  signal by a binary search using the output of a comparator wired to
  an interrupt pin. Like so:
                          _
                         | \
    input +------>-------|+ \
                         |   \
           .-------.     |    }---.
           |       |     |   /    |
           |    dac|-->--|- /     |
           |       |     |_/      |
           |       |              |
           |       |              |
           |    irq|------<-------'
           |       |
           '-------'

properties:
  compatible:
    const: axentia,tse850-envelope-detector

  io-channels:
    maxItems: 1
    description: Channel node of the dac to be used for comparator input.

  io-channel-names:
    const: dac

  interrupts:
    maxItems: 1

  interrupt-names:
    const: comp

required:
  - compatible
  - io-channels
  - io-channel-names
  - interrupts
  - interrupt-names

additionalProperties: false

examples:
  - |
    #include <dt-bindings/interrupt-controller/irq.h>
    i2c {
        #address-cells = <1>;
        #size-cells = <0>;
        dpot: dpot@28 {
            compatible = "microchip,mcp4651-104";
            reg = <0x28>;
            #io-channel-cells = <1>;
        };
    };

    dac: dac {
        compatible = "dpot-dac";
        vref-supply = <&reg_3v3>;
        io-channels = <&dpot 0>;
        io-channel-names = "dpot";
        #io-channel-cells = <1>;
    };

    envelope-detector {
        compatible = "axentia,tse850-envelope-detector";
        io-channels = <&dac 0>;
        io-channel-names = "dac";

        interrupt-parent = <&gpio>;
        interrupts = <3 IRQ_TYPE_EDGE_FALLING>;
        interrupt-names = "comp";
    };
...
```

## Documentation/devicetree/bindings/iio/adc/fsl,imx25-gcq.txt
```
Freescale i.MX25 ADC GCQ device

This is a generic conversion queue device that can convert any of the
analog inputs using the ADC unit of the i.MX25.

Required properties:
 - compatible: Should be "fsl,imx25-gcq".
 - reg: Should be the register range of the module.
 - interrupts: Should be the interrupt number of the module.
   Typically this is <1>.
 - #address-cells: Should be <1> (setting for the subnodes)
 - #size-cells: Should be <0> (setting for the subnodes)

Optional properties:
 - vref-ext-supply: The regulator supplying the ADC reference voltage.
   Required when at least one subnode uses the this reference.
 - vref-xp-supply: The regulator supplying the ADC reference voltage on pin XP.
   Required when at least one subnode uses this reference.
 - vref-yp-supply: The regulator supplying the ADC reference voltage on pin YP.
   Required when at least one subnode uses this reference.

Sub-nodes:
Optionally you can define subnodes which define the reference voltage
for the analog inputs.

Required properties for subnodes:
 - reg: Should be the number of the analog input.
     0: xp
     1: yp
     2: xn
     3: yn
     4: wiper
     5: inaux0
     6: inaux1
     7: inaux2
Optional properties for subnodes:
 - fsl,adc-refp: specifies the positive reference input as defined in
     <dt-bindings/iio/adc/fsl-imx25-gcq.h>
 - fsl,adc-refn: specifies the negative reference input as defined in
     <dt-bindings/iio/adc/fsl-imx25-gcq.h>

Example:

	adc: adc@50030800 {
		compatible = "fsl,imx25-gcq";
		reg = <0x50030800 0x60>;
		interrupt-parent = <&tscadc>;
		interrupts = <1>;
		#address-cells = <1>;
		#size-cells = <0>;

		inaux@5 {
			reg = <5>;
			fsl,adc-refp = <MX25_ADC_REFP_INT>;
			fsl,adc-refn = <MX25_ADC_REFN_NGND>;
		};
	};
```

## Documentation/devicetree/bindings/iio/adc/fsl,imx25-gcq.yaml
```yaml
# SPDX-License-Identifier: (GPL-2.0 OR BSD-2-Clause)
%YAML 1.2
---
$id: http://devicetree.org/schemas/iio/adc/fsl,imx25-gcq.yaml#
$schema: http://devicetree.org/meta-schemas/core.yaml#

title: Freescale ADC GCQ device

description:
  This is a generic conversion queue device that can convert any of the
  analog inputs using the ADC unit of the i.MX25.

maintainers:
  - Jonathan Cameron <jic23@kernel.org>

properties:
  compatible:
    const: fsl,imx25-gcq

  reg:
    maxItems: 1

  interrupts:
    maxItems: 1

  vref-ext-supply:
    description:
      The regulator supplying the ADC reference voltage.
      Required when at least one subnode uses the this reference.

  vref-xp-supply:
    description:
      The regulator supplying the ADC reference voltage on pin XP.
      Required when at least one subnode uses this reference.

  vref-yp-supply:
    description:
      The regulator supplying the ADC reference voltage on pin YP.
      Required when at least one subnode uses this reference.

  "#io-channel-cells":
    const: 1

  "#address-cells":
    const: 1

  "#size-cells":
    const: 0

required:
  - compatible
  - reg
  - interrupts
  - "#address-cells"
  - "#size-cells"

patternProperties:
  "[a-z][a-z0-9]+@[0-9a-f]+$":
    type: object
    description:
      Child nodes used to define the reference voltages used for each channel

    properties:
      reg:
        description: |
          Number of the analog input.
          0: xp
          1: yp
          2: xn
          3: yn
          4: wiper
          5: inaux0
          6: inaux1
          7: inaux2
        items:
          - minimum: 0
            maximum: 7

      fsl,adc-refp:
        $ref: /schemas/types.yaml#/definitions/uint32
        description: |
          Specifies the positive reference input as defined in
          <dt-bindings/iio/adc/fsl-imx25-gcq.h>
          0: YP voltage reference
          1: XP voltage reference
          2: External voltage reference
          3: Internal voltage reference (default)
        minimum: 0
        maximum: 3

      fsl,adc-refn:
        $ref: /schemas/types.yaml#/definitions/uint32
        description: |
          Specifies the negative reference input as defined in
          <dt-bindings/iio/adc/fsl-imx25-gcq.h>
          0: XN ground reference
          1: YN ground reference
          2: Internal ground reference
          3: External ground reference (default)
        minimum: 0
        maximum: 3

    required:
      - reg

    additionalProperties: false

additionalProperties: false

examples:
  - |
    #include <dt-bindings/iio/adc/fsl-imx25-gcq.h>
    soc {
        #address-cells = <1>;
        #size-cells = <1>;
        adc@50030800 {
            compatible = "fsl,imx25-gcq";
            reg = <0x50030800 0x60>;
            interrupt-parent = <&tscadc>;
            interrupts = <1>;
            #address-cells = <1>;
            #size-cells = <0>;

            inaux@5 {
                reg = <5>;
                fsl,adc-refp = <MX25_ADC_REFP_INT>;
                fsl,adc-refn = <MX25_ADC_REFN_NGND>;
            };
        };
    };
...
```

## Documentation/devicetree/bindings/iio/adc/fsl,imx7d-adc.yaml
```yaml
# SPDX-License-Identifier: (GPL-2.0 OR BSD-2-Clause)
%YAML 1.2
---
$id: http://devicetree.org/schemas/iio/adc/fsl,imx7d-adc.yaml#
$schema: http://devicetree.org/meta-schemas/core.yaml#

title: Freescale ADC found on the imx7d SoC

maintainers:
  - Haibo Chen <haibo.chen@nxp.com>

properties:
  compatible:
    const: fsl,imx7d-adc

  reg:
    maxItems: 1

  interrupts:
    maxItems: 1

  clocks:
    maxItems: 1

  clock-names:
    const: adc

  vref-supply: true

  "#io-channel-cells":
    const: 1

required:
  - compatible
  - reg
  - interrupts
  - clocks
  - clock-names
  - vref-supply
  - "#io-channel-cells"

additionalProperties: false

examples:
  - |
    #include <dt-bindings/interrupt-controller/irq.h>
    #include <dt-bindings/clock/imx7d-clock.h>
    #include <dt-bindings/interrupt-controller/arm-gic.h>
    soc {
        #address-cells = <1>;
        #size-cells = <1>;
        adc@30610000 {
            compatible = "fsl,imx7d-adc";
            reg = <0x30610000 0x10000>;
            interrupts = <GIC_SPI 98 IRQ_TYPE_LEVEL_HIGH>;
            clocks = <&clks IMX7D_ADC_ROOT_CLK>;
            clock-names = "adc";
            vref-supply = <&reg_vcc_3v3_mcu>;
            #io-channel-cells = <1>;
        };
    };
...
```
