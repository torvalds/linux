## Documentation/devicetree/bindings/iio/adc/ti,ads1298.yaml
```yaml
# SPDX-License-Identifier: (GPL-2.0-only OR BSD-2-Clause)
%YAML 1.2
---
$id: http://devicetree.org/schemas/iio/adc/ti,ads1298.yaml#
$schema: http://devicetree.org/meta-schemas/core.yaml#

title: Texas Instruments' ads1298 medical ADC chips

description: |
  Datasheet at: https://www.ti.com/product/ADS1298
  Bindings for this chip aren't complete.

maintainers:
  - Mike Looijmans <mike.looijmans@topic.nl>

properties:
  compatible:
    enum:
      - ti,ads1298

  reg:
    maxItems: 1

  spi-cpha: true

  reset-gpios:
    maxItems: 1

  avdd-supply:
    description:
      Analog power supply, voltage between AVDD and AVSS. When providing a
      symmetric +/- 2.5V, the regulator should report 5V.

  vref-supply:
    description:
      Optional reference voltage. If omitted, internal reference is used,
      which is 2.4V when analog supply is below 4.4V, 4V otherwise.

  clocks:
    description: Optional 2.048 MHz external source clock on CLK pin
    maxItems: 1

  interrupts:
    description: Interrupt on DRDY pin, triggers on falling edge
    maxItems: 1

  label: true

required:
  - compatible
  - reg
  - avdd-supply
  - interrupts

allOf:
  - $ref: /schemas/spi/spi-peripheral-props.yaml#

unevaluatedProperties: false

examples:
  - |
    #include <dt-bindings/gpio/gpio.h>
    #include <dt-bindings/interrupt-controller/irq.h>
    spi {
        #address-cells = <1>;
        #size-cells = <0>;

        adc@1 {
          reg = <1>;
          compatible = "ti,ads1298";
          label = "ads1298-1-ecg";
          avdd-supply = <&reg_iso_5v_a>;
          clocks = <&clk_ads1298>;
          interrupt-parent = <&gpio0>;
          interrupts = <78 IRQ_TYPE_EDGE_FALLING>;
          spi-max-frequency = <20000000>;
          spi-cpha;
        };
    };
...
```

## Documentation/devicetree/bindings/iio/adc/ti,ads131e08.yaml
```yaml
# SPDX-License-Identifier: (GPL-2.0-only OR BSD-2-Clause)
%YAML 1.2
---
$id: http://devicetree.org/schemas/iio/adc/ti,ads131e08.yaml#
$schema: http://devicetree.org/meta-schemas/core.yaml#

title: Texas Instruments ADS131E0x 4-, 6- and 8-Channel ADCs

maintainers:
  - Tomislav Denis <tomislav.denis@avl.com>

description: |
  The ADS131E0x are a family of multichannel, simultaneous sampling,
  24-bit, delta-sigma, analog-to-digital converters (ADCs) with a
  built-in programmable gain amplifier (PGA), internal reference
  and an onboard oscillator.
  The communication with ADC chip is via the SPI bus (mode 1).

  https://www.ti.com/lit/ds/symlink/ads131e08.pdf

properties:
  compatible:
    enum:
      - ti,ads131e04
      - ti,ads131e06
      - ti,ads131e08

  reg:
    maxItems: 1

  spi-max-frequency: true

  spi-cpha: true

  clocks:
    description: |
      Device tree identifier to the clock source (2.048 MHz).
      Note: clock source is selected using CLKSEL pin.
    maxItems: 1

  clock-names:
    items:
      - const: adc-clk

  interrupts:
    description: |
      IRQ line for the ADC data ready.
    maxItems: 1

  vref-supply:
    description: |
      Optional external voltage reference. If not supplied, internal voltage
      reference is used.

  ti,vref-internal:
    description: |
      Select the internal voltage reference value.
      0: 2.4V
      1: 4.0V
      If this field is left empty, 2.4V is selected.
      Note: internal voltage reference is used only if vref-supply is not supplied.
    $ref: /schemas/types.yaml#/definitions/uint32
    enum: [0, 1]
    default: 0

  '#address-cells':
    const: 1

  '#size-cells':
    const: 0

required:
  - compatible
  - reg
  - spi-cpha
  - clocks
  - clock-names
  - interrupts

patternProperties:
  "^channel@([0-7])$":
    $ref: "adc.yaml"
    type: object
    description: |
      Represents the external channels which are connected to the ADC.

    properties:
      reg:
        description: |
          The channel number.
          Up to 4 channels, numbered from 0 to 3 for ti,ads131e04.
          Up to 6 channels, numbered from 0 to 5 for ti,ads131e06.
          Up to 8 channels, numbered from 0 to 7 for ti,ads131e08.
        items:
          minimum: 0
          maximum: 7

      ti,gain:
        description: |
          The PGA gain value for the channel.
          If this field is left empty, PGA gain 1 is used.
        $ref: /schemas/types.yaml#/definitions/uint32
        enum: [1, 2, 4, 8, 12]
        default: 1

      ti,mux:
        description: |
          Channel input selection(muliplexer).
          0: Normal input.
          1: Input shorted to (VREFP + VREFN) / 2 (for offset or noise measurements).
          3: MVDD (for supply measurement)
          4: Temperature sensor
          If this field is left empty, normal input is selected.
        $ref: /schemas/types.yaml#/definitions/uint32
        enum: [0, 1, 3, 4]
        default: 0

    required:
      - reg

    additionalProperties: false

additionalProperties: false

examples:
  - |
    #include <dt-bindings/interrupt-controller/irq.h>

    spi {
      #address-cells = <1>;
      #size-cells = <0>;

      adc@0 {
        compatible = "ti,ads131e08";
        reg = <0>;
        spi-max-frequency = <1000000>;
        spi-cpha;
        clocks = <&clk2048k>;
        clock-names = "adc-clk";
        interrupt-parent = <&gpio5>;
        interrupts = <28 IRQ_TYPE_EDGE_FALLING>;
        vref-supply = <&adc_vref>;

        #address-cells = <1>;
        #size-cells = <0>;

        channel@0 {
          reg = <0>;
        };

        channel@1 {
          reg = <1>;
        };

        channel@2 {
          reg = <2>;
          ti,gain = <2>;
        };

        channel@3 {
          reg = <3>;
        };

        channel@4 {
          reg = <4>;
        };

        channel@5 {
          reg = <5>;
        };

        channel@6 {
          reg = <6>;
        };

        channel@7 {
          reg = <7>;
          ti,mux = <4>;
        };
      };
    };
```

## Documentation/devicetree/bindings/iio/adc/ti,ads131m02.yaml
```yaml
# SPDX-License-Identifier: (GPL-2.0-only OR BSD-2-Clause)
%YAML 1.2
---
$id: http://devicetree.org/schemas/iio/adc/ti,ads131m02.yaml#
$schema: http://devicetree.org/meta-schemas/core.yaml#

title: Texas Instruments ADS131M0x 2-, 3-, 4-, 6- and 8-Channel ADCs

maintainers:
  - Oleksij Rempel <o.rempel@pengutronix.de>

description: |
  The ADS131M0x are a family of multichannel, simultaneous sampling,
  24-bit, delta-sigma, analog-to-digital converters (ADCs) with a
  built-in programmable gain amplifier (PGA) and internal reference.
  Communication with the ADC chip is via SPI.

  Datasheets:
  - ADS131M02: https://www.ti.com/lit/ds/symlink/ads131m02.pdf
  - ADS131M03: https://www.ti.com/lit/ds/symlink/ads131m03.pdf
  - ADS131M04: https://www.ti.com/lit/ds/symlink/ads131m04.pdf
  - ADS131M06: https://www.ti.com/lit/ds/symlink/ads131m06.pdf
  - ADS131M08: https://www.ti.com/lit/ds/symlink/ads131m08.pdf

properties:
  compatible:
    enum:
      - ti,ads131m02
      - ti,ads131m03
      - ti,ads131m04
      - ti,ads131m06
      - ti,ads131m08

  reg:
    description: SPI chip select number.

  clocks:
    description:
      Phandle to the external clock source required by the ADC's CLKIN pin.
      The datasheet recommends specific frequencies based on the desired power
      mode (e.g., 8.192 MHz for High-Resolution mode).
    maxItems: 1

  avdd-supply:
    description: Analog power supply (AVDD).

  dvdd-supply:
    description: Digital power supply (DVDD).

  interrupts:
    description: DRDY (Data Ready) output signal.
    maxItems: 1

  reset-gpios:
    description: Optional RESET signal.
    maxItems: 1

  clock-names:
    description:
      Indicates if a crystal oscillator (XTAL) or CMOS signal is connected
      (CLKIN). Note that XTAL mode is only supported on ADS131M06 and ADS131M08.
    enum: [xtal, clkin]

  refin-supply:
    description: Optional external reference supply (REFIN).

  '#address-cells':
    const: 1

  '#size-cells':
    const: 0

required:
  - compatible
  - reg
  - clocks
  - clock-names
  - avdd-supply
  - dvdd-supply

patternProperties:
  "^channel@[0-7]$":
    type: object
    $ref: /schemas/iio/adc/adc.yaml#
    description: Properties for a single ADC channel.

    properties:
      reg:
        description: The channel index (0-7).
        minimum: 0
        maximum: 7  # Max channels on ADS131M08

      label: true

    required:
      - reg

    unevaluatedProperties: false

allOf:
  - $ref: /schemas/spi/spi-peripheral-props.yaml#

  - if:
      # 20-pin devices: M02, M03, M04
      # These do not support XTAL or REFIN.
      properties:
        compatible:
          enum:
            - ti,ads131m02
            - ti,ads131m03
            - ti,ads131m04
    then:
      properties:
        clock-names:
          const: clkin
        refin-supply: false

  - if:
      # ADS131M02: 2 channels max (0-1)
      properties:
        compatible:
          contains:
            const: ti,ads131m02
    then:
      patternProperties:
        "^channel@[0-1]$":
          properties:
            reg:
              maximum: 1
        "^channel@[2-7]$": false

  - if:
      # ADS131M03: 3 channels max (0-2)
      properties:
        compatible:
          contains:
            const: ti,ads131m03
    then:
      patternProperties:
        "^channel@[0-2]$":
          properties:
            reg:
              maximum: 2
        "^channel@[3-7]$": false

  - if:
      # ADS131M04: 4 channels max (0-3)
      properties:
        compatible:
          contains:
            const: ti,ads131m04
    then:
      patternProperties:
        "^channel@[0-3]$":
          properties:
            reg:
              maximum: 3
        "^channel@[4-7]$": false

  - if:
      # ADS131M06: 6 channels max (0-5)
      properties:
        compatible:
          contains:
            const: ti,ads131m06
    then:
      patternProperties:
        "^channel@[0-5]$":
          properties:
            reg:
              maximum: 5
        "^channel@[6-7]$": false

unevaluatedProperties: false

examples:
  - |
    #include <dt-bindings/clock/stm32mp1-clks.h>

    spi1 {
        #address-cells = <1>;
        #size-cells = <0>;

        adc@0 {
            compatible = "ti,ads131m02";
            reg = <0>;
            spi-max-frequency = <8000000>;

            clocks = <&rcc CK_MCO2>;
            clock-names = "clkin";

            avdd-supply = <&vdd_ana>;
            dvdd-supply = <&vdd_dig>;

            #address-cells = <1>;
            #size-cells = <0>;

            channel@0 {
                reg = <0>;
                label = "input_voltage";
            };

            channel@1 {
                reg = <1>;
                label = "input_current";
            };
        };
    };
```

## Documentation/devicetree/bindings/iio/adc/ti,ads7138.yaml
```yaml
# SPDX-License-Identifier: (GPL-2.0 OR BSD-2-Clause)
%YAML 1.2
---
$id: http://devicetree.org/schemas/iio/adc/ti,ads7138.yaml#
$schema: http://devicetree.org/meta-schemas/core.yaml#

title: Texas Instruments ADS7128/ADS7138 analog-to-digital converter (ADC)

maintainers:
  - Tobias Sperling <tobias.sperling@softing.com>

description: |
  The ADS7128 and ADS7138 chips are 12-bit, 8 channel analog-to-digital
  converters (ADC) with build-in digital window comparator (DWC), using the
  I2C interface.
  ADS7128 differs in the addition of further hardware features, like a
  root-mean-square (RMS) and a zero-crossing-detect (ZCD) module.

  Datasheets:
    https://www.ti.com/product/ADS7128
    https://www.ti.com/product/ADS7138

properties:
  compatible:
    enum:
      - ti,ads7128
      - ti,ads7138

  reg:
    maxItems: 1

  avdd-supply:
    description:
      The regulator used as analog supply voltage as well as reference voltage.

  interrupts:
    description:
      Interrupt on ALERT pin, triggers on low level.
    maxItems: 1

required:
  - compatible
  - reg
  - avdd-supply

additionalProperties: false

examples:
  - |
    #include <dt-bindings/interrupt-controller/irq.h>
    i2c {
        #address-cells = <1>;
        #size-cells = <0>;

        adc@10 {
            compatible = "ti,ads7138";
            reg = <0x10>;
            avdd-supply = <&reg_stb_3v3>;
            interrupt-parent = <&gpio2>;
            interrupts = <12 IRQ_TYPE_LEVEL_LOW>;
        };
    };
...
```

## Documentation/devicetree/bindings/iio/adc/ti,ads7924.yaml
```yaml
# SPDX-License-Identifier: (GPL-2.0 OR BSD-2-Clause)
%YAML 1.2
---
$id: http://devicetree.org/schemas/iio/adc/ti,ads7924.yaml#
$schema: http://devicetree.org/meta-schemas/core.yaml#

title: TI ADS7924 4 channels 12 bits I2C analog to digital converter

maintainers:
  - Hugo Villeneuve <hvilleneuve@dimonoff.com>

description: |
  Texas Instruments ADS7924 4 channels 12 bits I2C analog to digital converter

  Specifications:
    https://www.ti.com/lit/gpn/ads7924

properties:
  compatible:
    const: ti,ads7924

  reg:
    maxItems: 1

  vref-supply:
    description:
      The regulator supply for the ADC reference voltage (AVDD)

  reset-gpios:
    maxItems: 1

  interrupts:
    maxItems: 1

  "#address-cells":
    const: 1

  "#size-cells":
    const: 0

  "#io-channel-cells":
    const: 1

patternProperties:
  "^channel@[0-3]+$":
    $ref: adc.yaml

    description: |
      Represents the external channels which are connected to the ADC.

    properties:
      reg:
        description: |
          The channel number. It can have up to 4 channels numbered from 0 to 3.
        items:
          - minimum: 0
            maximum: 3

      label: true

    required:
      - reg

    additionalProperties: false

additionalProperties: false

required:
  - compatible
  - reg
  - vref-supply
  - "#address-cells"
  - "#size-cells"

examples:
  - |
    #include <dt-bindings/interrupt-controller/irq.h>
    #include <dt-bindings/gpio/gpio.h>
    i2c {
        #address-cells = <1>;
        #size-cells = <0>;

        adc@48 {
            compatible = "ti,ads7924";
            reg = <0x48>;
            vref-supply = <&ads7924_reg>;
            reset-gpios = <&gpio 5 GPIO_ACTIVE_LOW>;
            interrupts = <25 IRQ_TYPE_EDGE_FALLING>;
            interrupt-parent = <&gpio>;
            #address-cells = <1>;
            #size-cells = <0>;
            channel@0 {
                reg = <0>;
                label = "CH0";
            };
            channel@1 {
                reg = <1>;
                label = "CH1";
            };
            channel@2 {
                reg = <2>;
                label = "CH2";
            };
            channel@3 {
                reg = <3>;
                label = "CH3";
            };
        };
    };
...
```
