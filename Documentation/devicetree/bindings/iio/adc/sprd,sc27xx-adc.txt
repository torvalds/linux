## Documentation/devicetree/bindings/iio/adc/sprd,sc27xx-adc.txt
```
Spreadtrum SC27XX series PMICs ADC binding

Required properties:
- compatible: Should be one of the following.
	"sprd,sc2720-adc"
	"sprd,sc2721-adc"
	"sprd,sc2723-adc"
	"sprd,sc2730-adc"
	"sprd,sc2731-adc"
- reg: The address offset of ADC controller.
- interrupt-parent: The interrupt controller.
- interrupts: The interrupt number for the ADC device.
- #io-channel-cells: Number of cells in an IIO specifier.
- hwlocks: Reference to a phandle of a hwlock provider node.
- nvmem-cells: A phandle to the calibration cells provided by eFuse device.
- nvmem-cell-names: Should be "big_scale_calib", "small_scale_calib".

Example:

	sc2731_pmic: pmic@0 {
		compatible = "sprd,sc2731";
		reg = <0>;
		spi-max-frequency = <26000000>;
		interrupts = <GIC_SPI 31 IRQ_TYPE_LEVEL_HIGH>;
		interrupt-controller;
		#interrupt-cells = <2>;
		#address-cells = <1>;
		#size-cells = <0>;

		pmic_adc: adc@480 {
			compatible = "sprd,sc2731-adc";
			reg = <0x480>;
			interrupt-parent = <&sc2731_pmic>;
			interrupts = <0 IRQ_TYPE_LEVEL_HIGH>;
			#io-channel-cells = <1>;
			hwlocks = <&hwlock 4>;
			nvmem-cells = <&adc_big_scale>, <&adc_small_scale>;
			nvmem-cell-names = "big_scale_calib", "small_scale_calib";
		};
	};
```

## Documentation/devicetree/bindings/iio/adc/st,spear600-adc.yaml
```yaml
# SPDX-License-Identifier: (GPL-2.0 OR BSD-2-Clause)
%YAML 1.2
---
$id: http://devicetree.org/schemas/iio/adc/st,spear600-adc.yaml#
$schema: http://devicetree.org/meta-schemas/core.yaml#

title: ST SPEAr ADC device driver

maintainers:
  - Jonathan Cameron <jic23@kernel.org>

description: |
  Integrated ADC inside the ST SPEAr SoC, SPEAr600, supporting
  10-bit resolution. Datasheet can be found here:
  https://www.st.com/resource/en/datasheet/spear600.pdf

properties:
  compatible:
    enum:
      - st,spear600-adc

  reg:
    maxItems: 1

  interrupts:
    maxItems: 1

  sampling-frequency:
    $ref: /schemas/types.yaml#/definitions/uint32
    minimum: 2500000
    maximum: 20000000
    description:
      Default sampling frequency of the ADC in Hz.

  vref-external:
    $ref: /schemas/types.yaml#/definitions/uint32
    minimum: 1000
    maximum: 2800
    description:
      External voltage reference in milli-volts. If omitted the internal voltage
      reference will be used.

  average-samples:
    $ref: /schemas/types.yaml#/definitions/uint32
    minimum: 0
    maximum: 15
    default: 0
    description:
      Number of samples to generate an average value. If omitted, single data
      conversion will be used.

required:
  - compatible
  - reg
  - interrupts
  - sampling-frequency

additionalProperties: false

examples:
  - |
    adc@d8200000 {
        compatible = "st,spear600-adc";
        reg = <0xd8200000 0x1000>;
        interrupt-parent = <&vic1>;
        interrupts = <6>;
        sampling-frequency = <5000000>;
        vref-external = <2500>;	/* 2.5V VRef */
    };
```

## Documentation/devicetree/bindings/iio/adc/st,stm32-adc.txt
```
STMicroelectronics STM32 ADC device driver

STM32 ADC is a successive approximation analog-to-digital converter.
It has several multiplexed input channels. Conversions can be performed
in single, continuous, scan or discontinuous mode. Result of the ADC is
stored in a left-aligned or right-aligned 32-bit data register.
Conversions can be launched in software or using hardware triggers.

The analog watchdog feature allows the application to detect if the input
voltage goes beyond the user-defined, higher or lower thresholds.

Each STM32 ADC block can have up to 3 ADC instances.

Each instance supports two contexts to manage conversions, each one has its
own configurable sequence and trigger:
- regular conversion can be done in sequence, running in background
- injected conversions have higher priority, and so have the ability to
  interrupt regular conversion sequence (either triggered in SW or HW).
  Regular sequence is resumed, in case it has been interrupted.

Contents of a stm32 adc root node:
-----------------------------------
Required properties:
- compatible: Should be one of:
  "st,stm32f4-adc-core"
  "st,stm32h7-adc-core"
  "st,stm32mp1-adc-core"
- reg: Offset and length of the ADC block register set.
- interrupts: One or more interrupts for ADC block. Some parts like stm32f4
  and stm32h7 share a common ADC interrupt line. stm32mp1 has two separate
  interrupt lines, one for each ADC within ADC block.
- clocks: Core can use up to two clocks, depending on part used:
  - "adc" clock: for the analog circuitry, common to all ADCs.
    It's required on stm32f4.
    It's optional on stm32h7.
  - "bus" clock: for registers access, common to all ADCs.
    It's not present on stm32f4.
    It's required on stm32h7.
- clock-names: Must be "adc" and/or "bus" depending on part used.
- interrupt-controller: Identifies the controller node as interrupt-parent
- vdda-supply: Phandle to the vdda input analog voltage.
- vref-supply: Phandle to the vref input analog reference voltage.
- #interrupt-cells = <1>;
- #address-cells = <1>;
- #size-cells = <0>;

Optional properties:
- A pinctrl state named "default" for each ADC channel may be defined to set
  inX ADC pins in mode of operation for analog input on external pin.
- booster-supply: Phandle to the embedded booster regulator that can be used
  to supply ADC analog input switches on stm32h7 and stm32mp1.
- vdd-supply: Phandle to the vdd input voltage. It can be used to supply ADC
  analog input switches on stm32mp1.
- st,syscfg: Phandle to system configuration controller. It can be used to
  control the analog circuitry on stm32mp1.

Contents of a stm32 adc child node:
-----------------------------------
An ADC block node should contain at least one subnode, representing an
ADC instance available on the machine.

Required properties:
- compatible: Should be one of:
  "st,stm32f4-adc"
  "st,stm32h7-adc"
  "st,stm32mp1-adc"
- reg: Offset of ADC instance in ADC block (e.g. may be 0x0, 0x100, 0x200).
- clocks: Input clock private to this ADC instance. It's required only on
  stm32f4, that has per instance clock input for registers access.
- interrupts: IRQ Line for the ADC (e.g. may be 0 for adc@0, 1 for adc@100 or
  2 for adc@200).
- st,adc-channels: List of single-ended channels muxed for this ADC.
  It can have up to 16 channels on stm32f4 or 20 channels on stm32h7, numbered
  from 0 to 15 or 19 (resp. for in0..in15 or in0..in19).
- st,adc-diff-channels: List of differential channels muxed for this ADC.
  Depending on part used, some channels can be configured as differential
  instead of single-ended (e.g. stm32h7). List here positive and negative
  inputs pairs as <vinp vinn>, <vinp vinn>,... vinp and vinn are numbered
  from 0 to 19 on stm32h7)
  Note: At least one of "st,adc-channels" or "st,adc-diff-channels" is required.
  Both properties can be used together. Some channels can be used as
  single-ended and some other ones as differential (mixed). But channels
  can't be configured both as single-ended and differential (invalid).
- #io-channel-cells = <1>: See the IIO bindings section "IIO consumers" in
  Documentation/devicetree/bindings/iio/iio-bindings.txt

Optional properties:
- dmas: Phandle to dma channel for this ADC instance.
  See ../../dma/dma.txt for details.
- dma-names: Must be "rx" when dmas property is being used.
- assigned-resolution-bits: Resolution (bits) to use for conversions. Must
  match device available resolutions:
  * can be 6, 8, 10 or 12 on stm32f4
  * can be 8, 10, 12, 14 or 16 on stm32h7
  Default is maximum resolution if unset.
- st,min-sample-time-nsecs: Minimum sampling time in nanoseconds.
  Depending on hardware (board) e.g. high/low analog input source impedance,
  fine tune of ADC sampling time may be recommended.
  This can be either one value or an array that matches 'st,adc-channels' list,
  to set sample time resp. for all channels, or independently for each channel.

Example:
	adc: adc@40012000 {
		compatible = "st,stm32f4-adc-core";
		reg = <0x40012000 0x400>;
		interrupts = <18>;
		clocks = <&rcc 0 168>;
		clock-names = "adc";
		vref-supply = <&reg_vref>;
		interrupt-controller;
		pinctrl-names = "default";
		pinctrl-0 = <&adc3_in8_pin>;

		#interrupt-cells = <1>;
		#address-cells = <1>;
		#size-cells = <0>;

		adc@0 {
			compatible = "st,stm32f4-adc";
			#io-channel-cells = <1>;
			reg = <0x0>;
			clocks = <&rcc 0 168>;
			interrupt-parent = <&adc>;
			interrupts = <0>;
			st,adc-channels = <8>;
			dmas = <&dma2 0 0 0x400 0x0>;
			dma-names = "rx";
			assigned-resolution-bits = <8>;
		};
		...
		other adc child nodes follow...
	};

Example to setup:
- channel 1 as single-ended
- channels 2 & 3 as differential (with resp. 6 & 7 negative inputs)

	adc: adc@40022000 {
		compatible = "st,stm32h7-adc-core";
		...
		adc1: adc@0 {
			compatible = "st,stm32h7-adc";
			...
			st,adc-channels = <1>;
			st,adc-diff-channels = <2 6>, <3 7>;
		};
	};
```
