## Documentation/devicetree/bindings/iio/adc/ti,adc084s021.yaml
```yaml
# SPDX-License-Identifier: (GPL-2.0 OR BSD-2-Clause)
%YAML 1.2
---
$id: http://devicetree.org/schemas/iio/adc/ti,adc084s021.yaml#
$schema: http://devicetree.org/meta-schemas/core.yaml#

title: Texas Instruments ADC084S021 ADC

maintainers:
  - Mårten Lindahl <martenli@axis.com>

description: |
  8 bit ADC with 4 channels

properties:
  compatible:
    const: ti,adc084s021

  reg:
    maxItems: 1

  spi-max-frequency: true

  vref-supply:
    description: External reference, needed to establish input scaling

  spi-cpol: true
  spi-cpha: true

  "#io-channel-cells":
    const: 1

required:
  - compatible
  - reg
  - vref-supply
  - spi-cpol
  - spi-cpha

additionalProperties: false

examples:
  - |
    spi {
        #address-cells = <1>;
        #size-cells = <0>;

        adc@0 {
            compatible = "ti,adc084s021";
            reg = <0>;
            vref-supply = <&adc_vref>;
            spi-cpol;
            spi-cpha;
            spi-max-frequency = <16000000>;
            #io-channel-cells = <1>;
        };
    };
...
```

## Documentation/devicetree/bindings/iio/adc/ti,adc108s102.yaml
```yaml
# SPDX-License-Identifier: (GPL-2.0 OR BSD-2-Clause)
%YAML 1.2
---
$id: http://devicetree.org/schemas/iio/adc/ti,adc108s102.yaml#
$schema: http://devicetree.org/meta-schemas/core.yaml#

title: Texas Instruments ADC108S102 and ADC128S102

maintainers:
  - Jonathan Cameron <jic23@kernel.org>

description: |
  Family of 8 channel, 10/12 bit, SPI, single ended ADCs.

properties:
  compatible:
    const:
      ti,adc108s102

  reg: true
  vref-supply: true
  "#io-channel-cells":
    const: 1

required:
  - compatible
  - reg
  - vref-supply

allOf:
  - $ref: /schemas/spi/spi-peripheral-props.yaml#

unevaluatedProperties: false

examples:
  - |
    spi {
        #address-cells = <1>;
        #size-cells = <0>;

        adc@0 {
            compatible = "ti,adc108s102";
            reg = <0>;
            vref-supply = <&vdd_supply>;
            spi-max-frequency = <1000000>;
            #io-channel-cells = <1>;
        };
    };
...
```

## Documentation/devicetree/bindings/iio/adc/ti,adc12138.yaml
```yaml
# SPDX-License-Identifier: (GPL-2.0 OR BSD-2-Clause)
%YAML 1.2
---
$id: http://devicetree.org/schemas/iio/adc/ti,adc12138.yaml#
$schema: http://devicetree.org/meta-schemas/core.yaml#

title: Texas Instruments ADC12138 and similar self-calibrating ADCs

maintainers:
  - Akinobu Mita <akinobu.mita@gmail.com>

description: |
  13 bit ADCs with 1, 2 or 8 inputs and self calibrating circuitry to
  correct for linearity, zero and full scale errors.

properties:
  compatible:
    enum:
      - ti,adc12130
      - ti,adc12132
      - ti,adc12138

  reg:
    maxItems: 1

  interrupts:
    maxItems: 1
    description: End of Conversion (EOC) interrupt

  clocks:
    maxItems: 1
    description: Conversion clock input.

  vref-p-supply:
    description: The regulator supply for positive analog voltage reference

  vref-n-supply:
    description: |
      The regulator supply for negative analog voltage reference
      (Note that this must not go below GND or exceed vref-p)
      If not specified, this is assumed to be analog ground.

  ti,acquisition-time:
    $ref: /schemas/types.yaml#/definitions/uint32
    enum: [ 6, 10, 18, 34 ]
    description: |
      The number of conversion clock periods for the S/H's acquisition time.
      For high source impedances, this value can be increased to 18 or 34.
      For less ADC accuracy and/or slower CCLK frequencies this value may be
      decreased to 6.  See section 6.0 INPUT SOURCE RESISTANCE in the
      datasheet for details.

  "#io-channel-cells":
    const: 1

required:
  - compatible
  - reg
  - interrupts
  - clocks
  - vref-p-supply

allOf:
  - $ref: /schemas/spi/spi-peripheral-props.yaml#

unevaluatedProperties: false

examples:
  - |
    #include <dt-bindings/interrupt-controller/irq.h>
    spi {
        #address-cells = <1>;
        #size-cells = <0>;

        adc@0 {
            compatible = "ti,adc12138";
            reg = <0>;
            interrupts = <28 IRQ_TYPE_EDGE_RISING>;
            interrupt-parent = <&gpio1>;
            clocks = <&cclk>;
            vref-p-supply = <&ldo4_reg>;
            spi-max-frequency = <5000000>;
            ti,acquisition-time = <6>;
            #io-channel-cells = <1>;
        };
    };
...
```

## Documentation/devicetree/bindings/iio/adc/ti,adc128s052.yaml
```yaml
# SPDX-License-Identifier: (GPL-2.0 OR BSD-2-Clause)
%YAML 1.2
---
$id: http://devicetree.org/schemas/iio/adc/ti,adc128s052.yaml#
$schema: http://devicetree.org/meta-schemas/core.yaml#

title: Texas Instruments ADC128S052 and similar ADCs

maintainers:
  - Angelo Compagnucci <angelo.compagnucci@gmail.com>

description: |
  Family of 12 bit SPI ADCs with 2 to 8 channels with a range of different
  target sample rates.

properties:
  compatible:
    enum:
      - ti,adc122s021
      - ti,adc122s051
      - ti,adc122s101
      - ti,adc124s021
      - ti,adc124s051
      - ti,adc124s101
      - ti,adc128s052

  reg:
    maxItems: 1

  vref-supply: true

  "#io-channel-cells":
    const: 1

required:
  - compatible
  - reg
  - vref-supply

allOf:
  - $ref: /schemas/spi/spi-peripheral-props.yaml#

unevaluatedProperties: false

examples:
  - |
    spi {
        #address-cells = <1>;
        #size-cells = <0>;

        adc@0 {
            compatible = "ti,adc128s052";
            reg = <0>;
            vref-supply = <&vdd_supply>;
            spi-max-frequency = <1000000>;
            #io-channel-cells = <1>;
        };
    };
...
```

## Documentation/devicetree/bindings/iio/adc/ti,adc161s626.yaml
```yaml
# SPDX-License-Identifier: (GPL-2.0 OR BSD-2-Clause)
%YAML 1.2
---
$id: http://devicetree.org/schemas/iio/adc/ti,adc161s626.yaml#
$schema: http://devicetree.org/meta-schemas/core.yaml#

title: Texas Instruments ADC141S626 and ADC161S626 ADCs

maintainers:
  - Matt Ranostay <matt.ranostay@konsulko.com>

description: |
  Single channel 14/16bit differential ADCs

properties:
  compatible:
    enum:
      - ti,adc141s626
      - ti,adc161s626

  reg:
    maxItems: 1

  spi-max-frequency: true

  vdda-supply: true

  "#io-channel-cells":
    const: 1

required:
  - compatible
  - reg

additionalProperties: false

examples:
  - |
    spi {
        #address-cells = <1>;
        #size-cells = <0>;

        adc@0 {
            compatible = "ti,adc161s626";
            vdda-supply = <&vdda_fixed>;
            reg = <0>;
            spi-max-frequency = <4300000>;
            #io-channel-cells = <1>;
        };
    };
...
```

## Documentation/devicetree/bindings/iio/adc/ti,ads1015.yaml
```yaml
# SPDX-License-Identifier: (GPL-2.0 OR BSD-2-Clause)
%YAML 1.2
---
$id: http://devicetree.org/schemas/iio/adc/ti,ads1015.yaml#
$schema: http://devicetree.org/meta-schemas/core.yaml#

title: TI ADS1015/ADS1115 4 channel I2C analog to digital converter

maintainers:
  - Daniel Baluta <daniel.baluta@nxp.com>

description: |
  Datasheet at: https://www.ti.com/lit/gpn/ads1015
  Supports both single ended and differential channels.

properties:
  compatible:
    enum:
      - ti,ads1015
      - ti,ads1115
      - ti,tla2024

  reg:
    maxItems: 1

  "#address-cells":
    const: 1

  "#size-cells":
    const: 0

  "#io-channel-cells":
    const: 1

required:
  - compatible
  - reg
  - "#address-cells"
  - "#size-cells"

additionalProperties: false

patternProperties:
  "^channel@[0-7]+$":
    type: object
    additionalProperties: false
    description:
      Child nodes needed for each channel that the platform uses.

    properties:
      reg:
        description: |
          0: Voltage over AIN0 and AIN1.
          1: Voltage over AIN0 and AIN3.
          2: Voltage over AIN1 and AIN3.
          3: Voltage over AIN2 and AIN3.
          4: Voltage over AIN0 and GND.
          5: Voltage over AIN1 and GND.
          6: Voltage over AIN2 and GND.
          7: Voltage over AIN3 and GND.
        items:
          - minimum: 0
            maximum: 7

      ti,gain:
        $ref: /schemas/types.yaml#/definitions/uint32
        minimum: 0
        maximum: 5
        description: |
          pga is the programmable gain amplifier (values are full scale)
          0: +/- 6.144 V
          1: +/- 4.096 V
          2: +/- 2.048 V (default)
          3: +/- 1.024 V
          4: +/- 0.512 V
          5: +/- 0.256 V

      ti,datarate:
        $ref: /schemas/types.yaml#/definitions/uint32
        minimum: 0
        maximum: 6
        description: |
          Data acquisition rate in samples per second
          0: 128
          1: 250
          2: 490
          3: 920
          4: 1600 (default)
          5: 2400
          6: 3300

    required:
      - reg

examples:
  - |
    i2c {
        #address-cells = <1>;
        #size-cells = <0>;

        adc@49 {
            compatible = "ti,ads1015";
            reg = <0x49>;
            #address-cells = <1>;
            #size-cells = <0>;
            channel@0 {
              reg = <0>;
            };
            channel@4 {
              reg = <4>;
              ti,gain = <3>;
              ti,datarate = <5>;
            };
        };
    };
...
```

## Documentation/devicetree/bindings/iio/adc/ti,ads1018.yaml
```yaml
# SPDX-License-Identifier: (GPL-2.0-only OR BSD-2-Clause)
%YAML 1.2
---
$id: http://devicetree.org/schemas/iio/adc/ti,ads1018.yaml#
$schema: http://devicetree.org/meta-schemas/core.yaml#

title: TI ADS1018/ADS1118 SPI analog to digital converter

maintainers:
  - Kurt Borja <kuurtb@gmail.com>

description: |
  The ADS1018/ADS1118 is a precision, low-power, 12-bit/16-bit, analog to
  digital converter (ADC). It integrates a programmable gain amplifier (PGA),
  internal voltage reference, oscillator and high-accuracy temperature sensor.

  Datasheets:
    - ADS1018: https://www.ti.com/lit/ds/symlink/ads1018.pdf
    - ADS1118: https://www.ti.com/lit/ds/symlink/ads1118.pdf

properties:
  compatible:
    enum:
      - ti,ads1018
      - ti,ads1118

  reg:
    maxItems: 1

  vdd-supply: true

  spi-max-frequency:
    maximum: 4000000

  spi-cpha: true

  interrupts:
    description: DOUT/DRDY (Data Out/Data Ready) line.
    maxItems: 1

  drdy-gpios:
    description:
      Extra GPIO line connected to DOUT/DRDY (Data Out/Data Ready). This allows
      distinguishing between interrupts triggered by the data-ready signal and
      interrupts triggered by an SPI transfer.
    maxItems: 1

  '#io-channel-cells':
    const: 1

required:
  - compatible
  - reg
  - vdd-supply

allOf:
  - $ref: /schemas/spi/spi-peripheral-props.yaml#

unevaluatedProperties: false

examples:
  - |
    #include <dt-bindings/interrupt-controller/irq.h>
    #include <dt-bindings/gpio/gpio.h>

    spi {
        #address-cells = <1>;
        #size-cells = <0>;

        adc@0 {
            compatible = "ti,ads1118";
            reg = <0>;

            spi-max-frequency = <4000000>;
            spi-cpha;

            vdd-supply = <&vdd_3v3_reg>;

            interrupts-extended = <&gpio 14 IRQ_TYPE_EDGE_FALLING>;
            drdy-gpios = <&gpio 14 GPIO_ACTIVE_LOW>;
        };
    };
```

## Documentation/devicetree/bindings/iio/adc/ti,ads1119.yaml
```yaml
# SPDX-License-Identifier: (GPL-2.0-only OR BSD-2-Clause)
%YAML 1.2
---
$id: http://devicetree.org/schemas/iio/adc/ti,ads1119.yaml#
$schema: http://devicetree.org/meta-schemas/core.yaml#

title: Texas Instruments ADS1119 ADC

maintainers:
  - João Paulo Gonçalves <jpaulo.silvagoncalves@gmail.com>

description:
  The TI ADS1119 is a precision 16-bit ADC over I2C that offers single-ended and
  differential measurements using a multiplexed input. It features a programmable
  gain, a programmable sample rate, an internal oscillator and voltage reference,
  and a 50/60Hz rejection filter.

properties:
  compatible:
    const: ti,ads1119

  reg:
    maxItems: 1

  interrupts:
    maxItems: 1

  reset-gpios:
    maxItems: 1

  avdd-supply: true
  dvdd-supply: true

  vref-supply:
    description:
      ADC external reference voltage (VREF).

  "#address-cells":
    const: 1

  "#size-cells":
    const: 0

  "#io-channel-cells":
    const: 1

required:
  - compatible
  - reg
  - "#address-cells"
  - "#size-cells"
  - avdd-supply
  - dvdd-supply

patternProperties:
  "^channel@([0-6])$":
    $ref: adc.yaml
    type: object
    properties:
      reg:
        minimum: 0
        maximum: 6

      diff-channels:
        description:
          Differential input channels AIN0-AIN1, AIN2-AIN3 and AIN1-AIN2.
        oneOf:
          - items:
              - const: 0
              - const: 1
          - items:
              - const: 2
              - const: 3
          - items:
              - const: 1
              - const: 2

      single-channel:
        description:
          Single-ended input channels AIN0, AIN1, AIN2 and AIN3.
        minimum: 0
        maximum: 3

    oneOf:
      - required:
          - diff-channels
      - required:
          - single-channel

    required:
      - reg

    unevaluatedProperties: false

additionalProperties: false

examples:
  - |

    #include <dt-bindings/gpio/gpio.h>
    #include <dt-bindings/interrupt-controller/irq.h>

    i2c {
        #address-cells = <1>;
        #size-cells = <0>;

        adc@40 {
            compatible = "ti,ads1119";
            reg = <0x40>;
            interrupt-parent = <&gpio1>;
            interrupts = <25 IRQ_TYPE_EDGE_FALLING>;
            reset-gpios = <&gpio1 10 GPIO_ACTIVE_LOW>;
            avdd-supply = <&reg_avdd_ads1119>;
            dvdd-supply = <&reg_dvdd_ads1119>;
            vref-supply = <&reg_vref_ads1119>;
            #address-cells = <1>;
            #size-cells = <0>;
            #io-channel-cells = <1>;

            channel@0 {
                reg = <0>;
                single-channel = <0>;
            };

            channel@1 {
                reg = <1>;
                diff-channels = <0 1>;
            };

            channel@2 {
                reg = <2>;
                single-channel = <3>;
            };

            channel@3 {
                reg = <3>;
                single-channel = <1>;
            };

            channel@4 {
                reg = <4>;
                single-channel = <2>;
            };

            channel@5 {
                reg = <5>;
                diff-channels = <1 2>;
            };

            channel@6 {
                reg = <6>;
                diff-channels = <2 3>;
            };
        };
    };
```

## Documentation/devicetree/bindings/iio/adc/ti,ads124s08.yaml
```yaml
# SPDX-License-Identifier: (GPL-2.0-only OR BSD-2-Clause)
%YAML 1.2
---
$id: http://devicetree.org/schemas/iio/adc/ti,ads124s08.yaml#
$schema: http://devicetree.org/meta-schemas/core.yaml#

title: Texas Instruments' ads124s08 and ads124s06 ADC chip

maintainers:
  - Andrew Davis <afd@ti.com>

properties:
  compatible:
    enum:
      - ti,ads124s06
      - ti,ads124s08

  reg:
    maxItems: 1

  spi-max-frequency: true

  spi-cpha: true

  reset-gpios:
    maxItems: 1

  "#io-channel-cells":
    const: 1

required:
  - compatible
  - reg

additionalProperties: false

examples:
  - |
    #include <dt-bindings/gpio/gpio.h>
    spi {
        #address-cells = <1>;
        #size-cells = <0>;

        adc@0 {
            compatible = "ti,ads124s08";
            reg = <0>;
            spi-max-frequency = <1000000>;
            spi-cpha;
            reset-gpios = <&gpio1 16 GPIO_ACTIVE_LOW>;
        };
    };
...
```
