## Documentation/devicetree/bindings/iio/amplifiers/adi,adl8113.yaml
```yaml
# SPDX-License-Identifier: (GPL-2.0-only OR BSD-2-Clause)
%YAML 1.2
---
$id: http://devicetree.org/schemas/iio/amplifiers/adi,adl8113.yaml#
$schema: http://devicetree.org/meta-schemas/core.yaml#

title: Analog Devices ADL8113 Low Noise Amplifier with integrated bypass switches

maintainers:
  - Antoniu Miclaus <antoniu.miclaus@analog.com>

description: |
  The ADL8113 is a 10MHz to 12GHz Low Noise Amplifier with integrated bypass
  switches controlled by two GPIO pins (VA and VB). The device supports four
  operation modes:
    - Internal Amplifier: VA=0, VB=0 - Signal passes through the internal LNA
    - Internal Bypass: VA=1, VB=1 - Signal bypasses through internal path
    - External Bypass A: VA=0, VB=1 - Signal routes from RFIN to OUT_A and from IN_A to RFOUT
    - External Bypass B: VA=1, VB=0 - Signal routes from RFIN to OUT_B and from IN_B to RFOUT

    https://www.analog.com/en/products/adl8113.html

properties:
  compatible:
    const: adi,adl8113

  vdd1-supply: true

  vdd2-supply: true

  vss2-supply: true

  ctrl-gpios:
    items:
      - description: VA control pin
      - description: VB control pin

  adi,external-bypass-a-gain-db:
    description:
      Gain in dB of external amplifier connected to bypass path A (OUT_A/IN_A).
      When specified, this gain value becomes selectable via the hardwaregain
      attribute and automatically routes through the external A path.

  adi,external-bypass-b-gain-db:
    description:
      Gain in dB of external amplifier connected to bypass path B (OUT_B/IN_B).
      When specified, this gain value becomes selectable via the hardwaregain
      attribute and automatically routes through the external B path.

required:
  - compatible
  - ctrl-gpios
  - vdd1-supply
  - vdd2-supply
  - vss2-supply

additionalProperties: false

examples:
  - |
    #include <dt-bindings/gpio/gpio.h>

    /* Basic configuration with only internal paths */
    amplifier {
        compatible = "adi,adl8113";
        ctrl-gpios = <&gpio 22 GPIO_ACTIVE_HIGH>,
                     <&gpio 23 GPIO_ACTIVE_HIGH>;
        vdd1-supply = <&vdd1_5v>;
        vdd2-supply = <&vdd2_3v3>;
        vss2-supply = <&vss2_neg>;
    };

  - |
    #include <dt-bindings/gpio/gpio.h>

    /* Configuration with external bypass amplifiers */
    amplifier {
        compatible = "adi,adl8113";
        ctrl-gpios = <&gpio 24 GPIO_ACTIVE_HIGH>,
                     <&gpio 25 GPIO_ACTIVE_HIGH>;
        vdd1-supply = <&vdd1_5v>;
        vdd2-supply = <&vdd2_3v3>;
        vss2-supply = <&vss2_neg>;
        adi,external-bypass-a-gain-db = <20>;  /* 20dB external amp on path A */
        adi,external-bypass-b-gain-db = <6>;   /* 6dB external amp on path B */
    };
...
```

## Documentation/devicetree/bindings/iio/amplifiers/adi,hmc425a.yaml
```yaml
# SPDX-License-Identifier: (GPL-2.0-only OR BSD-2-Clause)
%YAML 1.2
---
$id: http://devicetree.org/schemas/iio/amplifiers/adi,hmc425a.yaml#
$schema: http://devicetree.org/meta-schemas/core.yaml#

title: Analog Devices HMC425A and similar Digital Step Attenuators

maintainers:
  - Michael Hennerich <michael.hennerich@analog.com>

description: |
  Digital Step Attenuator IIO devices with gpio interface.
  Offer various frequency and attenuation ranges.
  ADRF5750 2 dB LSB, 4-Bit, Silicon Digital Attenuator, 10 MHz to 60 GHz
    https://www.analog.com/media/en/technical-documentation/data-sheets/adrf5740.pdf

  HMC425A 0.5 dB LSB GaAs MMIC 6-BIT DIGITAL POSITIVE CONTROL ATTENUATOR, 2.2 - 8.0 GHz
    https://www.analog.com/media/en/technical-documentation/data-sheets/hmc425A.pdf

  HMC540S 1 dB LSB Silicon MMIC 4-Bit Digital Positive Control Attenuator, 0.1 - 8 GHz
    https://www.analog.com/media/en/technical-documentation/data-sheets/hmc540s.pdf

  LTC6373 is a 3-Bit precision instrumentation amplifier with fully differential outputs
    https://www.analog.com/media/en/technical-documentation/data-sheets/ltc6373.pdf

properties:
  compatible:
    enum:
      - adi,adrf5740
      - adi,hmc425a
      - adi,hmc540s
      - adi,ltc6373

  vcc-supply: true

  ctrl-gpios:
    description:
      Must contain an array of GPIO specifiers, referring to the GPIO pins
      connected to the control pins.
        ADRF5740  - 4 GPIO connected to D2-D5
        HMC540S   - 4 GPIO connected to V1-V4
        HMC425A   - 6 GPIO connected to V1-V6
        LTC6373   - 3 GPIO connected to A0-A2
    minItems: 1
    maxItems: 6

allOf:
  - if:
      properties:
        compatible:
          contains:
            const: adi,hmc425a
    then:
      properties:
        ctrl-gpios:
          minItems: 6
          maxItems: 6
  - if:
      properties:
        compatible:
          contains:
            anyOf:
              - const: adi,adrf5740
              - const: adi,hmc540s
    then:
      properties:
        ctrl-gpios:
          minItems: 4
          maxItems: 4
  - if:
      properties:
        compatible:
          contains:
            const: adi,ltc6373
    then:
      properties:
        ctrl-gpios:
          minItems: 3
          maxItems: 3

required:
  - compatible
  - ctrl-gpios

additionalProperties: false

examples:
  - |
    #include <dt-bindings/gpio/gpio.h>
    gpio_hmc425a: hmc425a {
      compatible = "adi,hmc425a";
      ctrl-gpios = <&gpio 40 GPIO_ACTIVE_HIGH>,
        <&gpio 39 GPIO_ACTIVE_HIGH>,
        <&gpio 38 GPIO_ACTIVE_HIGH>,
        <&gpio 37 GPIO_ACTIVE_HIGH>,
        <&gpio 36 GPIO_ACTIVE_HIGH>,
        <&gpio 35 GPIO_ACTIVE_HIGH>;
      vcc-supply = <&foo>;
    };
...
```

## Documentation/devicetree/bindings/iio/cdc/adi,ad7150.yaml
```yaml
# SPDX-License-Identifier: (GPL-2.0 OR BSD-2-Clause)
%YAML 1.2
---
$id: http://devicetree.org/schemas/iio/cdc/adi,ad7150.yaml#
$schema: http://devicetree.org/meta-schemas/core.yaml#

title: Analog device AD7150 and similar capacitance to digital converters.

maintainers:
  - Jonathan Cameron <jic23@kernel.org>

properties:
  compatible:
    enum:
      - adi,ad7150
      - adi,ad7151
      - adi,ad7156

  reg:
    maxItems: 1

  vdd-supply: true

  interrupts: true

allOf:
  - if:
      properties:
        compatible:
          contains:
            enum:
              - adi,ad7150
              - adi,ad7156
    then:
      properties:
        interrupts:
          minItems: 2
          maxItems: 2
  - if:
      properties:
        compatible:
          contains:
            const: adi,ad7151
    then:
      properties:
        interrupts:
          minItems: 1
          maxItems: 1

required:
  - compatible
  - reg

additionalProperties: false

examples:
  - |
    i2c {
        #address-cells = <1>;
        #size-cells = <0>;

        cdc@48 {
            compatible = "adi,ad7150";
            reg = <0x48>;
            interrupts = <25 2>, <26 2>;
            interrupt-parent = <&gpio>;
        };
    };
...
```

## Documentation/devicetree/bindings/iio/cdc/adi,ad7746.yaml
```yaml
# SPDX-License-Identifier: (GPL-2.0-only OR BSD-2-Clause)
%YAML 1.2
---
$id: http://devicetree.org/schemas/iio/cdc/adi,ad7746.yaml#
$schema: http://devicetree.org/meta-schemas/core.yaml#

title: AD7746 24-Bit Capacitance-to-Digital Converter with Temperature Sensor

maintainers:
  - Michael Hennerich <michael.hennerich@analog.com>

description: |
  AD7746 24-Bit Capacitance-to-Digital Converter with Temperature Sensor

  Specifications about the part can be found at:
  https://www.analog.com/media/en/technical-documentation/data-sheets/ad7291.pdf

properties:
  compatible:
    enum:
      - adi,ad7745
      - adi,ad7746
      - adi,ad7747

  reg:
    maxItems: 1

  adi,excitation-vdd-permille:
    description: |
      Set VDD per mille to be used as the excitation voltage.
    $ref: /schemas/types.yaml#/definitions/uint32
    enum: [125, 250, 375, 500]

  adi,exca-output-en:
    description: Enables the EXCA pin as the excitation output.
    type: boolean

  adi,exca-output-invert:
    description: |
      Inverts the excitation output in the EXCA pin.
      Normally only one of the EXCX pins would be inverted, check the following
      application notes for more details
      https://www.analog.com/media/en/technical-documentation/application-notes/AN-1585.pdf
    type: boolean

  adi,excb-output-en:
    description: Enables the EXCB pin as the excitation output.
    type: boolean

  adi,excb-output-invert:
    description: Inverts the excitation output in the EXCB pin.
    type: boolean

required:
  - compatible
  - reg

additionalProperties: false

examples:
  - |
    i2c {
      #address-cells = <1>;
      #size-cells = <0>;

      ad7746: cdc@48 {
        compatible = "adi,ad7746";
        reg = <0x48>;
        adi,excitation-vdd-permille = <125>;

        adi,exca-output-en;
        adi,exca-output-invert;
        adi,excb-output-en;
        adi,excb-output-invert;
      };
    };
...
```

## Documentation/devicetree/bindings/iio/chemical/ams,ccs811.yaml
```yaml
# SPDX-License-Identifier: (GPL-2.0 OR BSD-2-Clause)
%YAML 1.2
---
$id: http://devicetree.org/schemas/iio/chemical/ams,ccs811.yaml#
$schema: http://devicetree.org/meta-schemas/core.yaml#

title: AMS CCS811 VOC Sensor

maintainers:
  - Narcisa Vasile <narcisaanamaria12@gmail.com>

description: |
  Ultra-Low Power Digital Gas Sensor for Monitoring Indoor Air Quality.

properties:
  compatible:
    enum:
      - ams,ccs811
  reg:
    maxItems: 1

  reset-gpios:
    description: GPIO connected to the nRESET line. This is an active low
                 input to CCS811.
    maxItems: 1

  wakeup-gpios:
    description: GPIO connected to the nWAKE line. This is an active low
                 input to CCS811.
    maxItems: 1

required:
  - compatible
  - reg

additionalProperties: false

examples:
  - |
    #include <dt-bindings/gpio/gpio.h>
    i2c {
      #address-cells = <1>;
      #size-cells = <0>;

      voc@5b {
        compatible = "ams,ccs811";
        reg = <0x5b>;
        reset-gpios = <&gpioa 11 GPIO_ACTIVE_LOW>;
        wakeup-gpios = <&gpioa 12 GPIO_ACTIVE_LOW>;
      };
    };

...
```

## Documentation/devicetree/bindings/iio/chemical/aosong,ags02ma.yaml
```yaml
# SPDX-License-Identifier: (GPL-2.0 OR BSD-2-Clause)
%YAML 1.2
---
$id: http://devicetree.org/schemas/iio/chemical/aosong,ags02ma.yaml#
$schema: http://devicetree.org/meta-schemas/core.yaml#

title: Aosong AGS02MA VOC Sensor

description: |
  AGS02MA is an TVOC (Total Volatile Organic Compounds) i2c sensor with default
  address of 0x1a.

  Datasheet:
    https://asairsensors.com/wp-content/uploads/2021/09/AGS02MA.pdf

maintainers:
  - Anshul Dalal <anshulusr@gmail.com>

properties:
  compatible:
    enum:
      - aosong,ags02ma

  reg:
    maxItems: 1

  vdd-supply: true

required:
  - compatible
  - reg
  - vdd-supply

additionalProperties: false

examples:
  - |
    i2c {
        #address-cells = <1>;
        #size-cells = <0>;

        voc-sensor@1a {
            compatible = "aosong,ags02ma";
            reg = <0x1a>;
            vdd-supply = <&vdd_regulator>;
        };
    };
```

## Documentation/devicetree/bindings/iio/chemical/atlas,orp-sm.txt
```
* Atlas Scientific ORP-SM OEM sensor

https://www.atlas-scientific.com/_files/_datasheets/_oem/ORP_oem_datasheet.pdf

Required properties:

  - compatible: must be "atlas,orp-sm"
  - reg: the I2C address of the sensor
  - interrupts: the sole interrupt generated by the device

  Refer to interrupt-controller/interrupts.txt for generic interrupt client
  node bindings.

Example:

atlas@66 {
	compatible = "atlas,orp-sm";
	reg = <0x66>;
	interrupt-parent = <&gpio1>;
	interrupts = <16 2>;
};
```

## Documentation/devicetree/bindings/iio/chemical/atlas,ph-sm.txt
```
* Atlas Scientific pH-SM OEM sensor

http://www.atlas-scientific.com/_files/_datasheets/_oem/pH_oem_datasheet.pdf

Required properties:

  - compatible: must be "atlas,ph-sm"
  - reg: the I2C address of the sensor
  - interrupts: the sole interrupt generated by the device

  Refer to interrupt-controller/interrupts.txt for generic interrupt client
  node bindings.

Example:

atlas@65 {
	compatible = "atlas,ph-sm";
	reg = <0x65>;
	interrupt-parent = <&gpio1>;
	interrupts = <16 2>;
};
```

## Documentation/devicetree/bindings/iio/chemical/atlas,sensor.yaml
```yaml
# SPDX-License-Identifier: (GPL-2.0 OR BSD-2-Clause)
%YAML 1.2
---
$id: http://devicetree.org/schemas/iio/chemical/atlas,sensor.yaml#
$schema: http://devicetree.org/meta-schemas/core.yaml#

title: Atlas Scientific OEM sensors

maintainers:
  - Matt Ranostay <matt.ranostay@konsulko.com>

description: |
  Atlas Scientific OEM sensors connected via I2C

  Datasheets:
    http://www.atlas-scientific.com/_files/_datasheets/_oem/DO_oem_datasheet.pdf
    http://www.atlas-scientific.com/_files/_datasheets/_oem/EC_oem_datasheet.pdf
    http://www.atlas-scientific.com/_files/_datasheets/_oem/ORP_oem_datasheet.pdf
    http://www.atlas-scientific.com/_files/_datasheets/_oem/pH_oem_datasheet.pdf

properties:
  compatible:
    enum:
      - atlas,do-sm
      - atlas,ec-sm
      - atlas,orp-sm
      - atlas,ph-sm

  reg:
     maxItems: 1

  interrupts:
     maxItems: 1

required:
  - compatible
  - reg

additionalProperties: false

examples:
  - |
    i2c {
      #address-cells = <1>;
      #size-cells = <0>;

      atlas@66 {
        compatible = "atlas,orp-sm";
        reg = <0x66>;
        interrupt-parent = <&gpio1>;
        interrupts = <16 2>;
      };
    };
```

## Documentation/devicetree/bindings/iio/chemical/bme680.txt
```
Bosch Sensortec BME680 pressure/temperature/humidity/voc sensors

Required properties:
- compatible: must be "bosch,bme680"

Example:

bme680@76 {
          compatible = "bosch,bme680";
          reg = <0x76>;
};
```

## Documentation/devicetree/bindings/iio/chemical/bosch,bme680.yaml
```yaml
# SPDX-License-Identifier: (GPL-2.0 OR BSD-2-Clause)
%YAML 1.2
---
$id: http://devicetree.org/schemas/iio/chemical/bosch,bme680.yaml#
$schema: http://devicetree.org/meta-schemas/core.yaml#

title: Bosch BME680 Gas sensor

maintainers:
  - Vasileios Amoiridis <vassilisamir@gmail.com>

description: >
  BME680 is a gas sensor which combines relative humidity, barometric pressure,
  ambient temperature and gas (VOC - Volatile Organic Compounds) measurements.

  https://www.bosch-sensortec.com/media/boschsensortec/downloads/datasheets/bst-bme680-ds001.pdf

properties:
  compatible:
    const: bosch,bme680

  reg:
    maxItems: 1

  vdd-supply: true
  vddio-supply: true

required:
  - compatible
  - reg

allOf:
  - $ref: /schemas/spi/spi-peripheral-props.yaml#

unevaluatedProperties: false

examples:
  - |
    i2c {
        #address-cells = <1>;
        #size-cells = <0>;

        co2-sensor@77 {
            compatible = "bosch,bme680";
            reg = <0x77>;
            vddio-supply = <&vddio>;
            vdd-supply = <&vdd>;
        };
    };
  - |
    spi {
        #address-cells = <1>;
        #size-cells = <0>;

        co2-sensor@0 {
            compatible = "bosch,bme680";
            reg = <0>;
            spi-max-frequency = <500000>;
            vddio-supply = <&vddio>;
            vdd-supply = <&vdd>;
        };
    };
```

## Documentation/devicetree/bindings/iio/chemical/plantower,pms7003.txt
```
* Plantower PMS7003 particulate matter sensor

Required properties:
- compatible: must one of:
   "plantower,pms1003"
   "plantower,pms3003"
   "plantower,pms5003"
   "plantower,pms6003"
   "plantower,pms7003"
   "plantower,pmsa003"
- vcc-supply: phandle to the regulator that provides power to the sensor

Optional properties:
- plantower,set-gpios: phandle to the GPIO connected to the SET line
- reset-gpios: phandle to the GPIO connected to the RESET line

Refer to serial/slave-device.txt for generic serial attached device bindings.

Example:

&uart0 {
	air-pollution-sensor {
		compatible = "plantower,pms7003";
		vcc-supply = <&reg_vcc5v0>;
	};
};
```
