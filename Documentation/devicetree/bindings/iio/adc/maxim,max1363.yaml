## Documentation/devicetree/bindings/iio/adc/maxim,max1363.yaml
```yaml
# SPDX-License-Identifier: (GPL-2.0 OR BSD-2-Clause)
%YAML 1.2
---
$id: http://devicetree.org/schemas/iio/adc/maxim,max1363.yaml#
$schema: http://devicetree.org/meta-schemas/core.yaml#

title: Maxim MAX1363 and similar ADCs

maintainers:
  - Jonathan Cameron <jic23@kernel.org>

description: |
   Family of ADCs with i2c interface, internal references and threshold
   monitoring.

properties:
  compatible:
    enum:
      - maxim,max1361
      - maxim,max1362
      - maxim,max1363
      - maxim,max1364

  reg:
    maxItems: 1

  vcc-supply: true
  vref-supply:
    description: Optional external reference.  If not supplied, internal
      reference will be used.

  interrupts:
    maxItems: 1

required:
  - compatible
  - reg

additionalProperties: false

examples:
  - |
    i2c {
        #address-cells = <1>;
        #size-cells = <0>;

        adc@36 {
            compatible = "maxim,max1363";
            reg = <0x36>;
        };
    };
...
```

## Documentation/devicetree/bindings/iio/adc/maxim,max34408.yaml
```yaml
# SPDX-License-Identifier: (GPL-2.0 OR BSD-2-Clause)
%YAML 1.2
---
$id: http://devicetree.org/schemas/iio/adc/maxim,max34408.yaml#
$schema: http://devicetree.org/meta-schemas/core.yaml#

title: Maxim MAX34408/MAX34409 current monitors with overcurrent control

maintainers:
  - Ivan Mikhaylov <fr0st61te@gmail.com>

description: |
  The MAX34408/MAX34409 are two- and four-channel current monitors that are
  configured and monitored with a standard I2C/SMBus serial interface. Each
  unidirectional current sensor offers precision high-side operation with a
  low full-scale sense voltage. The devices automatically sequence through
  two or four channels and collect the current-sense samples and average them
  to reduce the effect of impulse noise. The raw ADC samples are compared to
  user-programmable digital thresholds to indicate overcurrent conditions.
  Overcurrent conditions trigger a hardware output to provide an immediate
  indication to shut down any necessary external circuitry.

  Specifications about the devices can be found at:
  https://www.analog.com/media/en/technical-documentation/data-sheets/MAX34408-MAX34409.pdf

properties:
  compatible:
    enum:
      - maxim,max34408
      - maxim,max34409

  "#address-cells":
    const: 1

  "#size-cells":
    const: 0

  reg:
    maxItems: 1

  interrupts:
    maxItems: 1

  powerdown-gpios:
    description:
      Shutdown Output. Open-drain output. This output transitions to high impedance
      when any of the digital comparator thresholds are exceeded as long as the ENA
      pin is high.
    maxItems: 1

  powerdown-status-gpios:
    description:
      SHTDN Enable Input. CMOS digital input. Connect to GND to clear the latch and
      unconditionally deassert (force low) the SHTDN output and reset the shutdown
      delay. Connect to VDD to enable normal latch operation of the SHTDN output.
    maxItems: 1

  vdd-supply: true

patternProperties:
  "^channel@[0-3]$":
    $ref: adc.yaml
    type: object
    description:
      Represents the internal channels of the ADC.

    properties:
      reg:
        items:
          - minimum: 0
            maximum: 3

      maxim,rsense-val-micro-ohms:
        description:
          Adjust the Rsense value to monitor higher or lower current levels for
          input.
        enum: [250, 500, 1000, 5000, 10000, 50000, 100000, 200000, 500000]
        default: 1000

    required:
      - reg
      - maxim,rsense-val-micro-ohms

    unevaluatedProperties: false

required:
  - compatible
  - reg

allOf:
  - if:
      properties:
        compatible:
          contains:
            const: maxim,max34408
    then:
      patternProperties:
        "^channel@[2-3]$": false
        "^channel@[0-1]$":
          properties:
            reg:
              maximum: 1
    else:
      patternProperties:
        "^channel@[0-3]$":
          properties:
            reg:
              maximum: 3

additionalProperties: false

examples:
  - |
    #include <dt-bindings/gpio/gpio.h>

    i2c {
        #address-cells = <1>;
        #size-cells = <0>;

        adc@1e {
              compatible = "maxim,max34409";
              reg = <0x1e>;
              powerdown-gpios = <&gpio0 1 GPIO_ACTIVE_LOW>;
              powerdown-status-gpios = <&gpio0 2 GPIO_ACTIVE_HIGH>;

              #address-cells = <1>;
              #size-cells = <0>;

              channel@0 {
                  reg = <0x0>;
                  maxim,rsense-val-micro-ohms = <5000>;
              };

              channel@1 {
                  reg = <0x1>;
                  maxim,rsense-val-micro-ohms = <10000>;
             };
        };
    };
```

## Documentation/devicetree/bindings/iio/adc/maxim,max9611.yaml
```yaml
# SPDX-License-Identifier: (GPL-2.0 OR BSD-2-Clause)
%YAML 1.2
---
$id: http://devicetree.org/schemas/iio/adc/maxim,max9611.yaml#
$schema: http://devicetree.org/meta-schemas/core.yaml#

title: Maxim MAX9611 and similar current sense amplifiers with integrated ADCs

maintainers:
  - Jacopo Mondi <jacopo@jmondi.org>

description: |
   These devices combine a high-side current sense amplifier with a 12 bit ADC.
   They have an i2c interface.

properties:
  compatible:
    enum:
      - maxim,max9611
      - maxim,max9612

  reg:
    maxItems: 1

  shunt-resistor-micro-ohms:
    $ref: /schemas/types.yaml#/definitions/uint32
    description: |
      Value in micro Ohms of the shunt resistor connected between the RS+ and
      RS- inputs, across which the current is measured.  Value needed to compute
      the scaling of the measured current.

additionalProperties: false

required:
  - compatible
  - reg
  - shunt-resistor-micro-ohms

examples:
  - |
    i2c {
        #address-cells = <1>;
        #size-cells = <0>;

        adc@7c {
            compatible = "maxim,max9611";
            reg = <0x7c>;
            shunt-resistor-micro-ohms = <5000>;
        };
    };
...
```

## Documentation/devicetree/bindings/iio/adc/mcp320x.txt
```
* Microchip Analog to Digital Converter (ADC)

The node for this driver must be a child node of a SPI controller, hence
all mandatory properties described in

        Documentation/devicetree/bindings/spi/spi-bus.txt

must be specified.

Required properties:
	- compatible:  	Must be one of the following, depending on the
			model:
				"mcp3001" (DEPRECATED)
				"mcp3002" (DEPRECATED)
				"mcp3004" (DEPRECATED)
				"mcp3008" (DEPRECATED)
				"mcp3201" (DEPRECATED)
				"mcp3202" (DEPRECATED)
				"mcp3204" (DEPRECATED)
				"mcp3208" (DEPRECATED)
				"mcp3301" (DEPRECATED)

				"microchip,mcp3001"
				"microchip,mcp3002"
				"microchip,mcp3004"
				"microchip,mcp3008"
				"microchip,mcp3201"
				"microchip,mcp3202"
				"microchip,mcp3204"
				"microchip,mcp3208"
				"microchip,mcp3301"

			NOTE: The use of the compatibles with no vendor prefix
			is deprecated and only listed because old DT use them.

Examples:
spi_controller {
	mcp3x0x@0 {
		compatible = "mcp3002";
		reg = <0>;
		spi-max-frequency = <1000000>;
	};
};
```

## Documentation/devicetree/bindings/iio/adc/mcp3422.txt
```
* Microchip mcp3421/2/3/4/6/7/8 chip family (ADC)

Required properties:
 - compatible: Should be
	"microchip,mcp3421" or
	"microchip,mcp3422" or
	"microchip,mcp3423" or
	"microchip,mcp3424" or
	"microchip,mcp3425" or
	"microchip,mcp3426" or
	"microchip,mcp3427" or
	"microchip,mcp3428"
 - reg: I2C address for the device

Example:
adc@0 {
	compatible = "microchip,mcp3424";
	reg = <0x68>;
};
```

## Documentation/devicetree/bindings/iio/adc/mcp3911.txt
```
* Microchip MCP3911 Dual channel analog front end (ADC)

Required properties:
 - compatible: Should be "microchip,mcp3911"
 - reg: SPI chip select number for the device

Recommended properties:
 - spi-max-frequency: Definition as per
	 Documentation/devicetree/bindings/spi/spi-bus.txt.
	 Max frequency for this chip is 20MHz.

Optional properties:
 - clocks: Phandle and clock identifier for sampling clock
 - interrupt-parent: Phandle to the parent interrupt controller
 - interrupts: IRQ line for the ADC
 - microchip,device-addr: Device address when multiple MCP3911 chips are present on the
	same SPI bus. Valid values are 0-3. Defaults to 0.
 - vref-supply: Phandle to the external reference voltage supply.

Example:
adc@0 {
	compatible = "microchip,mcp3911";
	reg = <0>;
	interrupt-parent = <&gpio5>;
	interrupts = <15 IRQ_TYPE_EDGE_RISING>;
	spi-max-frequency = <20000000>;
	microchip,device-addr = <0>;
	vref-supply = <&vref_reg>;
	clocks = <&xtal>;
};
```

## Documentation/devicetree/bindings/iio/adc/mediatek,mt2701-auxadc.yaml
```yaml
# SPDX-License-Identifier: (GPL-2.0 OR BSD-2-Clause)
%YAML 1.2
---
$id: http://devicetree.org/schemas/iio/adc/mediatek,mt2701-auxadc.yaml#
$schema: http://devicetree.org/meta-schemas/core.yaml#

title: Mediatek AUXADC - ADC on Mediatek mobile SoC (mt65xx/mt81xx/mt27xx)

maintainers:
  - Zhiyong Tao <zhiyong.tao@mediatek.com>
  - Matthias Brugger <matthias.bgg@gmail.com>

description: |
  The Auxiliary Analog/Digital Converter (AUXADC) is an ADC found
  in some Mediatek SoCs which among other things measures the temperatures
  in the SoC. It can be used directly with register accesses, but it is also
  used by thermal controller which reads the temperatures from the AUXADC
  directly via its own bus interface. See mediatek-thermal bindings
  for the Thermal Controller which holds a phandle to the AUXADC.

properties:
  compatible:
    oneOf:
      - enum:
          - mediatek,mt2701-auxadc
          - mediatek,mt2712-auxadc
          - mediatek,mt6765-auxadc
          - mediatek,mt7622-auxadc
          - mediatek,mt8173-auxadc
      - items:
          - enum:
              - mediatek,mt7623-auxadc
          - const: mediatek,mt2701-auxadc
      - items:
          - enum:
              - mediatek,mt8183-auxadc
              - mediatek,mt8186-auxadc
              - mediatek,mt8195-auxadc
              - mediatek,mt8516-auxadc
          - const: mediatek,mt8173-auxadc

  reg:
    maxItems: 1

  clocks:
    maxItems: 1

  clock-names:
    const: main

  "#io-channel-cells":
    const: 1

additionalProperties: false

required:
  - compatible
  - reg
  - clocks
  - clock-names
  - "#io-channel-cells"

examples:
  - |
    #include <dt-bindings/clock/mt8183-clk.h>
    soc {
        #address-cells = <2>;
        #size-cells = <2>;

        adc@11001000 {
            compatible = "mediatek,mt8183-auxadc",
                         "mediatek,mt8173-auxadc";
            reg = <0 0x11001000 0 0x1000>;
            clocks = <&infracfg CLK_INFRA_AUXADC>;
            clock-names = "main";
            #io-channel-cells = <1>;
        };
    };
...
```

## Documentation/devicetree/bindings/iio/adc/mediatek,mt6359-auxadc.yaml
```yaml
# SPDX-License-Identifier: (GPL-2.0 OR BSD-2-Clause)
%YAML 1.2
---
$id: http://devicetree.org/schemas/iio/adc/mediatek,mt6359-auxadc.yaml#
$schema: http://devicetree.org/meta-schemas/core.yaml#

title: MediaTek MT6350 series PMIC AUXADC

maintainers:
  - AngeloGioacchino Del Regno <angelogioacchino.delregno@collabora.com>

description:
  The Auxiliary Analog/Digital Converter (AUXADC) is an ADC found
  in some MediaTek PMICs, performing various PMIC related measurements
  such as battery and PMIC internal voltage regulators temperatures,
  accessory detection resistance (usually, for a 3.5mm audio jack)
  other than voltages for various PMIC internal components.

properties:
  compatible:
    enum:
      - mediatek,mt6357-auxadc
      - mediatek,mt6358-auxadc
      - mediatek,mt6359-auxadc
      - mediatek,mt6363-auxadc
      - mediatek,mt6373-auxadc

  "#io-channel-cells":
    const: 1

required:
  - compatible
  - "#io-channel-cells"

additionalProperties: false
```

## Documentation/devicetree/bindings/iio/adc/mediatek,mt6360-adc.yaml
```yaml
# SPDX-License-Identifier: (GPL-2.0 OR BSD-2-Clause)
%YAML 1.2
---
$id: http://devicetree.org/schemas/iio/adc/mediatek,mt6360-adc.yaml#
$schema: http://devicetree.org/meta-schemas/core.yaml#

title: Mediatek MT6360 and similar ADCs

maintainers:
  - Gene Chen <gene_chen@richtek.com>

properties:
  compatible:
    const: mediatek,mt6360-adc

  "#io-channel-cells":
    const: 1

required:
  - compatible
  - "#io-channel-cells"

additionalProperties: false

examples:
  - |
    adc {
      compatible = "mediatek,mt6360-adc";
      #io-channel-cells = <1>;
    };
...
```

## Documentation/devicetree/bindings/iio/adc/microchip,mcp3201.yaml
```yaml
# SPDX-License-Identifier: (GPL-2.0 OR BSD-2-Clause)
%YAML 1.2
---
$id: http://devicetree.org/schemas/iio/adc/microchip,mcp3201.yaml#
$schema: http://devicetree.org/meta-schemas/core.yaml#

title: Microchip mcp3201 and similar ADCs

maintainers:
  - Oskar Andero <oskar.andero@gmail.com>

description: |
   Family of simple ADCs with a SPI interface.

properties:
  compatible:
    enum:
      - microchip,mcp3001
      - microchip,mcp3002
      - microchip,mcp3004
      - microchip,mcp3008
      - microchip,mcp3201
      - microchip,mcp3202
      - microchip,mcp3204
      - microchip,mcp3208
      - microchip,mcp3301
      - microchip,mcp3550-50
      - microchip,mcp3550-60
      - microchip,mcp3551
      - microchip,mcp3553

  reg:
    maxItems: 1

  spi-cpha: true
  spi-cpol: true

  vref-supply:
    description: External reference.

  "#io-channel-cells":
    const: 1

dependencies:
  spi-cpol: [ spi-cpha ]
  spi-cpha: [ spi-cpol ]

required:
  - compatible
  - reg
  - vref-supply

allOf:
  - $ref: /schemas/spi/spi-peripheral-props.yaml#

unevaluatedProperties: false

examples:
  - |
    spi {
        #address-cells = <1>;
        #size-cells = <0>;

        adc@0 {
            compatible = "microchip,mcp3002";
            reg = <0>;
            vref-supply = <&vref_reg>;
            spi-cpha;
            spi-cpol;
            #io-channel-cells = <1>;
        };
        adc@1 {
            compatible = "microchip,mcp3002";
            reg = <1>;
            vref-supply = <&vref_reg>;
            spi-max-frequency = <1500000>;
        };
    };
...
```
