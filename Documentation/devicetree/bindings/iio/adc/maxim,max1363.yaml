## Documentation/devicetree/bindings/iio/adc/nuvoton,nau7802.yaml
```yaml
# SPDX-License-Identifier: (GPL-2.0 OR BSD-2-Clause)
%YAML 1.2
---
$id: http://devicetree.org/schemas/iio/adc/nuvoton,nau7802.yaml#
$schema: http://devicetree.org/meta-schemas/core.yaml#

title: Nuvoton NAU7802 I2c Analog to Digital Converter (ADC)

maintainers:
  - Alexandre Belloni <alexandre.belloni@bootlin.com>
  - Maxime Ripard <mripard@kernel.org>

properties:
  compatible:
    const: nuvoton,nau7802

  reg:
    maxItems: 1

  interrupts:
    maxItems: 1

  nuvoton,vldo:
    $ref: /schemas/types.yaml#/definitions/uint32
    description:
      Internal reference voltage in millivolts to be configured.
    minimum: 2400
    maximum: 4500

  "#io-channel-cells":
    const: 1

required:
  - compatible
  - reg

additionalProperties: false

examples:
  - |
    i2c {
        #address-cells = <1>;
        #size-cells = <0>;
        nau7802@2a {
            compatible = "nuvoton,nau7802";
            reg = <0x2a>;
            nuvoton,vldo = <3000>;
        };
    };
...
```

## Documentation/devicetree/bindings/iio/adc/nuvoton,nct7201.yaml
```yaml
# SPDX-License-Identifier: (GPL-2.0 OR BSD-2-Clause)
%YAML 1.2
---
$id: http://devicetree.org/schemas/iio/adc/nuvoton,nct7201.yaml#
$schema: http://devicetree.org/meta-schemas/core.yaml#

title: Nuvoton nct7201 and similar ADCs

maintainers:
  - Eason Yang <j2anfernee@gmail.com>

description: |
  The NCT7201/NCT7202 is a Nuvoton Hardware Monitor IC, contains up to 12
  voltage monitoring channels, with SMBus interface, and up to 4 sets SMBus
  address selection by ADDR connection. It also provides ALERT# signal for
  event notification and reset input RSTIN# to recover it from a fault
  condition.

  NCT7201 contains 8 voltage monitor inputs (VIN1~VIN8).
  NCT7202 contains 12 voltage monitor inputs (VIN1~VIN12).

properties:
  compatible:
    enum:
      - nuvoton,nct7201
      - nuvoton,nct7202

  reg:
    maxItems: 1

  vdd-supply:
    description:
      A 3.3V to supply that powers the chip.

  vref-supply:
    description:
      The regulator supply for the ADC reference voltage.

  interrupts:
    maxItems: 1

  reset-gpios:
    maxItems: 1

required:
  - compatible
  - reg

additionalProperties: false

examples:
  - |
    #include <dt-bindings/gpio/gpio.h>
    #include <dt-bindings/interrupt-controller/irq.h>

    i2c {
        #address-cells = <1>;
        #size-cells = <0>;

        adc@1d {
            compatible = "nuvoton,nct7202";
            reg = <0x1d>;
            vdd-supply = <&vdd>;
            vref-supply = <&vref>;
            interrupt-parent = <&gpio3>;
            interrupts = <30 IRQ_TYPE_LEVEL_LOW>;
            reset-gpios = <&gpio3 28 GPIO_ACTIVE_LOW>;
        };
    };
...
```

## Documentation/devicetree/bindings/iio/adc/nuvoton,npcm-adc.txt
```
Nuvoton NPCM Analog to Digital Converter (ADC)

The NPCM ADC is a 10-bit converter for eight channel inputs.

Required properties:
- compatible: "nuvoton,npcm750-adc" for the NPCM7XX BMC.
- reg: specifies physical base address and size of the registers.
- interrupts: Contain the ADC interrupt with flags for falling edge.
- resets : phandle to the reset control for this device.

Optional properties:
- clocks: phandle of ADC reference clock, in case the clock is not
		  added the ADC will use the default ADC sample rate.
- vref-supply: The regulator supply ADC reference voltage, in case the
			   vref-supply is not added the ADC will use internal voltage
			   reference.

Example:

adc: adc@f000c000 {
	compatible = "nuvoton,npcm750-adc";
	reg = <0xf000c000 0x8>;
	interrupts = <GIC_SPI 0 IRQ_TYPE_LEVEL_HIGH>;
	clocks = <&clk NPCM7XX_CLK_ADC>;
	resets = <&rstc NPCM7XX_RESET_IPSRST1 NPCM7XX_RESET_ADC>;
};
```

## Documentation/devicetree/bindings/iio/adc/nuvoton,npcm750-adc.yaml
```yaml
# SPDX-License-Identifier: (GPL-2.0 OR BSD-2-Clause)
%YAML 1.2
---
$id: http://devicetree.org/schemas/iio/adc/nuvoton,npcm750-adc.yaml#
$schema: http://devicetree.org/meta-schemas/core.yaml#

title: Nuvoton NPCM BMC Analog to Digital Converter (ADC)

maintainers:
  - Tomer Maimon <tmaimon77@gmail.com>

description:
  The NPCM7XX ADC is a 10-bit converter and NPCM8XX ADC is a 12-bit converter,
  both have eight channel inputs.

properties:
  compatible:
    enum:
      - nuvoton,npcm750-adc
      - nuvoton,npcm845-adc

  reg:
    maxItems: 1

  interrupts:
    maxItems: 1
    description: ADC interrupt, should be set for falling edge.

  resets:
    maxItems: 1

  clocks:
    maxItems: 1
    description: If not provided the defulat ADC sample rate will be used.

  vref-supply:
    description: If not supplied, the internal voltage reference will be used.

  "#io-channel-cells":
    const: 1

required:
  - compatible
  - reg
  - interrupts
  - resets

additionalProperties: false

examples:
  - |
    #include <dt-bindings/interrupt-controller/irq.h>
    #include <dt-bindings/interrupt-controller/arm-gic.h>
    #include <dt-bindings/clock/nuvoton,npcm7xx-clock.h>
    #include <dt-bindings/reset/nuvoton,npcm7xx-reset.h>
    soc {
        #address-cells = <1>;
        #size-cells = <1>;
        adc@f000c000 {
            compatible = "nuvoton,npcm750-adc";
            reg = <0xf000c000 0x8>;
            interrupts = <GIC_SPI 0 IRQ_TYPE_LEVEL_HIGH>;
            clocks = <&clk NPCM7XX_CLK_ADC>;
            resets = <&rstc NPCM7XX_RESET_IPSRST1 NPCM7XX_RESET_ADC>;
        };
    };
...
```

## Documentation/devicetree/bindings/iio/adc/nuvoton-nau7802.txt
```
* Nuvoton NAU7802 Analog to Digital Converter (ADC)

Required properties:
  - compatible: Should be "nuvoton,nau7802"
  - reg: Should contain the ADC I2C address

Optional properties:
  - nuvoton,vldo: Internal reference voltage in millivolts to be
    configured valid values are between 2400 mV and 4500 mV.
  - interrupts: IRQ line for the ADC. If not used the driver will use
    polling.

Example:
adc2: nau7802@2a {
	compatible = "nuvoton,nau7802";
	reg = <0x2a>;
	nuvoton,vldo = <3000>;
};
```

## Documentation/devicetree/bindings/iio/adc/nxp,imx8qxp-adc.yaml
```yaml
# SPDX-License-Identifier: (GPL-2.0-only OR BSD-2-Clause)
%YAML 1.2
---
$id: http://devicetree.org/schemas/iio/adc/nxp,imx8qxp-adc.yaml#
$schema: http://devicetree.org/meta-schemas/core.yaml#

title: NXP IMX8QXP ADC

maintainers:
  - Cai Huoqing <caihuoqing@baidu.com>

description:
  Supports the ADC found on the IMX8QXP SoC.

properties:
  compatible:
    const: nxp,imx8qxp-adc

  reg:
    maxItems: 1

  interrupts:
    maxItems: 1

  clocks:
    maxItems: 2

  clock-names:
    items:
      - const: per
      - const: ipg

  assigned-clocks:
    maxItems: 1

  assigned-clock-rates:
    maxItems: 1

  power-domains:
    maxItems: 1

  vref-supply:
    description: |
      External ADC reference voltage supply on VREFH pad. If VERID[MVI] is
      set, there are additional, internal reference voltages selectable.
      VREFH1 is always from VREFH pad.

  "#io-channel-cells":
    const: 1

required:
  - compatible
  - reg
  - interrupts
  - clocks
  - clock-names
  - assigned-clocks
  - assigned-clock-rates
  - power-domains
  - "#io-channel-cells"

additionalProperties: false

examples:
  - |
    #include <dt-bindings/interrupt-controller/arm-gic.h>
    #include <dt-bindings/firmware/imx/rsrc.h>
    soc {
        #address-cells = <2>;
        #size-cells = <2>;
        adc@5a880000 {
            compatible = "nxp,imx8qxp-adc";
            reg = <0x0 0x5a880000 0x0 0x10000>;
            interrupts = <GIC_SPI 240 IRQ_TYPE_LEVEL_HIGH>;
            clocks = <&clk IMX_SC_R_ADC_0>,
                     <&clk IMX_SC_R_ADC_0>;
            clock-names = "per", "ipg";
            assigned-clocks = <&clk IMX_SC_R_ADC_0>;
            assigned-clock-rates = <24000000>;
            power-domains = <&pd IMX_SC_R_ADC_0>;
            vref-supply = <&reg_1v8>;
            #io-channel-cells = <1>;
        };
    };
...
```

## Documentation/devicetree/bindings/iio/adc/nxp,imx93-adc.yaml
```yaml
# SPDX-License-Identifier: (GPL-2.0 OR BSD-2-Clause)
%YAML 1.2
---
$id: http://devicetree.org/schemas/iio/adc/nxp,imx93-adc.yaml#
$schema: http://devicetree.org/meta-schemas/core.yaml#

title: NXP iMX93 ADC

maintainers:
  - Haibo Chen <haibo.chen@nxp.com>

description:
  The ADC on iMX93 is a 8-channel 12-bit 1MS/s ADC with 4 channels
  connected to pins. it support normal and inject mode, include
  One-Shot and Scan (continuous) conversions. Programmable DMA
  enables for each channel  Also this ADC contain alternate analog
  watchdog thresholds, select threshold through input ports. And
  also has Self-test logic and Software-initiated calibration.

properties:
  compatible:
    const: nxp,imx93-adc

  reg:
    maxItems: 1

  interrupts:
    items:
      - description: WDGnL, watchdog threshold interrupt requests.
      - description: WDGnH, watchdog threshold interrupt requests.
      - description: normal conversion, include EOC (End of Conversion),
          ECH (End of Chain), JEOC (End of Injected Conversion) and
          JECH (End of injected Chain).
      - description: Self-testing Interrupts.

  clocks:
    maxItems: 1

  clock-names:
    const: ipg

  vref-supply:
    description:
      The reference voltage which used to establish channel scaling.

  "#io-channel-cells":
    const: 1

required:
  - compatible
  - reg
  - interrupts
  - clocks
  - clock-names
  - vref-supply
  - "#io-channel-cells"

additionalProperties: false

examples:
  - |
    #include <dt-bindings/interrupt-controller/irq.h>
    #include <dt-bindings/clock/imx93-clock.h>
    #include <dt-bindings/interrupt-controller/arm-gic.h>
    soc {
        #address-cells = <1>;
        #size-cells = <1>;
        adc@44530000 {
            compatible = "nxp,imx93-adc";
            reg = <0x44530000 0x10000>;
            interrupts = <GIC_SPI 217 IRQ_TYPE_LEVEL_HIGH>,
                         <GIC_SPI 218 IRQ_TYPE_LEVEL_HIGH>,
                         <GIC_SPI 219 IRQ_TYPE_LEVEL_HIGH>,
                         <GIC_SPI 268 IRQ_TYPE_LEVEL_HIGH>;
            clocks = <&clk IMX93_CLK_ADC1_GATE>;
            clock-names = "ipg";
            vref-supply = <&reg_vref_1v8>;
            #io-channel-cells = <1>;
        };
    };
...
```

## Documentation/devicetree/bindings/iio/adc/nxp,lpc1850-adc.yaml
```yaml
# SPDX-License-Identifier: (GPL-2.0 OR BSD-2-Clause)
%YAML 1.2
---
$id: http://devicetree.org/schemas/iio/adc/nxp,lpc1850-adc.yaml#
$schema: http://devicetree.org/meta-schemas/core.yaml#

title: NXP LPC1850 ADC bindings

maintainers:
  - Joachim Eastwood <manabian@gmail.com>

description:
  Supports the ADC found on the LPC1850 SoC.

properties:
  compatible:
    const: nxp,lpc1850-adc

  reg:
    maxItems: 1

  interrupts:
    maxItems: 1

  clocks:
    maxItems: 1

  vref-supply: true

  resets:
    maxItems: 1

  "#io-channel-cells":
    const: 1

required:
  - compatible
  - reg
  - interrupts
  - clocks
  - vref-supply
  - resets

additionalProperties: false

examples:
  - |
    #include <dt-bindings/clock/lpc18xx-ccu.h>
    soc {
        #address-cells = <1>;
        #size-cells = <1>;
        adc@400e3000 {
            compatible = "nxp,lpc1850-adc";
            reg = <0x400e3000 0x1000>;
            interrupts = <17>;
            clocks = <&ccu1 CLK_APB3_ADC0>;
            vref-supply = <&reg_vdda>;
            resets = <&rgu 40>;
         };
    };
...
```

## Documentation/devicetree/bindings/iio/adc/nxp,lpc3220-adc.yaml
```yaml
# SPDX-License-Identifier: (GPL-2.0 OR BSD-2-Clause)
%YAML 1.2
---
$id: http://devicetree.org/schemas/iio/adc/nxp,lpc3220-adc.yaml#
$schema: http://devicetree.org/meta-schemas/core.yaml#

title: NXP LPC3220 SoC ADC controller

maintainers:
  - Gregory Clement <gregory.clement@bootlin.com>

description:
  This hardware block has been used on several LPC32XX SoCs.

properties:
  compatible:
    const: nxp,lpc3220-adc

  reg:
    maxItems: 1

  interrupts:
    maxItems: 1

  clocks:
    maxItems: 1

  vref-supply: true

  "#io-channel-cells":
    const: 1

required:
  - compatible
  - reg
  - interrupts

additionalProperties: false

examples:
  - |
    soc {
        #address-cells = <1>;
        #size-cells = <1>;
        adc@40048000 {
            compatible = "nxp,lpc3220-adc";
            reg = <0x40048000 0x1000>;
            interrupt-parent = <&mic>;
            interrupts = <39 0>;
            vref-supply = <&vcc>;
        };
    };
...
```
