## Documentation/devicetree/bindings/iio/adc/microchip,mcp3564.yaml
```yaml
# SPDX-License-Identifier: (GPL-2.0 OR BSD-2-Clause)
%YAML 1.2
---
$id: http://devicetree.org/schemas/iio/adc/microchip,mcp3564.yaml#
$schema: http://devicetree.org/meta-schemas/core.yaml#

title: Microchip MCP346X and MCP356X ADC Family

maintainers:
  - Marius Cristea <marius.cristea@microchip.com>

description: |
  Bindings for the Microchip family of 153.6 ksps, Low-Noise 16/24-Bit
  Delta-Sigma ADCs with an SPI interface. Datasheet can be found here:
  Datasheet for MCP3561, MCP3562, MCP3564 can be found here:
    https://ww1.microchip.com/downloads/aemDocuments/documents/MSLD/ProductDocuments/DataSheets/MCP3561-2-4-Family-Data-Sheet-DS20006181C.pdf
  Datasheet for MCP3561R, MCP3562R, MCP3564R can be found here:
    https://ww1.microchip.com/downloads/aemDocuments/documents/APID/ProductDocuments/DataSheets/MCP3561_2_4R-Data-Sheet-DS200006391C.pdf
  Datasheet for MCP3461, MCP3462, MCP3464 can be found here:
    https://ww1.microchip.com/downloads/aemDocuments/documents/APID/ProductDocuments/DataSheets/MCP3461-2-4-Two-Four-Eight-Channel-153.6-ksps-Low-Noise-16-Bit-Delta-Sigma-ADC-Data-Sheet-20006180D.pdf
  Datasheet for MCP3461R, MCP3462R, MCP3464R can be found here:
    https://ww1.microchip.com/downloads/aemDocuments/documents/APID/ProductDocuments/DataSheets/MCP3461-2-4R-Family-Data-Sheet-DS20006404C.pdf

properties:
  compatible:
    enum:
      - microchip,mcp3461
      - microchip,mcp3462
      - microchip,mcp3464
      - microchip,mcp3461r
      - microchip,mcp3462r
      - microchip,mcp3464r
      - microchip,mcp3561
      - microchip,mcp3562
      - microchip,mcp3564
      - microchip,mcp3561r
      - microchip,mcp3562r
      - microchip,mcp3564r

  reg:
    maxItems: 1

  spi-max-frequency:
    maximum: 20000000

  spi-cpha: true

  spi-cpol: true

  vdd-supply: true

  avdd-supply: true

  clocks:
    description:
      Phandle and clock identifier for external sampling clock.
      If not specified, the internal crystal oscillator will be used.
    maxItems: 1

  interrupts:
    description: IRQ line of the ADC
    maxItems: 1

  drive-open-drain:
    description:
      Whether to drive the IRQ signal as push-pull (default) or open-drain. Note
      that the device requires this pin to become "high", otherwise it will stop
      converting.
    type: boolean

  vref-supply:
    description:
      Some devices have a specific reference voltage supplied on a different
      pin to the other supplies. Needed to be able to establish channel scaling
      unless there is also an internal reference available (e.g. mcp3564r). In
      case of "r" devices (e. g. mcp3564r), if it does not exists the internal
      reference will be used.

  microchip,hw-device-address:
    $ref: /schemas/types.yaml#/definitions/uint32
    minimum: 0
    maximum: 3
    description:
      The address is set on a per-device basis by fuses in the factory,
      configured on request. If not requested, the fuses are set for 0x1.
      The device address is part of the device markings to avoid
      potential confusion. This address is coded on two bits, so four possible
      addresses are available when multiple devices are present on the same
      SPI bus with only one Chip Select line for all devices.
      Each device communication starts by a CS falling edge, followed by the
      clocking of the device address (BITS[7:6] - top two bits of COMMAND BYTE
      which is first one on the wire).

  "#io-channel-cells":
    const: 1

  "#address-cells":
    const: 1

  "#size-cells":
    const: 0

patternProperties:
  "^channel@([0-9]|([1-7][0-9]))$":
    $ref: adc.yaml
    type: object
    unevaluatedProperties: false
    description: Represents the external channels which are connected to the ADC.

    properties:
      reg:
        description: The channel number in single-ended and differential mode.
        minimum: 0
        maximum: 79

    required:
      - reg

dependencies:
  spi-cpol: [ spi-cpha ]
  spi-cpha: [ spi-cpol ]

required:
  - compatible
  - reg
  - microchip,hw-device-address
  - spi-max-frequency

allOf:
  - $ref: /schemas/spi/spi-peripheral-props.yaml#
  - # External vref, no internal reference
    if:
      properties:
        compatible:
          contains:
            enum:
              - microchip,mcp3461
              - microchip,mcp3462
              - microchip,mcp3464
              - microchip,mcp3561
              - microchip,mcp3562
              - microchip,mcp3564
    then:
      required:
        - vref-supply

unevaluatedProperties: false

examples:
  - |
    spi {
        #address-cells = <1>;
        #size-cells = <0>;

        adc@0 {
            compatible = "microchip,mcp3564r";
            reg = <0>;
            vref-supply = <&vref_reg>;
            spi-cpha;
            spi-cpol;
            spi-max-frequency = <10000000>;
            microchip,hw-device-address = <1>;

            #address-cells = <1>;
            #size-cells = <0>;

            channel@0 {
                /* CH0 to AGND */
                reg = <0>;
                label = "CH0";
            };

            channel@1 {
                /* CH1 to AGND */
                reg = <1>;
                label = "CH1";
            };

            /* diff-channels */
            channel@11 {
                reg = <11>;

                /* CN0, CN1 */
                diff-channels = <0 1>;
                label = "CH0_CH1";
            };

            channel@22 {
                reg = <0x22>;

                /* CN1, CN2 */
                diff-channels = <1 2>;
                label = "CH1_CH3";
            };

            channel@23 {
                reg = <0x23>;

                /* CN1, CN3 */
                diff-channels = <1 3>;
                label = "CH1_CH3";
            };
        };
    };
...
```

## Documentation/devicetree/bindings/iio/adc/microchip,mcp3911.yaml
```yaml
# SPDX-License-Identifier: GPL-2.0 OR BSD-2-Clause
# Copyright 2019 Marcus Folkesson <marcus.folkesson@gmail.com>
%YAML 1.2
---
$id: http://devicetree.org/schemas/iio/adc/microchip,mcp3911.yaml#
$schema: http://devicetree.org/meta-schemas/core.yaml#

title: Microchip MCP3911 Dual channel analog front end (ADC)

maintainers:
  - Marcus Folkesson <marcus.folkesson@gmail.com>
  - Kent Gustavsson <nedo80@gmail.com>

description: |
  Bindings for the Microchip MCP3911 Dual channel ADC device. Datasheet can be
  found here: https://ww1.microchip.com/downloads/en/DeviceDoc/20002286C.pdf

properties:
  compatible:
    enum:
      - microchip,mcp3910
      - microchip,mcp3911
      - microchip,mcp3912
      - microchip,mcp3913
      - microchip,mcp3914
      - microchip,mcp3918
      - microchip,mcp3919

  reg:
    maxItems: 1

  spi-max-frequency:
    maximum: 20000000

  reset-gpios:
    maxItems: 1

  clocks:
    description: |
      Phandle and clock identifier for external sampling clock.
      If not specified, the internal crystal oscillator will be used.
    maxItems: 1

  interrupts:
    description: IRQ line of the ADC
    maxItems: 1

  microchip,data-ready-hiz:
    description:
      Data Ready Pin Inactive State Control
      true = The DR pin state is high-impedance
      false = The DR pin state is logic high
    type: boolean

  microchip,device-addr:
    description: Device address when multiple MCP3911 chips are present on the same SPI bus.
    $ref: /schemas/types.yaml#/definitions/uint32
    enum: [0, 1, 2, 3]
    default: 0

  vref-supply:
    description: |
      Phandle to the external reference voltage supply.
      If not specified, the internal voltage reference (1.2V) will be used.

required:
  - compatible
  - reg

allOf:
  - $ref: /schemas/spi/spi-peripheral-props.yaml#

unevaluatedProperties: false

examples:
  - |
    #include <dt-bindings/gpio/gpio.h>
    spi {
      #address-cells = <1>;
      #size-cells = <0>;

      adc@0 {
        compatible = "microchip,mcp3911";
        reg = <0>;
        interrupt-parent = <&gpio5>;
        interrupts = <15 2>;
        reset-gpios = <&gpio1 10 GPIO_ACTIVE_LOW>;
        spi-max-frequency = <20000000>;
        microchip,device-addr = <0>;
        vref-supply = <&vref_reg>;
        clocks = <&xtal>;
      };
    };
```

## Documentation/devicetree/bindings/iio/adc/microchip,pac1921.yaml
```yaml
# SPDX-License-Identifier: (GPL-2.0 OR BSD-2-Clause)
%YAML 1.2
---
$id: http://devicetree.org/schemas/iio/adc/microchip,pac1921.yaml#
$schema: http://devicetree.org/meta-schemas/core.yaml#

title: Microchip PAC1921 High-Side Power/Current Monitor with Anaog Output

maintainers:
  - Matteo Martelli <matteomartelli3@gmail.com>

description: |
  The PAC1921 is a power/current monitoring device with an analog output
  and I2C/SMBus interface.

  Datasheet can be found here:
  https://ww1.microchip.com/downloads/en/DeviceDoc/PAC1921-Data-Sheet-DS20005293E.pdf

properties:
  compatible:
    const: microchip,pac1921

  reg:
    maxItems: 1

  vdd-supply: true

  "#io-channel-cells":
    const: 1

  shunt-resistor-micro-ohms:
    description:
      Value in micro Ohms of the shunt resistor connected between
      the SENSE+ and SENSE- inputs, across which the current is measured.
      Value is needed to compute the scaling of the measured current.

  label:
    description: Unique name to identify which device this is.

  read-integrate-gpios:
    description:
      READ/INT input pin to control the current state of the device, either in
      the INTEGRATE state when driven high, or in the READ state when driven low.
      When not connected the pin is floating and it can be overridden by the
      INT_EN register bit after asserting the READ/INT_OVR register bit.
    maxItems: 1

required:
  - compatible
  - reg
  - vdd-supply
  - shunt-resistor-micro-ohms

additionalProperties: false

examples:
  - |
    i2c {
        #address-cells = <1>;
        #size-cells = <0>;

        adc@4c {
            compatible = "microchip,pac1921";
            reg = <0x4c>;
            vdd-supply = <&vdd>;
            #io-channel-cells = <1>;
            label = "vbat";
            shunt-resistor-micro-ohms = <10000>;
        };
    };
...
```

## Documentation/devicetree/bindings/iio/adc/microchip,pac1934.yaml
```yaml
# SPDX-License-Identifier: (GPL-2.0 OR BSD-2-Clause)
%YAML 1.2
---
$id: http://devicetree.org/schemas/iio/adc/microchip,pac1934.yaml#
$schema: http://devicetree.org/meta-schemas/core.yaml#

title: Microchip PAC1934 Power Monitors with Accumulator

maintainers:
  - Marius Cristea <marius.cristea@microchip.com>

description: |
  This device is part of the Microchip family of Power Monitors with
  Accumulator.
  The datasheet for PAC1931, PAC1932, PAC1933 and PAC1934 can be found here:
    https://ww1.microchip.com/downloads/aemDocuments/documents/OTH/ProductDocuments/DataSheets/PAC1931-Family-Data-Sheet-DS20005850E.pdf

properties:
  compatible:
    enum:
      - microchip,pac1931
      - microchip,pac1932
      - microchip,pac1933
      - microchip,pac1934

  reg:
    maxItems: 1

  "#address-cells":
    const: 1

  "#size-cells":
    const: 0

  interrupts:
    maxItems: 1

  slow-io-gpios:
    description:
      A GPIO used to trigger a change is sampling rate (lowering the chip power
      consumption). If configured in SLOW mode, if this pin is forced high,
      sampling rate is forced to eight samples/second. When it is forced low,
      the sampling rate is 1024 samples/second unless a different sample rate
      has been programmed.

patternProperties:
  "^channel@[1-4]+$":
    type: object
    $ref: adc.yaml
    description:
      Represents the external channels which are connected to the ADC.

    properties:
      reg:
        items:
          minimum: 1
          maximum: 4

      shunt-resistor-micro-ohms:
        description:
          Value in micro Ohms of the shunt resistor connected between
          the SENSE+ and SENSE- inputs, across which the current is measured.
          Value is needed to compute the scaling of the measured current.

    required:
      - reg
      - shunt-resistor-micro-ohms

    unevaluatedProperties: false

required:
  - compatible
  - reg
  - "#address-cells"
  - "#size-cells"

additionalProperties: false

examples:
  - |
    i2c {
        #address-cells = <1>;
        #size-cells = <0>;

        power-monitor@10 {
            compatible = "microchip,pac1934";
            reg = <0x10>;

            #address-cells = <1>;
            #size-cells = <0>;

            channel@1 {
                reg = <0x1>;
                shunt-resistor-micro-ohms = <24900000>;
                label = "CPU";
            };

            channel@2 {
                reg = <0x2>;
                shunt-resistor-micro-ohms = <49900000>;
                label = "GPU";
            };

            channel@3 {
                reg = <0x3>;
                shunt-resistor-micro-ohms = <75000000>;
                label = "MEM";
                bipolar;
            };

            channel@4 {
                reg = <0x4>;
                shunt-resistor-micro-ohms = <100000000>;
                label = "NET";
                bipolar;
            };
        };
    };

...
```

## Documentation/devicetree/bindings/iio/adc/motorola,cpcap-adc.yaml
```yaml
# SPDX-License-Identifier: (GPL-2.0 OR BSD-2-Clause)
%YAML 1.2
---
$id: http://devicetree.org/schemas/iio/adc/motorola,cpcap-adc.yaml#
$schema: http://devicetree.org/meta-schemas/core.yaml#

title: Motorola CPCAP PMIC ADC

maintainers:
  - Tony Lindgren <tony@atomide.com>

description:
  On Motorola phones like droid 4 there is a custom CPCAP PMIC. This PMIC
  has ADCs that are used for battery charging and USB PHY VBUS and ID pin
  detection.

properties:
  compatible:
    enum:
      - motorola,cpcap-adc
      - motorola,mapphone-cpcap-adc

  interrupts:
    maxItems: 1

  interrupt-names:
    const: adcdone

  "#io-channel-cells":
    const: 1

required:
  - compatible
  - interrupts
  - "#io-channel-cells"

additionalProperties: false

examples:
  - |
    #include <dt-bindings/interrupt-controller/irq.h>
    pmic {
        #address-cells = <1>;
        #size-cells = <0>;
        adc {
            compatible = "motorola,mapphone-cpcap-adc";
            interrupt-parent = <&cpcap>;
            interrupts = <8 IRQ_TYPE_NONE>;
            interrupt-names = "adcdone";
            #io-channel-cells = <1>;
        };
    };
...
```

## Documentation/devicetree/bindings/iio/adc/mt6577_auxadc.txt
```
* Mediatek AUXADC - Analog to Digital Converter on Mediatek mobile soc (mt65xx/mt81xx/mt27xx)
===============

The Auxiliary Analog/Digital Converter (AUXADC) is an ADC found
in some Mediatek SoCs which among other things measures the temperatures
in the SoC. It can be used directly with register accesses, but it is also
used by thermal controller which reads the temperatures from the AUXADC
directly via its own bus interface. See
Documentation/devicetree/bindings/thermal/mediatek-thermal.txt
for the Thermal Controller which holds a phandle to the AUXADC.

Required properties:
  - compatible: Should be one of:
    - "mediatek,mt2701-auxadc": For MT2701 family of SoCs
    - "mediatek,mt2712-auxadc": For MT2712 family of SoCs
    - "mediatek,mt7622-auxadc": For MT7622 family of SoCs
    - "mediatek,mt8173-auxadc": For MT8173 family of SoCs
  - reg: Address range of the AUXADC unit.
  - clocks: Should contain a clock specifier for each entry in clock-names
  - clock-names: Should contain "main".
  - #io-channel-cells: Should be 1, see ../iio-bindings.txt

Example:

auxadc: adc@11001000 {
	compatible = "mediatek,mt2701-auxadc";
	reg = <0 0x11001000 0 0x1000>;
	clocks = <&pericfg CLK_PERI_AUXADC>;
	clock-names = "main";
	#io-channel-cells = <1>;
};
```
