## Documentation/devicetree/bindings/iio/adc/rockchip-saradc.txt
```
Rockchip Successive Approximation Register (SAR) A/D Converter bindings

Required properties:
- compatible: should be "rockchip,<name>-saradc" or "rockchip,rk3066-tsadc"
   - "rockchip,saradc": for rk3188, rk3288
   - "rockchip,rk3066-tsadc": for rk3036
   - "rockchip,rk3328-saradc", "rockchip,rk3399-saradc": for rk3328
   - "rockchip,rk3399-saradc": for rk3399
   - "rockchip,rv1108-saradc", "rockchip,rk3399-saradc": for rv1108
   - "rockchip,rk1808-saradc", "rockchip,rk3399-saradc": for rk1808

- reg: physical base address of the controller and length of memory mapped
       region.
- interrupts: The interrupt number to the cpu. The interrupt specifier format
              depends on the interrupt controller.
- clocks: Must contain an entry for each entry in clock-names.
- clock-names: Shall be "saradc" for the converter-clock, and "apb_pclk" for
               the peripheral clock.
- vref-supply: The regulator supply ADC reference voltage.
- #io-channel-cells: Should be 1, see ../iio-bindings.txt

Optional properties:
- resets: Must contain an entry for each entry in reset-names if need support
	  this option. See ../reset/reset.txt for details.
- reset-names: Must include the name "saradc-apb".

Example:
	saradc: saradc@2006c000 {
		compatible = "rockchip,saradc";
		reg = <0x2006c000 0x100>;
		interrupts = <GIC_SPI 26 IRQ_TYPE_LEVEL_HIGH>;
		clocks = <&cru SCLK_SARADC>, <&cru PCLK_SARADC>;
		clock-names = "saradc", "apb_pclk";
		resets = <&cru SRST_SARADC>;
		reset-names = "saradc-apb";
		#io-channel-cells = <1>;
		vref-supply = <&vcc18>;
	};
```

## Documentation/devicetree/bindings/iio/adc/rockchip-saradc.yaml
```yaml
# SPDX-License-Identifier: GPL-2.0
%YAML 1.2
---
$id: http://devicetree.org/schemas/iio/adc/rockchip-saradc.yaml#
$schema: http://devicetree.org/meta-schemas/core.yaml#

title: Rockchip Successive Approximation Register (SAR) A/D Converter

maintainers:
  - Heiko Stuebner <heiko@sntech.de>

properties:
  compatible:
    oneOf:
      - const: rockchip,saradc
      - const: rockchip,rk3066-tsadc
      - const: rockchip,rk3399-saradc
      - items:
          - enum:
              - rockchip,px30-saradc
              - rockchip,rk3308-saradc
              - rockchip,rk3328-saradc
              - rockchip,rk3568-saradc
              - rockchip,rv1108-saradc
              - rockchip,rv1126-saradc
          - const: rockchip,rk3399-saradc

  reg:
    maxItems: 1

  interrupts:
    maxItems: 1

  clocks:
    items:
      - description: converter clock
      - description: peripheral clock

  clock-names:
    items:
      - const: saradc
      - const: apb_pclk

  resets:
    maxItems: 1

  reset-names:
    const: saradc-apb

  vref-supply:
    description:
      The regulator supply for the ADC reference voltage.

  "#io-channel-cells":
    const: 1

required:
  - compatible
  - reg
  - interrupts
  - clocks
  - clock-names
  - vref-supply
  - "#io-channel-cells"

additionalProperties: false

examples:
  - |
    #include <dt-bindings/clock/rk3288-cru.h>
    #include <dt-bindings/interrupt-controller/arm-gic.h>
    saradc: saradc@2006c000 {
      compatible = "rockchip,saradc";
      reg = <0x2006c000 0x100>;
      interrupts = <GIC_SPI 26 IRQ_TYPE_LEVEL_HIGH>;
      clocks = <&cru SCLK_SARADC>, <&cru PCLK_SARADC>;
      clock-names = "saradc", "apb_pclk";
      resets = <&cru SRST_SARADC>;
      reset-names = "saradc-apb";
      vref-supply = <&vcc18>;
      #io-channel-cells = <1>;
    };
```

## Documentation/devicetree/bindings/iio/adc/rohm,bd79104.yaml
```yaml
# SPDX-License-Identifier: (GPL-2.0 OR BSD-2-Clause)
%YAML 1.2
---
$id: http://devicetree.org/schemas/iio/adc/rohm,bd79104.yaml#
$schema: http://devicetree.org/meta-schemas/core.yaml#

title: ROHM Semiconductor BD79104 ADC

maintainers:
  - Matti Vaittinen <mazziesaccount@gmail.com>

description: |
  12 bit SPI ADC with 8 channels.

properties:
  compatible:
    oneOf:
      - enum:
          - rohm,bd79100
          - rohm,bd79101
          - rohm,bd79102
          - rohm,bd79104
      - items:
          - const: rohm,bd79103
          - const: rohm,bd79104

  reg:
    maxItems: 1

  vdd-supply: true
  iovdd-supply: true

# The component data-sheet says the frequency is 20M. I, however, found
# that the ROHM evaluation board BD79104FV-EVK-001 had problems with 20M.
# I have successfully used it with 4M. My _assumption_ is that this is not
# the limitation of the component itself, but a limitation of the EVK.
  spi-max-frequency:
    maximum: 20000000

  "#io-channel-cells":
    const: 1

  spi-cpha: true
  spi-cpol: true

required:
  - compatible
  - reg
  - vdd-supply
  - iovdd-supply
  - spi-cpha
  - spi-cpol

allOf:
  - $ref: /schemas/spi/spi-peripheral-props.yaml#

unevaluatedProperties: false

examples:
  - |
    spi {
        #address-cells = <1>;
        #size-cells = <0>;

        adc@0 {
            compatible = "rohm,bd79104";
            reg = <0>;
            vdd-supply = <&vdd_supply>;
            iovdd-supply = <&iovdd_supply>;
            spi-max-frequency = <4000000>;
            spi-cpha;
            spi-cpol;
            #io-channel-cells = <1>;
        };
    };
...
```

## Documentation/devicetree/bindings/iio/adc/rohm,bd79112.yaml
```yaml
# SPDX-License-Identifier: GPL-2.0-only OR BSD-2-Clause
%YAML 1.2
---
$id: http://devicetree.org/schemas/iio/adc/rohm,bd79112.yaml#
$schema: http://devicetree.org/meta-schemas/core.yaml#

title: ROHM BD79112 ADC/GPO

maintainers:
  - Matti Vaittinen <mazziesaccount@gmail.com>

description: |
  The ROHM BD79112 is a 12-bit, 32-channel, SAR ADC. ADC input pins can be
  also configured as general purpose inputs/outputs. SPI should use MODE 3.

properties:
  compatible:
    const: rohm,bd79112

  reg:
    maxItems: 1

  spi-cpha: true
  spi-cpol: true

  gpio-controller: true
  "#gpio-cells":
    const: 2

  vdd-supply: true

  iovdd-supply: true

  "#address-cells":
    const: 1

  "#size-cells":
    const: 0

patternProperties:
  "^channel@([0-9]|[12][0-9]|3[01])$":
    type: object
    $ref: /schemas/iio/adc/adc.yaml#
    description: Represents ADC channel. Omitted channels' inputs are GPIOs.

    properties:
      reg:
        description: AIN pin number
        minimum: 0
        maximum: 31

    required:
      - reg

    additionalProperties: false

required:
  - compatible
  - reg
  - iovdd-supply
  - vdd-supply
  - spi-cpha
  - spi-cpol

additionalProperties: false

examples:
  - |
    spi {
        #address-cells = <1>;
        #size-cells = <0>;
        adc: adc@0 {
            compatible = "rohm,bd79112";
            reg = <0x0>;

            spi-cpha;
            spi-cpol;

            vdd-supply = <&dummyreg>;
            iovdd-supply = <&dummyreg>;

            #address-cells = <1>;
            #size-cells = <0>;

            gpio-controller;
            #gpio-cells = <2>;

            channel@0 {
                reg = <0>;
            };
            channel@1 {
                reg = <1>;
            };
            channel@2 {
                reg = <2>;
            };
            channel@16 {
                reg = <16>;
            };
            channel@20 {
                reg = <20>;
            };
        };
    };
```

## Documentation/devicetree/bindings/iio/adc/rohm,bd79124.yaml
```yaml
# SPDX-License-Identifier: GPL-2.0-only OR BSD-2-Clause
%YAML 1.2
---
$id: http://devicetree.org/schemas/iio/adc/rohm,bd79124.yaml#
$schema: http://devicetree.org/meta-schemas/core.yaml#

title: ROHM BD79124 ADC/GPO

maintainers:
  - Matti Vaittinen <mazziesaccount@gmail.com>

description: |
  The ROHM BD79124 is a 12-bit, 8-channel, SAR ADC. The ADC supports
  an automatic measurement mode, with an alarm interrupt for out-of-window
  measurements. ADC input pins can be also configured as general purpose
  outputs.

properties:
  compatible:
    const: rohm,bd79124

  reg:
    description:
      I2C slave address.
    maxItems: 1

  interrupts:
    maxItems: 1

  gpio-controller: true

  "#gpio-cells":
    const: 1
    description:
      The pin number.

  vdd-supply: true

  iovdd-supply: true

  "#address-cells":
    const: 1

  "#size-cells":
    const: 0

patternProperties:
  "^channel@[0-7]+$":
    type: object
    $ref: /schemas/iio/adc/adc.yaml#
    description: Represents ADC channel.

    properties:
      reg:
        description: AIN pin number
        minimum: 0
        maximum: 7

    required:
      - reg

    additionalProperties: false

required:
  - compatible
  - reg
  - iovdd-supply
  - vdd-supply

additionalProperties: false

examples:
  - |
    #include <dt-bindings/interrupt-controller/irq.h>
    #include <dt-bindings/leds/common.h>
    i2c {
        #address-cells = <1>;
        #size-cells = <0>;
        adc: adc@10 {
            compatible = "rohm,bd79124";
            reg = <0x10>;

            interrupt-parent = <&gpio1>;
            interrupts = <29 IRQ_TYPE_LEVEL_LOW>;

            vdd-supply = <&dummyreg>;
            iovdd-supply = <&dummyreg>;

            #address-cells = <1>;
            #size-cells = <0>;

            channel@0 {
                reg = <0>;
            };
            channel@1 {
                reg = <1>;
            };
            channel@2 {
                reg = <2>;
            };
            channel@3 {
                reg = <3>;
            };
            channel@4 {
                reg = <4>;
            };
            channel@5 {
                reg = <5>;
            };
            channel@6 {
                reg = <6>;
            };
        };
    };
```

## Documentation/devicetree/bindings/iio/adc/samsung,exynos-adc.yaml
```yaml
# SPDX-License-Identifier: GPL-2.0
%YAML 1.2
---
$id: http://devicetree.org/schemas/iio/adc/samsung,exynos-adc.yaml#
$schema: http://devicetree.org/meta-schemas/core.yaml#

title: Samsung Exynos Analog to Digital Converter (ADC)

maintainers:
  - Krzysztof Kozlowski <krzk@kernel.org>

properties:
  compatible:
    enum:
      - samsung,exynos-adc-v1                 # Exynos5250
      - samsung,exynos-adc-v2
      - samsung,exynos3250-adc
      - samsung,exynos4212-adc                # Exynos4212 and Exynos4412
      - samsung,exynos7-adc
      - samsung,s3c2410-adc
      - samsung,s3c2416-adc
      - samsung,s3c2440-adc
      - samsung,s3c2443-adc
      - samsung,s3c6410-adc
      - samsung,s5pv210-adc

  reg:
    maxItems: 1

  clocks:
    description:
      Phandle to ADC bus clock. For Exynos3250 additional clock is needed.
    minItems: 1
    maxItems: 2

  clock-names:
    description:
      Must contain clock names (adc, sclk) matching phandles in clocks
      property.
    minItems: 1
    maxItems: 2

  interrupts:
    maxItems: 1

  "#io-channel-cells":
    const: 1

  vdd-supply: true

  samsung,syscon-phandle:
    $ref: '/schemas/types.yaml#/definitions/phandle'
    description:
      Phandle to the PMU system controller node (to access the ADC_PHY
      register on Exynos3250/4x12/5250/5420/5800).

  has-touchscreen:
    description:
      If present, indicates that a touchscreen is connected and usable.
    type: boolean

required:
  - compatible
  - reg
  - clocks
  - clock-names
  - interrupts
  - "#io-channel-cells"
  - vdd-supply

allOf:
  - if:
      properties:
        compatible:
          contains:
            enum:
              - samsung,exynos-adc-v1
              - samsung,exynos-adc-v2
              - samsung,exynos3250-adc
              - samsung,exynos4212-adc
              - samsung,s5pv210-adc
    then:
      required:
        - samsung,syscon-phandle

  - if:
      properties:
        compatible:
          contains:
            enum:
              - samsung,exynos3250-adc
    then:
      properties:
        clocks:
          minItems: 2
          maxItems: 2
        clock-names:
          items:
            - const: adc
            - const: sclk
    else:
      properties:
        clocks:
          minItems: 1
          maxItems: 1
        clock-names:
          items:
            - const: adc

examples:
  - |
    adc: adc@12d10000 {
        compatible = "samsung,exynos-adc-v1";
        reg = <0x12d10000 0x100>;
        interrupts = <0 106 0>;
        #io-channel-cells = <1>;
        io-channel-ranges;

        clocks = <&clock 303>;
        clock-names = "adc";

        vdd-supply = <&buck5_reg>;
        samsung,syscon-phandle = <&pmu_system_controller>;

        /* NTC thermistor is a hwmon device */
        ncp15wb473 {
            compatible = "murata,ncp15wb473";
            pullup-uv = <1800000>;
            pullup-ohm = <47000>;
            pulldown-ohm = <0>;
            io-channels = <&adc 4>;
          };
    };

  - |
    #include <dt-bindings/clock/exynos3250.h>

    adc@126c0000 {
        compatible = "samsung,exynos3250-adc";
        reg = <0x126C0000 0x100>;
        interrupts = <0 137 0>;
        #io-channel-cells = <1>;
        io-channel-ranges;

        clocks = <&cmu CLK_TSADC>,
                 <&cmu CLK_SCLK_TSADC>;
        clock-names = "adc", "sclk";

        vdd-supply = <&buck5_reg>;
        samsung,syscon-phandle = <&pmu_system_controller>;
    };
```

## Documentation/devicetree/bindings/iio/adc/sigma-delta-modulator.txt
```
Device-Tree bindings for sigma delta modulator

Required properties:
- compatible: should be "ads1201", "sd-modulator". "sd-modulator" can be use
	as a generic SD modulator if modulator yest specified in compatible list.
- #io-channel-cells = <0>: See the IIO bindings section "IIO consumers".

Example yesde:

	ads1202: adc {
		compatible = "sd-modulator";
		#io-channel-cells = <0>;
	};
```

## Documentation/devicetree/bindings/iio/adc/sigma-delta-modulator.yaml
```yaml
# SPDX-License-Identifier: (GPL-2.0-only OR BSD-2-Clause)
%YAML 1.2
---
$id: http://devicetree.org/schemas/iio/adc/sigma-delta-modulator.yaml#
$schema: http://devicetree.org/meta-schemas/core.yaml#

title: Sigma delta modulator

maintainers:
  - Arnaud Pouliquen <arnaud.pouliquen@foss.st.com>

properties:
  compatible:
    description: |
      "sd-modulator" can be used as a generic SD modulator,
      if the modulator is not specified in the compatible list.
    enum:
      - sd-modulator
      - ads1201

  '#io-backend-cells':
    const: 0

  '#io-channel-cells':
    const: 0

  vref-supply:
    description: Phandle to the vref input analog reference voltage.

dependencies:
  vref-supply: [ '#io-backend-cells' ]

required:
  - compatible

anyOf:
  - required: ['#io-backend-cells']
  - required: ['#io-channel-cells']

additionalProperties: false

examples:
  - |
    // Backend binding example. SD modulator configured as an IIO backend device
    ads1201_0: adc {
      compatible = "sd-modulator";
      vref-supply = <&vdd_adc>;
      #io-backend-cells = <0>;
    };

  - |
    // Legacy binding example. SD modulator configured as an IIO channel provider
    ads1201_1: adc {
      compatible = "sd-modulator";
      #io-channel-cells = <0>;
    };

...
```
