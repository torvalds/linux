## Documentation/devicetree/bindings/iio/adc/qcom,spmi-vadc.yaml
```yaml
# SPDX-License-Identifier: GPL-2.0-only
%YAML 1.2
---
$id: http://devicetree.org/schemas/iio/adc/qcom,spmi-vadc.yaml#
$schema: http://devicetree.org/meta-schemas/core.yaml#

title: Qualcomm's SPMI PMIC ADC

maintainers:
  - Andy Gross <agross@kernel.org>
  - Bjorn Andersson <bjorn.andersson@linaro.org>

description: |
  SPMI PMIC voltage ADC (VADC) provides interface to clients to read
  voltage. The VADC is a 15-bit sigma-delta ADC.
  SPMI PMIC5/PMIC7 voltage ADC (ADC) provides interface to clients to read
  voltage. The VADC is a 16-bit sigma-delta ADC.

properties:
  compatible:
    oneOf:
      - items:
          - const: qcom,pms405-adc
          - const: qcom,spmi-adc-rev2
      - enum:
          - qcom,spmi-vadc
          - qcom,spmi-adc5
          - qcom,spmi-adc-rev2
          - qcom,spmi-adc7

  reg:
    description: VADC base address in the SPMI PMIC register map
    maxItems: 1

  '#address-cells':
    const: 1

  '#size-cells':
    const: 0

  '#io-channel-cells':
    const: 1

  interrupts:
    maxItems: 1
    description:
      End of conversion interrupt.

required:
  - compatible
  - reg
  - '#address-cells'
  - '#size-cells'
  - '#io-channel-cells'

patternProperties:
  "^channel@[0-9a-f]+$":
    type: object
    additionalProperties: false
    description: |
      Represents the external channels which are connected to the ADC.
      For compatible property "qcom,spmi-vadc" following channels, also known as
      reference point channels, are used for result calibration and their channel
      configuration nodes should be defined:
      VADC_REF_625MV and/or VADC_SPARE1(based on PMIC version) VADC_REF_1250MV,
      VADC_GND_REF and VADC_VDD_VADC.

    properties:
      reg:
        maxItems: 1
        description: |
          ADC channel number.
          See include/dt-bindings/iio/qcom,spmi-vadc.h
          For PMIC7 ADC, the channel numbers are specified separately per PMIC
          in the PMIC-specific files in include/dt-bindings/iio/.

      label:
        description: |
            ADC input of the platform as seen in the schematics.
            For thermistor inputs connected to generic AMUX or GPIO inputs
            these can vary across platform for the same pins. Hence select
            the platform schematics name for this channel.

      qcom,decimation:
        $ref: /schemas/types.yaml#/definitions/uint32
        description: |
            This parameter is used to decrease ADC sampling rate.
            Quicker measurements can be made by reducing decimation ratio.

      qcom,pre-scaling:
        description: |
            Used for scaling the channel input signal before the signal is
            fed to VADC. The configuration for this node is to know the
            pre-determined ratio and use it for post scaling. It is a pair of
            integers, denoting the numerator and denominator of the fraction by which
            input signal is multiplied. For example, <1 3> indicates the signal is scaled
            down to 1/3 of its value before ADC measurement.
            If property is not found default value depending on chip will be used.
        $ref: /schemas/types.yaml#/definitions/uint32-array
        oneOf:
          - items:
              - const: 1
              - enum: [ 1, 3, 4, 6, 20, 8, 10, 16 ]
          - items:
              - const: 10
              - const: 81

      qcom,ratiometric:
        description: |
            Channel calibration type.
            - For compatible property "qcom,spmi-vadc", if this property is
              specified VADC will use the VDD reference (1.8V) and GND for
              channel calibration. If property is not found, channel will be
              calibrated with 0.625V and 1.25V reference channels, also
              known as absolute calibration.
            - For compatible property "qcom,spmi-adc5", "qcom,spmi-adc7" and
              "qcom,spmi-adc-rev2", if this property is specified VADC will use
              the VDD reference (1.875V) and GND for channel calibration. If
              property is not found, channel will be calibrated with 0V and 1.25V
              reference channels, also known as absolute calibration.
        type: boolean

      qcom,hw-settle-time:
        $ref: /schemas/types.yaml#/definitions/uint32
        description: |
            Time between AMUX getting configured and the ADC starting
            conversion. The 'hw_settle_time' is an index used from valid values
            and programmed in hardware to achieve the hardware settling delay.

      qcom,avg-samples:
        $ref: /schemas/types.yaml#/definitions/uint32
        description: |
            Number of samples to be used for measurement.
            Averaging provides the option to obtain a single measurement
            from the ADC that is an average of multiple samples. The value
            selected is 2^(value).

    required:
      - reg

allOf:
  - if:
      properties:
        compatible:
          contains:
            const: qcom,spmi-vadc

    then:
      patternProperties:
        "^channel@[0-9a-f]+$":
          properties:
            qcom,decimation:
              enum: [ 512, 1024, 2048, 4096 ]
              default: 512

            qcom,hw-settle-time:
              enum: [ 0, 100, 200, 300, 400, 500, 600, 700, 800, 900, 1, 2,
                      4, 6, 8, 10 ]
              default: 0

            qcom,avg-samples:
              enum: [ 1, 2, 4, 8, 16, 32, 64, 128, 256, 512 ]
              default: 1

  - if:
      properties:
        compatible:
          contains:
            const: qcom,spmi-adc-rev2

    then:
      patternProperties:
        "^channel@[0-9a-f]+$":
          properties:
            qcom,decimation:
              enum: [ 256, 512, 1024 ]
              default: 1024

            qcom,hw-settle-time:
              enum: [ 0, 100, 200, 300, 400, 500, 600, 700, 800, 900, 1, 2,
                      4, 6, 8, 10 ]
              default: 0

            qcom,avg-samples:
              enum: [ 1, 2, 4, 8, 16 ]
              default: 1

  - if:
      properties:
        compatible:
          contains:
            const: qcom,spmi-adc5

    then:
      patternProperties:
        "^channel@[0-9a-f]+$":
          properties:
            qcom,decimation:
              enum: [ 250, 420, 840 ]
              default: 840

            qcom,hw-settle-time:
              enum: [ 15, 100, 200, 300, 400, 500, 600, 700, 800, 900, 1, 2,
                      4, 6, 8, 10, 16, 32, 64, 128 ]
              default: 15

            qcom,avg-samples:
              enum: [ 1, 2, 4, 8, 16 ]
              default: 1

  - if:
      properties:
        compatible:
          contains:
            const: qcom,spmi-adc7

    then:
      patternProperties:
        "^channel@[0-9a-f]+$":
          properties:
            qcom,decimation:
              enum: [ 85, 340, 1360 ]
              default: 1360

            qcom,hw-settle-time:
              enum: [ 15, 100, 200, 300, 400, 500, 600, 700, 1000, 2000, 4000,
                      8000, 16000, 32000, 64000, 128000 ]
              default: 15

            qcom,avg-samples:
              enum: [ 1, 2, 4, 8, 16 ]
              default: 1

additionalProperties: false

examples:
  - |
    pmic {
        #address-cells = <1>;
        #size-cells = <0>;

        adc@3100 {
            compatible = "qcom,spmi-vadc";
            reg = <0x3100>;
            interrupts = <0x0 0x31 0x0 0x1>;
            #address-cells = <1>;
            #size-cells = <0>;
            #io-channel-cells = <1>;

            /* Channel node */
            channel@39 {
                reg = <0x39>;
                qcom,decimation = <512>;
                qcom,ratiometric;
                qcom,hw-settle-time = <200>;
                qcom,avg-samples = <1>;
                qcom,pre-scaling = <1 3>;
            };

            channel@9 {
                reg = <0x9>;
            };

            channel@a {
                reg = <0xa>;
            };

            channel@e {
                reg = <0xe>;
            };

            channel@f {
                reg = <0xf>;
            };
        };
    };

  - |
    #include <dt-bindings/iio/qcom,spmi-adc7-pmk8350.h>
    #include <dt-bindings/iio/qcom,spmi-adc7-pm8350.h>
    #include <dt-bindings/interrupt-controller/irq.h>

    pmic {
        #address-cells = <1>;
        #size-cells = <0>;

        adc@3100 {
            reg = <0x3100>;
            compatible = "qcom,spmi-adc7";
            #address-cells = <1>;
            #size-cells = <0>;
            #io-channel-cells = <1>;

            /* Other properties are omitted */
            channel@44 {
                reg = <PMK8350_ADC7_AMUX_THM1_100K_PU>;
                qcom,ratiometric;
                qcom,hw-settle-time = <200>;
                label = "xo_therm";
            };

            channel@47 {
                reg = <PM8350_ADC7_AMUX_THM4_100K_PU(1)>;
                qcom,ratiometric;
                qcom,hw-settle-time = <200>;
                label = "conn_therm";
            };
        };
    };
```

## Documentation/devicetree/bindings/iio/adc/renesas,gyroadc.txt
```
* Renesas R-Car GyroADC device driver

The GyroADC block is a reduced SPI block with up to 8 chipselect lines,
which supports the SPI protocol of a selected few SPI ADCs. The SPI ADCs
are sampled by the GyroADC block in a round-robin fashion and the result
presented in the GyroADC registers.

Required properties:
- compatible:	Should be "<soc-specific>", "renesas,rcar-gyroadc".
                The <soc-specific> should be one of:
		renesas,r8a7791-gyroadc - for the GyroADC block present
					  in r8a7791 SoC
		renesas,r8a7792-gyroadc - for the GyroADC with interrupt
					  block present in r8a7792 SoC
- reg:		Address and length of the register set for the device
- clocks:	References to all the clocks specified in the clock-names
		property as specified in
		Documentation/devicetree/bindings/clock/clock-bindings.txt.
- clock-names:	Shall contain "fck". The "fck" is the GyroADC block clock.
- power-domains: Must contain a reference to the PM domain, if available.
- #address-cells: Should be <1> (setting for the subnodes) for all ADCs
		except for "fujitsu,mb88101a". Should be <0> (setting for
		only subnode) for "fujitsu,mb88101a".
- #size-cells:	Should be <0> (setting for the subnodes)

Sub-nodes:
You must define subnode(s) which select the connected ADC type and reference
voltage for the GyroADC channels.

Required properties for subnodes:
- compatible:	Should be either of:
		"fujitsu,mb88101a"
			- Fujitsu MB88101A compatible mode,
			  12bit sampling, up to 4 channels can be sampled in
			  round-robin fashion. One Fujitsu chip supplies four
			  GyroADC channels with data as it contains four ADCs
			  on the chip and thus for 4-channel operation, single
			  MB88101A is required. The Cx chipselect lines of the
			  MB88101A connect directly to two CHS lines of the
			  GyroADC, no demuxer is required. The data out line
			  of each MB88101A connects to a shared input pin of
			  the GyroADC.
		"ti,adcs7476" or "ti,adc121" or "adi,ad7476"
			- TI ADCS7476 / TI ADC121 / ADI AD7476 compatible mode,
			  15bit sampling, up to 8 channels can be sampled in
			  round-robin fashion. One TI/ADI chip supplies single
			  ADC channel with data, thus for 8-channel operation,
			  8 chips are required. A 3:8 chipselect demuxer is
			  required to connect the nCS line of the TI/ADI chips
			  to the GyroADC, while MISO line of each TI/ADI ADC
			  connects to a shared input pin of the GyroADC.
		"maxim,max1162" or "maxim,max11100"
			- Maxim MAX1162 / Maxim MAX11100 compatible mode,
			  16bit sampling, up to 8 channels can be sampled in
			  round-robin fashion. One Maxim chip supplies single
			  ADC channel with data, thus for 8-channel operation,
			  8 chips are required. A 3:8 chipselect demuxer is
			  required to connect the nCS line of the MAX chips
			  to the GyroADC, while MISO line of each Maxim ADC
			  connects to a shared input pin of the GyroADC.
- reg:		Should be the number of the analog input. Should be present
		for all ADCs except "fujitsu,mb88101a".
- vref-supply:	Reference to the channel reference voltage regulator.

Example:
	vref_max1162: regulator-vref-max1162 {
		compatible = "regulator-fixed";

		regulator-name = "MAX1162 Vref";
		regulator-min-microvolt = <4096000>;
		regulator-max-microvolt = <4096000>;
	};

	adc@e6e54000 {
		compatible = "renesas,r8a7791-gyroadc", "renesas,rcar-gyroadc";
		reg = <0 0xe6e54000 0 64>;
		clocks = <&mstp9_clks R8A7791_CLK_GYROADC>;
		clock-names = "fck";
		power-domains = <&sysc R8A7791_PD_ALWAYS_ON>;

		pinctrl-0 = <&adc_pins>;
		pinctrl-names = "default";

		#address-cells = <1>;
		#size-cells = <0>;

		adc@0 {
			reg = <0>;
			compatible = "maxim,max1162";
			vref-supply = <&vref_max1162>;
		};

		adc@1 {
			reg = <1>;
			compatible = "maxim,max1162";
			vref-supply = <&vref_max1162>;
		};
	};
```
