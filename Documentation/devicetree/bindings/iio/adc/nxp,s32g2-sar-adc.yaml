## Documentation/devicetree/bindings/iio/adc/renesas,r9a09g077-adc.yaml
```yaml
# SPDX-License-Identifier: (GPL-2.0-only OR BSD-2-Clause)
%YAML 1.2
---
$id: http://devicetree.org/schemas/iio/adc/renesas,r9a09g077-adc.yaml#
$schema: http://devicetree.org/meta-schemas/core.yaml#

title: Renesas RZ/T2H / RZ/N2H ADC12

maintainers:
  - Cosmin Tanislav <cosmin-gabriel.tanislav.xa@renesas.com>

description: |
  A/D Converter block is a successive approximation analog-to-digital converter
  with a 12-bit accuracy. Up to 16 analog input channels can be selected.
  Conversions can be performed in single or continuous mode. Result of the ADC
  is stored in a 16-bit data register corresponding to each channel.

properties:
  compatible:
    oneOf:
      - items:
          - const: renesas,r9a09g087-adc # RZ/N2H
          - const: renesas,r9a09g077-adc # RZ/T2H
      - items:
          - const: renesas,r9a09g077-adc # RZ/T2H

  reg:
    maxItems: 1

  interrupts:
    items:
      - description: A/D scan end interrupt
      - description: A/D scan end interrupt for Group B
      - description: A/D scan end interrupt for Group C
      - description: Window A compare match
      - description: Window B compare match
      - description: Compare match
      - description: Compare mismatch

  interrupt-names:
    items:
      - const: adi
      - const: gbadi
      - const: gcadi
      - const: cmpai
      - const: cmpbi
      - const: wcmpm
      - const: wcmpum

  clocks:
    items:
      - description: Converter clock
      - description: Peripheral clock

  clock-names:
    items:
      - const: adclk
      - const: pclk

  power-domains:
    maxItems: 1

  '#address-cells':
    const: 1

  '#size-cells':
    const: 0

  "#io-channel-cells":
    const: 1

patternProperties:
  "^channel@[0-9a-f]$":
    $ref: adc.yaml
    type: object
    description: The external channels which are connected to the ADC.

    properties:
      reg:
        description: The channel number.
        maximum: 15

    required:
      - reg

    additionalProperties: false

required:
  - compatible
  - reg
  - interrupts
  - clocks
  - clock-names
  - power-domains

additionalProperties: false

examples:
  - |
    #include <dt-bindings/clock/renesas,r9a09g077-cpg-mssr.h>
    #include <dt-bindings/interrupt-controller/arm-gic.h>

    adc@80008000 {
      compatible = "renesas,r9a09g077-adc";
      reg = <0x80008000 0x400>;
      interrupts = <GIC_SPI 708 IRQ_TYPE_EDGE_RISING>,
                   <GIC_SPI 709 IRQ_TYPE_EDGE_RISING>,
                   <GIC_SPI 710 IRQ_TYPE_EDGE_RISING>,
                   <GIC_SPI 711 IRQ_TYPE_LEVEL_HIGH>,
                   <GIC_SPI 712 IRQ_TYPE_LEVEL_HIGH>,
                   <GIC_SPI 855 IRQ_TYPE_EDGE_RISING>,
                   <GIC_SPI 856 IRQ_TYPE_EDGE_RISING>;
      interrupt-names = "adi", "gbadi", "gcadi",
                        "cmpai", "cmpbi", "wcmpm", "wcmpum";
      clocks = <&cpg CPG_CORE R9A09G077_CLK_PCLKL>,
               <&cpg CPG_MOD 225>;
      clock-names = "adclk", "pclk";
      power-domains = <&cpg>;
      #address-cells = <1>;
      #size-cells = <0>;
      #io-channel-cells = <1>;

      channel@0 {
        reg = <0x0>;
      };
      channel@1 {
        reg = <0x1>;
      };
      channel@2 {
        reg = <0x2>;
      };
      channel@3 {
        reg = <0x3>;
      };
    };
```

## Documentation/devicetree/bindings/iio/adc/renesas,rcar-gyroadc.yaml
```yaml
# SPDX-License-Identifier: (GPL-2.0 OR BSD-2-Clause)
%YAML 1.2
---
$id: http://devicetree.org/schemas/iio/adc/renesas,rcar-gyroadc.yaml#
$schema: http://devicetree.org/meta-schemas/core.yaml#

title: Renesas R-Car GyroADC

maintainers:
  - Marek Vasut <marek.vasut+renesas@gmail.com>

description: |
  The GyroADC block is a reduced SPI block with up to 8 chipselect lines,
  which supports the SPI protocol of a selected few SPI ADCs. The SPI ADCs
  are sampled by the GyroADC block in a round-robin fashion and the result
  presented in the GyroADC registers.
  The ADC bindings should match with that of the devices connected to a
  full featured SPI bus.

properties:
  compatible:
    items:
      - enum:
          - renesas,r8a7791-gyroadc
          - renesas,r8a7792-gyroadc
      - const: renesas,rcar-gyroadc

  reg:
    maxItems: 1

  clocks:
    maxItems: 1

  clock-names:
    const: fck

  power-domains: true

  resets: true

  "#address-cells":
    const: 1

  "#size-cells":
    const: 0

additionalProperties: false

required:
  - compatible
  - reg
  - clocks
  - clock-names
  - "#address-cells"
  - "#size-cells"

patternProperties:
  "@[0-7]$":
    type: object
    properties:
      compatible:
        description: |
          fujitsu,mb88101a
          - Fujitsu MB88101A compatible mode,
            12bit sampling, up to 4 channels can be sampled in round-robin
            fashion. One Fujitsu chip supplies four GyroADC channels with
            data as it contains four ADCs on the chip and thus for 4-channel
            operation, single MB88101A is required. The Cx chipselect lines
            of the MB88101A connect directly to two CHS lines of the GyroADC,
            no demuxer is required. The data out line of each MB88101A
            connects to a shared input pin of the GyroADC.
          ti,adcs7476 or ti,adc121 or adi,ad7476
          - TI ADCS7476 / TI ADC121 / ADI AD7476 compatible mode, 15bit
            sampling, up to 8 channels can be sampled in round-robin
            fashion. One TI/ADI chip supplies single ADC channel with data,
            thus for 8-channel operation, 8 chips are required.
            A 3:8 chipselect demuxer is  required to connect the nCS line
            of the TI/ADI chips to the GyroADC, while MISO line of each
            TI/ADI ADC connects to a shared input pin of the GyroADC.
          maxim,max1162 or maxim,max11100
          - Maxim MAX1162 / Maxim MAX11100 compatible mode,  16bit sampling,
            up to 8 channels can be sampled in round-robin fashion. One
            Maxim chip supplies single ADC channel with data, thus for
            8-channel operation, 8 chips are required.
            A 3:8 chipselect demuxer is required to connect the nCS line
            of the MAX chips to the GyroADC, while MISO line of each Maxim
            ADC connects to a shared input pin of the GyroADC.
        enum:
          - adi,ad7476
          - fujitsu,mb88101a
          - maxim,max1162
          - maxim,max11100
          - ti,adcs7476
          - ti,adc121

      reg:
        minimum: 0
        maximum: 7

      vref-supply: true

    additionalProperties: false

    required:
      - compatible
      - reg
      - vref-supply

examples:
  - |
    #include <dt-bindings/clock/r8a7791-clock.h>
    #include <dt-bindings/power/r8a7791-sysc.h>
    soc {
        #address-cells = <2>;
        #size-cells = <2>;

        adc@e6e54000 {
            compatible = "renesas,r8a7791-gyroadc", "renesas,rcar-gyroadc";
            reg = <0 0xe6e54000 0 64>;
            clocks = <&mstp9_clks R8A7791_CLK_GYROADC>;
            clock-names = "fck";
            power-domains = <&sysc R8A7791_PD_ALWAYS_ON>;

            pinctrl-0 = <&adc_pins>;
            pinctrl-names = "default";

            #address-cells = <1>;
            #size-cells = <0>;

            adc@0 {
                reg = <0>;
                compatible = "maxim,max1162";
                vref-supply = <&vref_max1162>;
            };

            adc@1 {
                reg = <1>;
                compatible = "maxim,max1162";
                vref-supply = <&vref_max1162>;
            };
        };
    };
...
```

## Documentation/devicetree/bindings/iio/adc/renesas,rzg2l-adc.yaml
```yaml
# SPDX-License-Identifier: (GPL-2.0-only OR BSD-2-Clause)
%YAML 1.2
---
$id: http://devicetree.org/schemas/iio/adc/renesas,rzg2l-adc.yaml#
$schema: http://devicetree.org/meta-schemas/core.yaml#

title: Renesas RZ/G2L ADC

maintainers:
  - Lad Prabhakar <prabhakar.mahadev-lad.rj@bp.renesas.com>

description: |
  A/D Converter block is a successive approximation analog-to-digital converter
  with a 12-bit accuracy. Up to eight analog input channels can be selected.
  Conversions can be performed in single or repeat mode. Result of the ADC is
  stored in a 32-bit data register corresponding to each channel.

properties:
  compatible:
    items:
      - enum:
          - renesas,r9a07g044-adc   # RZ/G2{L,LC}
      - const: renesas,rzg2l-adc

  reg:
    maxItems: 1

  interrupts:
    maxItems: 1

  clocks:
    items:
      - description: converter clock
      - description: peripheral clock

  clock-names:
    items:
      - const: adclk
      - const: pclk

  power-domains:
    maxItems: 1

  resets:
    maxItems: 2

  reset-names:
    items:
      - const: presetn
      - const: adrst-n

  '#address-cells':
    const: 1

  '#size-cells':
    const: 0

required:
  - compatible
  - reg
  - interrupts
  - clocks
  - clock-names
  - power-domains
  - resets
  - reset-names

patternProperties:
  "^channel@[0-7]$":
    $ref: "adc.yaml"
    type: object
    description: |
      Represents the external channels which are connected to the ADC.

    properties:
      reg:
        description: |
          The channel number. It can have up to 8 channels numbered from 0 to 7.
        items:
          - minimum: 0
            maximum: 7

    required:
      - reg

    additionalProperties: false

additionalProperties: false

examples:
  - |
    #include <dt-bindings/clock/r9a07g044-cpg.h>
    #include <dt-bindings/interrupt-controller/arm-gic.h>

    adc: adc@10059000 {
      compatible = "renesas,r9a07g044-adc", "renesas,rzg2l-adc";
      reg = <0x10059000 0x400>;
      interrupts = <GIC_SPI 347 IRQ_TYPE_EDGE_RISING>;
      clocks = <&cpg CPG_MOD R9A07G044_ADC_ADCLK>,
               <&cpg CPG_MOD R9A07G044_ADC_PCLK>;
      clock-names = "adclk", "pclk";
      power-domains = <&cpg>;
      resets = <&cpg R9A07G044_ADC_PRESETN>,
               <&cpg R9A07G044_ADC_ADRST_N>;
      reset-names = "presetn", "adrst-n";

      #address-cells = <1>;
      #size-cells = <0>;

      channel@0 {
        reg = <0>;
      };
      channel@1 {
        reg = <1>;
      };
      channel@2 {
        reg = <2>;
      };
      channel@3 {
        reg = <3>;
      };
      channel@4 {
        reg = <4>;
      };
      channel@5 {
        reg = <5>;
      };
      channel@6 {
        reg = <6>;
      };
      channel@7 {
        reg = <7>;
      };
    };
```

## Documentation/devicetree/bindings/iio/adc/renesas,rzn1-adc.yaml
```yaml
# SPDX-License-Identifier: (GPL-2.0-only OR BSD-2-Clause)
%YAML 1.2
---
$id: http://devicetree.org/schemas/iio/adc/renesas,rzn1-adc.yaml#
$schema: http://devicetree.org/meta-schemas/core.yaml#

title: Renesas RZ/N1 Analog to Digital Converter (ADC)

maintainers:
  - Herve Codina <herve.codina@bootlin.com>

description:
  The Renesas RZ/N1 ADC controller available in the Renesas RZ/N1 SoCs family
  can use up to two internal ADC cores (ADC1 and ADC2) those internal cores are
  handled through ADC controller virtual channels.

properties:
  compatible:
    items:
      - const: renesas,r9a06g032-adc   # RZ/N1D
      - const: renesas,rzn1-adc

  reg:
    maxItems: 1

  clocks:
    items:
      - description: APB internal bus clock
      - description: ADC clock

  clock-names:
    items:
      - const: pclk
      - const: adc

  power-domains:
    maxItems: 1

  adc1-avdd-supply:
    description:
      ADC1 analog power supply.

  adc1-vref-supply:
    description:
      ADC1 reference voltage supply.

  adc2-avdd-supply:
    description:
      ADC2 analog power supply.

  adc2-vref-supply:
    description:
      ADC2 reference voltage supply.

  '#io-channel-cells':
    const: 1
    description: |
      Channels numbers available:
        if ADC1 is used (i.e. adc1-{avdd,vref}-supply present):
          - 0: ADC1 IN0
          - 1: ADC1 IN1
          - 2: ADC1 IN2
          - 3: ADC1 IN3
          - 4: ADC1 IN4
          - 5: ADC1 IN6
          - 6: ADC1 IN7
          - 7: ADC1 IN8
        if ADC2 is used (i.e. adc2-{avdd,vref}-supply present):
          - 8: ADC2 IN0
          - 9: ADC2 IN1
          - 10: ADC2 IN2
          - 11: ADC2 IN3
          - 12: ADC2 IN4
          - 13: ADC2 IN6
          - 14: ADC2 IN7
          - 15: ADC2 IN8

required:
  - compatible
  - reg
  - clocks
  - clock-names
  - power-domains
  - '#io-channel-cells'

# At least one of avvd/vref supplies
anyOf:
  - required:
      - adc1-vref-supply
      - adc1-avdd-supply
  - required:
      - adc2-vref-supply
      - adc2-avdd-supply

additionalProperties: false

examples:
  - |
    #include <dt-bindings/clock/r9a06g032-sysctrl.h>

    adc: adc@40065000 {
      compatible = "renesas,r9a06g032-adc", "renesas,rzn1-adc";
      reg = <0x40065000 0x200>;
      clocks = <&sysctrl R9A06G032_HCLK_ADC>, <&sysctrl R9A06G032_CLK_ADC>;
      clock-names = "pclk", "adc";
      power-domains = <&sysctrl>;
      adc1-avdd-supply = <&adc1_avdd>;
      adc1-vref-supply = <&adc1_vref>;
      #io-channel-cells = <1>;
    };
...
```

## Documentation/devicetree/bindings/iio/adc/richtek,rtq6056.yaml
```yaml
# SPDX-License-Identifier: (GPL-2.0 OR BSD-2-Clause)
%YAML 1.2
---
$id: http://devicetree.org/schemas/iio/adc/richtek,rtq6056.yaml#
$schema: http://devicetree.org/meta-schemas/core.yaml#

title: RTQ6056 Bi-Directional Current and Power Monitor with 16-bit ADC

maintainers:
  - ChiYuan Huang <cy_huang@richtek.com>

description: |
  The RTQ6056 is a high accuracy current-sense monitor with I2C and SMBus
  interface, and the device provides full information for system by reading
  out the loading current and power.

  The device monitors both of the drops across sense resistor and the BUS
  voltage, converts into the current in amperes, and power in watts through
  internal analog-to-digital converter ADC. The programmable calibration,
  adjustable conversion time, and averaging function are also built in for
  more design flexibility.

  Datasheet is available at
  https://www.richtek.com/assets/product_file/RTQ6056/DSQ6056-00.pdf

properties:
  compatible:
    const: richtek,rtq6056

  reg:
    maxItems: 1

  "#io-channel-cells":
    const: 1

  shunt-resistor-micro-ohms:
    description: Shunt IN+/IN- sensing node resistor

required:
  - compatible
  - reg
  - "#io-channel-cells"

additionalProperties: false

examples:
  - |
    i2c {
      #address-cells = <1>;
      #size-cells = <0>;
      adc@40 {
        compatible = "richtek,rtq6056";
        reg = <0x40>;
        #io-channel-cells = <1>;
      };
    };
```
