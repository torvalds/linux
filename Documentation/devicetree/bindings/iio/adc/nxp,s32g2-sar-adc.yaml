## Documentation/devicetree/bindings/iio/adc/nxp,s32g2-sar-adc.yaml
```yaml
# SPDX-License-Identifier: (GPL-2.0 OR BSD-2-Clause)
%YAML 1.2
---
$id: http://devicetree.org/schemas/iio/adc/nxp,s32g2-sar-adc.yaml#
$schema: http://devicetree.org/meta-schemas/core.yaml#

title: NXP Successive Approximation ADC

description:
  The NXP SAR ADC provides fast and accurate analog-to-digital
  conversion using the Successive Approximation Register (SAR) method.
  It has 12-bit resolution with 8 input channels. Conversions can be
  launched in software or using hardware triggers. It supports
  continuous and one-shot modes with separate registers.

maintainers:
  - Daniel Lezcano <daniel.lezcano@kernel.org>

properties:
  compatible:
    oneOf:
      - const: nxp,s32g2-sar-adc
      - items:
          - const: nxp,s32g3-sar-adc
          - const: nxp,s32g2-sar-adc

  reg:
    maxItems: 1

  interrupts:
    maxItems: 1

  clocks:
    maxItems: 1

  dmas:
    maxItems: 1

  dma-names:
    const: rx

required:
  - compatible
  - reg
  - interrupts
  - clocks
  - dmas
  - dma-names

additionalProperties: false

examples:
  - |
    #include <dt-bindings/interrupt-controller/arm-gic.h>

    adc@401f8000 {
        compatible = "nxp,s32g2-sar-adc";
        reg = <0x401f8000 0x1000>;
        interrupts = <GIC_SPI 70 IRQ_TYPE_LEVEL_HIGH>;
        clocks = <&clks 0x41>;
        dmas = <&edma0 0 32>;
        dma-names = "rx";
    };
```

## Documentation/devicetree/bindings/iio/adc/palmas-gpadc.txt
```
* Palmas general purpose ADC IP block devicetree bindings

Channels list:
	0 battery type
	1 battery temp NTC (optional current source)
	2 GP
	3 temp (with ext. diode, optional current source)
	4 GP
	5 GP
	6 VBAT_SENSE
	7 VCC_SENSE
	8 Backup Battery voltage
	9 external charger (VCHG)
	10 VBUS
	11 DC-DC current probe (how does this work?)
	12 internal die temp
	13 internal die temp
	14 USB ID pin voltage
	15 test network

Required properties:
- compatible : Must be "ti,palmas-gpadc".
- #io-channel-cells: Should be set to <1>.

Optional sub-nodes:
ti,channel0-current-microamp: Channel 0 current in uA.
	Values are rounded to derive 0uA, 5uA, 15uA, 20uA.
ti,channel3-current-microamp: Channel 3 current in uA.
	Values are rounded to derive 0uA, 10uA, 400uA, 800uA.
ti,enable-extended-delay: Enable extended delay.

Example:

pmic {
	compatible = "ti,twl6035-pmic", "ti,palmas-pmic";
	...
	gpadc {
		compatible = "ti,palmas-gpadc";
		interrupts = <18 0
			      16 0
			      17 0>;
		#io-channel-cells = <1>;
		ti,channel0-current-microamp = <5>;
		ti,channel3-current-microamp = <10>;
		};
	};
	...
};
```

## Documentation/devicetree/bindings/iio/adc/qcom,pm8018-adc.yaml
```yaml
# SPDX-License-Identifier: (GPL-2.0 OR BSD-2-Clause)
%YAML 1.2
---
$id: http://devicetree.org/schemas/iio/adc/qcom,pm8018-adc.yaml#
$schema: http://devicetree.org/meta-schemas/core.yaml#

title: Qualcomm's PM8xxx voltage XOADC

maintainers:
  - Linus Walleij <linus.walleij@linaro.org>

description: |
  The Qualcomm PM8xxx PMICs contain a HK/XO ADC (Housekeeping/Crystal
  oscillator ADC) encompassing PM8018, PM8038, PM8058 and PM8921.

properties:
  compatible:
    enum:
      - qcom,pm8018-adc
      - qcom,pm8038-adc
      - qcom,pm8058-adc
      - qcom,pm8921-adc

  reg:
    maxItems: 1
    description:
      ADC base address in the PMIC, typically 0x197.

  xoadc-ref-supply:
    description:
      The reference voltage may vary with PMIC variant but is typically
      something like 2.2 or 1.8V.

  interrupts:
    maxItems: 1

  "#address-cells":
    const: 2
    description:
      The first cell is the prescaler (on PM8058) or premux (on PM8921)
      with two valid bits  so legal values are 0x00, 0x01 or 0x02.
      The second cell is the main analog mux setting (0x00..0x0f).
      The combination of prescaler/premux and analog mux uniquely addresses
      a hardware channel on all systems.

  "#size-cells":
    const: 0

  "#io-channel-cells":
    const: 2
    description:
      The cells are precaler or premux followed by the analog muxing line.

additionalProperties: false

required:
  - compatible
  - reg
  - "#io-channel-cells"
  - "#address-cells"
  - "#size-cells"
  - adc-channel@c
  - adc-channel@d
  - adc-channel@f

patternProperties:
  "^(adc-channel@)[0-9a-f]$":
    type: object
    description: |
      ADC channel specific configuration.
      Note that channels c, d and f must be present for calibration.
      These three nodes are used for absolute and ratiometric calibration
      and only need to have these reg values: they are by hardware definition
      1:1 ratio converters that sample 625, 1250 and 0 milliV and create
      an interpolation calibration for all other ADCs.

    properties:
      reg:
        maxItems: 1

      qcom,decimation:
        $ref: /schemas/types.yaml#/definitions/uint32
        description: |
          This parameter is used to decrease the ADC sampling rate.
          Quicker measurements can be made by reducing the decimation ratio.
          Valid values are 512, 1024, 2048, 4096.
          If the property is not found, a default value of 512 will be used.

      qcom,ratiometric:
        $ref: /schemas/types.yaml#/definitions/uint32
        description: |
          Channel calibration type. If this property is specified
          VADC will use a special voltage references for channel
          calibration. The available references are specified in the
          as a u32 value setting (see below) and it is compulsory
          to also specify this reference if ratiometric calibration
          is selected.

          If the property is not found, the channel will be
          calibrated with the 0.625V and 1.25V reference channels, also
          known as an absolute calibration.

          The reference voltage pairs when using ratiometric calibration:
          0 = XO_IN/XOADC_GND
          1 = PMIC_IN/XOADC_GND
          2 = PMIC_IN/BMS_CSP
          3 (invalid)
          4 = XOADC_GND/XOADC_GND
          5 = XOADC_VREF/XOADC_GND

    additionalProperties: false

    required:
      - reg

examples:
  - |
    #include <dt-bindings/interrupt-controller/irq.h>
    pmic {
        #address-cells = <1>;
        #size-cells = <0>;

        adc@197 {
            compatible = "qcom,pm8058-adc";
            reg = <0x197>;
            interrupts-extended = <&pm8058 76 IRQ_TYPE_EDGE_RISING>;
            #address-cells = <2>;
            #size-cells = <0>;
            #io-channel-cells = <2>;

            vcoin: adc-channel@0 {
                reg = <0x00 0x00>;
            };
            vbat: adc-channel@1 {
                reg = <0x00 0x01>;
            };
            dcin: adc-channel@2 {
                reg = <0x00 0x02>;
            };
            ichg: adc-channel@3 {
                reg = <0x00 0x03>;
            };
            vph_pwr: adc-channel@4 {
                reg = <0x00 0x04>;
            };
            usb_vbus: adc-channel@a {
                reg = <0x00 0x0a>;
            };
            die_temp: adc-channel@b {
                reg = <0x00 0x0b>;
            };
            ref_625mv: adc-channel@c {
                reg = <0x00 0x0c>;
            };
            ref_1250mv: adc-channel@d {
                reg = <0x00 0x0d>;
            };
            ref_325mv: adc-channel@e {
                reg = <0x00 0x0e>;
            };
            ref_muxoff: adc-channel@f {
                reg = <0x00 0x0f>;
            };
        };
    };
...
```

## Documentation/devicetree/bindings/iio/adc/qcom,pm8xxx-xoadc.txt
```
Qualcomm's PM8xxx voltage XOADC

The Qualcomm PM8xxx PMICs contain a HK/XO ADC (Housekeeping/Crystal
oscillator ADC) encompassing PM8018, PM8038, PM8058 and PM8921.

Required properties:

- compatible: should be one of:
  "qcom,pm8018-adc"
  "qcom,pm8038-adc"
  "qcom,pm8058-adc"
  "qcom,pm8921-adc"

- reg: should contain the ADC base address in the PMIC, typically
  0x197.

- xoadc-ref-supply: should reference a regulator that can supply
  a reference voltage on demand. The reference voltage may vary
  with PMIC variant but is typically something like 2.2 or 1.8V.

The following required properties are standard for IO channels, see
iio-bindings.txt for more details, but notice that this particular
ADC has a special addressing scheme that require two cells for
identifying each ADC channel:

- #address-cells: should be set to <2>, the first cell is the
  prescaler (on PM8058) or premux (on PM8921) with two valid bits
  so legal values are 0x00, 0x01 or 0x02. The second cell
  is the main analog mux setting (0x00..0x0f). The combination
  of prescaler/premux and analog mux uniquely addresses a hardware
  channel on all systems.

- #size-cells: should be set to <0>

- #io-channel-cells: should be set to <2>, again the cells are
  precaler or premux followed by the analog muxing line.

- interrupts: should refer to the parent PMIC interrupt controller
  and reference the proper ADC interrupt.

Required subnodes:

The ADC channels are configured as subnodes of the ADC.

Since some of them are used for calibrating the ADC, these nodes are
compulsory:

adc-channel@c {
	reg = <0x00 0x0c>;
};

adc-channel@d {
	reg = <0x00 0x0d>;
};

adc-channel@f {
	reg = <0x00 0x0f>;
};

These three nodes are used for absolute and ratiometric calibration
and only need to have these reg values: they are by hardware definition
1:1 ratio converters that sample 625, 1250 and 0 milliV and create
an interpolation calibration for all other ADCs.

Optional subnodes: any channels other than channels [0x00 0x0c],
[0x00 0x0d] and [0x00 0x0f] are optional.

Required channel node properties:

- reg: should contain the hardware channel number in the range
  0 .. 0xff (8 bits).

Optional channel node properties:

- qcom,decimation:
  Value type: <u32>
  Definition: This parameter is used to decrease the ADC sampling rate.
          Quicker measurements can be made by reducing the decimation ratio.
          Valid values are 512, 1024, 2048, 4096.
          If the property is not found, a default value of 512 will be used.

- qcom,ratiometric:
  Value type: <u32>
  Definition: Channel calibration type. If this property is specified
          VADC will use a special voltage references for channel
          calibration. The available references are specified in the
	  as a u32 value setting (see below) and it is compulsory
	  to also specify this reference if ratiometric calibration
	  is selected.

	  If the property is not found, the channel will be
          calibrated with the 0.625V and 1.25V reference channels, also
          known as an absolute calibration.
  The reference voltage pairs when using ratiometric calibration:
	  0 = XO_IN/XOADC_GND
	  1 = PMIC_IN/XOADC_GND
	  2 = PMIC_IN/BMS_CSP
	  3 (invalid)
	  4 = XOADC_GND/XOADC_GND
	  5 = XOADC_VREF/XOADC_GND

Example:

xoadc: xoadc@197 {
	compatible = "qcom,pm8058-adc";
	reg = <0x197>;
	interrupts-extended = <&pm8058 76 IRQ_TYPE_EDGE_RISING>;
	#address-cells = <2>;
	#size-cells = <0>;
	#io-channel-cells = <2>;

	vcoin: adc-channel@0 {
		reg = <0x00 0x00>;
	};
	vbat: adc-channel@1 {
		reg = <0x00 0x01>;
	};
	dcin: adc-channel@2 {
		reg = <0x00 0x02>;
	};
	ichg: adc-channel@3 {
		reg = <0x00 0x03>;
	};
	vph_pwr: adc-channel@4 {
		reg = <0x00 0x04>;
	};
	usb_vbus: adc-channel@a {
		reg = <0x00 0x0a>;
	};
	die_temp: adc-channel@b {
		reg = <0x00 0x0b>;
	};
	ref_625mv: adc-channel@c {
		reg = <0x00 0x0c>;
	};
	ref_1250mv: adc-channel@d {
		reg = <0x00 0x0d>;
	};
	ref_325mv: adc-channel@e {
		reg = <0x00 0x0e>;
	};
	ref_muxoff: adc-channel@f {
		reg = <0x00 0x0f>;
	};
};

/* IIO client node */
iio-hwmon {
	compatible = "iio-hwmon";
	io-channels = <&xoadc 0x00 0x01>, /* Battery */
		    <&xoadc 0x00 0x02>, /* DC in (charger) */
		    <&xoadc 0x00 0x04>, /* VPH the main system voltage */
		    <&xoadc 0x00 0x0b>, /* Die temperature */
		    <&xoadc 0x00 0x0c>, /* Reference voltage 1.25V */
		    <&xoadc 0x00 0x0d>, /* Reference voltage 0.625V */
		    <&xoadc 0x00 0x0e>; /* Reference voltage 0.325V */
};
```

## Documentation/devicetree/bindings/iio/adc/qcom,spmi-iadc.txt
```
Qualcomm's SPMI PMIC current ADC

QPNP PMIC current ADC (IADC) provides interface to clients to read current.
A 16 bit ADC is used for current measurements. IADC can measure the current
through an external resistor (channel 1) or internal (built-in) resistor
(channel 0). When using an external resistor it is to be described by
qcom,external-resistor-micro-ohms property.

IADC node:

- compatible:
    Usage: required
    Value type: <string>
    Definition: Should contain "qcom,spmi-iadc".

- reg:
    Usage: required
    Value type: <prop-encoded-array>
    Definition: IADC base address and length in the SPMI PMIC register map

- interrupts:
    Usage: optional
    Value type: <prop-encoded-array>
    Definition: End of ADC conversion.

- qcom,external-resistor-micro-ohms:
    Usage: optional
    Value type: <u32>
    Definition: Sense resister value in micro Ohm.
                If not defined value of 10000 micro Ohms will be used.

Example:
	/* IADC node */
	pmic_iadc: iadc@3600 {
		compatible = "qcom,spmi-iadc";
		reg = <0x3600 0x100>;
		interrupts = <0x0 0x36 0x0 IRQ_TYPE_EDGE_RISING>;
		qcom,external-resistor-micro-ohms = <10000>;
		#io-channel-cells  = <1>;
	};

	/* IIO client node */
	bat {
		io-channels = <&pmic_iadc  0>;
		io-channel-names = "iadc";
	};
```

## Documentation/devicetree/bindings/iio/adc/qcom,spmi-iadc.yaml
```yaml
# SPDX-License-Identifier: (GPL-2.0 OR BSD-2-Clause)
%YAML 1.2
---
$id: http://devicetree.org/schemas/iio/adc/qcom,spmi-iadc.yaml#
$schema: http://devicetree.org/meta-schemas/core.yaml#

title: Qualcomm's SPMI PMIC current ADC

maintainers:
  - Jonathan Cameron <jic23@kernel.org>

description: |
  QPNP PMIC current ADC (IADC) provides interface to clients to read current.
  A 16 bit ADC is used for current measurements. IADC can measure the current
  through an external resistor (channel 1) or internal (built-in) resistor
  (channel 0). When using an external resistor it is to be described by
  qcom,external-resistor-micro-ohms property.

properties:
  compatible:
    items:
      - enum:
          - qcom,pm8226-iadc
          - qcom,pm8941-iadc
      - const: qcom,spmi-iadc

  reg:
    description: IADC base address in the SPMI PMIC register map
    maxItems: 1

  qcom,external-resistor-micro-ohms:
    description:
      Sensor resistor value. If not defined value of 10000 micro Ohms
      will be used.

  interrupts:
    maxItems: 1
    description:
      End of conversion interrupt.

  "#io-channel-cells":
    const: 1

required:
  - compatible
  - reg

additionalProperties: false

examples:
  - |
    #include <dt-bindings/interrupt-controller/irq.h>

    pmic {
        #address-cells = <1>;
        #size-cells = <0>;

        adc@3600 {
            compatible = "qcom,pm8941-iadc", "qcom,spmi-iadc";
            reg = <0x3600>;
            interrupts = <0x0 0x36 0x0 IRQ_TYPE_EDGE_RISING>;
            qcom,external-resistor-micro-ohms = <10000>;
            #io-channel-cells = <1>;
        };
    };
...
```
