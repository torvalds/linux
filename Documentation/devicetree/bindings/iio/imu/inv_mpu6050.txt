## Documentation/devicetree/bindings/iio/light/adux1020.yaml
```yaml
# SPDX-License-Identifier: (GPL-2.0 OR BSD-2-Clause)
%YAML 1.2
---
$id: http://devicetree.org/schemas/iio/light/adux1020.yaml#
$schema: http://devicetree.org/meta-schemas/core.yaml#

title: Analog Devices ADUX1020 Photometric sensor

maintainers:
  - Manivannan Sadhasivam <manivannan.sadhasivam@linaro.org>

description: |
  Photometric sensor over an i2c interface.
  https://www.analog.com/media/en/technical-documentation/data-sheets/ADUX1020.pdf

properties:
  compatible:
    enum:
      - adi,adux1020

  reg:
    maxItems: 1

  interrupts:
    maxItems: 1

required:
  - compatible
  - reg

examples:
  - |
    #include <dt-bindings/interrupt-controller/irq.h>

    i2c {

        #address-cells = <1>;
        #size-cells = <0>;

        adux1020@64 {
                compatible = "adi,adux1020";
                reg = <0x64>;
                interrupt-parent = <&msmgpio>;
                interrupts = <24 IRQ_TYPE_LEVEL_HIGH>;
        };
    };
...
```

## Documentation/devicetree/bindings/iio/light/ams,as73211.yaml
```yaml
# SPDX-License-Identifier: GPL-2.0-only OR BSD-2-Clause
%YAML 1.2
---
$id: http://devicetree.org/schemas/iio/light/ams,as73211.yaml#
$schema: http://devicetree.org/meta-schemas/core.yaml#

title: AMS AS73211 JENCOLOR(R) Digital XYZ Sensor

maintainers:
  - Christian Eggers <ceggers@arri.de>

description: |
  XYZ True Color Sensor with I2C Interface
  https://ams.com/documents/20143/36005/AS73211_DS000556_3-01.pdf/a65474c0-b302-c2fd-e30a-c98df87616df

properties:
  compatible:
    enum:
      - ams,as73211

  reg:
    description:
      I2C address of the device (0x74...0x77).
    maxItems: 1

  interrupts:
    description:
      Interrupt specifier for the READY interrupt generated by the device.
    maxItems: 1

required:
  - compatible
  - reg

additionalProperties: false

examples:
  - |
    #include <dt-bindings/interrupt-controller/irq.h>

    i2c {
        #address-cells = <1>;
        #size-cells = <0>;

        as73211@74 {
            compatible = "ams,as73211";
            reg = <0x74>;
            pinctrl-names = "default";
            pinctrl-0 = <&pinctrl_color_sensor>;
            interrupt-parent = <&gpio2>;
            interrupts = <19 IRQ_TYPE_EDGE_RISING>; /* READY */
        };
    };
...
```

## Documentation/devicetree/bindings/iio/light/amstaos,tsl2563.yaml
```yaml
# SPDX-License-Identifier: (GPL-2.0 OR BSD-2-Clause)
%YAML 1.2
---
$id: http://devicetree.org/schemas/iio/light/amstaos,tsl2563.yaml#
$schema: http://devicetree.org/meta-schemas/core.yaml#

title: AMS TAOS TSL2563 ambient light sensor

maintainers:
  - Sebastian Reichel <sre@kernel.org>

description: |
  Ambient light sensor with an i2c interface.

properties:
  compatible:
    enum:
      - amstaos,tsl2560
      - amstaos,tsl2561
      - amstaos,tsl2562
      - amstaos,tsl2563

  reg:
    maxItems: 1

  amstaos,cover-comp-gain:
    description: Multiplier for gain compensation
    $ref: /schemas/types.yaml#/definitions/uint32
    enum: [1, 16]

required:
  - compatible
  - reg

examples:
  - |
    i2c {

      #address-cells = <1>;
      #size-cells = <0>;

      light-sensor@29 {
        compatible = "amstaos,tsl2563";
        reg = <0x29>;
        amstaos,cover-comp-gain = <16>;
      };
    };
...
```

## Documentation/devicetree/bindings/iio/light/amstaos,tsl2591.yaml
```yaml
# SPDX-License-Identifier: (GPL-2.0 OR BSD-2-Clause)
%YAML 1.2
---
$id: http://devicetree.org/schemas/iio/light/amstaos,tsl2591.yaml#
$schema: http://devicetree.org/meta-schemas/core.yaml#

title: AMS/TAOS TSL2591 Ambient Light Sensor (ALS)

maintainers:
  - Joe Sandom <joe.g.sandom@gmail.com>

description: |
  AMS/TAOS TSL2591 is a very-high sensitivity
  light-to-digital converter that transforms light intensity into a digital
  signal.

properties:
  compatible:
    const: amstaos,tsl2591

  reg:
    maxItems: 1

  interrupts:
    maxItems: 1
    description:
      Interrupt (INT:Pin 2) Active low. Should be set to IRQ_TYPE_EDGE_FALLING.
      interrupt is used to detect if the light intensity has fallen below
      or reached above the configured threshold values.

required:
  - compatible
  - reg

additionalProperties: false

examples:
  - |
    #include <dt-bindings/interrupt-controller/irq.h>
    i2c {
        #address-cells = <1>;
        #size-cells = <0>;

        tsl2591@29 {
            compatible = "amstaos,tsl2591";
            reg = <0x29>;
            interrupts = <20 IRQ_TYPE_EDGE_FALLING>;
       };
    };
...
```

## Documentation/devicetree/bindings/iio/light/apds9300.txt
```
* Avago APDS9300 ambient light sensor

https://www.avagotech.com/docs/AV02-1077EN

Required properties:

  - compatible : should be "avago,apds9300"
  - reg : the I2C address of the sensor

Optional properties:

  - interrupts : interrupt mapping for GPIO IRQ

Example:

apds9300@39 {
	compatible = "avago,apds9300";
	reg = <0x39>;
	interrupt-parent = <&gpio2>;
	interrupts = <29 8>;
};
```

## Documentation/devicetree/bindings/iio/light/apds9960.txt
```
* Avago APDS9960 gesture/RGB/ALS/proximity sensor

http://www.avagotech.com/docs/AV02-4191EN

Required properties:

  - compatible: must be "avago,apds9960"
  - reg: the I2c address of the sensor
  - interrupts : the sole interrupt generated by the device

  Refer to interrupt-controller/interrupts.txt for generic interrupt client
  node bindings.

Example:

apds9960@39 {
	compatible = "avago,apds9960";
	reg = <0x39>;
	interrupt-parent = <&gpio1>;
	interrupts = <16 1>;
};
```

## Documentation/devicetree/bindings/iio/light/avago,apds9300.yaml
```yaml
# SPDX-License-Identifier: (GPL-2.0 OR BSD-2-Clause)
%YAML 1.2
---
$id: http://devicetree.org/schemas/iio/light/avago,apds9300.yaml#
$schema: http://devicetree.org/meta-schemas/core.yaml#

title: Avago Gesture/RGB/ALS/Proximity sensors

maintainers:
  - Subhajit Ghosh <subhajit.ghosh@tweaklogic.com>

description: |
  Datasheet: https://www.avagotech.com/docs/AV02-1077EN
  Datasheet: https://www.avagotech.com/docs/AV02-4191EN
  Datasheet: https://www.avagotech.com/docs/AV02-4755EN

properties:
  compatible:
    enum:
      - avago,apds9300
      - avago,apds9306
      - avago,apds9960

  reg:
    maxItems: 1

  interrupts:
    maxItems: 1

  vdd-supply: true

additionalProperties: false

required:
  - compatible
  - reg

examples:
  - |
    #include <dt-bindings/interrupt-controller/irq.h>

    i2c {
        #address-cells = <1>;
        #size-cells = <0>;

        light-sensor@39 {
            compatible = "avago,apds9300";
            reg = <0x39>;
            interrupt-parent = <&gpio2>;
            interrupts = <29 IRQ_TYPE_LEVEL_LOW>;
            vdd-supply = <&regulator_3v3>;
        };
    };
...
```

## Documentation/devicetree/bindings/iio/light/avago,apds9960.yaml
```yaml
# SPDX-License-Identifier: (GPL-2.0 OR BSD-2-Clause)
%YAML 1.2
---
$id: http://devicetree.org/schemas/iio/light/avago,apds9960.yaml#
$schema: http://devicetree.org/meta-schemas/core.yaml#

title: Avago APDS9960 gesture/RGB/ALS/proximity sensor

maintainers:
  - Matt Ranostay <matt.ranostay@konsulko.com>

description: |
  Datasheet at https://www.avagotech.com/docs/AV02-4191EN

properties:
  compatible:
    const: avago,apds9960

  reg:
    maxItems: 1

  interrupts:
    maxItems: 1

additionalProperties: false

required:
  - compatible
  - reg

examples:
  - |
    i2c {
        #address-cells = <1>;
        #size-cells = <0>;

        light-sensor@39 {
            compatible = "avago,apds9960";
            reg = <0x39>;
            interrupt-parent = <&gpio1>;
            interrupts = <16 1>;
        };
    };
...
```

## Documentation/devicetree/bindings/iio/light/bh1750.txt
```
ROHM BH1750 - ALS, Ambient light sensor

Required properties:

- compatible: Must be one of:
    "rohm,bh1710"
    "rohm,bh1715"
    "rohm,bh1721"
    "rohm,bh1750"
    "rohm,bh1751"
- reg: the I2C address of the sensor

Example:

light-sensor@23 {
	compatible = "rohm,bh1750";
	reg = <0x23>;
};
```

## Documentation/devicetree/bindings/iio/light/bh1750.yaml
```yaml
# SPDX-License-Identifier: GPL-2.0
%YAML 1.2
---
$id: http://devicetree.org/schemas/iio/light/bh1750.yaml#
$schema: http://devicetree.org/meta-schemas/core.yaml#

title: ROHM BH1750 ambient light sensor

maintainers:
  - Tomasz Duszynski <tduszyns@gmail.com>

description: |
  Ambient light sensor with an i2c interface.

properties:
  compatible:
    enum:
      - rohm,bh1710
      - rohm,bh1715
      - rohm,bh1721
      - rohm,bh1750
      - rohm,bh1751

  reg:
    maxItems: 1

required:
  - compatible
  - reg

examples:
  - |
    i2c {
      #address-cells = <1>;
      #size-cells = <0>;

      light-sensor@23 {
        compatible = "rohm,bh1750";
        reg = <0x23>;
      };
    };

...
```

## Documentation/devicetree/bindings/iio/light/brcm,apds9160.yaml
```yaml
# SPDX-License-Identifier: (GPL-2.0 OR BSD-2-Clause)
%YAML 1.2
---
$id: http://devicetree.org/schemas/iio/light/brcm,apds9160.yaml#
$schema: http://devicetree.org/meta-schemas/core.yaml#

title: Broadcom Combined Proximity & Ambient light sensor

maintainers:
  - Mikael Gonella-Bolduc <m.gonella.bolduc@gmail.com>

description: |
  Datasheet: https://docs.broadcom.com/docs/APDS-9160-003-DS

properties:
  compatible:
    enum:
      - brcm,apds9160

  reg:
    maxItems: 1

  interrupts:
    maxItems: 1

  vdd-supply: true

  ps-cancellation-duration:
    $ref: /schemas/types.yaml#/definitions/uint32
    description:
      Proximity sensor cancellation pulse duration in half clock cycles.
      This parameter determines a cancellation pulse duration.
      The cancellation is applied in the integration phase to cancel out
      unwanted reflected light from very near objects such as tempered glass
      in front of the sensor.
    default: 0
    maximum: 63

  ps-cancellation-current-picoamp:
    description:
      Proximity sensor crosstalk cancellation current in picoampere.
      This parameter adjusts the current in steps of 2400 pA up to 276000 pA.
      The provided value must be a multiple of 2400 and in one of these ranges
      [60000 - 96000]
      [120000 - 156000]
      [180000 - 216000]
      [240000 - 276000]
      This parameter is used in conjunction with the cancellation duration.
    minimum: 60000
    maximum: 276000
    multipleOf: 2400

required:
  - compatible
  - reg
  - vdd-supply

additionalProperties: false

examples:
  - |
    #include <dt-bindings/interrupt-controller/irq.h>

    i2c {
        #address-cells = <1>;
        #size-cells = <0>;

        light-sensor@53 {
            compatible = "brcm,apds9160";
            reg = <0x53>;
            vdd-supply = <&vdd_reg>;
            interrupts = <29 IRQ_TYPE_EDGE_FALLING>;
            interrupt-parent = <&pinctrl>;
            ps-cancellation-duration = <10>;
            ps-cancellation-current-picoamp = <62400>;
        };
    };
...
```

## Documentation/devicetree/bindings/iio/light/brcm,apds9999.yaml
```yaml
# SPDX-License-Identifier: (GPL-2.0 OR BSD-2-Clause)
%YAML 1.2
---
$id: http://devicetree.org/schemas/iio/light/brcm,apds9999.yaml#
$schema: http://devicetree.org/meta-schemas/core.yaml#
title: Broadcom APDS-9999 Digital Proximity and RGB Sensor

maintainers:
  - Jose A. Perez de Azpillaga <azpijr@gmail.com>

description: |
  Broadcom APDS-9999 is a digital proximity and RGB sensor with
  ambient light sensing (ALS) capability. The device uses individual
  R, G, B, and IR channels plus a Vertical Cavity Surface Emitting
  Laser (VCSEL) for proximity detection.

  Datasheet: https://docs.broadcom.com/docs/APDS-9999-DS

properties:
  compatible:
    enum:
      - brcm,apds9999

  reg:
    maxItems: 1

  vdd-supply: true

  vcsel-supply:
    description: VCSEL power supply (VVCSEL pin)

  interrupts:
    maxItems: 1

additionalProperties: false

required:
  - compatible
  - reg
  - vdd-supply

examples:
  - |
    i2c {
        #address-cells = <1>;
        #size-cells = <0>;

        light-sensor@52 {
            compatible = "brcm,apds9999";
            reg = <0x52>;
            vdd-supply = <&vdd_reg>;
            vcsel-supply = <&vcsel_reg>;
        };
    };
```

## Documentation/devicetree/bindings/iio/light/capella,cm3605.yaml
```yaml
# SPDX-License-Identifier: (GPL-2.0 OR BSD-2-Clause)
%YAML 1.2
---
$id: http://devicetree.org/schemas/iio/light/capella,cm3605.yaml#
$schema: http://devicetree.org/meta-schemas/core.yaml#

title:
  Capella Microsystems CM3605 Ambient Light and Short Distance Proximity Sensor

maintainers:
  - Linus Walleij <linus.walleij@linaro.org>
  - Kevin Tsai <ktsai@capellamicro.com>

description: |
  The CM3605 is an entirely analog part. However, it requires quite a bit of
  software logic to interface a host operating system.

  This ALS and proximity sensor was one of the very first deployed in mobile
  handsets, notably it is used in the very first Nexus One Android phone from
  2010.

properties:
  compatible:
    const: capella,cm3605

  aset-gpios:
    maxItems: 1
    description:
      ASET line (drive low to activate the ALS, should be flagged
      GPIO_ACTIVE_LOW)

  interrupts:
    maxItems: 1
    description:
      Connected to the POUT (proximity sensor out) line. The edge
      detection must be set to IRQ_TYPE_EDGE_BOTH so as to detect
      movements toward and away from the proximity sensor.

  io-channels:
    maxItems: 1
    description:
      ADC channel used for converting the voltage from AOUT to a digital
      representation.

  io-channel-names:
    const: aout

  vdd-supply: true

  capella,aset-resistance-ohms:
    enum: [50000, 100000, 300000, 600000]
    description: >
      Sensitivity calibration resistance. Note that calibration curves
      are only provided for specific allowed values. Default: 100 kOhms.

required:
  - compatible
  - aset-gpios
  - interrupts
  - io-channels
  - io-channel-names

additionalProperties: false

examples:
  - |
    #include <dt-bindings/gpio/gpio.h>
    #include <dt-bindings/interrupt-controller/irq.h>
    light-sensor {
        compatible = "capella,cm3605";
        vdd-supply = <&foo_reg>;
        aset-gpios = <&foo_gpio 1 GPIO_ACTIVE_LOW>;
        capella,aset-resistance-ohms = <100000>;
        interrupts = <1 IRQ_TYPE_EDGE_BOTH>;
        io-channels = <&adc 0x01>;
        io-channel-names = "aout";
    };
...
```

## Documentation/devicetree/bindings/iio/light/capella,cm36651.yaml
```yaml
# SPDX-License-Identifier: (GPL-2.0 OR BSD-2-Clause)
%YAML 1.2
---
$id: http://devicetree.org/schemas/iio/light/capella,cm36651.yaml#
$schema: http://devicetree.org/meta-schemas/core.yaml#

title: Capella CM36651 I2C Proximity and Color Light sensor

maintainers:
  - Beomho Seo <beomho.seo@samsung.com>

properties:
  compatible:
    const: capella,cm36651

  reg:
    maxItems: 1

  interrupts:
    maxItems: 1

  vled-supply:
    description: |
      Supply for the IR_LED which is part of the cm36651 for proximity detection.

additionalProperties: false

required:
  - compatible
  - reg
  - interrupts
  - vled-supply

examples:
  - |
    i2c {
        #address-cells = <1>;
        #size-cells = <0>;

        light-sensor@18 {
            compatible = "capella,cm36651";
            reg = <0x18>;
            interrupt-parent = <&gpx0>;
            interrupts = <2 0>;
            vled-supply = <&ps_als_reg>;
        };
    };
...
```
