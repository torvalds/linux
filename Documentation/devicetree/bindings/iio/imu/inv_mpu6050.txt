## Documentation/devicetree/bindings/iio/imu/inv_mpu6050.txt
```
InvenSense MPU-6050 Six-Axis (Gyro + Accelerometer) MEMS MotionTracking Device

http://www.invensense.com/mems/gyro/mpu6050.html

Required properties:
 - compatible : should be one of
		"invensense,mpu6050"
 		"invensense,mpu6500"
		"invensense,mpu6515"
		"invensense,mpu9150"
		"invensense,mpu9250"
		"invensense,mpu9255"
		"invensense,icm20608"
 - reg : the I2C address of the sensor
 - interrupt-parent : should be the phandle for the interrupt controller
 - interrupts: interrupt mapping for IRQ. It should be configured with flags
   IRQ_TYPE_LEVEL_HIGH, IRQ_TYPE_EDGE_RISING, IRQ_TYPE_LEVEL_LOW or
   IRQ_TYPE_EDGE_FALLING.

  Refer to interrupt-controller/interrupts.txt for generic interrupt client node
  bindings.

Optional properties:
 - mount-matrix: an optional 3x3 mounting rotation matrix
 - i2c-gate node.  These devices also support an auxiliary i2c bus.  This is
   simple enough to be described using the i2c-gate binding. See
   i2c/i2c-gate.txt for more details.

Example:
	mpu6050@68 {
		compatible = "invensense,mpu6050";
		reg = <0x68>;
		interrupt-parent = <&gpio1>;
		interrupts = <18 IRQ_TYPE_EDGE_RISING>;
		mount-matrix = "-0.984807753012208",  /* x0 */
		               "0",                   /* y0 */
		               "-0.173648177666930",  /* z0 */
		               "0",                   /* x1 */
		               "-1",                  /* y1 */
		               "0",                   /* z1 */
		               "-0.173648177666930",  /* x2 */
		               "0",                   /* y2 */
		               "0.984807753012208";   /* z2 */
	};


	mpu9250@68 {
		compatible = "invensense,mpu9250";
		reg = <0x68>;
		interrupt-parent = <&gpio3>;
		interrupts = <21 IRQ_TYPE_LEVEL_HIGH>;
		i2c-gate {
			#address-cells = <1>;
			#size-cells = <0>;
			ax8975@c {
				compatible = "ak,ak8975";
				reg = <0x0c>;
			};
		};
	};
```

## Documentation/devicetree/bindings/iio/imu/invensense,icm42600.yaml
```yaml
# SPDX-License-Identifier: (GPL-2.0-only OR BSD-2-Clause)
%YAML 1.2
---
$id: http://devicetree.org/schemas/iio/imu/invensense,icm42600.yaml#
$schema: http://devicetree.org/meta-schemas/core.yaml#

title: InvenSense ICM-426xx Inertial Measurement Unit

maintainers:
  - Jean-Baptiste Maneyrol <jmaneyrol@invensense.com>

description: |
  6-axis MotionTracking device that combines a 3-axis gyroscope and a 3-axis
  accelerometer.

  It has a configurable host interface that supports I3C, I2C and SPI serial
  communication, features a 2kB FIFO and 2 programmable interrupts with
  ultra-low-power wake-on-motion support to minimize system power consumption.

  Other industry-leading features include InvenSense on-chip APEX Motion
  Processing engine for gesture recognition, activity classification, and
  pedometer, along with programmable digital filters, and an embedded
  temperature sensor.

  https://invensense.tdk.com/wp-content/uploads/2020/03/DS-000292-ICM-42605-v1.4.pdf

properties:
  compatible:
    enum:
      - invensense,icm42600
      - invensense,icm42602
      - invensense,icm42605
      - invensense,icm42622
      - invensense,icm42631

  reg:
    maxItems: 1

  interrupts:
    maxItems: 1

  drive-open-drain:
    type: boolean

  vdd-supply:
    description: Regulator that provides power to the sensor

  vddio-supply:
    description: Regulator that provides power to the bus

  spi-cpha: true
  spi-cpol: true

required:
  - compatible
  - reg
  - interrupts

allOf:
  - $ref: /schemas/spi/spi-peripheral-props.yaml#

unevaluatedProperties: false

examples:
  - |
    #include <dt-bindings/gpio/gpio.h>
    #include <dt-bindings/interrupt-controller/irq.h>
    i2c0 {
        #address-cells = <1>;
        #size-cells = <0>;

        icm42605@68 {
          compatible = "invensense,icm42605";
          reg = <0x68>;
          interrupt-parent = <&gpio2>;
          interrupts = <7 IRQ_TYPE_EDGE_FALLING>;
          vdd-supply = <&vdd>;
          vddio-supply = <&vddio>;
        };
    };
  - |
    #include <dt-bindings/gpio/gpio.h>
    #include <dt-bindings/interrupt-controller/irq.h>
    spi0 {
        #address-cells = <1>;
        #size-cells = <0>;

        icm42602@0 {
          compatible = "invensense,icm42602";
          reg = <0>;
          spi-max-frequency = <24000000>;
          spi-cpha;
          spi-cpol;
          interrupt-parent = <&gpio1>;
          interrupts = <2 IRQ_TYPE_EDGE_FALLING>;
          vdd-supply = <&vdd>;
          vddio-supply = <&vddio>;
        };
    };
```

## Documentation/devicetree/bindings/iio/imu/invensense,icm45600.yaml
```yaml
# SPDX-License-Identifier: (GPL-2.0-only OR BSD-2-Clause)
%YAML 1.2
---
$id: http://devicetree.org/schemas/iio/imu/invensense,icm45600.yaml#
$schema: http://devicetree.org/meta-schemas/core.yaml#

title: InvenSense ICM-45600 Inertial Measurement Unit

maintainers:
  - Remi Buisson <remi.buisson@tdk.com>

description: |
  6-axis MotionTracking device that combines a 3-axis gyroscope and a 3-axis
  accelerometer.

  It has a configurable host interface that supports I3C, I2C and SPI serial
  communication, features up to 8kB FIFO and 2 programmable interrupts with
  ultra-low-power wake-on-motion support to minimize system power consumption.

  Other industry-leading features include InvenSense on-chip APEX Motion
  Processing engine for gesture recognition, activity classification, and
  pedometer, along with programmable digital filters, and an embedded
  temperature sensor.

  https://invensense.tdk.com/wp-content/uploads/documentation/DS-000576_ICM-45605.pdf

properties:
  compatible:
    enum:
      - invensense,icm45605
      - invensense,icm45606
      - invensense,icm45608
      - invensense,icm45634
      - invensense,icm45686
      - invensense,icm45687
      - invensense,icm45688p
      - invensense,icm45689

  reg:
    maxItems: 1

  interrupts:
    minItems: 1
    maxItems: 2

  interrupt-names:
    minItems: 1
    items:
      - enum: [int1, int2]
      - const: int2
    description: Choose chip interrupt pin to be used as interrupt input.

  drive-open-drain:
    type: boolean

  vdd-supply: true

  vddio-supply: true

  mount-matrix: true

required:
  - compatible
  - reg
  - vdd-supply
  - vddio-supply

unevaluatedProperties: false

examples:
  - |
    #include <dt-bindings/gpio/gpio.h>
    #include <dt-bindings/interrupt-controller/irq.h>
    i2c {
        #address-cells = <1>;
        #size-cells = <0>;

        imu@68 {
            compatible = "invensense,icm45605";
            reg = <0x68>;
            interrupt-parent = <&gpio2>;
            interrupt-names = "int1";
            interrupts = <7 IRQ_TYPE_EDGE_RISING>;
            vdd-supply = <&vdd>;
            vddio-supply = <&vddio>;
            mount-matrix = "0", "-1", "0",
                           "1", "0", "0",
                           "0", "0", "1";
        };
    };
```

## Documentation/devicetree/bindings/iio/imu/invensense,mpu6050.yaml
```yaml
# SPDX-License-Identifier: (GPL-2.0 OR BSD-2-Clause)
%YAML 1.2
---
$id: http://devicetree.org/schemas/iio/imu/invensense,mpu6050.yaml#
$schema: http://devicetree.org/meta-schemas/core.yaml#

title: InvenSense MPU-6050 Six-Axis (Gyro + Accelerometer) MEMS MotionTracking Device

maintainers:
  - Jean-Baptiste Maneyrol <jmaneyrol@invensense.com>

description: |
  These devices support both I2C and SPI bus interfaces.

properties:
  compatible:
    enum:
      - invensense,iam20680
      - invensense,icm20608
      - invensense,icm20609
      - invensense,icm20689
      - invensense,icm20602
      - invensense,icm20690
      - invensense,mpu6000
      - invensense,mpu6050
      - invensense,mpu6500
      - invensense,mpu6515
      - invensense,mpu6880
      - invensense,mpu9150
      - invensense,mpu9250
      - invensense,mpu9255

  reg:
    maxItems: 1

  interrupts:
    maxItems: 1

  spi-max-frequency: true

  vdd-supply: true
  vddio-supply: true

  mount-matrix: true

  i2c-gate:
    $ref: /schemas/i2c/i2c-controller.yaml
    unevaluatedProperties: false
    description: |
      These devices also support an auxiliary i2c bus via an i2c-gate.

allOf:
  - if:
      not:
        properties:
          compatible:
            contains:
              enum:
                - invensense,mpu9150
                - invensense,mpu9250
                - invensense,mpu9255
    then:
      properties:
        i2c-gate: false

additionalProperties: false

required:
  - compatible
  - reg
  - interrupts

examples:
  - |
    #include <dt-bindings/interrupt-controller/irq.h>
    i2c {
        #address-cells = <1>;
        #size-cells = <0>;

        imu@68 {
            compatible = "invensense,mpu9250";
            reg = <0x68>;
            interrupt-parent = <&gpio3>;
            interrupts = <21 IRQ_TYPE_LEVEL_HIGH>;
            mount-matrix = "-0.984807753012208",  /* x0 */
                           "0",                   /* y0 */
                           "-0.173648177666930",  /* z0 */
                           "0",                   /* x1 */
                           "-1",                  /* y1 */
                           "0",                   /* z1 */
                           "-0.173648177666930",  /* x2 */
                           "0",                   /* y2 */
                           "0.984807753012208";   /* z2 */
            i2c-gate {
                #address-cells = <1>;
                #size-cells = <0>;
                magnetometer@c {
                    compatible = "ak,ak8975";
                    reg = <0x0c>;
                };
            };
        };
    };
...
```

## Documentation/devicetree/bindings/iio/imu/nxp,fxos8700.yaml
```yaml
# SPDX-License-Identifier: (GPL-2.0 OR BSD-2-Clause)
%YAML 1.2
---
$id: http://devicetree.org/schemas/iio/imu/nxp,fxos8700.yaml#
$schema: http://devicetree.org/meta-schemas/core.yaml#

title: Freescale FXOS8700 Inertial Measurement Unit

maintainers:
  - Robert Jones <rjones@gateworks.com>

description: |
  Accelerometer and magnetometer combo device with an i2c and SPI interface.
  https://www.nxp.com/products/sensors/motion-sensors/6-axis/digital-motion-sensor-3d-accelerometer-2g-4g-8g-plus-3d-magnetometer:FXOS8700CQ

properties:
  compatible:
    enum:
      - nxp,fxos8700

  reg:
    maxItems: 1

  interrupts:
    minItems: 1
    maxItems: 2

  interrupt-names:
    minItems: 1
    maxItems: 2
    items:
      enum:
        - INT1
        - INT2

  drive-open-drain:
    type: boolean

required:
  - compatible
  - reg

examples:
  - |
    #include <dt-bindings/gpio/gpio.h>
    #include <dt-bindings/interrupt-controller/irq.h>
    i2c0 {
        #address-cells = <1>;
        #size-cells = <0>;

        fxos8700@1e {
          compatible = "nxp,fxos8700";
          reg = <0x1e>;

          interrupt-parent = <&gpio2>;
          interrupts = <7 IRQ_TYPE_EDGE_RISING>;
          interrupt-names = "INT1";
        };
    };
  - |
    #include <dt-bindings/gpio/gpio.h>
    #include <dt-bindings/interrupt-controller/irq.h>
    spi0 {
        #address-cells = <1>;
        #size-cells = <0>;

        fxos8700@0 {
          compatible = "nxp,fxos8700";
          reg = <0>;

          spi-max-frequency = <1000000>;
          interrupt-parent = <&gpio1>;
          interrupts = <7 IRQ_TYPE_EDGE_RISING>;
          interrupt-names = "INT2";
        };
    };
```

## Documentation/devicetree/bindings/iio/imu/st,lsm6dsx.yaml
```yaml
# SPDX-License-Identifier: (GPL-2.0 OR BSD-2-Clause)
%YAML 1.2
---
$id: http://devicetree.org/schemas/iio/imu/st,lsm6dsx.yaml#
$schema: http://devicetree.org/meta-schemas/core.yaml#

title: STM 6-axis (acc + gyro) IMU Mems sensors

maintainers:
  - Lorenzo Bianconi <lorenzo@kernel.org>

description:
  Devices have both I2C and SPI interfaces.

properties:
  compatible:
    enum:
      - st,lsm6ds3
      - st,lsm6ds3h
      - st,lsm6dsl
      - st,lsm6dsm
      - st,ism330dlc
      - st,lsm6dso
      - st,asm330lhh
      - st,lsm6dsox
      - st,lsm6dsr
      - st,lsm6ds3tr-c
      - st,ism330dhcx
      - st,lsm9ds1-imu
      - st,lsm6ds0
      - st,lsm6dsrx
      - st,lsm6dst
      - st,lsm6dsop

  reg:
    maxItems: 1

  interrupts:
    minItems: 1
    maxItems: 2
    description:
      Supports up to 2 interrupt lines via the INT1 and INT2 pins.

  spi-max-frequency: true

  vdd-supply:
    description: if defined provides VDD power to the sensor.

  vddio-supply:
    description: if defined provides VDD IO power to the sensor.

  st,drdy-int-pin:
    $ref: '/schemas/types.yaml#/definitions/uint32'
    description: |
      The pin on the package that will be used to signal data ready
    enum:
      - 1
      - 2

  st,pullups:
    type: boolean
    description: enable/disable internal i2c controller pullup resistors.

  st,disable-sensor-hub:
    type: boolean
    description:
      Enable/disable internal i2c controller slave autoprobing at bootstrap.
      Disable sensor-hub is useful if i2c controller clock/data lines are
      connected through a pull-up with other chip lines (e.g. SDO/SA0).

  drive-open-drain:
    type: boolean
    description:
      The interrupt/data ready line will be configured as open drain, which
      is useful if several sensors share the same interrupt line.

  wakeup-source:
    $ref: /schemas/types.yaml#/definitions/flag

additionalProperties: false

required:
  - compatible
  - reg

examples:
  - |
    #include <dt-bindings/interrupt-controller/irq.h>
    i2c {
        #address-cells = <1>;
        #size-cells = <0>;

        imu@6b {
            compatible = "st,lsm6dsm";
            reg = <0x6b>;
            interrupt-parent = <&gpio0>;
            interrupts = <0 IRQ_TYPE_EDGE_RISING>;
        };
    };
...
```

## Documentation/devicetree/bindings/iio/imu/st_lsm6dsx.txt
```
* ST_LSM6DSx driver for STM 6-axis (acc + gyro) imu Mems sensors

Required properties:
- compatible: must be one of:
  "st,lsm6ds3"
  "st,lsm6ds3h"
  "st,lsm6dsl"
  "st,lsm6dsm"
  "st,ism330dlc"
- reg: i2c address of the sensor / spi cs line

Optional properties:
- st,drdy-int-pin: the pin on the package that will be used to signal
  "data ready" (valid values: 1 or 2).
- drive-open-drain: the interrupt/data ready line will be configured
  as open drain, which is useful if several sensors share the same
  interrupt line. This is a boolean property.
  (This binding is taken from pinctrl/pinctrl-bindings.txt)
  If the requested interrupt is configured as IRQ_TYPE_LEVEL_HIGH or
  IRQ_TYPE_EDGE_RISING a pull-down resistor is needed to drive the line
  when it is not active, whereas a pull-up one is needed when interrupt
  line is configured as IRQ_TYPE_LEVEL_LOW or IRQ_TYPE_EDGE_FALLING.
- interrupt-parent: should be the phandle for the interrupt controller
- interrupts: interrupt mapping for IRQ. It should be configured with
  flags IRQ_TYPE_LEVEL_HIGH, IRQ_TYPE_EDGE_RISING, IRQ_TYPE_LEVEL_LOW or
  IRQ_TYPE_EDGE_FALLING.

  Refer to interrupt-controller/interrupts.txt for generic interrupt
  client node bindings.

Example:

lsm6dsm@6b {
	compatible = "st,lsm6dsm";
	reg = <0x6b>;
	interrupt-parent = <&gpio0>;
	interrupts = <0 IRQ_TYPE_EDGE_RISING>;
};
```
