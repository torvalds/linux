## Documentation/devicetree/bindings/iio/light/cm3605.txt
```
Capella Microsystems CM3605
Ambient Light and Short Distance Proximity Sensor

The CM3605 is an entirely analog part which however require quite a bit of
software logic to interface a host operating system.

This ALS and proximity sensor was one of the very first deployed in mobile
handsets, notably it is used in the very first Nexus One Android phone from
2010.

Required properties:
- compatible: must be: "capella,cm3605"
- aset-gpios: GPIO line controlling the ASET line (drive low
  to activate the ALS, should be flagged GPIO_ACTIVE_LOW)
- interrupts: the IRQ line (such as a GPIO) that is connected to
  the POUT (proximity sensor out) line. The edge detection must
  be set to IRQ_TYPE_EDGE_BOTH so as to detect movements toward
  and away from the proximity sensor.
- io-channels: the ADC channel used for converting the voltage from
  AOUT to a digital representation.
- io-channel-names: must be "aout"

Optional properties:
- vdd-supply: regulator supplying VDD power to the component.
- capella,aset-resistance-ohms: the sensitivity calibration resistance,
  in Ohms. Valid values are: 50000, 100000, 300000 and 600000,
  as these are the resistance values that we are supplied with
  calibration curves for. If not supplied, 100 kOhm will be assumed
  but it is strongly recommended to supply this.

Example:

cm3605 {
	compatible = "capella,cm3605";
	vdd-supply = <&foo_reg>;
	aset-gpios = <&foo_gpio 1 GPIO_ACTIVE_LOW>;
	capella,aset-resistance-ohms = <100000>;
	interrupts = <1 IRQ_TYPE_EDGE_BOTH>;
	io-channels = <&adc 0x01>;
	io-channel-names = "aout";
};
```

## Documentation/devicetree/bindings/iio/light/cm36651.txt
```
* Capella CM36651 I2C Proximity and Color Light sensor

Required properties:
- compatible: must be "capella,cm36651"
- reg: the I2C address of the device
- interrupts: interrupt-specifier for the sole interrupt
	      generated by the device
- vled-supply: regulator for the IR LED. IR_LED is a part
	      of the cm36651 for proximity detection.
	      As covered in ../../regulator/regulator.txt

Example:

	i2c_cm36651: i2c-gpio {
		/* ... */

		cm36651@18 {
			compatible = "capella,cm36651";
			reg = <0x18>;
			interrupt-parent = <&gpx0>;
			interrupts = <2 0>;
			vled-supply = <&ps_als_reg>;
		};

		/* ... */
	};
```

## Documentation/devicetree/bindings/iio/light/dynaimage,al3010.yaml
```yaml
# SPDX-License-Identifier: (GPL-2.0-only OR BSD-2-Clause)
%YAML 1.2
---
$id: http://devicetree.org/schemas/iio/light/dynaimage,al3010.yaml#
$schema: http://devicetree.org/meta-schemas/core.yaml#

title: Dyna-Image AL3000a/AL3010 sensor

maintainers:
  - David Heidelberg <david@ixit.cz>

properties:
  compatible:
    enum:
      - dynaimage,al3000a
      - dynaimage,al3010

  reg:
    maxItems: 1

  interrupts:
    maxItems: 1

  vdd-supply:
    description: Regulator that provides power to the sensor

required:
  - compatible
  - reg

additionalProperties: false

examples:
  - |
    #include <dt-bindings/interrupt-controller/irq.h>

    i2c {
        #address-cells = <1>;
        #size-cells = <0>;

        light-sensor@1c {
            compatible = "dynaimage,al3010";
            reg = <0x1c>;
            vdd-supply = <&vdd_reg>;
            interrupts = <0 99 4>;
        };
    };
```

## Documentation/devicetree/bindings/iio/light/dynaimage,al3320a.yaml
```yaml
# SPDX-License-Identifier: (GPL-2.0-only OR BSD-2-Clause)
%YAML 1.2
---
$id: http://devicetree.org/schemas/iio/light/dynaimage,al3320a.yaml#
$schema: http://devicetree.org/meta-schemas/core.yaml#

title: Dyna-Image AL3320A sensor

maintainers:
  - David Heidelberg <david@ixit.cz>

properties:
  compatible:
    const: dynaimage,al3320a

  reg:
    maxItems: 1

  interrupts:
    maxItems: 1

  vdd-supply:
    description: Regulator that provides power to the sensor

required:
  - compatible
  - reg

additionalProperties: false

examples:
  - |
    #include <dt-bindings/interrupt-controller/irq.h>

    i2c {
        #address-cells = <1>;
        #size-cells = <0>;

        light-sensor@1c {
            compatible = "dynaimage,al3320a";
            reg = <0x1c>;
            vdd-supply = <&vdd_reg>;
            interrupts = <99 IRQ_TYPE_LEVEL_HIGH>;
        };
    };
```
