## Documentation/devicetree/bindings/iio/light/vishay,veml6046x00.yaml
```yaml
# SPDX-License-Identifier: (GPL-2.0-only OR BSD-2-Clause)
%YAML 1.2
---
$id: http://devicetree.org/schemas/iio/light/vishay,veml6046x00.yaml#
$schema: http://devicetree.org/meta-schemas/core.yaml#

title: Vishay VEML6046X00 High accuracy RGBIR color sensor

maintainers:
  - Andreas Klinger <ak@it-klinger.de>

description:
  VEML6046X00 datasheet at https://www.vishay.com/docs/80173/veml6046x00.pdf

properties:
  compatible:
    enum:
      - vishay,veml6046x00

  reg:
    maxItems: 1

  vdd-supply: true

  interrupts:
    maxItems: 1

required:
  - compatible
  - reg
  - vdd-supply

additionalProperties: false

examples:
  - |
    #include <dt-bindings/interrupt-controller/irq.h>

    i2c {
        #address-cells = <1>;
        #size-cells = <0>;

        color-sensor@29 {
            compatible = "vishay,veml6046x00";
            reg = <0x29>;
            vdd-supply = <&vdd_reg>;
            interrupt-parent = <&gpio2>;
            interrupts = <3 IRQ_TYPE_EDGE_FALLING>;
        };
    };
...
```

## Documentation/devicetree/bindings/iio/light/vishay,veml6075.yaml
```yaml
# SPDX-License-Identifier: (GPL-2.0-only OR BSD-2-Clause)
%YAML 1.2
---
$id: http://devicetree.org/schemas/iio/light/vishay,veml6075.yaml#
$schema: http://devicetree.org/meta-schemas/core.yaml#

title: Vishay VEML6070 UVA, VEML6075 UVA/B and VEML6040 RGBW sensors

maintainers:
  - Javier Carrasco <javier.carrasco.cruz@gmail.com>

description:
  VEML6040 datasheet at https://www.vishay.com/docs/84276/veml6040.pdf

properties:
  compatible:
    enum:
      - vishay,veml6040
      - vishay,veml6070
      - vishay,veml6075

  reg:
    maxItems: 1

  vishay,rset-ohms:
    description:
      Resistor used to select the integration time.
    default: 270000
    minimum: 75000
    maximum: 1200000

  vdd-supply: true

required:
  - compatible
  - reg
  - vdd-supply

allOf:
  - if:
      properties:
        compatible:
          enum:
            - vishay,veml6040
            - vishay,veml6075
    then:
      properties:
        vishay,rset-ohms: false

additionalProperties: false

examples:
  - |
    i2c {
        #address-cells = <1>;
        #size-cells = <0>;

        uv-sensor@10 {
            compatible = "vishay,veml6075";
            reg = <0x10>;
            vdd-supply = <&vdd_reg>;
        };
    };
...
```

## Documentation/devicetree/bindings/iio/light/vl6180.txt
```
STMicro VL6180 -  ALS, range and proximity sensor

Link to datasheet: https://www.st.com/resource/en/datasheet/vl6180x.pdf

Required properties:

	-compatible: should be "st,vl6180"
	-reg: the I2C address of the sensor

Optional properties:
	-avdd-gpio: gpio to enable or disable the digital/analog power supply
	-chip-enable-gpio: gpio to enable or disable chip select (CE)

Example:

vl6180@29 {
	compatible = "st,vl6180";
	reg = <0x29>;
};

Here an example with power controlled by gpio:

vl6180@29 {
	compatible = "st,vl6180";
	reg = <0x29>;
	avdd-gpio = <&gpio1 2 GPIO_ACTIVE_HIGH>;
	chip-enable-gpio = <&gpio1 3 GPIO_ACTIVE_HIGH>;
};
```

## Documentation/devicetree/bindings/iio/magnetometer/ak8974.txt
```
* Asahi Kasei AK8974 magnetometer sensor

Required properties:

- compatible:
    * "asahi-kasei,ak8974"
    * "alps,hscdtd008a"
- reg : the I2C address of the magnetometer

Optional properties:

- avdd-supply: regulator supply for the analog voltage
  (see regulator/regulator.txt)
- dvdd-supply: regulator supply for the digital voltage
  (see regulator/regulator.txt)
- interrupts: data ready (DRDY) and interrupt (INT1) lines
  from the chip, the DRDY interrupt must be placed first.
  The interrupts can be triggered on rising or falling
  edges alike.
- mount-matrix: an optional 3x3 mounting rotation matrix

Example:

ak8974@f {
	compatible = "asahi-kasei,ak8974";
	reg = <0x0f>;
	avdd-supply = <&foo_reg>;
	dvdd-supply = <&bar_reg>;
	interrupts = <0 IRQ_TYPE_EDGE_RISING>,
		     <1 IRQ_TYPE_EDGE_RISING>;
};
```

## Documentation/devicetree/bindings/iio/magnetometer/ak8975.txt
```
* AsahiKASEI AK8975 magnetometer sensor

Required properties:

  - compatible : should be "asahi-kasei,ak8975".
  - reg : the I2C address of the magnetometer.

Optional properties:

  - gpios : AK8975 has a "Data ready" pin (DRDY) which informs that data
      is ready to be read and is possible to listen on it. If used,
      this should be active high. Prefer interrupt over this.

  - interrupts : interrupt for DRDY pin. Triggered on rising edge.

  - vdd-supply: an optional regulator that needs to be on to provide VDD.

  - mount-matrix: an optional 3x3 mounting rotation matrix.

Example:

ak8975@c {
        compatible = "asahi-kasei,ak8975";
        reg = <0x0c>;
        interrupt-parent = <&gpio6>;
        interrupts = <15 IRQ_TYPE_EDGE_RISING>;
        vdd-supply = <&ldo_3v3_gnss>;
        mount-matrix = "-0.984807753012208",  /* x0 */
                       "0",                   /* y0 */
                       "-0.173648177666930",  /* z0 */
                       "0",                   /* x1 */
                       "-1",                  /* y1 */
                       "0",                   /* z1 */
                       "-0.173648177666930",  /* x2 */
                       "0",                   /* y2 */
                       "0.984807753012208";   /* z2 */
};
```

## Documentation/devicetree/bindings/iio/magnetometer/allegromicro,als31300.yaml
```yaml
# SPDX-License-Identifier: GPL-2.0-only OR BSD-2-Clause
%YAML 1.2
---
$id: http://devicetree.org/schemas/iio/magnetometer/allegromicro,als31300.yaml#
$schema: http://devicetree.org/meta-schemas/core.yaml#

title: Allegro MicroSystems ALS31300 3-D Linear Hall Effect sensor

maintainers:
  - Neil Armstrong <neil.armstrong@linaro.org>

properties:
  $nodename:
    pattern: '^magnetometer@[0-9a-f]+$'

  compatible:
    enum:
      - allegromicro,als31300-500 # Factory configured at 500 Gauss input range
      - allegromicro,als31300-1000 # Factory configured at 1000 Gauss input range
      - allegromicro,als31300-2000 # Factory configured at 2000 Gauss input range

  reg:
    maxItems: 1

  vcc-supply:
    description: 5.5V supply

  interrupts:
    maxItems: 1

required:
  - compatible

additionalProperties: false

examples:
  - |
    i2c {
      #address-cells = <1>;
      #size-cells = <0>;
      magnetometer@61 {
        compatible = "allegromicro,als31300-500";
        reg = <0x61>;
        vcc-supply = <&hall_vcc>;
      };
    };
```

## Documentation/devicetree/bindings/iio/magnetometer/asahi-kasei,ak8974.yaml
```yaml
# SPDX-License-Identifier: (GPL-2.0 OR BSD-2-Clause)
%YAML 1.2
---
$id: http://devicetree.org/schemas/iio/magnetometer/asahi-kasei,ak8974.yaml#
$schema: http://devicetree.org/meta-schemas/core.yaml#

title: Asahi Kasei AK8974 magnetometer sensor

maintainers:
  - Linus Walleij <linus.walleij@linaro.org>

properties:
  compatible:
    enum:
      - alps,hscdtd008a
      - asahi-kasei,ak8974

  reg:
    maxItems: 1

  interrupts:
    minItems: 1
    maxItems: 2
    description: |
      Data ready (DRDY) and interrupt (INT1) lines from the chip. The DRDY
      interrupt must be placed first. The interrupts can be triggered on
      rising or falling edges.

  avdd-supply: true

  dvdd-supply: true

  mount-matrix: true

additionalProperties: false

required:
  - compatible
  - reg

examples:
  - |
    #include <dt-bindings/interrupt-controller/irq.h>
    i2c {
        #address-cells = <1>;
        #size-cells = <0>;

        magnetometer@f {
            compatible = "asahi-kasei,ak8974";
            reg = <0x0f>;
            avdd-supply = <&foo_reg>;
            dvdd-supply = <&bar_reg>;
            interrupts = <0 IRQ_TYPE_EDGE_RISING>,
                         <1 IRQ_TYPE_EDGE_RISING>;
        };
    };
...
```

## Documentation/devicetree/bindings/iio/magnetometer/asahi-kasei,ak8975.yaml
```yaml
# SPDX-License-Identifier: (GPL-2.0 OR BSD-2-Clause)
%YAML 1.2
---
$id: http://devicetree.org/schemas/iio/magnetometer/asahi-kasei,ak8975.yaml#
$schema: http://devicetree.org/meta-schemas/core.yaml#

title: AsahiKASEI AK8975 magnetometer sensor

maintainers:
  - Jonathan Albrieux <jonathan.albrieux@gmail.com>

properties:
  compatible:
    oneOf:
      - enum:
          - asahi-kasei,ak8975
          - asahi-kasei,ak8963
          - asahi-kasei,ak09911
          - asahi-kasei,ak09912
      - enum:
          - ak8975
          - ak8963
          - ak09911
          - ak09912
        deprecated: true

  reg:
    maxItems: 1

  gpios:
    maxItems: 1
    description: |
      AK8975 has a "Data ready" pin (DRDY) which informs that data
      is ready to be read and is possible to listen on it. If used,
      this should be active high. Prefer interrupt over this.

  interrupts:
    maxItems: 1
    description: interrupt for DRDY pin. Triggered on rising edge.

  vdd-supply:
    description: |
      an optional regulator that needs to be on to provide VDD power to
      the sensor.

  mount-matrix:
    description: an optional 3x3 mounting rotation matrix.

  reset-gpios:
    maxItems: 1
    description: |
      an optional pin needed for AK09911 to set the reset state. This should
      be usually active low

required:
  - compatible
  - reg

additionalProperties: false

examples:
  - |
    #include <dt-bindings/interrupt-controller/irq.h>
    #include <dt-bindings/gpio/gpio.h>
    i2c {
        #address-cells = <1>;
        #size-cells = <0>;

        magnetometer@c {
            compatible = "asahi-kasei,ak8975";
            reg = <0x0c>;
            interrupt-parent = <&gpio6>;
            interrupts = <15 IRQ_TYPE_EDGE_RISING>;
            vdd-supply = <&ldo_3v3_gnss>;
            reset-gpios = <&msmgpio 111 GPIO_ACTIVE_LOW>;
            mount-matrix = "-0.984807753012208",  /* x0 */
                           "0",                   /* y0 */
                           "-0.173648177666930",  /* z0 */
                           "0",                   /* x1 */
                           "-1",                  /* y1 */
                           "0",                   /* z1 */
                           "-0.173648177666930",  /* x2 */
                           "0",                   /* y2 */
                           "0.984807753012208";   /* z2 */
        };
    };
```

## Documentation/devicetree/bindings/iio/magnetometer/bmc150_magn.txt
```
* Bosch BMC150 magnetometer sensor

http://ae-bst.resource.bosch.com/media/products/dokumente/bmc150/BST-BMC150-DS000-04.pdf

Required properties:

  - compatible : should be one of:
                 "bosch,bmc150_magn"
                 "bosch,bmc156_magn"
                 "bosch,bmm150"
                 "bosch,bmm150_magn" (DEPRECATED, use bosch,bmm150)
  - reg : the I2C address of the magnetometer

Optional properties:

  - interrupts : interrupt mapping for GPIO IRQ

Example:

bmc150_magn@12 {
        compatible = "bosch,bmc150_magn";
        reg = <0x12>;
        interrupt-parent = <&gpio1>;
        interrupts = <0 1>;
};
```

## Documentation/devicetree/bindings/iio/magnetometer/bosch,bmc150_magn.yaml
```yaml
# SPDX-License-Identifier: (GPL-2.0 OR BSD-2-Clause)
%YAML 1.2
---
$id: http://devicetree.org/schemas/iio/magnetometer/bosch,bmc150_magn.yaml#
$schema: http://devicetree.org/meta-schemas/core.yaml#

title: Bosch BMC150 magnetometer sensor

maintainers:
  - Jonathan Cameron <jic23@kernel.org>

description: |
  Supports a range of parts, some of which form part of a multi die
  package that also contains other sensors.  The interface is independent
  however, so a separate driver is used to support the magnetometer part.
  Datasheet at:
  http://ae-bst.resource.bosch.com/media/products/dokumente/bmc150/BST-BMC150-DS000-04.pdf

properties:
  compatible:
    description:
      Note the bmm150_magn is a deprecated compatible as this part contains only
      a magnetometer.
    enum:
      - bosch,bmc150_magn
      - bosch,bmc156_magn
      - bosch,bmm150
      - bosch,bmm150_magn

  reg:
    maxItems: 1

  vdd-supply: true
  vddio-supply: true

  interrupts:
    maxItems: 1

additionalProperties: false

required:
  - compatible
  - reg

examples:
  - |
    i2c {
        #address-cells = <1>;
        #size-cells = <0>;

        magnetometer@12 {
            compatible = "bosch,bmc150_magn";
            reg = <0x12>;
            interrupt-parent = <&gpio1>;
            interrupts = <0 1>;
        };
    };
...
```

## Documentation/devicetree/bindings/iio/magnetometer/fsl,mag3110.yaml
```yaml
# SPDX-License-Identifier: (GPL-2.0 OR BSD-2-Clause)
%YAML 1.2
---
$id: http://devicetree.org/schemas/iio/magnetometer/fsl,mag3110.yaml#
$schema: http://devicetree.org/meta-schemas/core.yaml#

title: Freescale MAG3110 magnetometer sensor

maintainers:
  - Anson Huang <Anson.Huang@nxp.com>

properties:
  compatible:
    const: fsl,mag3110

  reg:
    maxItems: 1

  interrupts:
    maxItems: 1

  vdd-supply: true

  vddio-supply: true

additionalProperties: false

required:
  - compatible
  - reg

examples:
  - |
    #include <dt-bindings/interrupt-controller/irq.h>
    i2c {
        #address-cells = <1>;
        #size-cells = <0>;

        magnetometer@e {
            compatible = "fsl,mag3110";
            reg = <0x0e>;
            pinctrl-names = "default";
            pinctrl-0 = <&pinctrl_i2c3_mag3110_int>;
            interrupt-parent = <&gpio3>;
            interrupts = <16 IRQ_TYPE_EDGE_RISING>;
        };
    };
...
```

## Documentation/devicetree/bindings/iio/magnetometer/hmc5843.txt
```
* Honeywell HMC5843 magnetometer sensor

Required properties:

  - compatible : should be "honeywell,hmc5843"
  Other models which are supported with driver are:
	"honeywell,hmc5883"
	"honeywell,hmc5883l"
	"honeywell,hmc5983"
  - reg : the I2C address of the magnetometer - typically 0x1e

Optional properties:

  - gpios : should be device tree identifier of the magnetometer DRDY pin

Example:

hmc5843@1e {
        compatible = "honeywell,hmc5843"
        reg = <0x1e>;
};
```

## Documentation/devicetree/bindings/iio/magnetometer/honeywell,hmc5843.yaml
```yaml
# SPDX-License-Identifier: (GPL-2.0 OR BSD-2-Clause)
%YAML 1.2
---
$id: http://devicetree.org/schemas/iio/magnetometer/honeywell,hmc5843.yaml#
$schema: http://devicetree.org/meta-schemas/core.yaml#

title: Honeywell HMC5843 magnetometer sensor

maintainers:
  - Neil Brown <neilb@suse.de>

properties:
  compatible:
    enum:
      - honeywell,hmc5843
      - honeywell,hmc5883
      - honeywell,hmc5883l
      - honeywell,hmc5983

  reg:
    maxItems: 1

  interrupts:
    maxItems: 1

additionalProperties: false

required:
  - compatible
  - reg

examples:
  - |
    i2c {
        #address-cells = <1>;
        #size-cells = <0>;

        magnetometer@1e {
            compatible = "honeywell,hmc5843";
            reg = <0x1e>;
        };
    };
...
```
