## Documentation/devicetree/bindings/iio/light/tsl2583.yaml
```yaml
# SPDX-License-Identifier: (GPL-2.0 OR BSD-2-Clause)
%YAML 1.2
---
$id: http://devicetree.org/schemas/iio/light/tsl2583.yaml#
$schema: http://devicetree.org/meta-schemas/core.yaml#

title: AMS/TAOS Ambient Light Sensor (ALS)

maintainers:
  - Brian Masney <masneyb@onstation.org>

description: |
  Ambient light sensing with an i2c interface.

properties:
  compatible:
    enum:
      - amstaos,tsl2580
      - amstaos,tsl2581
      - amstaos,tsl2583

  reg:
    maxItems: 1

  interrupts:
    maxItems: 1

  vcc-supply:
    description: Regulator that provides power to the sensor

required:
  - compatible
  - reg

additionalProperties: false

examples:
  - |
    i2c {
        #address-cells = <1>;
        #size-cells = <0>;

        light-sensor@29 {
                compatible = "amstaos,tsl2581";
                reg = <0x29>;
        };
    };
...
```

## Documentation/devicetree/bindings/iio/light/tsl2772.txt
```
* AMS/TAOS ALS and proximity sensor

Required properties:

  - compatible: Should be one of
		"amstaos,tsl2571"
		"amstaos,tsl2671"
		"amstaos,tmd2671"
		"amstaos,tsl2771"
		"amstaos,tmd2771"
		"amstaos,tsl2572"
		"amstaos,tsl2672"
		"amstaos,tmd2672"
		"amstaos,tsl2772"
		"amstaos,tmd2772"
		"avago,apds9930"
  - reg: the I2C address of the device

Optional properties:

  - amstaos,proximity-diodes - proximity diodes to enable. <0>, <1>, or <0 1>
                               are the only valid values.
  - led-max-microamp - current for the proximity LED. Must be 100000, 50000,
                       25000, or 13000.
  - vdd-supply: phandle to the regulator that provides power to the sensor.
  - vddio-supply: phandle to the regulator that provides power to the bus.
  - interrupts: the sole interrupt generated by the device

  Refer to interrupt-controller/interrupts.txt for generic interrupt client
  node bindings.

Example:

tsl2772@39 {
	compatible = "amstaos,tsl2772";
	reg = <0x39>;
	interrupts-extended = <&msmgpio 61 IRQ_TYPE_EDGE_FALLING>;
	vdd-supply = <&pm8941_l17>;
	vddio-supply = <&pm8941_lvs1>;
	amstaos,proximity-diodes = <0>;
	led-max-microamp = <100000>;
};
```

## Documentation/devicetree/bindings/iio/light/tsl2772.yaml
```yaml
# SPDX-License-Identifier: (GPL-2.0 OR BSD-2-Clause)
%YAML 1.2
---
$id: http://devicetree.org/schemas/iio/light/tsl2772.yaml#
$schema: http://devicetree.org/meta-schemas/core.yaml#

title: AMS/TAOS Ambient Light Sensor (ALS) and Proximity Detector

maintainers:
  - Brian Masney <masneyb@onstation.org>

description: |
  Ambient light sensing and proximity detection with an i2c interface.
  https://ams.com/documents/20143/36005/TSL2772_DS000181_2-00.pdf

properties:
  compatible:
    enum:
      - amstaos,tsl2571
      - amstaos,tsl2671
      - amstaos,tmd2671
      - amstaos,tsl2771
      - amstaos,tmd2771
      - amstaos,tsl2572
      - amstaos,tsl2672
      - amstaos,tmd2672
      - amstaos,tsl2772
      - amstaos,tmd2772
      - avago,apds9930

  reg:
    maxItems: 1

  amstaos,proximity-diodes:
    description: Proximity diodes to enable
    allOf:
      - $ref: /schemas/types.yaml#/definitions/uint32-array
      - minItems: 1
        maxItems: 2
        items:
          minimum: 0
          maximum: 1

  interrupts:
    maxItems: 1

  led-max-microamp:
    description: Current for the proximity LED
    enum:
      - 13000
      - 25000
      - 50000
      - 100000

  vdd-supply:
    description: Regulator that provides power to the sensor

  vddio-supply:
    description: Regulator that provides power to the bus

required:
  - compatible
  - reg

additionalProperties: false

examples:
  - |
    #include <dt-bindings/interrupt-controller/irq.h>

    i2c {
        #address-cells = <1>;
        #size-cells = <0>;

        sensor@39 {
                compatible = "amstaos,tsl2772";
                reg = <0x39>;
                interrupts-extended = <&msmgpio 61 IRQ_TYPE_EDGE_FALLING>;
                vdd-supply = <&pm8941_l17>;
                vddio-supply = <&pm8941_lvs1>;
                amstaos,proximity-diodes = <0>;
                led-max-microamp = <100000>;
        };
    };
...
```

## Documentation/devicetree/bindings/iio/light/upisemi,us5182.yaml
```yaml
# SPDX-License-Identifier: (GPL-2.0 OR BSD-2-Clause)
%YAML 1.2
---
$id: http://devicetree.org/schemas/iio/light/upisemi,us5182.yaml#
$schema: http://devicetree.org/meta-schemas/core.yaml#

title: UPISEMI us5182d I2C ALS and Proximity sensor

maintainers:
  - Jonathan Cameron <jic23@kernel.org>

properties:
  compatible:
    const: upisemi,usd5182

  reg:
    maxItems: 1

  upisemi,glass-coef:
    $ref: /schemas/types.yaml#/definitions/uint32
    description: |
      glass attenuation factor - compensation factor of resolution 1000
      for material transmittance.
    default: 1000

  upisemi,dark-ths:
    $ref: /schemas/types.yaml#/definitions/uint16-array
    minItems: 8
    maxItems: 8
    description:
      16-bit thresholds (adc counts) corresponding to every scale.

  upisemi,upper-dark-gain:
    $ref: /schemas/types.yaml#/definitions/uint8
    description: |
      8-bit dark gain compensation factor(4 int and 4 fractional bits - Q4.4)
      applied when light > threshold.
    default: 0

  upisemi,lower-dark-gain:
    $ref: /schemas/types.yaml#/definitions/uint8
    description: |
      8-bit dark gain compensation factor(4 int and 4 fractional bits - Q4.4)
      applied when light < threshold.
    default: 0x16

  upisemi,continuous:
    $ref: /schemas/types.yaml#/definitions/flag
    description: |
      This chip has two power modes: one-shot (chip takes one measurement and
      then shuts itself down) and continuous (chip takes continuous
      measurements). The one-shot mode is more power-friendly but the
      continuous mode may be more reliable. If this property is specified
      the continuous mode will be used instead of the default one-shot one for
      raw reads.

additionalProperties: false

required:
  - compatible
  - reg

examples:
  - |
    i2c {
        #address-cells = <1>;
        #size-cells = <0>;

        light-sensor@39 {
            compatible = "upisemi,usd5182";
            reg = <0x39>;
            upisemi,glass-coef = < 1000 >;
            upisemi,dark-ths = /bits/ 16 <170 200 512 512 800 2000 4000 8000>;
            upisemi,upper-dark-gain = /bits/ 8 <0x00>;
            upisemi,lower-dark-gain = /bits/ 8 <0x16>;
        };
    };
...
```

## Documentation/devicetree/bindings/iio/light/us5182d.txt
```
* UPISEMI us5182d I2C ALS and Proximity sensor

Required properties:
- compatible: must be "upisemi,usd5182"
- reg: the I2C address of the device

Optional properties:
- upisemi,glass-coef: glass attenuation factor - compensation factor of
                      resolution 1000 for material transmittance.
- upisemi,dark-ths: array of 8 elements containing 16-bit thresholds (adc
                    counts) corresponding to every scale.
- upisemi,upper-dark-gain: 8-bit dark gain compensation factor(4 int and 4
                           fractional bits - Q4.4) applied when light > threshold
- upisemi,lower-dark-gain: 8-bit dark gain compensation factor(4 int and 4
                           fractional bits - Q4.4) applied when light < threshold

If the optional properties are not specified these factors will default to the
values in the below example.
The glass-coef defaults to no compensation for the covering material.
The threshold array defaults to experimental values that work with US5182D
sensor on evaluation board - roughly between 12-32 lux.
There will be no dark-gain compensation by default when ALS > thresh
(0 * dark-gain), and a 1.35 compensation factor when ALS < thresh.

Example:

    usd5182@39 {
                compatible = "upisemi,usd5182";
                reg = <0x39>;
                upisemi,glass-coef = < 1000 >;
                upisemi,dark-ths = /bits/ 16 <170 200 512 512 800 2000 4000 8000>;
                upisemi,upper-dark-gain = /bits/ 8 <0x00>;
                upisemi,lower-dark-gain = /bits/ 8 <0x16>;
    };
```

## Documentation/devicetree/bindings/iio/light/uvis25.txt
```
* ST UVIS25 uv sensor

Required properties:
- compatible: should be "st,uvis25"
- reg: i2c address of the sensor / spi cs line

Optional properties:
- interrupt-parent: should be the phandle for the interrupt controller
- interrupts: interrupt mapping for IRQ. It should be configured with
  flags IRQ_TYPE_LEVEL_HIGH, IRQ_TYPE_EDGE_RISING, IRQ_TYPE_LEVEL_LOW or
  IRQ_TYPE_EDGE_FALLING.

  Refer to interrupt-controller/interrupts.txt for generic interrupt
  client node bindings.

Example:

uvis25@47 {
	compatible = "st,uvis25";
	reg = <0x47>;
	interrupt-parent = <&gpio0>;
	interrupts = <0 IRQ_TYPE_EDGE_RISING>;
};
```

## Documentation/devicetree/bindings/iio/light/vcnl4000.txt
```
VISHAY VCNL4000 -  Ambient Light and proximity sensor

This driver supports the VCNL4000/10/20 and VCNL4200 chips

Required properties:

	-compatible: must be one of :
        vishay,vcnl4000
        vishay,vcnl4010
        vishay,vcnl4020
        vishay,vcnl4200

	-reg: I2C address of the sensor, should be one from below based on the model:
        0x13
        0x51

Example:

light-sensor@51 {
	compatible = "vishay,vcnl4200";
	reg = <0x51>;
};
```

## Documentation/devicetree/bindings/iio/light/vcnl4035.txt
```
VISHAY VCNL4035 -  Ambient Light and proximity sensor

Link to datasheet: https://www.vishay.com/docs/84251/vcnl4035x01.pdf

Required properties:

	-compatible: should be "vishay,vcnl4035"
	-reg: I2C address of the sensor, should be 0x60
	-interrupts: interrupt mapping for GPIO IRQ (level active low)

Example:

light-sensor@60 {
	compatible = "vishay,vcnl4035";
	reg = <0x60>;
	interrupt-parent = <&gpio4>;
	interrupts = <11 IRQ_TYPE_LEVEL_LOW>;
};
```

## Documentation/devicetree/bindings/iio/light/veml6030.yaml
```yaml
# SPDX-License-Identifier: GPL-2.0+
%YAML 1.2
---
$id: http://devicetree.org/schemas/iio/light/veml6030.yaml#
$schema: http://devicetree.org/meta-schemas/core.yaml#

title: VEML6030 Ambient Light Sensor (ALS)

maintainers:
  - Rishi Gupta <gupt21@gmail.com>

description: |
  Bindings for the ambient light sensor veml6030 from Vishay
  Semiconductors over an i2c interface.

  Irrespective of whether interrupt is used or not, application
  can get the ALS and White channel reading from IIO raw interface.

  If the interrupts are used, application will receive an IIO event
  whenever configured threshold is crossed.

  Specifications about the sensor can be found at:
    https://www.vishay.com/docs/84366/veml6030.pdf

properties:
  compatible:
    enum:
      - vishay,veml6030

  reg:
    description:
      I2C address of the device.
    enum:
      - 0x10 # ADDR pin pulled down
      - 0x48 # ADDR pin pulled up

  interrupts:
    description:
      interrupt mapping for IRQ. Configure with IRQ_TYPE_LEVEL_LOW.
      Refer to interrupt-controller/interrupts.txt for generic
      interrupt client node bindings.
    maxItems: 1

required:
  - compatible
  - reg

additionalProperties: false

examples:
  - |
    #include <dt-bindings/interrupt-controller/irq.h>

    i2c {
        #address-cells = <1>;
        #size-cells = <0>;

        light-sensor@10 {
                compatible = "vishay,veml6030";
                reg = <0x10>;
                interrupts = <12 IRQ_TYPE_LEVEL_LOW>;
        };
    };
...
```

## Documentation/devicetree/bindings/iio/light/vishay,vcnl4000.yaml
```yaml
# SPDX-License-Identifier: (GPL-2.0 OR BSD-2-Clause)
%YAML 1.2
---
$id: http://devicetree.org/schemas/iio/light/vishay,vcnl4000.yaml#
$schema: http://devicetree.org/meta-schemas/core.yaml#

title: VISHAY VCNL4000 ambient light and proximity sensor

maintainers:
  - Peter Meerwald <pmeerw@pmeerw.net>

description: |
  Ambient light sensing with proximity detection over an i2c
  interface.

allOf:
  - $ref: ../common.yaml#

properties:
  compatible:
    enum:
      - vishay,vcnl4000
      - vishay,vcnl4010
      - vishay,vcnl4020
      - vishay,vcnl4040
      - vishay,vcnl4200
  reg:
    maxItems: 1

  proximity-near-level: true

required:
  - compatible
  - reg

additionalProperties: false

examples:
  - |
    i2c {
        #address-cells = <1>;
        #size-cells = <0>;

        light-sensor@51 {
            compatible = "vishay,vcnl4200";
            reg = <0x51>;
            proximity-near-level = <220>;
        };
    };
...
```

## Documentation/devicetree/bindings/iio/light/vishay,vcnl4035.yaml
```yaml
# SPDX-License-Identifier: (GPL-2.0 OR BSD-2-Clause)
%YAML 1.2
---
$id: http://devicetree.org/schemas/iio/light/vishay,vcnl4035.yaml#
$schema: http://devicetree.org/meta-schemas/core.yaml#

title: VISHAY VCNL4035 ambient Light and proximity sensor

maintainers:
  - Jonathan Cameron <jic23@kernel.org>

description: |
  Datasheet at https://www.vishay.com/docs/84251/vcnl4035x01.pdf

properties:
  compatible:
    const: vishay,vcnl4035

  reg:
    maxItems: 1

  interrupts:
    maxItems: 1

additionalProperties: false

required:
  - compatible
  - reg

examples:
  - |
    #include <dt-bindings/interrupt-controller/irq.h>
    i2c {
        #address-cells = <1>;
        #size-cells = <0>;

        light-sensor@60 {
            compatible = "vishay,vcnl4035";
            reg = <0x60>;
            interrupt-parent = <&gpio4>;
            interrupts = <11 IRQ_TYPE_LEVEL_LOW>;
        };
    };
...
```

## Documentation/devicetree/bindings/iio/light/vishay,veml6030.yaml
```yaml
# SPDX-License-Identifier: GPL-2.0+
%YAML 1.2
---
$id: http://devicetree.org/schemas/iio/light/vishay,veml6030.yaml#
$schema: http://devicetree.org/meta-schemas/core.yaml#

title: VEML3235, VEML6030, VEML6035 and VEML7700 Ambient Light Sensors (ALS)

maintainers:
  - Rishi Gupta <gupt21@gmail.com>

description: |
  Bindings for the ambient light sensors veml6030 and veml6035 from
  Vishay Semiconductors over an i2c interface.

  Irrespective of whether interrupt is used or not, application
  can get the ALS and White channel reading from IIO raw interface.

  If the interrupts are used, application will receive an IIO event
  whenever configured threshold is crossed.

  Specifications about the sensors can be found at:
    https://www.vishay.com/docs/80131/veml3235.pdf
    https://www.vishay.com/docs/84366/veml6030.pdf
    https://www.vishay.com/docs/84889/veml6035.pdf
    https://www.vishay.com/docs/84286/veml7700.pdf

properties:
  compatible:
    enum:
      - vishay,veml3235
      - vishay,veml6030
      - vishay,veml6035
      - vishay,veml7700

  reg:
    maxItems: 1

  interrupts:
    description:
      interrupt mapping for IRQ. Configure with IRQ_TYPE_LEVEL_LOW.
      Refer to interrupt-controller/interrupts.txt for generic
      interrupt client node bindings.
    maxItems: 1

  vdd-supply: true

required:
  - compatible
  - reg
  - vdd-supply

allOf:
  - if:
      properties:
        compatible:
          enum:
            - vishay,veml6030
    then:
      properties:
        reg:
          enum:
            - 0x10  # ADDR pin pulled down
            - 0x48  # ADDR pin pulled up

  - if:
      properties:
        compatible:
          enum:
            - vishay,veml6035
    then:
      properties:
        reg:
          enum:
            - 0x29

  - if:
      properties:
        compatible:
          enum:
            - vishay,veml3235
            - vishay,veml7700
    then:
      properties:
        reg:
          enum:
            - 0x10
        interrupts: false

additionalProperties: false

examples:
  - |
    #include <dt-bindings/interrupt-controller/irq.h>

    i2c {
        #address-cells = <1>;
        #size-cells = <0>;

        light-sensor@10 {
                compatible = "vishay,veml6030";
                reg = <0x10>;
                interrupts = <12 IRQ_TYPE_LEVEL_LOW>;
                vdd-supply = <&vdd>;
        };
    };
...
```
