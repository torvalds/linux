## Documentation/devicetree/bindings/iio/light/sharp,gp2ap002.yaml
```yaml
# SPDX-License-Identifier: (GPL-2.0-only OR BSD-2-Clause)
%YAML 1.2
---
$id: http://devicetree.org/schemas/iio/light/sharp,gp2ap002.yaml#
$schema: http://devicetree.org/meta-schemas/core.yaml#

title: Sharp GP2AP002A00F and GP2AP002S00F proximity and ambient light sensors

maintainers:
  - Linus Walleij <linus.walleij@linaro.org>

description: |
  Proximity and ambient light sensor with IR LED for the proximity
  sensing and an analog output for light intensity. The ambient light
  sensor output is not available on the GP2AP002S00F variant.

properties:
  compatible:
    enum:
      - sharp,gp2ap002a00f
      - sharp,gp2ap002s00f

  reg:
    maxItems: 1

  interrupts:
    maxItems: 1
    description: an interrupt for proximity, usually a GPIO line

  vdd-supply:
    description: VDD power supply a phandle to a regulator

  vio-supply:
    description: VIO power supply a phandle to a regulator

  io-channels:
    maxItems: 1
    description: ALSOUT ADC channel to read the ambient light

  io-channel-names:
    const: alsout

  sharp,proximity-far-hysteresis:
    $ref: /schemas/types.yaml#/definitions/uint8
    description: |
      Hysteresis setting for "far" object detection, this setting is
      device-unique and adjust the optical setting for proximity detection
      of a "far away" object in front of the sensor.

  sharp,proximity-close-hysteresis:
    $ref: /schemas/types.yaml#/definitions/uint8
    description: |
      Hysteresis setting for "close" object detection, this setting is
      device-unique and adjust the optical setting for proximity detection
      of a "close" object in front of the sensor.

required:
  - compatible
  - reg
  - interrupts
  - sharp,proximity-far-hysteresis
  - sharp,proximity-close-hysteresis

examples:
  - |
    #include <dt-bindings/interrupt-controller/irq.h>

    i2c {
      #address-cells = <1>;
      #size-cells = <0>;

      light-sensor@44 {
        compatible = "sharp,gp2ap002a00f";
        reg = <0x44>;
        interrupts = <18 IRQ_TYPE_EDGE_FALLING>;
        vdd-supply = <&vdd_regulator>;
        vio-supply = <&vio_regulator>;
        io-channels = <&adc_channel>;
        io-channel-names = "alsout";
        sharp,proximity-far-hysteresis = /bits/ 8 <0x2f>;
        sharp,proximity-close-hysteresis = /bits/ 8 <0x0f>;
      };
    };

...
```

## Documentation/devicetree/bindings/iio/light/sharp,gp2ap020a00f.yaml
```yaml
# SPDX-License-Identifier: (GPL-2.0 OR BSD-2-Clause)
%YAML 1.2
---
$id: http://devicetree.org/schemas/iio/light/sharp,gp2ap020a00f.yaml#
$schema: http://devicetree.org/meta-schemas/core.yaml#

title: Sharp GP2AP020A00F I2C Proximity/ALS sensor

maintainers:
  - Kyungmin Park <kyungmin.park@samsung.com>

description: |
  The proximity detector sensor requires power supply for its built-in led.

properties:
  compatible:
    const: sharp,gp2ap020a00f

  reg:
    maxItems: 1

  interrupts:
    maxItems: 1

  vled-supply: true

additionalProperties: false

required:
  - compatible
  - reg
  - interrupts
  - vled-supply

examples:
  - |
    i2c {
        #address-cells = <1>;
        #size-cells = <0>;

        light-sensor@39 {
            compatible = "sharp,gp2ap020a00f";
            reg = <0x39>;
            interrupts = <2 0>;
            vled-supply = <&als_reg>;
        };
    };
...
```

## Documentation/devicetree/bindings/iio/light/st,uvis25.yaml
```yaml
# SPDX-License-Identifier: (GPL-2.0 OR BSD-2-Clause)
%YAML 1.2
---
$id: http://devicetree.org/schemas/iio/light/st,uvis25.yaml#
$schema: http://devicetree.org/meta-schemas/core.yaml#

title: ST UVIS25 uv sensor

maintainers:
  - Lorenzo Bianconi <lorenzo.bianconi83@gmail.com>

properties:
  compatible:
    const: st,uvis25

  reg:
    maxItems: 1

  interrupts:
    maxItems: 1

additionalProperties: false

required:
  - compatible
  - reg

examples:
  - |
    #include <dt-bindings/interrupt-controller/irq.h>
    i2c {
        #address-cells = <1>;
        #size-cells = <0>;

        uv-sensor@47 {
            compatible = "st,uvis25";
            reg = <0x47>;
            interrupt-parent = <&gpio0>;
            interrupts = <0 IRQ_TYPE_EDGE_RISING>;
        };
    };
...
```

## Documentation/devicetree/bindings/iio/light/st,vl6180.yaml
```yaml
# SPDX-License-Identifier: (GPL-2.0 OR BSD-2-Clause)
%YAML 1.2
---
$id: http://devicetree.org/schemas/iio/light/st,vl6180.yaml#
$schema: http://devicetree.org/meta-schemas/core.yaml#

title: STMicro VL6180 ALS, range and proximity sensor

maintainers:
  - Manivannan Sadhasivam <manivannanece23@gmail.com>
  - Peter Meerwald-Stadler <pmeerw@pmeerw.net>

description: |
  Proximity sensing module incorporating time of flight sensor
  Datasheet at https://www.st.com/resource/en/datasheet/vl6180x.pdf

properties:
  compatible:
    const: st,vl6180

  reg:
    maxItems: 1

  interrupts:
    maxItems: 1

additionalProperties: false

required:
  - compatible
  - reg

examples:
  - |
    #include <dt-bindings/interrupt-controller/irq.h>
    i2c {
        #address-cells = <1>;
        #size-cells = <0>;

        proximity@29 {
            compatible = "st,vl6180";
            reg = <0x29>;
        };
    };
...
```

## Documentation/devicetree/bindings/iio/light/stk33xx.yaml
```yaml
# SPDX-License-Identifier: (GPL-2.0 OR BSD-2-Clause)
%YAML 1.2
---
$id: http://devicetree.org/schemas/iio/light/stk33xx.yaml#
$schema: http://devicetree.org/meta-schemas/core.yaml#

title: |
  Sensortek STK33xx I2C Ambient Light and Proximity sensor

maintainers:
  - Jonathan Cameron <jic23@kernel.org>

description: |
  Ambient light and proximity sensor over an i2c interface.

allOf:
  - $ref: ../common.yaml#

properties:
  compatible:
    oneOf:
      - enum:
          - sensortek,stk3310
          - sensortek,stk3311
          - sensortek,stk3335
      - items:
          - enum:
              - sensortek,stk3013
          - const: sensortek,stk3310

  reg:
    maxItems: 1

  interrupts:
    maxItems: 1

  proximity-near-level: true

required:
  - compatible
  - reg

additionalProperties: false

examples:
  - |
    #include <dt-bindings/interrupt-controller/irq.h>

    i2c {

        #address-cells = <1>;
        #size-cells = <0>;

        stk3310@48 {
                compatible = "sensortek,stk3310";
                reg = <0x48>;
                proximity-near-level = <25>;
                interrupt-parent = <&gpio1>;
                interrupts = <5 IRQ_TYPE_LEVEL_LOW>;
        };
    };
...
```

## Documentation/devicetree/bindings/iio/light/ti,opt3001.yaml
```yaml
# SPDX-License-Identifier: (GPL-2.0 OR BSD-2-Clause)
%YAML 1.2
---
$id: http://devicetree.org/schemas/iio/light/ti,opt3001.yaml#
$schema: http://devicetree.org/meta-schemas/core.yaml#

title: Texas Instruments OPT3001 Ambient Light Sensor

maintainers:
  - Andreas Dannenberg <dannenberg@ti.com>

description: |
  The device supports interrupt-driven and interrupt-less operation, depending
  on whether an interrupt property has been populated into the DT.

properties:
  compatible:
    enum:
      - ti,opt3001
      - ti,opt3002

  reg:
    maxItems: 1

  interrupts:
    maxItems: 1
    description: Should be configured with type IRQ_TYPE_EDGE_FALLING

additionalProperties: false

required:
  - compatible
  - reg

examples:
  - |
    #include <dt-bindings/interrupt-controller/irq.h>
    i2c {
        #address-cells = <1>;
        #size-cells = <0>;

        light-sensor@44 {
            compatible = "ti,opt3001";
            reg = <0x44>;
            interrupt-parent = <&gpio1>;
            interrupts = <28 IRQ_TYPE_EDGE_FALLING>;
        };
    };
...
```

## Documentation/devicetree/bindings/iio/light/ti,opt4001.yaml
```yaml
# SPDX-License-Identifier: (GPL-2.0 OR BSD-2-Clause)
%YAML 1.2
---
$id: http://devicetree.org/schemas/iio/light/ti,opt4001.yaml#
$schema: http://devicetree.org/meta-schemas/core.yaml#

title: Texas Instruments OPT4001 Ambient Light Sensor

maintainers:
  - Stefan Windfeldt-Prytz <stefan.windfeldt-prytz@axis.com>

description:
  Ambient light sensor with an i2c interface.
  Last part of compatible is for the packaging used.
  Picostar is a 4 pinned SMT and sot-5x3 is a 8 pinned SOT.
  https://www.ti.com/lit/gpn/opt4001

properties:
  compatible:
    enum:
      - ti,opt4001-picostar
      - ti,opt4001-sot-5x3

  reg:
    maxItems: 1

  interrupts:
    maxItems: 1

  vdd-supply:
    description: Regulator that provides power to the sensor

required:
  - compatible
  - reg

allOf:
  - if:
      properties:
        compatible:
          contains:
            const: ti,opt4001-sot-5x3
    then:
      properties:
        interrupts:
          maxItems: 1
    else:
      properties:
        interrupts: false

additionalProperties: false

examples:
  - |
    #include <dt-bindings/interrupt-controller/irq.h>
    i2c {
        #address-cells = <1>;
        #size-cells = <0>;

        light-sensor@44 {
            compatible = "ti,opt4001-sot-5x3";
            reg = <0x44>;
            vdd-supply = <&vdd_reg>;
            interrupt-parent = <&gpio1>;
            interrupts = <28 IRQ_TYPE_EDGE_FALLING>;
        };
    };
...
```

## Documentation/devicetree/bindings/iio/light/ti,opt4060.yaml
```yaml
# SPDX-License-Identifier: (GPL-2.0 OR BSD-2-Clause)
%YAML 1.2
---
$id: http://devicetree.org/schemas/iio/light/ti,opt4060.yaml#
$schema: http://devicetree.org/meta-schemas/core.yaml#

title: Texas Instruments OPT4060 RGBW Color Sensor

maintainers:
  - Per-Daniel Olsson <perdaniel.olsson@axis.com>

description:
  Texas Instrument RGBW high resolution color sensor over I2C.
  https://www.ti.com/lit/gpn/opt4060

properties:
  compatible:
    enum:
      - ti,opt4060

  reg:
    maxItems: 1

  interrupts:
    maxItems: 1

  vdd-supply: true

required:
  - compatible
  - reg
  - vdd-supply

additionalProperties: false

examples:
  - |
    #include <dt-bindings/interrupt-controller/irq.h>
    i2c {
        #address-cells = <1>;
        #size-cells = <0>;

        light-sensor@44 {
            compatible = "ti,opt4060";
            reg = <0x44>;
            vdd-supply = <&vdd_reg>;
            interrupt-parent = <&gpio5>;
            interrupts = <13 IRQ_TYPE_EDGE_FALLING>;
        };
    };
...
```

## Documentation/devicetree/bindings/iio/light/tsl2563.txt
```
* AMS TAOS TSL2563 ambient light sensor

Required properties:

  - compatible : should be "amstaos,tsl2563"
  - reg : the I2C address of the sensor

Optional properties:

  - amstaos,cover-comp-gain : integer used as multiplier for gain
                              compensation (default = 1)

Example:

tsl2563@29 {
	compatible = "amstaos,tsl2563";
	reg = <0x29>;
	amstaos,cover-comp-gain = <16>;
};
```

## Documentation/devicetree/bindings/iio/light/tsl2583.txt
```
* TAOS TSL 2580/2581/2583 ALS sensor

Required properties:

  - compatible: Should be one of
		"amstaos,tsl2580"
		"amstaos,tsl2581"
		"amstaos,tsl2583"
  - reg: the I2C address of the device

Optional properties:

  - interrupt-parent: should be the phandle for the interrupt controller
  - interrupts: the sole interrupt generated by the device

  Refer to interrupt-controller/interrupts.txt for generic interrupt client
  node bindings.

  - vcc-supply: phandle to the regulator that provides power to the sensor.

Example:

tsl2581@29 {
	compatible = "amstaos,tsl2581";
	reg = <0x29>;
};
```
