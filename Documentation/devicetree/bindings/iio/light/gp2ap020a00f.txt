## Documentation/devicetree/bindings/iio/light/gp2ap020a00f.txt
```
* Sharp GP2AP020A00F I2C Proximity/ALS sensor

The proximity detector sensor requires power supply
for its built-in led. It is also defined by this binding.

Required properties:

  - compatible : should be "sharp,gp2ap020a00f"
  - reg : the I2C slave address of the light sensor
  - interrupts : interrupt specifier for the sole interrupt generated
		 by the device
  - vled-supply : VLED power supply, as covered in ../regulator/regulator.txt

Example:

gp2ap020a00f@39 {
	compatible = "sharp,gp2ap020a00f";
	reg = <0x39>;
	interrupts = <2 0>;
	vled-supply = <...>;
};
```

## Documentation/devicetree/bindings/iio/light/isl29018.txt
```
* ISL 29018/29023/29035 I2C ALS, Proximity, and Infrared sensor

Required properties:

  - compatible: Should be one of
		"isil,isl29018"
		"isil,isl29023"
		"isil,isl29035"
  - reg: the I2C address of the device

Optional properties:

  - interrupts: the sole interrupt generated by the device

  Refer to interrupt-controller/interrupts.txt for generic interrupt client
  node bindings.

  - vcc-supply: phandle to the regulator that provides power to the sensor.

Example:

isl29018@44 {
	compatible = "isil,isl29018";
	reg = <0x44>;
	interrupt-parent = <&gpio>;
	interrupts = <TEGRA_GPIO(Z, 2) IRQ_TYPE_LEVEL_HIGH>;
};
```

## Documentation/devicetree/bindings/iio/light/isl29018.yaml
```yaml
# SPDX-License-Identifier: (GPL-2.0 OR BSD-2-Clause)
%YAML 1.2
---
$id: http://devicetree.org/schemas/iio/light/isl29018.yaml#
$schema: http://devicetree.org/meta-schemas/core.yaml#

title: |
  Intersil 29018/29023/29035 Ambient Light, Infrared Light, and Proximity Sensor

maintainers:
  - Brian Masney <masneyb@onstation.org>

description: |
  Ambient and infrared light sensing with proximity detection over an i2c
  interface.

  https://www.renesas.com/us/en/www/doc/datasheet/isl29018.pdf
  https://www.renesas.com/us/en/www/doc/datasheet/isl29023.pdf
  https://www.renesas.com/us/en/www/doc/datasheet/isl29035.pdf

properties:
  compatible:
    enum:
      - isil,isl29018
      - isil,isl29023
      - isil,isl29035

  reg:
    maxItems: 1

  interrupts:
    maxItems: 1

  vcc-supply:
    description: Regulator that provides power to the sensor

required:
  - compatible
  - reg

examples:
  - |
    #include <dt-bindings/interrupt-controller/irq.h>

    i2c {

        #address-cells = <1>;
        #size-cells = <0>;

        sensor@44 {
                compatible = "isil,isl29018";
                reg = <0x44>;
                interrupts-extended = <&msmgpio 61 IRQ_TYPE_LEVEL_HIGH>;
        };
    };
...
```

## Documentation/devicetree/bindings/iio/light/isl29501.txt
```
* ISL29501 Time-of-flight sensor.

Required properties:

  - compatible : should be "renesas,isl29501"
  - reg : the I2C address of the sensor

Example:

isl29501@57 {
	compatible = "renesas,isl29501";
	reg = <0x57>;
};
```

## Documentation/devicetree/bindings/iio/light/liteon,ltr390.yaml
```yaml
# SPDX-License-Identifier: (GPL-2.0 OR BSD-2-Clause)
%YAML 1.2
---
$id: http://devicetree.org/schemas/iio/light/liteon,ltr390.yaml#
$schema: http://devicetree.org/meta-schemas/core.yaml#

title: Lite-On LTR390 ALS and UV Sensor

description: |
  The Lite-On LTR390 is an ALS (Ambient Light Sensor) and a UV sensor in a
  single package with i2c address of 0x53.

  Datasheet:
    https://optoelectronics.liteon.com/upload/download/DS86-2015-0004/LTR-390UV_Final_%20DS_V1%201.pdf

maintainers:
  - Anshul Dalal <anshulusr@gmail.com>

properties:
  compatible:
    enum:
      - liteon,ltr390

  reg:
    maxItems: 1

  interrupts:
    maxItems: 1
    description: |
      Level interrupt pin with open drain output.
      The sensor pulls this pin low when the measured reading is greater than
      some configured threshold.

  vdd-supply: true

required:
  - compatible
  - reg

additionalProperties: false

examples:
  - |
    #include <dt-bindings/interrupt-controller/irq.h>

    i2c {
        #address-cells = <1>;
        #size-cells = <0>;

        light-sensor@53 {
            compatible = "liteon,ltr390";
            reg = <0x53>;
            interrupts = <18 IRQ_TYPE_EDGE_FALLING>;
            vdd-supply = <&vdd_regulator>;
        };
    };
```

## Documentation/devicetree/bindings/iio/light/liteon,ltrf216a.yaml
```yaml
# SPDX-License-Identifier: (GPL-2.0 OR BSD-2-Clause)
%YAML 1.2
---
$id: http://devicetree.org/schemas/iio/light/liteon,ltrf216a.yaml#
$schema: http://devicetree.org/meta-schemas/core.yaml#

title: LTRF216A Ambient Light Sensor

maintainers:
  - Shreeya Patel <shreeya.patel@collabora.com>

description:
  Ambient light sensing with an i2c interface.

properties:
  compatible:
    const: liteon,ltrf216a

  reg:
    maxItems: 1

  interrupts:
    maxItems: 1

  vdd-supply:
    description: Regulator that provides power to the sensor.

required:
  - compatible
  - reg

additionalProperties: false

examples:
  - |
    #include <dt-bindings/interrupt-controller/irq.h>

    i2c {
        #address-cells = <1>;
        #size-cells = <0>;

        light-sensor@53 {
            compatible = "liteon,ltrf216a";
            reg = <0x53>;
            vdd-supply = <&vdd_regulator>;
            interrupt-parent = <&gpio0>;
            interrupts = <5 IRQ_TYPE_LEVEL_LOW>;
        };
    };
```

## Documentation/devicetree/bindings/iio/light/max44009.txt
```
* MAX44009 Ambient Light Sensor

Required properties:

- compatible: should be "maxim,max44009"
- reg: the I2C address of the device (default is <0x4a>)

Optional properties:

- interrupts: interrupt mapping for GPIO IRQ. Should be configured with
  IRQ_TYPE_EDGE_FALLING.

Refer to interrupt-controller/interrupts.txt for generic interrupt client
node bindings.

Example:

light-sensor@4a {
	compatible = "maxim,max44009";
	reg = <0x4a>;

	interrupt-parent = <&gpio1>;
	interrupts = <17 IRQ_TYPE_EDGE_FALLING>;
};
```

## Documentation/devicetree/bindings/iio/light/maxim,max44009.yaml
```yaml
# SPDX-License-Identifier: (GPL-2.0 OR BSD-2-Clause)
%YAML 1.2
---
$id: http://devicetree.org/schemas/iio/light/maxim,max44009.yaml#
$schema: http://devicetree.org/meta-schemas/core.yaml#

title: MAX44009 Ambient Light Sensor

maintainers:
  - Robert Eshleman <bobbyeshleman@gmail.com>

properties:
  compatible:
    const: maxim,max44009

  reg:
    maxItems: 1
    description: Default address is 0x4a

  interrupts:
    maxItems: 1
    description: Should be configured with type IRQ_TYPE_EDGE_FALLING

additionalProperties: false

required:
  - compatible
  - reg

examples:
  - |
    #include <dt-bindings/interrupt-controller/irq.h>
    i2c {
        #address-cells = <1>;
        #size-cells = <0>;

        light-sensor@4a {
            compatible = "maxim,max44009";
            reg = <0x4a>;

            interrupt-parent = <&gpio1>;
            interrupts = <17 IRQ_TYPE_EDGE_FALLING>;
        };
    };
...
```

## Documentation/devicetree/bindings/iio/light/noa1305.yaml
```yaml
# SPDX-License-Identifier: GPL-2.0
%YAML 1.2
---
$id: http://devicetree.org/schemas/iio/light/anala1305.yaml#
$schema: http://devicetree.org/meta-schemas/core.yaml#

title: ON Semiconductor ANALA1305 Ambient Light Sensor

maintainers:
  - Martyn Welch <martyn.welch@collabora.com>

description: |
  Ambient sensing with an i2c interface.

  https://www.onsemi.com/pub/Collateral/ANALA1305-D.PDF

properties:
  compatible:
    enum:
      - onnn,anala1305

  reg:
    maxItems: 1

  vin-supply:
    description: Regulator that provides power to the sensor

required:
  - compatible
  - reg

additionalProperties: false

examples:
  - |
    i2c {

        #address-cells = <1>;
        #size-cells = <0>;

        light@39 {
                compatible = "onnn,anala1305";
                reg = <0x39>;
        };
    };
...
```

## Documentation/devicetree/bindings/iio/light/opt3001.txt
```
* Texas Instruments OPT3001 Ambient Light Sensor

The driver supports interrupt-driven and interrupt-less operation, depending
on whether an interrupt property has been populated into the DT. Note that
the optional generation of IIO events on rising/falling light threshold changes
requires the use of interrupts. Without interrupts, only the simple reading
of the current light value is supported through the IIO API.

http://www.ti.com/product/opt3001

Required properties:
  - compatible: should be "ti,opt3001"
  - reg: the I2C address of the sensor

Optional properties:
  - interrupt-parent: should be the phandle for the interrupt controller
  - interrupts: interrupt mapping for GPIO IRQ (configure for falling edge)

Example:

opt3001@44 {
	compatible = "ti,opt3001";
	reg = <0x44>;
	interrupt-parent = <&gpio1>;
	interrupts = <28 IRQ_TYPE_EDGE_FALLING>;
};
```

## Documentation/devicetree/bindings/iio/light/rohm,bh1745.yaml
```yaml
# SPDX-License-Identifier: (GPL-2.0 OR BSD-2-Clause)
%YAML 1.2
---
$id: http://devicetree.org/schemas/iio/light/rohm,bh1745.yaml#
$schema: http://devicetree.org/meta-schemas/core.yaml#

title: ROHM BH1745 colour sensor

maintainers:
  - Mudit Sharma <muditsharma.info@gmail.com>

description:
  BH1745 is an I2C colour sensor with red, green, blue and clear
  channels. It has a programmable active low interrupt pin.
  Interrupt occurs when the signal from the selected interrupt
  source channel crosses set interrupt threshold high/low level.

properties:
  compatible:
    const: rohm,bh1745

  reg:
    maxItems: 1

  interrupts:
    maxItems: 1

  vdd-supply: true

required:
  - compatible
  - reg
  - vdd-supply

additionalProperties: false

examples:
  - |
    #include <dt-bindings/interrupt-controller/irq.h>
    i2c {
        #address-cells = <1>;
        #size-cells = <0>;

        colour-sensor@38 {
            compatible = "rohm,bh1745";
            reg = <0x38>;
            interrupt-parent = <&gpio>;
            interrupts = <19 IRQ_TYPE_LEVEL_LOW>;
            vdd-supply = <&vdd>;
        };
    };

...
```

## Documentation/devicetree/bindings/iio/light/rohm,bu27008.yaml
```yaml
# SPDX-License-Identifier: (GPL-2.0 OR BSD-2-Clause)
%YAML 1.2
---
$id: http://devicetree.org/schemas/iio/light/rohm,bu27008.yaml#
$schema: http://devicetree.org/meta-schemas/core.yaml#

title: ROHM BU27008 color sensor

maintainers:
  - Matti Vaittinen <mazziesaccount@gmail.com>

description:
  The ROHM BU27008 is a sensor with 5 photodiodes (red, green, blue, clear
  and IR) with four configurable channels. Red and green being always
  available and two out of the rest three (blue, clear, IR) can be
  selected to be simultaneously measured. Typical application is adjusting
  LCD backlight of TVs, mobile phones and tablet PCs.

properties:
  compatible:
    const: rohm,bu27008

  reg:
    maxItems: 1

  interrupts:
    maxItems: 1

  vdd-supply: true

required:
  - compatible
  - reg

additionalProperties: false

examples:
  - |
    i2c {
      #address-cells = <1>;
      #size-cells = <0>;

      light-sensor@38 {
        compatible = "rohm,bu27008";
        reg = <0x38>;
      };
    };

...
```

## Documentation/devicetree/bindings/iio/light/rohm,bu27010.yaml
```yaml
# SPDX-License-Identifier: (GPL-2.0 OR BSD-2-Clause)
%YAML 1.2
---
$id: http://devicetree.org/schemas/iio/light/rohm,bu27010.yaml#
$schema: http://devicetree.org/meta-schemas/core.yaml#

title: ROHM BU27010 color sensor

maintainers:
  - Matti Vaittinen <mazziesaccount@gmail.com>

description: |
  The ROHM BU27010 is a sensor with 6 photodiodes (red, green, blue, clear,
  IR and flickering detection) with five configurable channels. Red, green
  and flickering detection being always available and two out of the rest
  three (blue, clear, IR) can be selected to be simultaneously measured.
  Typical application is adjusting LCD/OLED backlight of TVs, mobile phones
  and tablet PCs.

properties:
  compatible:
    const: rohm,bu27010

  reg:
    maxItems: 1

  interrupts:
    maxItems: 1

  vdd-supply: true

required:
  - compatible
  - reg
  - vdd-supply

additionalProperties: false

examples:
  - |
    i2c {
      #address-cells = <1>;
      #size-cells = <0>;

      light-sensor@38 {
        compatible = "rohm,bu27010";
        reg = <0x38>;
        vdd-supply = <&vdd>;
      };
    };
```

## Documentation/devicetree/bindings/iio/light/rohm,bu27034.yaml
```yaml
# SPDX-License-Identifier: (GPL-2.0 OR BSD-2-Clause)
%YAML 1.2
---
$id: http://devicetree.org/schemas/iio/light/rohm,bu27034.yaml#
$schema: http://devicetree.org/meta-schemas/core.yaml#

title: ROHM BU27034 ambient light sensor

maintainers:
  - Matti Vaittinen <mazziesaccount@gmail.com>

description: |
  ROHM BU27034 is an ambient light sesnor with 3 channels and 3 photo diodes
  capable of detecting a very wide range of illuminance. Typical application
  is adjusting LCD and backlight power of TVs and mobile phones.
  https://fscdn.rohm.com/en/products/databook/datasheet/ic/sensor/light/bu27034nuc-e.pdf

properties:
  compatible:
    const: rohm,bu27034

  reg:
    maxItems: 1

  vdd-supply: true

required:
  - compatible
  - reg

additionalProperties: false

examples:
  - |
    i2c {
      #address-cells = <1>;
      #size-cells = <0>;

      light-sensor@38 {
        compatible = "rohm,bu27034";
        reg = <0x38>;
        vdd-supply = <&vdd>;
      };
    };

...
```

## Documentation/devicetree/bindings/iio/light/rohm,bu27034anuc.yaml
```yaml
# SPDX-License-Identifier: (GPL-2.0 OR BSD-2-Clause)
%YAML 1.2
---
$id: http://devicetree.org/schemas/iio/light/rohm,bu27034anuc.yaml#
$schema: http://devicetree.org/meta-schemas/core.yaml#

title: ROHM BU27034ANUC ambient light sensor

maintainers:
  - Matti Vaittinen <mazziesaccount@gmail.com>

description: |
  ROHM BU27034ANUC is an ambient light sensor with 2 channels and 2 photo diodes
  capable of detecting a very wide range of illuminance. Typical application
  is adjusting LCD and backlight power of TVs and mobile phones.

properties:
  compatible:
    const: rohm,bu27034anuc

  reg:
    maxItems: 1

  vdd-supply: true

required:
  - compatible
  - reg

additionalProperties: false

examples:
  - |
    i2c {
      #address-cells = <1>;
      #size-cells = <0>;

      light-sensor@38 {
        compatible = "rohm,bu27034anuc";
        reg = <0x38>;
        vdd-supply = <&vdd>;
      };
    };

...
```
