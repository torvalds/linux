## Documentation/devicetree/bindings/iio/stm/imu/st_lsm6dsox.txt
```
* st_lsm6dsox driver for imu MEMS sensors

Required properties for all bus drivers:
- compatible: must be one of:
              "st,lsm6dso"
              "st,lsm6dsox"
              "st,lsm6dso32"
              "st,lsm6dso32x"

Required properties for the i2c bindings:
- reg: i2c slave address

Required properties for the spi bindings:
- reg:               the chipselect index
- spi-max-frequency: maximal bus speed, should be set to 1000000 unless
                     constrained by external circuitry

Optional properties for all bus drivers:
- vdd-supply:       an optional regulator that needs to be on to provide VDD
                    power to the sensor.

- vddio-supply:     an optional regulator that needs to be on to provide the
                    VDD IO power to the sensor.

- st,int-pin:       the pin on the package that will be used to signal
                    "data ready" (valid values: 1 or 2, default: 1).

- mount-matrix:     mount rotation matrix.

                    Refer to iio/mount-matrix.txt for details.

- drive-open-drain: the interrupt/data ready line will be configured as open drain,
                    which is useful if several sensors share the same interrupt line.

- interrupts:       interrupt mapping for IRQ. It should be configured with
                    flags IRQ_TYPE_LEVEL_HIGH, IRQ_TYPE_EDGE_RISING,
                    IRQ_TYPE_LEVEL_LOW or IRQ_TYPE_EDGE_FALLING.

                    Refer to interrupt-controller/interrupts.txt for generic interrupt
                    client node bindings.

- st,module_id:     module identifier.
                    This is used by user-space to identify which devices
                    are part of the same module (particularly important for
                    supporting multiple sensors of the same type).

- wakeup-source:    https://www.kernel.org/doc/Documentation/devicetree/bindings/power/wakeup-source.txt

Example for an spi device node:

lsm6dsox-imu@0 {
	compatible = "st,lsm6dsox";
	reg = <0x0>;
	spi-max-frequency = <1000000>;
	interrupt-parent = <&gpio0>;
	interrupts = <0 IRQ_TYPE_LEVEL_HIGH>;
	vddio-supply = <&sensors_vddio>;
	vdd-supply = <&sensors_vdd>;
	st,int-pin = <1>;
	mount-matrix = "1", "0", "0",
		       "0", "1", "0",
		       "0", "0", "1";
	st,module_id = <5>;
};
```

## Documentation/devicetree/bindings/iio/stm/imu/st_lsm6dsr.txt
```
* st_lsm6dsr driver for imu MEMS sensors

Required properties for all bus drivers:
- compatible: must be one of:
              "st,lsm6dsr"

Required properties for the i2c bindings:
- reg: i2c slave address

Required properties for the spi bindings:
- reg:               the chipselect index
- spi-max-frequency: maximal bus speed, should be set to 1000000 unless
                     constrained by external circuitry

Optional properties for all bus drivers:
- st,int-pin:       the pin on the package that will be used to signal
                    "data ready" (valid values: 1 or 2, default: 1).

- drive-open-drain: the interrupt/data ready line will be configured as open drain,
                    which is useful if several sensors share the same interrupt line.

- interrupts:       interrupt mapping for IRQ. It should be configured with
                    flags IRQ_TYPE_LEVEL_HIGH, IRQ_TYPE_EDGE_RISING,
                    IRQ_TYPE_LEVEL_LOW or IRQ_TYPE_EDGE_FALLING.

                    Refer to interrupt-controller/interrupts.txt for generic interrupt
                    client node bindings.

Example for an spi device node:

lsm6dsox-imu@0 {
	compatible = "st,lsm6dsox";
	reg = <0x0>;
	spi-max-frequency = <1000000>;
	interrupt-parent = <&gpio0>;
	interrupts = <0 IRQ_TYPE_LEVEL_HIGH>;
	st,int-pin = <1>;
};
```

## Documentation/devicetree/bindings/iio/stm/imu/st_lsm6dsvx.txt
```
* st_lsm6dsvx driver for imu MEMS sensors

Required properties for all bus drivers:
- compatible: must be "st,lsm6dsv16x"

Required properties for the i2c bindings:
- reg:               i2c slave address

Required properties for the spi bindings:
- reg:               the chipselect index

- spi-max-frequency: maximal bus speed, should be set to 1000000 unless
                     constrained by external circuitry

Optional properties for all bus drivers:
- vdd-supply:        an optional regulator that needs to be on to provide VDD
                     power to the sensor.

- vddio-supply:      an optional regulator that needs to be on to provide the
                     VDD IO power to the sensor.

- st,int-pin:        the pin on the package that will be used to signal
                     "data ready" (valid values: 1 or 2, default: 1).

- mount-matrix:      mount rotation matrix.

                     Refer to iio/mount-matrix.txt for details.

- drive-open-drain:  the interrupt/data ready line will be configured as open drain,
                     which is useful if several sensors share the same interrupt line.

- drive-pullup-shub: enable pull up on the i2c master interface. Default is disabled.

- interrupts:        interrupt mapping for IRQ. It should be configured with
                     flags IRQ_TYPE_LEVEL_HIGH, IRQ_TYPE_EDGE_RISING,
                     IRQ_TYPE_LEVEL_LOW or IRQ_TYPE_EDGE_FALLING.

                     Refer to interrupt-controller/interrupts.txt for generic interrupt
                     client node bindings.

Example for an spi device node:

lsm6dsvx-imu@0 {
	compatible = "st,lsm6dsv16x";
	reg = <0x0>;
	spi-max-frequency = <1000000>;
	interrupt-parent = <&gpio0>;
	interrupts = <0 IRQ_TYPE_LEVEL_HIGH>;
	vddio-supply = <&sensors_vddio>;
	vdd-supply = <&sensors_vdd>;
	st,int-pin = <1>;
	mount-matrix = "1", "0", "0",
		       "0", "1", "0",
		       "0", "0", "1";
};

Example for an i2c device node (SA0 connected to ground):

lsm6dsvx-imu@6a {
	compatible = "st,lsm6dsv16x";
	reg = <0x6a>;
	interrupt-parent = <&gpio0>;
	interrupts = <0 IRQ_TYPE_LEVEL_HIGH>;
	vddio-supply = <&sensors_vddio>;
	vdd-supply = <&sensors_vdd>;
	st,int-pin = <1>;
	mount-matrix = "1", "0", "0",
		       "0", "1", "0",
		       "0", "0", "1";
};
```

## Documentation/devicetree/bindings/iio/stm/magnetometer/st_mag3d.txt
```
* st_mag3d driver for magnetometer MEMS sensors

Required properties for all bus drivers:
- compatible: must be one of:
              "st,lis3mdl_magn"
              "st,lsm9ds1_magn"

Required properties for the i2c bindings:
- reg: i2c slave address

Required properties for the spi bindings:
- reg:               the chipselect index
- spi-max-frequency: maximal bus speed, should be set to 1000000 unless
                     constrained by external circuitry

Optional properties for all bus drivers:
- interrupts: interrupt mapping for IRQ. It should be configured with
              flags IRQ_TYPE_LEVEL_HIGH.

              Refer to interrupt-controller/interrupts.txt for generic interrupt
              client node bindings.

Example for an spi device node:

lis3mdl-magn@0 {
	compatible = "st,lis3mdl_magn";
	reg = <0x0>;
	spi-max-frequency = <1000000>;
	interrupt-parent = <&gpio0>;
	interrupts = <0 IRQ_TYPE_LEVEL_HIGH>;
};

Example for an i2c device node:

lis3mdl-magn@0x1e {
        compatible = "st,lis3mdl_magn";
        reg = <0x1e>;
        interrupt-parent = <&gpio0>;
        interrupts = <0 IRQ_TYPE_LEVEL_HIGH>;
};
```

## Documentation/devicetree/bindings/iio/stm/magnetometer/st_mag40.txt
```
* st_mag40 driver for magnetometer MEMS sensors

Required properties for all bus drivers:
- compatible: must be one of:
              "st,lsm303ah_magn"
              "st,lsm303agr_magn"
              "st,lis2mdl_magn"
              "st,ism303dac_magn"
              "st,iis2mdc_magn"

Required properties for the i2c bindings:
- reg: i2c slave address

Required properties for the spi bindings:
- reg:               the chipselect index
- spi-max-frequency: maximal bus speed, should be set to 1000000 unless
                     constrained by external circuitry

Optional properties for all bus drivers:
- interrupts:   interrupt mapping for IRQ. It should be configured with
                flags IRQ_TYPE_LEVEL_HIGH.

                Refer to interrupt-controller/interrupts.txt for generic
                interrupt client node bindings.

- st,module_id: module identifier.
                If a sensor is supported by two different drivers (for example
                accel by this driver and magn by mag40 driver), module_id
                should be used by both drivers and should have the same id.
                This is used by user-space to identify which devices
                are part of the same module (particularly important for
                supporting multiple sensors of the same type).

Example for an spi device node:

lsm303ah-magn@0 {
	compatible = "st,lsm303ah_magn";
	reg = <0x0>;
	spi-max-frequency = <1000000>;
	interrupt-parent = <&gpio0>;
	interrupts = <0 IRQ_TYPE_LEVEL_HIGH>;
	st,module_id = <1>;
};
```

## Documentation/devicetree/bindings/iio/stm/pressure/st_ilps22qs.txt
```
* st_ilps22qs driver for pressure MEMS sensors

Required properties for all bus drivers:
- compatible: must be "st,ilps22qs"

Required properties for the i2c bindings:
- reg: i2c slave address

Required properties for the spi bindings:
- reg:               the chipselect index
- spi-max-frequency: maximal bus speed, should be set to 1000000 unless
                     constrained by external circuitry

Example for an spi device node:

ilps22qs-pressure@0 {
	compatible = "st,ilps22qs";
	reg = <0x0>;
	spi-max-frequency = <1000000>;
};

Example for an i2c device node:

ilps22qs-pressure@5c {
	compatible = "st,ilps22qs";
	reg = <0x5c>;
};
```

## Documentation/devicetree/bindings/iio/stm/pressure/st_lps22df.txt
```
* st_lps22df driver for pressure MEMS sensors

Required properties for all bus drivers:
- compatible: must be one of:
              "st,lps22df"
              "st,lps28dfw"

Required properties for the i2c bindings:
- reg: i2c slave address

Required properties for the spi bindings:
- reg:               the chipselect index
- spi-max-frequency: maximal bus speed, should be set to 1000000 unless
                     constrained by external circuitry

Optional properties for all bus drivers:
- interrupts:     interrupt mapping for IRQ. It should be configured with
                  flags IRQ_TYPE_LEVEL_HIGH, IRQ_TYPE_EDGE_RISING,
                  IRQ_TYPE_LEVEL_LOW or IRQ_TYPE_EDGE_FALLING.

                  Refer to interrupt-controller/interrupts.txt for generic
                  interrupt client node bindings.
- int-active-low: set device int pin active low (default active high)
- int-open-drain: set device int pin open in drain configuration (default
                  is push pull)

Example for an spi device node:

lps22df-pressure@0 {
	compatible = "st,lps22df";
	reg = <0x0>;
	spi-max-frequency = <1000000>;
	interrupt-parent = <&gpio0>;
	interrupts = <0 IRQ_TYPE_LEVEL_HIGH>;
};

Example for an i2c device node:

lps28dfw-pressure@5c {
	compatible = "st,lps28dfw";
	reg = <0x5c>;
	interrupt-parent = <&gpio0>;
	interrupts = <0 IRQ_TYPE_LEVEL_HIGH>;
};
```

## Documentation/devicetree/bindings/iio/stm/pressure/st_lps22hb.txt
```
* st_lps22hb driver for pressure MEMS sensors

Required properties for all bus drivers:
- compatible: must be one of:
              "st,lps22hb"
              "st,lps22hd"

Required properties for the i2c bindings:
- reg: i2c slave address

Required properties for the spi bindings:
- reg:               the chipselect index
- spi-max-frequency: maximal bus speed, should be set to 1000000 unless
                     constrained by external circuitry

Optional properties for all bus drivers:
- interrupts: interrupt mapping for IRQ. It should be configured with
              flags IRQ_TYPE_LEVEL_HIGH.

              Refer to interrupt-controller/interrupts.txt for generic interrupt
              client node bindings.

Example for an spi device node:

lps22hb-pressure@0 {
	compatible = "st,lps22hb";
	reg = <0x0>;
	spi-max-frequency = <1000000>;
	interrupt-parent = <&gpio0>;
	interrupts = <0 IRQ_TYPE_LEVEL_HIGH>;
};
```

## Documentation/devicetree/bindings/iio/stm/pressure/st_lps22hh.txt
```
* st_lps22hh driver for pressure MEMS sensors

Required properties for all bus drivers:
- compatible: must be one of:
              "st,lps22ch"
              "st,lps22hh"
              "st,lps27hhw"

Required properties for the i2c bindings:
- reg: i2c slave address

Required properties for the spi bindings:
- reg:               the chipselect index
- spi-max-frequency: maximal bus speed, should be set to 1000000 unless
                     constrained by external circuitry

Optional properties for all bus drivers:
- interrupts: interrupt mapping for IRQ. It should be configured with
              flags IRQ_TYPE_LEVEL_HIGH, IRQ_TYPE_EDGE_RISING,
              IRQ_TYPE_LEVEL_LOW or IRQ_TYPE_EDGE_FALLING.

              Refer to interrupt-controller/interrupts.txt for generic interrupt
              client node bindings.

Example for an spi device node:

lps22hh-pressure@0 {
	compatible = "st,lps22hh";
	reg = <0x0>;
	spi-max-frequency = <1000000>;
	interrupt-parent = <&gpio0>;
	interrupts = <0 IRQ_TYPE_LEVEL_HIGH>;
};
```

## Documentation/devicetree/bindings/iio/stm/pressure/st_lps33hw.txt
```
* st_lps33hw driver for pressure MEMS sensors

Required properties for all bus drivers:
- compatible: must be one of:
              "st,lps33hw"
              "st,lps35hw"

Required properties for the i2c bindings:
- reg: i2c slave address

Required properties for the spi bindings:
- reg:               the chipselect index
- spi-max-frequency: maximal bus speed, should be set to 1000000 unless
                     constrained by external circuitry

Optional properties for all bus drivers:
- interrupts: interrupt mapping for IRQ. It should be configured with
              flags IRQ_TYPE_LEVEL_HIGH.

              Refer to interrupt-controller/interrupts.txt for generic interrupt
              client node bindings.

Example for an spi device node:

lps33hw-pressure@0 {
	compatible = "st,lps33hw";
	reg = <0x0>;
	spi-max-frequency = <1000000>;
	interrupt-parent = <&gpio0>;
	interrupts = <0 IRQ_TYPE_LEVEL_HIGH>;
};
```

## Documentation/devicetree/bindings/iio/stm/temperature/stts22h.txt
```
* stts22h driver for temperature MEMS sensors

Required properties for the i2c bindings:
- compatible: must be one of:
              "st,stts22h"

Example for an i2c device node:

stts22h-temperature@38 {
	compatible = "st,stts22h";
	reg = <0x38>;
};
```
