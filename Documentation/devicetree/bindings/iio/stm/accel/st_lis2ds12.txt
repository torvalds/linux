## Documentation/devicetree/bindings/iio/stm/accel/st_lis2ds12.txt
```
* lis2ds12 driver for accel MEMS sensors

Required properties for all bus drivers:
- compatible: must be one of:
              "st,lis2ds12"
              "st,lsm303ah"
              "st,lis2dg"

Required properties for the i2c bindings:
- reg: i2c slave address

Required properties for the spi bindings:
- reg:               the chipselect index
- spi-max-frequency: maximal bus speed, should be set to 1000000 unless
                     constrained by external circuitry

Optional properties for the spi bindings:
- spi-3wire:  use sensor spi interface with 3 wires.

Optional properties for all bus drivers:
- st,drdy-int-pin: the pin on the package that will be used to signal
                   "data ready" (valid values: 1 or 2, default: 1).

- interrupts:      interrupt mapping for IRQ. It should be configured with
                   flags IRQ_TYPE_LEVEL_HIGH.

                   Refer to interrupt-controller/interrupts.txt for generic
                   interrupt client node bindings.

Example for an spi device node:

lis2ds12-accel@0 {
	compatible = "st,lis2ds12";
	reg = <0x0>;
	spi-max-frequency = <1000000>;
	interrupt-parent = <&gpio0>;
	interrupts = <0 IRQ_TYPE_LEVEL_HIGH>;
	st,drdy-int-pin = <1>;
};
```

## Documentation/devicetree/bindings/iio/stm/accel/st_lis2du12.txt
```
* lis2du12 driver for accel MEMS sensors

Required properties for all bus drivers:
- compatible: must be one of:
              "st,lis2du12"

Required properties for the i2c/i3c bindings:
- reg: i2c/i3c address of the sensor (for i3c is the static sddress)

Required properties for the spi bindings:
- reg:               the chipselect index
- spi-max-frequency: maximal bus speed, should be set to 1000000 unless
                     constrained by external circuitry

Optional properties for all bus drivers:
- st,int-pin:  the pin on the package that will be used to signal when
	       sensor data are available (valid values: 1 or 2, default: 1).

- interrupts:  interrupt mapping for IRQ. It should be configured with
               flags IRQ_TYPE_LEVEL_HIGH.

               Refer to interrupt-controller/interrupts.txt for generic
               interrupt client node bindings.

- pd_dis_int1: disable pull down on int1 pin.

- pp_od_int:   set int pin to open drain.

Example for an spi device node:

lis2du12-accel@0 {
	compatible = "st,lis2du12";
	reg = <0x0>;
	spi-max-frequency = <1000000>;
	interrupt-parent = <&gpio0>;
	interrupts = <0 IRQ_TYPE_LEVEL_HIGH>;
	st,int-pin = <1>;
};
```

## Documentation/devicetree/bindings/iio/stm/accel/st_lis2duxs12.txt
```
* lis2duxs12 driver for accel MEMS sensors

Required properties for all bus drivers:
- compatible: must be one of:
              "st,lis2dux12"
              "st,lis2duxs12"

Required properties for the i2c bindings:
- reg: i2c slave address

Required properties for the spi bindings:
- reg:               the chipselect index
- spi-max-frequency: maximal bus speed, should be set to 1000000 unless
                     constrained by external circuitry

Optional properties for all bus drivers:
- st,int-pin:  the pin on the package that will be used to signal when
	       sensor data are available (valid values: 1 or 2, default: 1).

- interrupts:  interrupt mapping for IRQ. It should be configured with
               flags IRQ_TYPE_LEVEL_HIGH.

               Refer to interrupt-controller/interrupts.txt for generic
               interrupt client node bindings.

- pd_dis_int1: disable pull down on int1 pin.
- pd_dis_int2: disable pull down on int2 pin.
- drive-open-drain: set interrupt pin in open drain (disable push-pull)

Example for an spi device node:

lis2duxs12-accel@0 {
	compatible = "st,lis2duxs12";
	reg = <0x0>;
	spi-max-frequency = <1000000>;
	interrupt-parent = <&gpio0>;
	interrupts = <0 IRQ_TYPE_LEVEL_HIGH>;
	st,int-pin = <1>;
};

Example for an i2c device node (I2C slave address 0x19):

lis2duxs12-accel@19 {
	compatible = "st,lis2duxs12";
	reg = <0x19>;
	interrupt-parent = <&gpio0>;
	interrupts = <0 IRQ_TYPE_LEVEL_HIGH>;
	st,int-pin = <1>;
};
```

## Documentation/devicetree/bindings/iio/stm/accel/st_lis2dw12.txt
```
* lis2dw12 driver for accel MEMS sensors

Required properties for all bus drivers:
- compatible: must be one of:
              "st,lis2dw12"
              "st,iis2dlpc"
              "st,ais2ih"

Required properties for the i2c bindings:
- reg: i2c slave address

Required properties for the spi bindings:
- reg:               the chipselect index
- spi-max-frequency: maximal bus speed, should be set to 1000000 unless
                     constrained by external circuitry

Optional properties for all bus drivers:
- st,drdy-int-pin: the pin on the package that will be used to signal
                   "data ready" (valid values: 1 or 2, default: 1).
                   The interrupt pin used by embedded events is hardwired to 1
                   by hardware design.

- interrupts:      interrupt mapping for IRQs. It is recommended to configure
                   them with flags IRQ_TYPE_LEVEL_HIGH. It is possible to
                   configure an interrupt array of two elements where the first
                   one is related to the accelerometer sensor data interrupt
                   while the second represents the embedded events detection
                   interrupt.

                   Refer to interrupt-controller/interrupts.txt for generic
                   interrupt client node bindings.

Example for an i2c device node (SA0 set to gnd):

lis2dw12-accel@19 {
        compatible = "st,lis2dw12";
        reg = <0x19>;
        interrupt-parent = <&gpio0>;
        interrupts = <0 IRQ_TYPE_LEVEL_HIGH>;
        st,drdy-int-pin = <1>;
};

Example for an spi device node:

lis2dw12-accel@0 {
	compatible = "st,lis2dw12";
	reg = <0x0>;
	spi-max-frequency = <1000000>;
	interrupt-parent = <&gpio0>;
	interrupts = <0 IRQ_TYPE_LEVEL_HIGH>, <2 IRQ_TYPE_LEVEL_HIGH>;
	st,drdy-int-pin = <1>;
};
```

## Documentation/devicetree/bindings/iio/stm/accel/st_lis3dhh.txt
```
* lis3dhh driver for accel MEMS sensors

Required properties for the spi bindings:
- compatible:        must be one of:
                     "st,lis3dhh"
                     "st,iis3dhhc"
- reg:               the chipselect index
- spi-max-frequency: maximal bus speed, should be set to 1000000 unless
                     constrained by external circuitry

Optional properties:
- st,drdy-int-pin: the pin on the package that will be used to signal
                   "data ready" (valid values: 1 or 2, default: 1).

- interrupts:      interrupt mapping for IRQ. It should be configured with
                   flags IRQ_TYPE_LEVEL_HIGH.

                   Refer to interrupt-controller/interrupts.txt for generic
                   interrupt client node bindings.

Example for an spi device node:

lis3dhh-accel@0 {
	compatible = "st,lis3dhh";
	reg = <0x0>;
	spi-max-frequency = <1000000>;
	interrupt-parent = <&gpio0>;
	interrupts = <0 IRQ_TYPE_LEVEL_HIGH>;
	st,drdy-int-pin = <1>;
};
```

## Documentation/devicetree/bindings/iio/stm/imu/st_asm330lhhx.txt
```
* st_asm330lhhx driver for imu MEMS sensors

Required properties for all bus drivers:
- compatible: must be one of:
              "st,asm330lhh"
              "st,asm330lhhx"

Required properties for the i2c bindings:
- reg: i2c slave address

Required properties for the spi bindings:
- reg:               the chipselect index
- spi-max-frequency: maximal bus speed, should be set to 1000000 unless
                     constrained by external circuitry

Optional properties for all bus drivers:
- vdd-supply:     an optional regulator that needs to be on to provide
                  VDD power to the sensor.

- vddio-supply:   an optional regulator that needs to be on to provide
                  the VDD IO power to the sensor.

- st,int-pin:     the pin on the package that will be used to signal
                  "data ready" (valid values: 1 or 2, default: 1).

- st,mlc-int-pin: the pin on the package that will be used to signal
                  MLC/FSM event (valid values: 1 for int pin 1, 2 for
                  int pin 2 or 3 for both int pin, default: st,int-pin).

- mount-matrix:   mount rotation matrix.

                  Refer to iio/mount-matrix.txt for details.

- interrupts:     interrupt mapping for IRQ. It should be configured
                  with flags IRQ_TYPE_LEVEL_HIGH or IRQ_TYPE_LEVEL_LOW.

                  Refer to interrupt-controller/interrupts.txt for
                  generic interrupt client node bindings.

- st,module_id:   module identifier.
                  This is used by user-space to identify which devices
                  are part of the same module (particularly important for
                  supporting multiple sensors of the same type).

- wakeup-source:  https://www.kernel.org/doc/Documentation/devicetree/bindings/power/wakeup-source.txt

Example for an spi asm330lhh device node:

asm330lhh-imu@0 {
	compatible = "st,asm330lhh";
	reg = <0x0>;
	spi-max-frequency = <1000000>;
	interrupt-parent = <&gpio0>;
	interrupts = <0 IRQ_TYPE_LEVEL_HIGH>;
	vddio-supply = <&sensors_vddio>;
	vdd-supply = <&sensors_vdd>;
	st,int-pin = <1>;
	st,mlc-int-pin = <2>;
	st,module_id = <1>;
	mount-matrix = "1", "0", "0",
		       "0", "1", "0",
		       "0", "0", "1";
};

Example for an i2c asm330lhhx device node (SA0 pulled down):

asm330lhhx-imu@0x6a {
	compatible = "st,asm330lhhx";
	reg = <0x6a>;
	interrupt-parent = <&gpio0>;
	interrupts = <0 IRQ_TYPE_LEVEL_HIGH>;
	vddio-supply = <&sensors_vddio>;
	vdd-supply = <&sensors_vdd>;
	st,int-pin = <1>;
	st,mlc-int-pin = <2>;
	mount-matrix = "1", "0", "0",
		       "0", "1", "0",
		       "0", "0", "1";
};
```

## Documentation/devicetree/bindings/iio/stm/imu/st_ism330dhcx.txt
```
* st_ism330dhcx driver for imu MEMS sensors

Required properties for all bus drivers:
- compatible: must be one of:
              "st,ism330dhcx"

Required properties for the i2c bindings:
- reg: i2c slave address

Required properties for the spi bindings:
- reg:               the chipselect index
- spi-max-frequency: maximal bus speed, should be set to 1000000 unless
                     constrained by external circuitry

Optional properties for all bus drivers:
- st,int-pin:       the pin on the package that will be used to signal
                    "data ready" (valid values: 1 or 2, default: 1).

- drive-open-drain: the interrupt/data ready line will be configured as open drain,
                    which is useful if several sensors share the same interrupt line.

- interrupts:       interrupt mapping for IRQ. It should be configured with
                    flags IRQ_TYPE_LEVEL_HIGH, IRQ_TYPE_EDGE_RISING,
                    IRQ_TYPE_LEVEL_LOW or IRQ_TYPE_EDGE_FALLING.

                    Refer to interrupt-controller/interrupts.txt for generic interrupt
                    client node bindings.

- st,module_id:     module identifier.
                    This is used by user-space to identify which devices
                    are part of the same module (particularly important for
                    supporting multiple sensors of the same type).

- wakeup-source:    https://www.kernel.org/doc/Documentation/devicetree/bindings/power/wakeup-source.txt

Example for an spi device node:

ism330dhcx-imu@0 {
	compatible = "st,ism330dhcx";
	reg = <0x0>;
	spi-max-frequency = <1000000>;
	interrupt-parent = <&gpio0>;
	interrupts = <0 IRQ_TYPE_LEVEL_HIGH>;
	st,module_id = <5>;
	st,int-pin = <1>;
};
```

## Documentation/devicetree/bindings/iio/stm/imu/st_lsm6ds3.txt
```
* st_lsm6ds3 driver for imu MEMS sensors

Required properties for all bus drivers:
- compatible: must be one of:
              "st,lsm6ds3"
              "st,lsm6ds33"

Required properties for the i2c bindings:
- reg: i2c slave address

Required properties for the spi bindings:
- reg:               the chipselect index
- spi-max-frequency: maximal bus speed, should be set to 1000000 unless
                     constrained by external circuitry

Optional properties for all bus drivers:
- interrupts: interrupt mapping for IRQ. It should be configured with
              flags IRQ_TYPE_LEVEL_HIGH.

              Refer to interrupt-controller/interrupts.txt for generic interrupt
              client node bindings.

- st,module_id: module identifier.
                This is used by user-space to identify which devices
                are part of the same module (particularly important for
                supporting multiple sensors of the same type).

Example for an spi device node:

lsm6ds3-imu@0 {
	compatible = "st,lsm6ds3";
	reg = <0x0>;
	spi-max-frequency = <1000000>;
	interrupt-parent = <&gpio0>;
	interrupts = <0 IRQ_TYPE_LEVEL_HIGH>;
	st,module_id = <5>;
};
```

## Documentation/devicetree/bindings/iio/stm/imu/st_lsm6dsm.txt
```
* st_lsm6dsm driver for imu MEMS sensors

Required properties for all bus drivers:
- compatible: must be one of:
              "st,lsm6dsm"
              "st,lsm6dsl"

Required properties for the i2c bindings:
- reg: i2c slave address

Required properties for the spi bindings:
- reg:               the chipselect index
- spi-max-frequency: maximal bus speed, should be set to 1000000 unless
                     constrained by external circuitry

Optional properties for all bus drivers:
- st,drdy-int-pin: the pin on the package that will be used to signal
                   "data ready" (valid values: 1 or 2, default: 1).

- interrupts:      interrupt mapping for IRQ. It should be configured with
                   flags IRQ_TYPE_LEVEL_HIGH.

                   Refer to interrupt-controller/interrupts.txt for generic interrupt
                   client node bindings.

- st,module_id:    module identifier.
                   This is used by user-space to identify which devices
                   are part of the same module (particularly important for
                   supporting multiple sensors of the same type).

Example for an spi device node:

lsm6dsm-imu@0 {
	compatible = "st,lsm6dsm";
	reg = <0x0>;
	spi-max-frequency = <1000000>;
	interrupt-parent = <&gpio0>;
	interrupts = <0 IRQ_TYPE_LEVEL_HIGH>;
	st,drdy-int-pin = <1>;
	st,module_id = <5>;
};
```

## Documentation/devicetree/bindings/iio/stm/imu/st_lsm6dso16is.txt
```
* st_lsm6dso16is driver for imu MEMS sensors

Required properties for all bus drivers:
- compatible: must be one of:
              "st,lsm6dso16is"

Required properties for the i2c bindings:
- reg: i2c slave address

Required properties for the spi bindings:
- reg:               the chipselect index

- spi-max-frequency: maximal bus speed, should be set to 1000000 unless
                     constrained by external circuitry.

Optional properties  for all bus drivers:
- vdd-supply:        an optional regulator that needs to be on to provide VDD
                     power to the sensor.

- vddio-supply:      an optional regulator that needs to be on to provide the
                     VDD IO power to the sensor.

- mount-matrix:      mount rotation matrix.
                     Refer to iio/mount-matrix.txt for details.

- enable-sensor-hub: enable i2c master interface. Default is disabled.

- drive-pullup-shub: enable pullup on master i2c line.

Example for an spi device node on CS0:

lsm6dso16is-imu@0 {
	compatible = "st,lsm6dso16is";
	reg = <0x0>;
	spi-max-frequency = <1000000>;
	vddio-supply = <&sensors_vddio>;
	vdd-supply = <&sensors_vdd>;
	mount-matrix = "1", "0", "0",
		       "0", "1", "0",
		       "0", "0", "1";
	drive-pullup-shub;
};

Example for an i2c device node when SA0 tied to ground:

lsm6dso16is@6a {
	compatible = "st,lsm6dso16is";
	reg = <0x6a>;
	vddio-supply = <&sensors_vddio>;
	vdd-supply = <&sensors_vdd>;
	mount-matrix = "1", "0", "0",
		       "0", "1", "0",
		       "0", "0", "1";
	drive-pullup-shub;
};
```
