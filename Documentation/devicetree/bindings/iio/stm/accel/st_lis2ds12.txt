## Documentation/devicetree/bindings/iio/temperature/max31856.txt
```
Maxim MAX31856 thermocouple support

https://datasheets.maximintegrated.com/en/ds/MAX31856.pdf

Optional property:
	- thermocouple-type: Type of thermocouple (THERMOCOUPLE_TYPE_K if
		omitted). Supported types are B, E, J, K, N, R, S, T.

Required properties:
	- compatible: must be "maxim,max31856"
	- reg: SPI chip select number for the device
	- spi-max-frequency: As per datasheet max. supported freq is 5000000
	- spi-cpha: must be defined for max31856 to enable SPI mode 1

	Refer to spi/spi-bus.txt for generic SPI slave bindings.

 Example:
	temp-sensor@0 {
		compatible = "maxim,max31856";
		reg = <0>;
		spi-max-frequency = <5000000>;
		spi-cpha;
		thermocouple-type = <THERMOCOUPLE_TYPE_K>;
	};
```

## Documentation/devicetree/bindings/iio/temperature/maxim,max31855k.yaml
```yaml
# SPDX-License-Identifier: (GPL-2.0 OR BSD-2-Clause)
%YAML 1.2
---
$id: http://devicetree.org/schemas/iio/temperature/maxim,max31855k.yaml#
$schema: http://devicetree.org/meta-schemas/core.yaml#

title: Maxim MAX31855 and similar thermocouples

maintainers:
  - Matt Ranostay <matt.ranostay@konsulko.com>

description: |
  https://datasheets.maximintegrated.com/en/ds/MAX6675.pdf
  https://datasheets.maximintegrated.com/en/ds/MAX31855.pdf

properties:
  compatible:
    description:
      The generic maxim,max31855 compatible is deprecated in favour of
      the thermocouple type specific variants.
    enum:
      - maxim,max6675
      - maxim,max31855
      - maxim,max31855k
      - maxim,max31855j
      - maxim,max31855n
      - maxim,max31855s
      - maxim,max31855t
      - maxim,max31855e
      - maxim,max31855r

  reg:
    maxItems: 1

  spi-cpha: true

required:
  - compatible
  - reg

allOf:
  - $ref: /schemas/spi/spi-peripheral-props.yaml#
  - if:
      properties:
        compatible:
          contains:
            enum:
              - maxim,max6675
    then:
      required:
        - spi-cpha
    else:
      properties:
        spi-cpha: false

unevaluatedProperties: false

examples:
  - |
    spi {
        #address-cells = <1>;
        #size-cells = <0>;

        temp-sensor@0 {
            compatible = "maxim,max31855k";
            reg = <0>;
            spi-max-frequency = <4300000>;
        };
        temp-sensor@1 {
            compatible = "maxim,max6675";
            reg = <1>;
            spi-max-frequency = <4300000>;
            spi-cpha;
        };
    };
...
```
