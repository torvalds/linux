## Documentation/devicetree/bindings/iio/accel/memsensing,msa311.yaml
```yaml
# SPDX-License-Identifier: GPL-2.0-only OR BSD-2-Clause

%YAML 1.2
---
$id: "http://devicetree.org/schemas/iio/accel/memsensing,msa311.yaml#"
$schema: "http://devicetree.org/meta-schemas/core.yaml#"

title: MEMSensing digital 3-Axis accelerometer

maintainers:
  - Dmitry Rokosov <ddrokosov@sberdevices.ru>

description: |
  MSA311 is a tri-axial, low-g accelerometer with I2C digital output for
  sensitivity consumer applications. It has dynamical user selectable full
  scales range of +-2g/+-4g/+-8g/+-16g and allows acceleration measurements
  with output data rates from 1Hz to 1000Hz.
  Datasheet can be found at following URL
  https://cdn-shop.adafruit.com/product-files/5309/MSA311-V1.1-ENG.pdf

properties:
  compatible:
    const: memsensing,msa311

  reg:
    maxItems: 1

  interrupts:
    maxItems: 1

  vdd-supply: true

required:
  - compatible
  - reg

additionalProperties: false

examples:
  - |
    #include <dt-bindings/interrupt-controller/irq.h>
    i2c {
        #address-cells = <1>;
        #size-cells = <0>;

        accelerometer@62 {
            compatible = "memsensing,msa311";
            reg = <0x62>;
            interrupt-parent = <&gpio_intc>;
            interrupts = <29 IRQ_TYPE_EDGE_RISING>;
            vdd-supply = <&vcc_5v>;
        };
    };
```

## Documentation/devicetree/bindings/iio/accel/mma8452.txt
```
Freescale MMA8451Q, MMA8452Q, MMA8453Q, MMA8652FC, MMA8653FC or FXLS8471Q
triaxial accelerometer

Required properties:

  - compatible: should contain one of
    * "fsl,mma8451"
    * "fsl,mma8452"
    * "fsl,mma8453"
    * "fsl,mma8652"
    * "fsl,mma8653"
    * "fsl,fxls8471"

  - reg: the I2C address of the chip

Optional properties:

  - interrupts: interrupt mapping for GPIO IRQ

  - interrupt-names: should contain "INT1" and/or "INT2", the accelerometer's
		     interrupt line in use.

  - vdd-supply: phandle to the regulator that provides vdd power to the accelerometer.

  - vddio-supply: phandle to the regulator that provides vddio power to the accelerometer.

Example:

	mma8453fc@1d {
		compatible = "fsl,mma8453";
		reg = <0x1d>;
		interrupt-parent = <&gpio1>;
		interrupts = <5 0>;
		interrupt-names = "INT2";
	};
```

## Documentation/devicetree/bindings/iio/accel/murata,sca3300.yaml
```yaml
# SPDX-License-Identifier: (GPL-2.0-only OR BSD-2-Clause)
%YAML 1.2
---
$id: http://devicetree.org/schemas/iio/accel/murata,sca3300.yaml#
$schema: http://devicetree.org/meta-schemas/core.yaml#

title: Murata SCA3300 Accelerometer

description: |
  3-axis industrial accelerometer with digital SPI interface
  https://www.murata.com/en-global/products/sensor/accel/sca3300

maintainers:
  - Tomas Melin <tomas.melin@vaisala.com>

properties:
  compatible:
    enum:
      - murata,sca3300
      - murata,scl3300

  reg:
    maxItems: 1

  spi-max-frequency:
    maximum: 8000000

required:
  - compatible
  - reg

additionalProperties: false

examples:
  - |
    spi {
        #address-cells = <1>;
        #size-cells = <0>;
        accelerometer@0 {
            compatible = "murata,sca3300";
            reg = <0x0>;
            spi-max-frequency = <4000000>;
        };
    };
...
```

## Documentation/devicetree/bindings/iio/accel/nxp,fxls8962af.yaml
```yaml
# SPDX-License-Identifier: (GPL-2.0-only OR BSD-2-Clause)
%YAML 1.2
---
$id: http://devicetree.org/schemas/iio/accel/nxp,fxls8962af.yaml#
$schema: http://devicetree.org/meta-schemas/core.yaml#

title: NXP FXLS8962AF/FXLS8964AF Accelerometer driver

maintainers:
  - Sean Nyekjaer <sean@geanix.com>

description: |
  NXP FXLS8962AF/FXLS8964AF Accelerometer driver that supports
  SPI and I2C interface.
    https://www.nxp.com/docs/en/data-sheet/FXLS8962AF.pdf
    https://www.nxp.com/docs/en/data-sheet/FXLS8964AF.pdf

properties:
  compatible:
    enum:
      - nxp,fxls8962af
      - nxp,fxls8964af

  reg:
    maxItems: 1

  vdd-supply:
    description: phandle to the regulator that provides power to the accelerometer

  interrupts:
    maxItems: 1

  interrupt-names:
    enum:
      - INT1
      - INT2

  drive-open-drain:
    type: boolean

required:
  - compatible
  - reg

allOf:
  - $ref: /schemas/spi/spi-peripheral-props.yaml#

unevaluatedProperties: false

examples:
  - |
    #include <dt-bindings/interrupt-controller/irq.h>
    i2c0 {
        #address-cells = <1>;
        #size-cells = <0>;

        /* Example for a I2C device node */
        accelerometer@62 {
            compatible = "nxp,fxls8962af";
            reg = <0x62>;
            interrupt-parent = <&gpio0>;
            interrupts = <0 IRQ_TYPE_LEVEL_HIGH>;
            interrupt-names = "INT1";
        };
    };
  - |
    #include <dt-bindings/interrupt-controller/irq.h>
    spi0 {
        #address-cells = <1>;
        #size-cells = <0>;

        /* Example for a SPI device node */
        accelerometer@0 {
            compatible = "nxp,fxls8962af";
            reg = <0>;
            spi-max-frequency = <4000000>;
            interrupt-parent = <&gpio0>;
            interrupts = <0 IRQ_TYPE_LEVEL_HIGH>;
            interrupt-names = "INT1";
        };
    };
```

## Documentation/devicetree/bindings/iio/adc/ad7949.txt
```
* Analog Devices AD7949/AD7682/AD7689

Required properties:
 - compatible: Should be one of
	* "adi,ad7949"
	* "adi,ad7682"
	* "adi,ad7689"
 - reg: spi chip select number for the device
 - vref-supply: The regulator supply for ADC reference voltage

Example:
adc@0 {
	compatible = "adi,ad7949";
	reg = <0>;
	vref-supply = <&vdd_supply>;
};
```

## Documentation/devicetree/bindings/iio/adc/adc.txt
```
Common ADCs properties

Optional properties for child nodes:
- bipolar : Boolean, if set the channel is used in bipolar mode.
- diff-channels : Differential channels muxed for this ADC. The first value
		specifies the positive input pin, the second value the negative
		input pin.
- reg: The channel number.
- label: Unique name to identify which channel this is.

Example:
	adc@0 {
		compatible = "some,adc";
		...
		channel@0 {
			reg = <0>;
			label = "channel_0_name";
			bipolar;
			diff-channels = <0 1>;
			...
		};

		channel@1 {
			reg = <1>;
			label = "channel_1_name";
			diff-channels = <2 3>;
			...
		};
	};
```

## Documentation/devicetree/bindings/iio/adc/adc.yaml
```yaml
# SPDX-License-Identifier: GPL-2.0
%YAML 1.2
---
$id: http://devicetree.org/schemas/iio/adc/adc.yaml#
$schema: http://devicetree.org/meta-schemas/core.yaml#

title: IIO Common Properties for ADC Channels

maintainers:
  - Jonathan Cameron <jic23@kernel.org>

description:
  A few properties are defined in a common way ADC channels.

properties:
  $nodename:
    pattern: "^channel(@[0-9a-f]+)?$"
    description:
      A channel index should match reg.

  reg:
    maxItems: 1

  label:
    description: Unique name to identify which channel this is.

  bipolar:
    $ref: /schemas/types.yaml#/definitions/flag
    description: If provided, the channel is to be used in bipolar mode.

  diff-channels:
    $ref: /schemas/types.yaml#/definitions/uint32-array
    maxItems: 2
    minItems: 2
    description:
      Many ADCs have dual Muxes to allow different input pins to be routed
      to both the positive and negative inputs of a differential ADC.
      The first value specifies the positive input pin, the second
      specifies the negative input pin.
      There are also some ADCs, where the differential channel has dedicated
      positive and negative inputs which can be used to measure differential
      voltage levels. For those setups, this property can be configured with
      the 'reg' property for both inputs (i.e. diff-channels = <reg reg>).

  single-channel:
    $ref: /schemas/types.yaml#/definitions/uint32
    description:
      When devices combine single-ended and differential channels, allow the
      channel for a single element to be specified, independent of reg (as for
      differential channels). If this and diff-channels are not present reg
      shall be used instead.

  common-mode-channel:
    $ref: /schemas/types.yaml#/definitions/uint32
    description:
      Some ADCs have differential input pins that can be used to measure
      single-ended or pseudo-differential inputs. This property can be used
      in addition to single-channel to signal software that this channel is
      not differential but still specify two inputs.

      The input pair is specified by setting single-channel to the positive
      input pin and common-mode-channel to the negative pin.

  settling-time-us:
    description:
      Time between enabling the channel and first stable readings.

  oversampling-ratio:
    $ref: /schemas/types.yaml#/definitions/uint32
    description:
      Oversampling is used as replacement of or addition to the low-pass filter.
      In some cases, the desired filtering characteristics are a function the
      device design and can interact with other characteristics such as
      settling time.

anyOf:
  - oneOf:
      - required:
          - reg
          - diff-channels
      - required:
          - reg
          - single-channel
  - required:
      - reg

additionalProperties: true
```
