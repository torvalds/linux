## Documentation/devicetree/bindings/iio/adc/adi,ad4000.yaml
```yaml
# SPDX-License-Identifier: (GPL-2.0-only OR BSD-2-Clause)
%YAML 1.2
---
$id: http://devicetree.org/schemas/iio/adc/adi,ad4000.yaml#
$schema: http://devicetree.org/meta-schemas/core.yaml#

title: Analog Devices AD4000 and similar Analog to Digital Converters

maintainers:
  - Marcelo Schmitt <marcelo.schmitt@analog.com>

description: |
  Analog Devices AD4000 family of Analog to Digital Converters with SPI support.
  Specifications can be found at:
    https://www.analog.com/media/en/technical-documentation/data-sheets/ad4000-4004-4008.pdf
    https://www.analog.com/media/en/technical-documentation/data-sheets/ad4001-4005.pdf
    https://www.analog.com/media/en/technical-documentation/data-sheets/ad4002-4006-4010.pdf
    https://www.analog.com/media/en/technical-documentation/data-sheets/ad4003-4007-4011.pdf
    https://www.analog.com/media/en/technical-documentation/data-sheets/ad4020-4021-4022.pdf
    https://www.analog.com/media/en/technical-documentation/data-sheets/adaq4001.pdf
    https://www.analog.com/media/en/technical-documentation/data-sheets/adaq4003.pdf
    https://www.analog.com/media/en/technical-documentation/data-sheets/ad7685.pdf
    https://www.analog.com/media/en/technical-documentation/data-sheets/ad7686.pdf
    https://www.analog.com/media/en/technical-documentation/data-sheets/ad7687.pdf
    https://www.analog.com/media/en/technical-documentation/data-sheets/ad7688.pdf
    https://www.analog.com/media/en/technical-documentation/data-sheets/ad7690.pdf
    https://www.analog.com/media/en/technical-documentation/data-sheets/ad7691.pdf
    https://www.analog.com/media/en/technical-documentation/data-sheets/ad7693.pdf
    https://www.analog.com/media/en/technical-documentation/data-sheets/ad7942.pdf
    https://www.analog.com/media/en/technical-documentation/data-sheets/ad7946.pdf
    https://www.analog.com/media/en/technical-documentation/data-sheets/ad7980.pdf
    https://www.analog.com/media/en/technical-documentation/data-sheets/ad7982.pdf
    https://www.analog.com/media/en/technical-documentation/data-sheets/ad7983.pdf
    https://www.analog.com/media/en/technical-documentation/data-sheets/ad7984.pdf
    https://www.analog.com/media/en/technical-documentation/data-sheets/ad7988-1_7988-5.pdf

$ref: /schemas/spi/spi-peripheral-props.yaml#

properties:
  compatible:
    oneOf:
      - enum:
          - adi,ad4000
          - adi,ad4001
          - adi,ad4002
          - adi,ad4003
          - adi,ad4020
          - adi,adaq4001
          - adi,adaq4003
          - adi,ad7687
          - adi,ad7691
          - adi,ad7942
          - adi,ad7946
          - adi,ad7983
      - items:
          - enum:
              - adi,ad4004
              - adi,ad4008
          - const: adi,ad4000
      - items:
          - enum:
              - adi,ad4005
          - const: adi,ad4001
      - items:
          - enum:
              - adi,ad4006
              - adi,ad4010
          - const: adi,ad4002
      - items:
          - enum:
              - adi,ad4007
              - adi,ad4011
          - const: adi,ad4003
      - items:
          - enum:
              - adi,ad4021
              - adi,ad4022
          - const: adi,ad4020
      - items:
          - enum:
              - adi,ad7685
              - adi,ad7686
              - adi,ad7980
              - adi,ad7988-1
              - adi,ad7988-5
          - const: adi,ad7983
      - items:
          - enum:
              - adi,ad7688
              - adi,ad7693
          - const: adi,ad7687
      - items:
          - enum:
              - adi,ad7690
              - adi,ad7982
              - adi,ad7984
          - const: adi,ad7691

  reg:
    maxItems: 1

  spi-max-frequency:
    maximum: 102040816 # for VIO > 2.7 V, 81300813 for VIO > 1.7 V

  adi,sdi-pin:
    $ref: /schemas/types.yaml#/definitions/string
    enum: [ high, low, cs, sdi ]
    default: sdi
    description:
      Describes how the ADC SDI pin is wired. A value of "sdi" indicates that
      the ADC SDI is connected to host SDO. "high" indicates that the ADC SDI
      pin is hard-wired to logic high (VIO). "low" indicates that it is
      hard-wired low (GND). "cs" indicates that the ADC SDI pin is connected to
      the host CS line.

  '#daisy-chained-devices': true

  vdd-supply:
    description: A 1.8V supply that powers the chip (VDD).

  vio-supply:
    description:
      A 1.8V to 5.5V supply for the digital inputs and outputs (VIO).

  ref-supply:
    description:
      A 2.5 to 5V supply for the external reference voltage (REF).

  cnv-gpios:
    description:
      When provided, this property indicates the GPIO that is connected to the
      CNV pin.
    maxItems: 1

  adi,high-z-input:
    type: boolean
    description:
      High-Z mode allows the amplifier and RC filter in front of the ADC to be
      chosen based on the signal bandwidth of interest, rather than the settling
      requirements of the switched capacitor SAR ADC inputs.

  adi,gain-milli:
    description: |
      The hardware gain applied to the ADC input (in milli units).
      The gain provided by the ADC input scaler is defined by the hardware
      connections between chip pins OUT+, R1K-, R1K1-, R1K+, R1K1+, and OUT-.
      If not present, default to 1000 (no actual gain applied).
    $ref: /schemas/types.yaml#/definitions/uint16
    enum: [454, 909, 1000, 1900]
    default: 1000

  interrupts:
    description:
      The SDO pin can also function as a busy indicator. This node should be
      connected to an interrupt that is triggered when the SDO line goes low
      while the SDI line is high and the CNV line is low ("3-wire" mode) or the
      SDI line is low and the CNV line is high ("4-wire" mode); or when the SDO
      line goes high while the SDI and CNV lines are high (chain mode),
    maxItems: 1

required:
  - compatible
  - reg
  - vdd-supply
  - vio-supply
  - ref-supply

allOf:
  # Single-channel PulSAR devices have SDI either tied to VIO, GND, or host CS.
  - if:
      properties:
        compatible:
          contains:
            enum:
              - adi,ad7687
              - adi,ad7691
              - adi,ad7942
              - adi,ad7946
              - adi,ad7983
    then:
      properties:
        adi,sdi-pin:
          enum: [ high, low, cs ]
          default: cs
  # The configuration register can only be accessed if SDI is connected to MOSI
  - if:
      required:
        - adi,sdi-pin
    then:
      properties:
        adi,high-z-input: false
  # chain mode has lower SCLK max rate
  - if:
      required:
        - '#daisy-chained-devices'
    then:
      properties:
        spi-max-frequency:
          maximum: 50000000 # for VIO > 2.7 V, 40000000 for VIO > 1.7 V
  # Gain property only applies to ADAQ devices
  - if:
      properties:
        compatible:
          not:
            contains:
              enum:
                - adi,adaq4001
                - adi,adaq4003
    then:
      properties:
        adi,gain-milli: false

unevaluatedProperties: false

examples:
  - |
    #include <dt-bindings/gpio/gpio.h>
    spi {
        #address-cells = <1>;
        #size-cells = <0>;
        adc@0 {
            compatible = "adi,ad4020";
            reg = <0>;
            spi-max-frequency = <71000000>;
            vdd-supply = <&supply_1_8V>;
            vio-supply = <&supply_1_8V>;
            ref-supply = <&supply_5V>;
            adi,sdi-pin = "cs";
            cnv-gpios = <&gpio0 88 GPIO_ACTIVE_HIGH>;
        };
    };
  - |
    spi {
        #address-cells = <1>;
        #size-cells = <0>;
        adc@0 {
            compatible = "adi,adaq4003";
            reg = <0>;
            spi-max-frequency = <80000000>;
            vdd-supply = <&supply_1_8V>;
            vio-supply = <&supply_1_8V>;
            ref-supply = <&supply_5V>;
            adi,high-z-input;
            adi,gain-milli = /bits/ 16 <454>;
        };
    };
```

## Documentation/devicetree/bindings/iio/adc/adi,ad4030.yaml
```yaml
# SPDX-License-Identifier: (GPL-2.0-only OR BSD-2-Clause)
# Copyright 2024 Analog Devices Inc.
# Copyright 2024 BayLibre, SAS.
%YAML 1.2
---
$id: http://devicetree.org/schemas/iio/adc/adi,ad4030.yaml#
$schema: http://devicetree.org/meta-schemas/core.yaml#

title: Analog Devices AD4030 and AD4630 ADC families

maintainers:
  - Michael Hennerich <michael.hennerich@analog.com>
  - Nuno Sa <nuno.sa@analog.com>

description: |
  Analog Devices AD4030 single channel and AD4630/AD4632 dual channel precision
  SAR ADC families

  * https://www.analog.com/media/en/technical-documentation/data-sheets/ad4030-24-4032-24.pdf
  * https://www.analog.com/media/en/technical-documentation/data-sheets/ad4630-24_ad4632-24.pdf
  * https://www.analog.com/media/en/technical-documentation/data-sheets/ad4630-16-4632-16.pdf

properties:
  compatible:
    enum:
      - adi,ad4030-24
      - adi,ad4032-24
      - adi,ad4630-16
      - adi,ad4630-24
      - adi,ad4632-16
      - adi,ad4632-24

  reg:
    maxItems: 1

  spi-max-frequency:
    maximum: 102040816

  spi-rx-bus-width:
    enum: [1, 2, 4]

  vdd-5v-supply: true
  vdd-1v8-supply: true
  vio-supply: true

  ref-supply:
    description:
      Optional External unbuffered reference. Used when refin-supply is not
      connected.

  refin-supply:
    description:
      Internal buffered Reference. Used when ref-supply is not connected.

  cnv-gpios:
    description:
      The Convert Input (CNV). It initiates the sampling conversions.
    maxItems: 1

  reset-gpios:
    description:
      The Reset Input (/RST). Used for asynchronous device reset.
    maxItems: 1

  interrupts:
    description:
      The BUSY pin is used to signal that the conversions results are available
      to be transferred when in SPI Clocking Mode. This nodes should be
      connected to an interrupt that is triggered when the BUSY line goes low.
    maxItems: 1

  interrupt-names:
    const: busy

required:
  - compatible
  - reg
  - vdd-5v-supply
  - vdd-1v8-supply
  - vio-supply
  - cnv-gpios

oneOf:
  - required:
      - ref-supply
  - required:
      - refin-supply

unevaluatedProperties: false

examples:
  - |
    #include <dt-bindings/gpio/gpio.h>

    spi {
        #address-cells = <1>;
        #size-cells = <0>;

        adc@0 {
            compatible = "adi,ad4030-24";
            reg = <0>;
            spi-max-frequency = <80000000>;
            vdd-5v-supply = <&supply_5V>;
            vdd-1v8-supply = <&supply_1_8V>;
            vio-supply = <&supply_1_8V>;
            ref-supply = <&supply_5V>;
            cnv-gpios = <&gpio0 0 GPIO_ACTIVE_HIGH>;
            reset-gpios = <&gpio0 1 GPIO_ACTIVE_LOW>;
        };
    };
```

## Documentation/devicetree/bindings/iio/adc/adi,ad4062.yaml
```yaml
# SPDX-License-Identifier: (GPL-2.0-only OR BSD-2-Clause)
# Copyright 2025 Analog Devices Inc.
%YAML 1.2
---
$id: http://devicetree.org/schemas/iio/adc/adi,ad4062.yaml#
$schema: http://devicetree.org/meta-schemas/core.yaml#

title: Analog Devices AD4062 ADC family device driver

maintainers:
  - Jorge Marques <jorge.marques@analog.com>

description: |
  Analog Devices AD4062 Single Channel Precision SAR ADC family

  https://www.analog.com/media/en/technical-documentation/data-sheets/ad4060.pdf
  https://www.analog.com/media/en/technical-documentation/data-sheets/ad4062.pdf

properties:
  compatible:
    enum:
      - adi,ad4060
      - adi,ad4062

  reg:
    maxItems: 1

  interrupts:
    description:
      Two pins are available that can be configured as either a general purpose
      digital output, device enable signal (used to synchronise other parts of
      the signal chain with ADC sampling), device ready (GP1 only) or various
      interrupt signals. If intended for use as a GPIO or device enable, will not
      present here.
    minItems: 1
    items:
      - description:
          GP0 pin, cannot be configured as DEV_RDY.
      - description:
          GP1 pin, can be configured to any setting.

  interrupt-names:
    minItems: 1
    items:
      - const: gp0
      - const: gp1

  gpio-controller:
    description:
      Marks the device node as a GPIO controller. GPs not listed as interrupts
      are exposed as a GPO.

  '#gpio-cells':
    const: 2
    description:
      The first cell is the GPIO number and the second cell specifies
      GPIO flags, as defined in <dt-bindings/gpio/gpio.h>.

  vdd-supply:
    description: Analog power supply.

  vio-supply:
    description: Digital interface logic power supply.

  ref-supply:
    description:
      Reference voltage to set the ADC full-scale range. If not present,
      vdd-supply is used as the reference voltage.

required:
  - compatible
  - reg
  - vdd-supply
  - vio-supply

allOf:
  - $ref: /schemas/i3c/i3c.yaml#

unevaluatedProperties: false

examples:
  - |
    #include <dt-bindings/gpio/gpio.h>
    #include <dt-bindings/interrupt-controller/irq.h>

    i3c {
        #address-cells = <3>;
        #size-cells = <0>;

        adc@0,2ee007c0000 {
            reg = <0x0 0x2ee 0x7c0000>;
            vdd-supply = <&vdd>;
            vio-supply = <&vio>;
            ref-supply = <&ref>;

            interrupt-parent = <&gpio>;
            interrupts = <0 0 IRQ_TYPE_EDGE_RISING>,
                         <0 1 IRQ_TYPE_EDGE_FALLING>;
            interrupt-names = "gp0", "gp1";
        };
    };

  - |
    #include <dt-bindings/gpio/gpio.h>
    #include <dt-bindings/interrupt-controller/irq.h>

    i3c {
        #address-cells = <3>;
        #size-cells = <0>;

        adc@0,2ee007c0000 {
            reg = <0x0 0x2ee 0x7c0000>;
            vdd-supply = <&vdd>;
            vio-supply = <&vio>;
            ref-supply = <&ref>;

            gpio-controller;
            #gpio-cells = <2>;
        };
    };
```
