## Documentation/devicetree/bindings/iio/adc/adi,ad7091r5.yaml
```yaml
# SPDX-License-Identifier: (GPL-2.0-only OR BSD-2-Clause)
%YAML 1.2
---
$id: http://devicetree.org/schemas/iio/adc/adi,ad7091r5.yaml#
$schema: http://devicetree.org/meta-schemas/core.yaml#

title: Analog Devices AD7091R-2/-4/-5/-8 Multi-Channel 12-Bit ADCs

maintainers:
  - Michael Hennerich <michael.hennerich@analog.com>
  - Marcelo Schmitt <marcelo.schmitt@analog.com>

description: |
  Analog Devices AD7091R5 4-Channel 12-Bit ADC supporting I2C interface
  https://www.analog.com/media/en/technical-documentation/data-sheets/ad7091r-5.pdf
  Analog Devices AD7091R-2/AD7091R-4/AD7091R-8 2-/4-/8-Channel 12-Bit ADCs
  supporting SPI interface
  https://www.analog.com/media/en/technical-documentation/data-sheets/AD7091R-2_7091R-4_7091R-8.pdf

properties:
  compatible:
    enum:
      - adi,ad7091r2
      - adi,ad7091r4
      - adi,ad7091r5
      - adi,ad7091r8

  reg:
    maxItems: 1

  vdd-supply:
    description:
      Provide VDD power to the sensor (VDD range is from 2.7V to 5.25V).

  vdrive-supply:
    description:
      Determines the voltage level at which the interface logic will operate.
      The V_drive voltage range is from 1.8V to 5.25V and must not exceed VDD by
      more than 0.3V.

  vref-supply:
    description:
      Phandle to the vref power supply

  convst-gpios:
    description:
      GPIO connected to the CONVST pin.
      This logic input is used to initiate conversions on the analog
      input channels.
    maxItems: 1

  reset-gpios:
    maxItems: 1

  interrupts:
    description:
      Interrupt for signaling when conversion results exceed the high limit for
      ADC readings or fall below the low limit for them. Interrupt source must
      be attached to ALERT/BUSY/GPO0 pin.
    maxItems: 1

required:
  - compatible
  - reg

allOf:
  - $ref: /schemas/spi/spi-peripheral-props.yaml#

  # AD7091R-2 does not have ALERT/BUSY/GPO pin
  - if:
      properties:
        compatible:
          contains:
            enum:
              - adi,ad7091r2
    then:
      properties:
        interrupts: false

  - if:
      properties:
        compatible:
          contains:
            enum:
              - adi,ad7091r2
              - adi,ad7091r4
              - adi,ad7091r8
    then:
      required:
        - convst-gpios

unevaluatedProperties: false

examples:
  - |
    #include <dt-bindings/gpio/gpio.h>
    #include <dt-bindings/interrupt-controller/irq.h>
    i2c {
        #address-cells = <1>;
        #size-cells = <0>;

        adc@2f {
            compatible = "adi,ad7091r5";
            reg = <0x2f>;

            interrupts = <25 IRQ_TYPE_EDGE_FALLING>;
            interrupt-parent = <&gpio>;
        };
    };
  - |
    #include <dt-bindings/gpio/gpio.h>
    #include <dt-bindings/interrupt-controller/irq.h>
    spi {
        #address-cells = <1>;
        #size-cells = <0>;

        adc@0 {
            compatible = "adi,ad7091r8";
            reg = <0x0>;
            spi-max-frequency = <1000000>;
            vref-supply = <&adc_vref>;
            convst-gpios = <&gpio 25 GPIO_ACTIVE_LOW>;
            reset-gpios = <&gpio 27 GPIO_ACTIVE_LOW>;
            interrupts = <22 IRQ_TYPE_EDGE_FALLING>;
            interrupt-parent = <&gpio>;
        };
    };
...
```

## Documentation/devicetree/bindings/iio/adc/adi,ad7124.txt
```
Analog Devices AD7124 ADC device driver

Required properties for the AD7124:
	- compatible: Must be one of "adi,ad7124-4" or "adi,ad7124-8"
	- reg: SPI chip select number for the device
	- spi-max-frequency: Max SPI frequency to use
		see: Documentation/devicetree/bindings/spi/spi-bus.txt
	- clocks: phandle to the master clock (mclk)
		see: Documentation/devicetree/bindings/clock/clock-bindings.txt
	- clock-names: Must be "mclk".
	- interrupts: IRQ line for the ADC
		see: Documentation/devicetree/bindings/interrupt-controller/interrupts.txt

	  Required properties:
		* #address-cells: Must be 1.
		* #size-cells: Must be 0.

	  Subnode(s) represent the external channels which are connected to the ADC.
	  Each subnode represents one channel and has the following properties:
		Required properties:
			* reg: The channel number. It can have up to 4 channels on ad7124-4
			  and 8 channels on ad7124-8, numbered from 0 to 15.
			* diff-channels: see: Documentation/devicetree/bindings/iio/adc/adc.txt

		Optional properties:
			* bipolar: see: Documentation/devicetree/bindings/iio/adc/adc.txt
			* adi,reference-select: Select the reference source to use when
			  converting on the the specific channel. Valid values are:
			  0: REFIN1(+)/REFIN1(−).
			  1: REFIN2(+)/REFIN2(−).
			  3: AVDD
			  If this field is left empty, internal reference is selected.

Optional properties:
	- refin1-supply: refin1 supply can be used as reference for conversion.
	- refin2-supply: refin2 supply can be used as reference for conversion.
	- avdd-supply: avdd supply can be used as reference for conversion.

Example:
	adc@0 {
		compatible = "adi,ad7124-4";
		reg = <0>;
		spi-max-frequency = <5000000>;
		interrupts = <25 2>;
		interrupt-parent = <&gpio>;
		refin1-supply = <&adc_vref>;
		clocks = <&ad7124_mclk>;
		clock-names = "mclk";

		#address-cells = <1>;
		#size-cells = <0>;

		channel@0 {
			reg = <0>;
			diff-channels = <0 1>;
			adi,reference-select = <0>;
		};

		channel@1 {
			reg = <1>;
			bipolar;
			diff-channels = <2 3>;
			adi,reference-select = <0>;
		};

		channel@2 {
			reg = <2>;
			diff-channels = <4 5>;
		};

		channel@3 {
			reg = <3>;
			diff-channels = <6 7>;
		};
	};
```

## Documentation/devicetree/bindings/iio/adc/adi,ad7124.yaml
```yaml
# SPDX-License-Identifier: (GPL-2.0 OR BSD-2-Clause)
# Copyright 2019 Analog Devices Inc.
%YAML 1.2
---
$id: http://devicetree.org/schemas/iio/adc/adi,ad7124.yaml#
$schema: http://devicetree.org/meta-schemas/core.yaml#

title: Analog Devices AD7124 ADC device driver

maintainers:
  - Marcelo Schmitt <marcelo.schmitt@analog.com>
  - Nuno Sá <nuno.sa@analog.com>

description: |
  Bindings for the Analog Devices AD7124 ADC device. Datasheet can be
  found here:
    https://www.analog.com/media/en/technical-documentation/data-sheets/AD7124-8.pdf

properties:
  compatible:
    enum:
      - adi,ad7124-4
      - adi,ad7124-8

  reg:
    description: SPI chip select number for the device
    maxItems: 1

  clocks:
    maxItems: 1
    description: Optional external clock connected to the CLK pin.

  clock-names:
    deprecated: true
    description:
      MCLK is an internal counter in the ADC. Do not use this property.
    items:
      - const: mclk

  '#clock-cells':
    description:
      The CLK pin can be used as an output. When that is the case, include
      this property.
    const: 0

  interrupts:
    description: IRQ line for the ADC
    maxItems: 1

  rdy-gpios:
    description:
      GPIO reading the R̅D̅Y̅ line. Having such a GPIO is technically optional but
      highly recommended because DOUT/R̅D̅Y̅ toggles during SPI transfers (in its
      DOUT aka MISO role) and so usually triggers a spurious interrupt. The
      distinction between such a spurious event and a real one can only be done
      by reading such a GPIO. (There is a register telling the same
      information, but accessing that one needs a SPI transfer which then
      triggers another interrupt event.)
    maxItems: 1

  '#address-cells':
    const: 1

  '#size-cells':
    const: 0

  refin1-supply:
    description: refin1 supply can be used as reference for conversion.

  refin2-supply:
    description: refin2 supply can be used as reference for conversion.

  avdd-supply:
    description: avdd supply can be used as reference for conversion.

required:
  - compatible
  - reg
  - interrupts

# Can't have both clock input and output at the same time.
not:
  required:
    - '#clock-cells'
    - clocks

patternProperties:
  "^channel@([0-9]|1[0-5])$":
    $ref: adc.yaml
    type: object
    description: |
      Represents the external channels which are connected to the ADC.

    properties:
      reg:
        description: |
          The channel number. It can have up to 8 channels on ad7124-4
          and 16 channels on ad7124-8, numbered from 0 to 15.
        items:
          minimum: 0
          maximum: 15

      adi,reference-select:
        description: |
          Select the reference source to use when converting on
          the specific channel. Valid values are:
          0: REFIN1(+)/REFIN1(−).
          1: REFIN2(+)/REFIN2(−).
          3: AVDD
          If this field is left empty, internal reference is selected.
        $ref: /schemas/types.yaml#/definitions/uint32
        enum: [0, 1, 3]

      diff-channels: true

      bipolar: true

      adi,buffered-positive:
        description: Enable buffered mode for positive input.
        type: boolean

      adi,buffered-negative:
        description: Enable buffered mode for negative input.
        type: boolean

    required:
      - reg
      - diff-channels

    additionalProperties: false

allOf:
  - $ref: /schemas/spi/spi-peripheral-props.yaml#

unevaluatedProperties: false

examples:
  - |
    #include <dt-bindings/gpio/gpio.h>
    spi {
      #address-cells = <1>;
      #size-cells = <0>;

      adc@0 {
        compatible = "adi,ad7124-4";
        reg = <0>;
        spi-max-frequency = <5000000>;
        interrupts = <25 2>;
        interrupt-parent = <&gpio>;
        rdy-gpios = <&gpio 25 GPIO_ACTIVE_LOW>;
        refin1-supply = <&adc_vref>;

        #address-cells = <1>;
        #size-cells = <0>;

        channel@0 {
          reg = <0>;
          diff-channels = <0 1>;
          adi,reference-select = <0>;
          adi,buffered-positive;
        };

        channel@1 {
          reg = <1>;
          bipolar;
          diff-channels = <2 3>;
          adi,reference-select = <0>;
          adi,buffered-positive;
          adi,buffered-negative;
        };

        channel@2 {
          reg = <2>;
          diff-channels = <4 5>;
        };

        channel@3 {
          reg = <3>;
          diff-channels = <6 7>;
        };
      };
    };
```
