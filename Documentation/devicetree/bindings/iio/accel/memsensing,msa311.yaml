## Documentation/devicetree/bindings/iio/adc/adi,ad7191.yaml
```yaml
# SPDX-License-Identifier: (GPL-2.0 OR BSD-2-Clause)
# Copyright 2025 Analog Devices Inc.
%YAML 1.2
---
$id: http://devicetree.org/schemas/iio/adc/adi,ad7191.yaml#
$schema: http://devicetree.org/meta-schemas/core.yaml#

title: Analog Devices AD7191 ADC

maintainers:
  - Alisa-Dariana Roman <alisa.roman@analog.com>

description: |
  Bindings for the Analog Devices AD7191 ADC device. Datasheet can be
  found here:
  https://www.analog.com/media/en/technical-documentation/data-sheets/AD7191.pdf
  The device's PDOWN pin must be connected to the SPI controller's chip select
  pin.

properties:
  compatible:
    enum:
      - adi,ad7191

  reg:
    maxItems: 1

  spi-cpol: true

  spi-cpha: true

  clocks:
    maxItems: 1
    description:
      Must be present when CLKSEL pin is tied HIGH to select external clock
      source (either a crystal between MCLK1 and MCLK2 pins, or a
      CMOS-compatible clock driving MCLK2 pin). Must be absent when CLKSEL pin
      is tied LOW to use the internal 4.92MHz clock.

  interrupts:
    maxItems: 1

  avdd-supply:
    description: AVdd voltage supply

  dvdd-supply:
    description: DVdd voltage supply

  vref-supply:
    description: Vref voltage supply

  odr-gpios:
    description:
      ODR1 and ODR2 pins for output data rate selection. Should be defined if
      adi,odr-value is absent.
    minItems: 2
    maxItems: 2

  adi,odr-value:
    $ref: /schemas/types.yaml#/definitions/uint32
    description: |
      Should be present if ODR pins are pin-strapped. Possible values:
      120 Hz (ODR1=0, ODR2=0)
      60 Hz (ODR1=0, ODR2=1)
      50 Hz (ODR1=1, ODR2=0)
      10 Hz (ODR1=1, ODR2=1)
      If defined, odr-gpios must be absent.
    enum: [120, 60, 50, 10]

  pga-gpios:
    description:
      PGA1 and PGA2 pins for gain selection. Should be defined if adi,pga-value
      is absent.
    minItems: 2
    maxItems: 2

  adi,pga-value:
    $ref: /schemas/types.yaml#/definitions/uint32
    description: |
      Should be present if PGA pins are pin-strapped. Possible values:
      Gain 1 (PGA1=0, PGA2=0)
      Gain 8 (PGA1=0, PGA2=1)
      Gain 64 (PGA1=1, PGA2=0)
      Gain 128 (PGA1=1, PGA2=1)
      If defined, pga-gpios must be absent.
    enum: [1, 8, 64, 128]

  temp-gpios:
    description: TEMP pin for temperature sensor enable.
    maxItems: 1

  chan-gpios:
    description: CHAN pin for input channel selection.
    maxItems: 1

required:
  - compatible
  - reg
  - interrupts
  - avdd-supply
  - dvdd-supply
  - vref-supply
  - spi-cpol
  - spi-cpha
  - temp-gpios
  - chan-gpios

allOf:
  - $ref: /schemas/spi/spi-peripheral-props.yaml#
  - oneOf:
      - required:
          - adi,odr-value
      - required:
          - odr-gpios
  - oneOf:
      - required:
          - adi,pga-value
      - required:
          - pga-gpios

unevaluatedProperties: false

examples:
  - |
    #include <dt-bindings/gpio/gpio.h>
    #include <dt-bindings/interrupt-controller/irq.h>

    spi {
        #address-cells = <1>;
        #size-cells = <0>;

        adc@0 {
            compatible = "adi,ad7191";
            reg = <0>;
            spi-max-frequency = <1000000>;
            spi-cpol;
            spi-cpha;
            clocks = <&ad7191_mclk>;
            interrupts = <25 IRQ_TYPE_EDGE_FALLING>;
            interrupt-parent = <&gpio>;
            avdd-supply = <&avdd>;
            dvdd-supply = <&dvdd>;
            vref-supply = <&vref>;
            adi,pga-value = <1>;
            odr-gpios = <&gpio 23 GPIO_ACTIVE_HIGH>, <&gpio 24 GPIO_ACTIVE_HIGH>;
            temp-gpios = <&gpio 22 GPIO_ACTIVE_HIGH>;
            chan-gpios = <&gpio 27 GPIO_ACTIVE_HIGH>;
        };
    };
```

## Documentation/devicetree/bindings/iio/adc/adi,ad7192.yaml
```yaml
# SPDX-License-Identifier: (GPL-2.0 OR BSD-2-Clause)
# Copyright 2019 Analog Devices Inc.
%YAML 1.2
---
$id: http://devicetree.org/schemas/iio/adc/adi,ad7192.yaml#
$schema: http://devicetree.org/meta-schemas/core.yaml#

title: Analog Devices AD7192 ADC device driver

maintainers:
  - Michael Hennerich <michael.hennerich@analog.com>

description: |
  Bindings for the Analog Devices AD7192 ADC device. Datasheet can be
  found here:
  https://www.analog.com/media/en/technical-documentation/data-sheets/AD7192.pdf

properties:
  compatible:
    enum:
      - adi,ad7190
      - adi,ad7192
      - adi,ad7193
      - adi,ad7194
      - adi,ad7195

  "#address-cells":
    const: 1

  "#size-cells":
    const: 0

  reg:
    maxItems: 1

  spi-cpol: true

  spi-cpha: true

  clocks:
    maxItems: 1
    description:
      Optionally, either a crystal can be attached externally between MCLK1 and
      MCLK2 pins, or an external CMOS-compatible clock can drive the MCLK2
      pin. If absent, internal 4.92MHz clock is used, which can be made
      available on MCLK2 pin.

  clock-names:
    enum:
      - xtal
      - mclk

  "#clock-cells":
    const: 0
    description:
      If present when internal clock is used, configured as clock provider.

  interrupts:
    maxItems: 1

  aincom-supply:
    description: |
      AINCOM voltage supply. Analog inputs AINx are referenced to this input
      when configured for pseudo-differential operation.

  dvdd-supply:
    description: DVdd voltage supply

  avdd-supply:
    description: AVdd voltage supply

  vref-supply:
    description: VRef voltage supply

  adi,rejection-60-Hz-enable:
    description: |
      This bit enables a notch at 60 Hz when the first notch of the sinc
      filter is at 50 Hz. When REJ60 is set, a filter notch is placed at
      60 Hz when the sinc filter first notch is at 50 Hz. This allows
      simultaneous 50 Hz/ 60 Hz rejection.
    type: boolean

  adi,refin2-pins-enable:
    description: |
      External reference applied between the P1/REFIN2(+) and P0/REFIN2(−) pins.
    type: boolean

  adi,buffer-enable:
    description: |
      Enables the buffer on the analog inputs. If cleared, the analog inputs
      are unbuffered, lowering the power consumption of the device. If this
      bit is set, the analog inputs are buffered, allowing the user to place
      source impedances on the front end without contributing gain errors to
      the system.
    type: boolean

  adi,burnout-currents-enable:
    description: |
      When this bit is set to 1, the 500 nA current sources in the signal
      path are enabled. When BURN = 0, the burnout currents are disabled.
      The burnout currents can be enabled only when the buffer is active
      and when chop is disabled.
    type: boolean

  bipolar:
    description: see Documentation/devicetree/bindings/iio/adc/adc.yaml
    type: boolean

patternProperties:
  "^channel@[0-9a-f]+$":
    type: object
    $ref: adc.yaml
    unevaluatedProperties: false

    properties:
      reg:
        description: The channel index.
        minimum: 0
        maximum: 271

      diff-channels:
        description:
          Both inputs can be connected to pins AIN1 to AIN16 by choosing the
          appropriate value from 1 to 16.
        items:
          minimum: 1
          maximum: 16

      single-channel:
        description:
          Positive input can be connected to pins AIN1 to AIN16 by choosing the
          appropriate value from 1 to 16. Negative input is connected to AINCOM.
        minimum: 1
        maximum: 16

    oneOf:
      - required:
          - reg
          - diff-channels
      - required:
          - reg
          - single-channel

required:
  - compatible
  - reg
  - interrupts
  - dvdd-supply
  - avdd-supply
  - vref-supply
  - spi-cpol
  - spi-cpha

allOf:
  - $ref: /schemas/spi/spi-peripheral-props.yaml#
  - if:
      properties:
        compatible:
          enum:
            - adi,ad7190
            - adi,ad7192
            - adi,ad7193
            - adi,ad7195
    then:
      patternProperties:
        "^channel@[0-9a-f]+$": false
  - if:
      anyOf:
        - required:
            - clocks
        - required:
            - clock-names
    then:
      properties:
        "#clock-cells": false
      required:
        - clocks
        - clock-names

unevaluatedProperties: false

examples:
  - |
    spi {
        #address-cells = <1>;
        #size-cells = <0>;

        adc@0 {
            compatible = "adi,ad7192";
            reg = <0>;
            spi-max-frequency = <1000000>;
            spi-cpol;
            spi-cpha;
            clocks = <&ad7192_mclk>;
            clock-names = "mclk";
            interrupts = <25 0x2>;
            interrupt-parent = <&gpio>;
            aincom-supply = <&aincom>;
            dvdd-supply = <&dvdd>;
            avdd-supply = <&avdd>;
            vref-supply = <&vref>;

            adi,refin2-pins-enable;
            adi,rejection-60-Hz-enable;
            adi,buffer-enable;
            adi,burnout-currents-enable;
        };
    };
  - |
    spi {
        #address-cells = <1>;
        #size-cells = <0>;

        adc@0 {
            compatible = "adi,ad7194";
            reg = <0>;

            #address-cells = <1>;
            #size-cells = <0>;

            spi-max-frequency = <1000000>;
            spi-cpol;
            spi-cpha;
            #clock-cells = <0>;
            interrupts = <25 0x2>;
            interrupt-parent = <&gpio>;
            aincom-supply = <&aincom>;
            dvdd-supply = <&dvdd>;
            avdd-supply = <&avdd>;
            vref-supply = <&vref>;

            channel@0 {
                reg = <0>;
                diff-channels = <1 6>;
            };

            channel@1 {
                reg = <1>;
                single-channel = <1>;
            };
        };
    };
```

## Documentation/devicetree/bindings/iio/adc/adi,ad7280a.yaml
```yaml
# SPDX-License-Identifier: (GPL-2.0 OR BSD-2-Clause)
%YAML 1.2
---
$id: http://devicetree.org/schemas/iio/adc/adi,ad7280a.yaml#
$schema: http://devicetree.org/meta-schemas/core.yaml#

title: Analog Devices AD7280a Lithium Ion Battery Monitoring System

maintainers:
  - Michael Hennerich <michael.hennerich@analog.com>
  - Jonathan Cameron <jic23@kernel.org>

description: |
  Bindings for the Analog Devices AD7280a Battery Monitoring System.
  Used in devices such as hybrid electric cars, battery backup and power tools.
  Multiple chips can be daisy chained and accessed via a single SPI interface.
  Data sheet found here:
    https://www.analog.com/media/en/technical-documentation/data-sheets/AD7280A.pdf

properties:
  compatible:
    const: adi,ad7280a

  reg:
    maxItems: 1

  interrupts:
    description: IRQ line for the ADC
    maxItems: 1

  spi-max-frequency: true

  adi,voltage-alert-last-chan:
    $ref: /schemas/types.yaml#/definitions/uint32
    description:
      Allows limiting of scope of which channels are considered for voltage
      alerts, typically because not all are wired to anything. Only applies to
      last device in the daisy chain.
    default: 5
    enum: [3, 4, 5]

  adi,acquisition-time-ns:
    description:
      Additional time may be needed to charge the sampling capacitors depending
      on external writing.
    default: 400
    enum: [400, 800, 1200, 1600]

  adi,thermistor-termination:
    type: boolean
    description:
      Enable the thermistor termination function.

required:
  - compatible
  - reg

additionalProperties: false

examples:
  - |
    spi {
      #address-cells = <1>;
      #size-cells = <0>;

      adc@0 {
        compatible = "adi,ad7280a";
        reg = <0>;
        spi-max-frequency = <700000>;
        interrupt-parent = <&gpio>;
        interrupts = <25 2>;
        adi,thermistor-termination;
        adi,acquisition-time-ns = <800>;
        adi,voltage-alert-last-chan = <5>;
      };
    };
...
```

## Documentation/devicetree/bindings/iio/adc/adi,ad7291.yaml
```yaml
# SPDX-License-Identifier: (GPL-2.0-only OR BSD-2-Clause)
%YAML 1.2
---
$id: http://devicetree.org/schemas/iio/adc/adi,ad7291.yaml#
$schema: http://devicetree.org/meta-schemas/core.yaml#

title: AD7291 8-Channel, I2C, 12-Bit SAR ADC with Temperature Sensor

maintainers:
  - Michael Auchter <michael.auchter@ni.com>

description: |
  Analog Devices AD7291 8-Channel I2C 12-Bit SAR ADC with Temperature Sensor
  https://www.analog.com/media/en/technical-documentation/data-sheets/ad7291.pdf

properties:
  compatible:
    enum:
      - adi,ad7291

  reg:
    maxItems: 1

  vref-supply:
    description: |
      The regulator supply for ADC reference voltage.

required:
  - compatible
  - reg

additionalProperties: false

examples:
  - |
    i2c {
      #address-cells = <1>;
      #size-cells = <0>;

      ad7291: adc@0 {
        compatible = "adi,ad7291";
        reg = <0>;
        vref-supply = <&adc_vref>;
      };
    };
...
```
