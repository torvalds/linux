## Documentation/devicetree/bindings/iio/adc/adi,ad4080.yaml
```yaml
# SPDX-License-Identifier: (GPL-2.0-only OR BSD-2-Clause)
# Copyright 2025 Analog Devices Inc.
%YAML 1.2
---
$id: http://devicetree.org/schemas/iio/adc/adi,ad4080.yaml#
$schema: http://devicetree.org/meta-schemas/core.yaml#

title: Analog Devices AD4080 20-Bit, 40 MSPS, Differential SAR ADC

maintainers:
  - Antoniu Miclaus <antoniu.miclaus@analog.com>

description: |
  The AD4080 is a high speed, low noise, low distortion, 20-bit, Easy Drive,
  successive approximation register (SAR) analog-to-digital converter (ADC).
  Maintaining high performance (signal-to-noise and distortion (SINAD) ratio
  > 90 dBFS) at signal frequencies in excess of 1 MHz enables the AD4080 to
  service a wide variety of precision, wide bandwidth data acquisition
  applications.

  https://www.analog.com/media/en/technical-documentation/data-sheets/ad4080.pdf

$ref: /schemas/spi/spi-peripheral-props.yaml#

properties:
  compatible:
    enum:
      - adi,ad4080

  reg:
    maxItems: 1

  spi-max-frequency:
    description: Configuration of the SPI bus.
    maximum: 50000000

  clocks:
    maxItems: 1

  clock-names:
    items:
      - const: cnv

  vdd33-supply: true

  vdd11-supply: true

  vddldo-supply: true

  iovdd-supply: true

  vrefin-supply: true

  io-backends:
    maxItems: 1

  adi,lvds-cnv-enable:
    description: Enable the LVDS signal type on the CNV pin. Default is CMOS.
    type: boolean

  adi,num-lanes:
    description:
      Number of lanes on which the data is sent on the output (DA, DB pins).
    $ref: /schemas/types.yaml#/definitions/uint32
    enum: [1, 2]
    default: 1

required:
  - compatible
  - reg
  - clocks
  - clock-names
  - vdd33-supply
  - vrefin-supply

additionalProperties: false

examples:
  - |
    spi {
        #address-cells = <1>;
        #size-cells = <0>;

        adc@0 {
          compatible = "adi,ad4080";
          reg = <0>;
          spi-max-frequency = <10000000>;
          vdd33-supply = <&vdd33>;
          vddldo-supply = <&vddldo>;
          vrefin-supply = <&vrefin>;
          clocks = <&cnv>;
          clock-names = "cnv";
          io-backends = <&iio_backend>;
        };
    };
...
```

## Documentation/devicetree/bindings/iio/adc/adi,ad4130.yaml
```yaml
# SPDX-License-Identifier: (GPL-2.0 OR BSD-2-Clause)
# Copyright 2022 Analog Devices Inc.
%YAML 1.2
---
$id: http://devicetree.org/schemas/iio/adc/adi,ad4130.yaml#
$schema: http://devicetree.org/meta-schemas/core.yaml#

title: Analog Devices AD4130 ADC device driver

maintainers:
  - Cosmin Tanislav <cosmin.tanislav@analog.com>

description: |
  Bindings for the Analog Devices AD4130 ADC. Datasheet can be found here:
    https://www.analog.com/media/en/technical-documentation/data-sheets/AD4130-8.pdf

properties:
  compatible:
    enum:
      - adi,ad4130

  reg:
    maxItems: 1

  clocks:
    maxItems: 1
    description: phandle to the master clock (mclk)

  clock-names:
    items:
      - const: mclk

  interrupts:
    maxItems: 1

  interrupt-names:
    description: |
      Specify which interrupt pin should be configured as Data Ready / FIFO
      interrupt.
      Default if not supplied is int.
    enum:
      - int
      - clk
      - p2
      - dout

  '#address-cells':
    const: 1

  '#size-cells':
    const: 0

  '#clock-cells':
    const: 0

  clock-output-names:
    maxItems: 1

  refin1-supply:
    description: refin1 supply. Can be used as reference for conversion.

  refin2-supply:
    description: refin2 supply. Can be used as reference for conversion.

  avdd-supply:
    description: AVDD voltage supply. Can be used as reference for conversion.

  iovdd-supply:
    description: IOVDD voltage supply. Used for the chip interface.

  spi-max-frequency:
    maximum: 5000000

  adi,ext-clk-freq-hz:
    description: Specify the frequency of the external clock.
    enum: [76800, 153600]
    default: 76800

  adi,bipolar:
    description: Specify if the device should be used in bipolar mode.
    type: boolean

  adi,vbias-pins:
    description: Analog inputs to apply a voltage bias of (AVDD − AVSS) / 2 to.
    $ref: /schemas/types.yaml#/definitions/uint32-array
    minItems: 1
    maxItems: 16
    items:
      minimum: 0
      maximum: 15

required:
  - compatible
  - reg
  - interrupts

patternProperties:
  "^channel@([0-9a-f])$":
    type: object
    $ref: adc.yaml
    unevaluatedProperties: false

    properties:
      reg:
        description: The channel number.
        minimum: 0
        maximum: 15

      diff-channels:
        description: |
          Besides the analog inputs available, internal inputs can be used.
          16: Internal temperature sensor.
          17: AVSS
          18: Internal reference
          19: DGND
          20: (AVDD − AVSS)/6+
          21: (AVDD − AVSS)/6-
          22: (IOVDD − DGND)/6+
          23: (IOVDD − DGND)/6-
          24: (ALDO − AVSS)/6+
          25: (ALDO − AVSS)/6-
          26: (DLDO − DGND)/6+
          27: (DLDO − DGND)/6-
          28: V_MV_P
          29: V_MV_M
        items:
          minimum: 0
          maximum: 29

      adi,reference-select:
        description: |
          Select the reference source to use when converting on the
          specific channel. Valid values are:
          0: REFIN1(+)/REFIN1(−)
          1: REFIN2(+)/REFIN2(−)
          2: REFOUT/AVSS (Internal reference)
          3: AVDD/AVSS
          If not specified, REFIN1 is used.
        $ref: /schemas/types.yaml#/definitions/uint32
        enum: [0, 1, 2, 3]
        default: 0

      adi,excitation-pin-0:
        description: |
          Analog input to apply excitation current to while the channel
          is active.
        $ref: /schemas/types.yaml#/definitions/uint32
        minimum: 0
        maximum: 15
        default: 0

      adi,excitation-pin-1:
        description: |
          Analog input to apply excitation current to while this channel
          is active.
        $ref: /schemas/types.yaml#/definitions/uint32
        minimum: 0
        maximum: 15
        default: 0

      adi,excitation-current-0-nanoamp:
        description: |
          Excitation current in nanoamps to be applied to pin specified in
          adi,excitation-pin-0 while this channel is active.
        enum: [0, 100, 10000, 20000, 50000, 100000, 150000, 200000]
        default: 0

      adi,excitation-current-1-nanoamp:
        description: |
          Excitation current in nanoamps to be applied to pin specified in
          adi,excitation-pin-1 while this channel is active.
        enum: [0, 100, 10000, 20000, 50000, 100000, 150000, 200000]
        default: 0

      adi,burnout-current-nanoamp:
        description: |
          Burnout current in nanoamps to be applied for this channel.
        enum: [0, 500, 2000, 4000]
        default: 0

      adi,buffered-positive:
        description: Enable buffered mode for positive input.
        type: boolean

      adi,buffered-negative:
        description: Enable buffered mode for negative input.
        type: boolean

    required:
      - reg
      - diff-channels

allOf:
  - $ref: /schemas/spi/spi-peripheral-props.yaml#

unevaluatedProperties: false

examples:
  - |
    #include <dt-bindings/interrupt-controller/irq.h>

    spi {
      #address-cells = <1>;
      #size-cells = <0>;

      adc@0 {
        compatible = "adi,ad4130";
        reg = <0>;

        #address-cells = <1>;
        #size-cells = <0>;

        spi-max-frequency = <5000000>;
        interrupts = <27 IRQ_TYPE_EDGE_FALLING>;
        interrupt-parent = <&gpio>;

        channel@0 {
          reg = <0>;

          adi,reference-select = <2>;

          /* AIN8, AIN9 */
          diff-channels = <8 9>;
        };

        channel@1 {
          reg = <1>;

          adi,reference-select = <2>;

          /* AIN10, AIN11 */
          diff-channels = <10 11>;
        };

        channel@2 {
          reg = <2>;

          adi,reference-select = <2>;

          /* Temperature Sensor, DGND */
          diff-channels = <16 19>;
        };

        channel@3 {
          reg = <3>;

          adi,reference-select = <2>;

          /* Internal reference, DGND */
          diff-channels = <18 19>;
        };

        channel@4 {
          reg = <4>;

          adi,reference-select = <2>;

          /* DGND, DGND */
          diff-channels = <19 19>;
        };
      };
    };
```

## Documentation/devicetree/bindings/iio/adc/adi,ad4134.yaml
```yaml
# SPDX-License-Identifier: (GPL-2.0-only OR BSD-2-Clause)
%YAML 1.2
---
$id: http://devicetree.org/schemas/iio/adc/adi,ad4134.yaml#
$schema: http://devicetree.org/meta-schemas/core.yaml#

title: Analog Devices AD4134 ADC

maintainers:
  - Marcelo Schmitt <marcelo.schmitt@analog.com>

description: |
  The AD4134 is a quad channel, low noise, simultaneous sampling, precision
  analog-to-digital converter (ADC).
  Specifications can be found at:
    https://www.analog.com/media/en/technical-documentation/data-sheets/ad4134.pdf

$ref: /schemas/spi/spi-peripheral-props.yaml#

properties:
  compatible:
    enum:
      - adi,ad4134

  reg:
    maxItems: 1

  spi-max-frequency:
    maximum: 50000000

  avdd5-supply:
    description: A 5V supply that powers the chip's analog circuitry.

  dvdd5-supply:
    description: A 5V supply that powers the chip's digital circuitry.

  iovdd-supply:
    description:
      A 1.8V supply that sets the logic levels for the digital interface pins.

  refin-supply:
    description:
      A 4.096V or 5V supply that serves as reference for ADC conversions.

  avdd1v8-supply:
    description: A 1.8V supply used by the analog circuitry.

  dvdd1v8-supply:
    description: A 1.8V supply used by the digital circuitry.

  clkvdd-supply:
    description: A 1.8V supply for the chip's clock management circuit.

  ldoin-supply:
    description:
      A 2.6V to 5.5V supply that generates 1.8V for AVDD1V8, DVDD1V8, and CLKVDD
      pins.

  clocks:
    maxItems: 1
    description:
      Required external clock source. Can specify either a crystal or CMOS clock
      source. If an external crystal is set, connect the CLKSEL pin to IOVDD.
      Otherwise, connect the CLKSEL pin to IOGND and the external CMOS clock
      signal to the XTAL2/CLKIN pin.

  clock-names:
    enum:
      - xtal
      - clkin
    default: clkin

  '#clock-cells':
    const: 0

  clock-output-names:
    maxItems: 1

  regulators:
    type: object
    description:
      list of regulators provided by this controller.

    properties:
      vcm-output:
        $ref: /schemas/regulator/regulator.yaml#
        type: object
        unevaluatedProperties: false

    additionalProperties: false

  reset-gpios:
    maxItems: 1

  powerdown-gpios:
    description:
      Active low GPIO connected to the /PDN pin. Forces the device into full
      power-down mode when brought low. Pull this input to IOVDD for normal
      operation.
    maxItems: 1

  odr-gpios:
    description:
      GPIO connected to ODR pin. Used to sample ADC data in minimum I/O mode.
    maxItems: 1

  adi,asrc-mode:
    $ref: /schemas/types.yaml#/definitions/string
    description:
      Asynchronous Sample Rate Converter (ASRC) operation mode control input.
      Describes whether the MODE pin is set to a high level (for master mode
      operation) or to a low level (for slave mode operation).
    enum: [ high, low ]
    default: low

  adi,dclkio:
    description:
      DCLK pin I/O direction control for when the device operates in Pin Control
      Slave Mode or in SPI Control Mode. Describes if DEC0/DCLKIO pin is at a
      high level (which configures DCLK as an output) or to set to a low level
      (configuring DCLK for input).
    enum: [ out, in ]
    default: in

  adi,dclkmode:
    description:
      DCLK mode control for when the device operates in Pin Control Slave Mode
      or in SPI Control Mode. Describes whether the DEC1/DCLKMODE pin is set to
      a high level (configuring the DCLK to operate in free running mode) or
      to a low level (to configure DCLK to operate in gated mode).
    enum: [ free-running, gated ]
    default: gated

required:
  - compatible
  - reg
  - avdd5-supply
  - dvdd5-supply
  - iovdd-supply
  - refin-supply
  - clocks
  - clock-names

oneOf:
  - required:
      - ldoin-supply
  - required:
      - avdd1v8-supply
      - dvdd1v8-supply
      - clkvdd-supply

unevaluatedProperties: false

examples:
  - |
    #include <dt-bindings/gpio/gpio.h>

    spi {
        #address-cells = <1>;
        #size-cells = <0>;

        adc@0 {
            compatible = "adi,ad4134";
            reg = <0>;

            spi-max-frequency = <1000000>;

            reset-gpios = <&gpio0 86 GPIO_ACTIVE_LOW>;
            odr-gpios = <&gpio0 87 GPIO_ACTIVE_HIGH>;
            powerdown-gpios = <&gpio0 88 GPIO_ACTIVE_LOW>;

            clocks = <&sys_clk>;
            clock-names = "clkin";

            avdd5-supply = <&avdd5>;
            dvdd5-supply = <&dvdd5>;
            iovdd-supply = <&iovdd>;
            refin-supply = <&refin>;
            avdd1v8-supply = <&avdd1v8>;
            dvdd1v8-supply = <&dvdd1v8>;
            clkvdd-supply = <&clkvdd>;

            regulators {
                vcm_reg: vcm-output {
                    regulator-name = "ad4134-vcm";
                };
            };

        };
    };
...
```
