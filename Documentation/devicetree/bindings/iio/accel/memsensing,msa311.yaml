## Documentation/devicetree/bindings/iio/adc/adi,ad4691.yaml
```yaml
# SPDX-License-Identifier: (GPL-2.0-only OR BSD-2-Clause)
%YAML 1.2
---
$id: http://devicetree.org/schemas/iio/adc/adi,ad4691.yaml#
$schema: http://devicetree.org/meta-schemas/core.yaml#

title: Analog Devices AD4691 Family Multichannel SAR ADCs

maintainers:
  - Radu Sabau <radu.sabau@analog.com>

description: |
  The AD4691 family are high-speed, low-power, multichannel successive
  approximation register (SAR) analog-to-digital converters (ADCs) with
  an SPI-compatible serial interface. The ADC supports CNV Burst Mode,
  where an external PWM drives the CNV pin, and Manual Mode, where CNV
  is directly tied to the SPI chip-select.

  Datasheets:
    * https://www.analog.com/en/products/ad4691.html
    * https://www.analog.com/en/products/ad4692.html
    * https://www.analog.com/en/products/ad4693.html
    * https://www.analog.com/en/products/ad4694.html

$ref: /schemas/spi/spi-peripheral-props.yaml#

properties:
  compatible:
    enum:
      - adi,ad4691
      - adi,ad4692
      - adi,ad4693
      - adi,ad4694

  reg:
    maxItems: 1

  spi-max-frequency:
    maximum: 40000000

  spi-cpol: true
  spi-cpha: true

  avdd-supply:
    description: Analog power supply (4.5V to 5.5V).

  vdd-supply:
    description:
      External 1.8V digital core supply. When present, the internal LDO is
      disabled (LDO_EN = 0). Mutually exclusive with ldo-in-supply.

  ldo-in-supply:
    description:
      LDO input supply (2.4V to 5.5V). When present and vdd-supply is absent,
      the internal LDO generates 1.8V VDD from this input (LDO_EN = 1).
      Mutually exclusive with vdd-supply.

  vio-supply:
    description: I/O voltage supply (1.71V to 1.89V or VDD).

  ref-supply:
    description: External reference voltage supply (2.4V to 5.25V).

  refin-supply:
    description: Internal reference buffer input supply.

  reset-gpios:
    description:
      GPIO line controlling the hardware reset pin (active-low).
    maxItems: 1

  pwms:
    description:
      PWM connected to the CNV pin. When present, selects CNV Burst Mode where
      the PWM drives the conversion rate. When absent, Manual Mode is used
      (CNV tied to SPI CS).
    maxItems: 1

  interrupts:
    description:
      Interrupt lines connected to the ADC GP pins. Each GP pin can be
      physically wired to an interrupt-capable input on the SoC.
    maxItems: 4

  interrupt-names:
    description: Names of the interrupt lines, matching the GP pin names.
    minItems: 1
    maxItems: 4
    items:
      enum:
        - gp0
        - gp1
        - gp2
        - gp3

  gpio-controller: true

  '#gpio-cells':
    const: 2

  '#trigger-source-cells':
    description:
      This node can act as a trigger source. The single cell in a consumer
      reference specifies the GP pin number (0-3) used as the trigger output.
    const: 1

required:
  - compatible
  - reg
  - avdd-supply
  - vio-supply

allOf:
  # vdd-supply and ldo-in-supply are mutually exclusive, one is required:
  # either an external 1.8V VDD is provided or the internal LDO is fed from
  # ldo-in-supply to generate VDD.
  - oneOf:
      - required:
          - vdd-supply
      - required:
          - ldo-in-supply
  # ref-supply and refin-supply are mutually exclusive, one is required
  - oneOf:
      - required:
          - ref-supply
      - required:
          - refin-supply

unevaluatedProperties: false

examples:
  - |
    #include <dt-bindings/gpio/gpio.h>
    /* AD4692 in CNV Burst Mode with SPI offload */
    spi {
        #address-cells = <1>;
        #size-cells = <0>;

        adc@0 {
            compatible = "adi,ad4692";
            reg = <0>;
            spi-cpol;
            spi-cpha;
            spi-max-frequency = <40000000>;

            avdd-supply = <&avdd_supply>;
            ldo-in-supply = <&avdd_supply>;
            vio-supply = <&vio_supply>;
            ref-supply = <&ref_5v>;

            reset-gpios = <&gpio0 15 GPIO_ACTIVE_LOW>;

            pwms = <&pwm_gen 0 0>;

            #trigger-source-cells = <1>;
        };
    };

  - |
    #include <dt-bindings/gpio/gpio.h>
    /* AD4692 in Manual Mode (CNV tied to SPI CS) */
    spi {
        #address-cells = <1>;
        #size-cells = <0>;

        adc@0 {
            compatible = "adi,ad4692";
            reg = <0>;
            spi-cpol;
            spi-cpha;
            spi-max-frequency = <31250000>;

            avdd-supply = <&avdd_supply>;
            ldo-in-supply = <&avdd_supply>;
            vio-supply = <&vio_supply>;
            refin-supply = <&refin_supply>;

            reset-gpios = <&gpio0 15 GPIO_ACTIVE_LOW>;
        };
    };
```

## Documentation/devicetree/bindings/iio/adc/adi,ad4695.yaml
```yaml
# SPDX-License-Identifier: (GPL-2.0-only OR BSD-2-Clause)
%YAML 1.2
---
$id: http://devicetree.org/schemas/iio/adc/adi,ad4695.yaml#
$schema: http://devicetree.org/meta-schemas/core.yaml#

title: Analog Devices Easy Drive Multiplexed SAR Analog to Digital Converters

maintainers:
  - Michael Hennerich <Michael.Hennerich@analog.com>
  - Nuno Sá <nuno.sa@analog.com>

description: |
  A family of similar multi-channel analog to digital converters with SPI bus.

  * https://www.analog.com/en/products/ad4695.html
  * https://www.analog.com/en/products/ad4696.html
  * https://www.analog.com/en/products/ad4697.html
  * https://www.analog.com/en/products/ad4698.html

$ref: /schemas/spi/spi-peripheral-props.yaml#

properties:
  compatible:
    enum:
      - adi,ad4695
      - adi,ad4696
      - adi,ad4697
      - adi,ad4698

  reg:
    maxItems: 1

  spi-max-frequency:
    maximum: 80000000

  spi-cpol: true
  spi-cpha: true

  spi-rx-bus-width:
    minimum: 1
    maximum: 4

  avdd-supply:
    description: Analog power supply.

  vio-supply:
    description: I/O pin power supply.

  ldo-in-supply:
    description: Internal LDO Input. Mutually exclusive with vdd-supply.

  vdd-supply:
    description: Core power supply. Mutually exclusive with ldo-in-supply.

  ref-supply:
    description:
      External reference voltage. Mutually exclusive with refin-supply.

  refin-supply:
    description:
      Internal reference buffer input. Mutually exclusive with ref-supply.

  com-supply:
    description: Common voltage supply for pseudo-differential analog inputs.

  adi,no-ref-current-limit:
    $ref: /schemas/types.yaml#/definitions/flag
    description:
      When this flag is present, the REF Overvoltage Reduced Current protection
      is disabled.

  adi,no-ref-high-z:
    $ref: /schemas/types.yaml#/definitions/flag
    description:
      Enable this flag if the ref-supply requires Reference Input High-Z Mode
      to be disabled for proper operation.

  cnv-gpios:
    description: The Convert Input (CNV). If omitted, CNV is tied to SPI CS.
    maxItems: 1

  reset-gpios:
    description: The Reset Input (RESET). Should be configured GPIO_ACTIVE_LOW.
    maxItems: 1

  pwms:
    description: PWM signal connected to the CNV pin.
    maxItems: 1

  interrupts:
    minItems: 1
    items:
      - description: Signal coming from the BSY_ALT_GP0 pin (ALERT or BUSY).
      - description: Signal coming from the GP2 pin (ALERT).
      - description: Signal coming from the GP3 pin (BUSY).

  interrupt-names:
    minItems: 1
    items:
      - const: gp0
      - const: gp2
      - const: gp3

  gpio-controller: true

  "#gpio-cells":
    const: 2
    description: |
      The first cell is the GPn number: 0 to 3.
      The second cell takes standard GPIO flags.

  '#trigger-source-cells':
    description: |
      First cell indicates the output signal: 0 = BUSY, 1 = ALERT.
      Second cell indicates which GPn pin is used: 0, 2 or 3.

      For convenience, macros for these values are available in
      dt-bindings/iio/adc/adi,ad4695.h.
    const: 2

  "#address-cells":
    const: 1

  "#size-cells":
    const: 0

patternProperties:
  "^in(?:[13579]|1[135])-supply$":
    description:
      Optional voltage supply for odd numbered channels when they are used as
      the negative input for a pseudo-differential channel.

  "^channel@[0-9a-f]$":
    type: object
    $ref: adc.yaml
    unevaluatedProperties: false
    description:
      Describes each individual channel. In addition the properties defined
      below, bipolar from adc.yaml is also supported.

    properties:
      reg:
        maximum: 15

      common-mode-channel:
        description:
          Describes the common mode channel for single channels. 0xFF is REFGND
          and OxFE is COM. Macros are available for these values in
          dt-bindings/iio/adc/adi,ad4695.h. Values 1 to 15 correspond to INx
          inputs. Only odd numbered INx inputs can be used as common mode
          channels.
        enum: [1, 3, 5, 7, 9, 11, 13, 15, 0xFE, 0xFF]
        default: 0xFF

      adi,no-high-z:
        $ref: /schemas/types.yaml#/definitions/flag
        description:
          Enable this flag if the input pin requires the Analog Input High-Z
          Mode to be disabled for proper operation.

    required:
      - reg

    allOf:
      # bipolar mode can't be used with REFGND
      - if:
          properties:
            common-mode-channel:
              const: 0xFF
        then:
          properties:
            bipolar: false

required:
  - compatible
  - reg
  - avdd-supply
  - vio-supply

allOf:
  - oneOf:
      - required:
          - ldo-in-supply
      - required:
          - vdd-supply

  - oneOf:
      - required:
          - ref-supply
      - required:
          - refin-supply

  # the internal reference buffer always requires high-z mode
  - if:
      required:
        - refin-supply
    then:
      properties:
        adi,no-ref-high-z: false

  # limit channels for 8-channel chips
  - if:
      properties:
        compatible:
          contains:
            enum:
              - adi,ad4697
              - adi,ad4698
    then:
      patternProperties:
        "^in(?:9|1[135])-supply$": false
        "^channel@[0-7]$":
          properties:
            reg:
              maximum: 7
            common-mode-channel:
              enum: [1, 3, 5, 7, 0xFE, 0xFF]
        "^channel@[8-9a-f]$": false

unevaluatedProperties: false

examples:
  - |
    #include <dt-bindings/gpio/gpio.h>
    #include <dt-bindings/iio/adc/adi,ad4695.h>

    spi {
        #address-cells = <1>;
        #size-cells = <0>;

        adc@0 {
            compatible = "adi,ad4695";
            reg = <0>;
            spi-cpol;
            spi-cpha;
            spi-max-frequency = <80000000>;
            avdd-supply = <&power_supply>;
            ldo-in-supply = <&power_supply>;
            vio-supply = <&io_supply>;
            refin-supply = <&supply_5V>;
            com-supply = <&supply_2V5>;
            in3-supply = <&supply_2V5>;
            reset-gpios = <&gpio 1 GPIO_ACTIVE_LOW>;

            #address-cells = <1>;
            #size-cells = <0>;

            /* Pseudo-differential channel between IN0 and REFGND. */
            channel@0 {
                reg = <0>;
            };

            /* Pseudo-differential channel between IN1 and COM. */
            channel@1 {
                reg = <1>;
                common-mode-channel = <AD4695_COMMON_MODE_COM>;
                bipolar;
            };

            /* Pseudo-differential channel between IN2 and IN3. */
            channel@2 {
                reg = <2>;
                common-mode-channel = <3>;
                bipolar;
            };
        };
    };
```

## Documentation/devicetree/bindings/iio/adc/adi,ad4851.yaml
```yaml
# SPDX-License-Identifier: (GPL-2.0-only OR BSD-2-Clause)
# Copyright 2024 Analog Devices Inc.
%YAML 1.2
---
$id: http://devicetree.org/schemas/iio/adc/adi,ad4851.yaml#
$schema: http://devicetree.org/meta-schemas/core.yaml#

title: Analog Devices AD485X family

maintainers:
  - Sergiu Cuciurean <sergiu.cuciurean@analog.com>
  - Dragos Bogdan <dragos.bogdan@analog.com>
  - Antoniu Miclaus <antoniu.miclaus@analog.com>

description: |
  Analog Devices AD485X fully buffered, 8-channel simultaneous sampling,
  16/20-bit, 1 MSPS data acquisition system (DAS) with differential, wide
  common-mode range inputs.

  https://www.analog.com/media/en/technical-documentation/data-sheets/ad4855.pdf
  https://www.analog.com/media/en/technical-documentation/data-sheets/ad4856.pdf
  https://www.analog.com/media/en/technical-documentation/data-sheets/ad4857.pdf
  https://www.analog.com/media/en/technical-documentation/data-sheets/ad4858.pdf

$ref: /schemas/spi/spi-peripheral-props.yaml#

properties:
  compatible:
    enum:
      - adi,ad4851
      - adi,ad4852
      - adi,ad4853
      - adi,ad4854
      - adi,ad4855
      - adi,ad4856
      - adi,ad4857
      - adi,ad4858
      - adi,ad4858i

  reg:
    maxItems: 1

  vcc-supply: true

  vee-supply: true

  vdd-supply: true

  vddh-supply: true

  vddl-supply: true

  vio-supply: true

  vrefbuf-supply: true

  vrefio-supply: true

  pwms:
    description: PWM connected to the CNV pin.
    maxItems: 1

  io-backends:
    maxItems: 1

  pd-gpios:
    maxItems: 1

  spi-max-frequency:
    maximum: 25000000

  '#address-cells':
    const: 1

  '#size-cells':
    const: 0

patternProperties:
  "^channel(@[0-7])?$":
    $ref: adc.yaml
    type: object
    description: Represents the channels which are connected to the ADC.

    properties:
      reg:
        description:
          The channel number, as specified in the datasheet (from 0 to 7).
        minimum: 0
        maximum: 7

      diff-channels:
        description:
          Each channel can be configured as a bipolar differential channel.
          The ADC uses the same positive and negative inputs for this.
          This property must be specified as 'reg' (or the channel number) for
          both positive and negative inputs (i.e. diff-channels = <reg reg>).
          Since the configuration is bipolar differential, the 'bipolar'
          property is required.
        items:
          minimum: 0
          maximum: 7

      bipolar: true

    required:
      - reg

    additionalProperties: false

required:
  - compatible
  - reg
  - vcc-supply
  - vee-supply
  - vdd-supply
  - vio-supply
  - pwms

unevaluatedProperties: false

examples:
  - |
    spi {
        #address-cells = <1>;
        #size-cells = <0>;

        adc@0{
            #address-cells = <1>;
            #size-cells = <0>;
            compatible = "adi,ad4858";
            reg = <0>;
            spi-max-frequency = <10000000>;
            vcc-supply = <&vcc>;
            vdd-supply = <&vdd>;
            vee-supply = <&vee>;
            vddh-supply = <&vddh>;
            vddl-supply = <&vddl>;
            vio-supply = <&vio>;
            pwms = <&pwm_gen 0 0>;
            io-backends = <&iio_backend>;

            channel@0 {
              reg = <0>;
              diff-channels = <0 0>;
              bipolar;
            };

            channel@1 {
              reg = <1>;
            };
        };
    };
...
```
