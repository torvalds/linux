## Documentation/devicetree/bindings/iio/accel/adxl372.txt
```
Analog Devices ADXL372 3-Axis, +/-(200g) Digital Accelerometer

http://www.analog.com/media/en/technical-documentation/data-sheets/adxl372.pdf

Required properties:
 - compatible : should be "adi,adxl372"
 - reg: the I2C address or SPI chip select number for the device

Required properties for SPI bus usage:
 - spi-max-frequency: Max SPI frequency to use

Optional properties:
 - interrupts: interrupt mapping for IRQ as documented in
   Documentation/devicetree/bindings/interrupt-controller/interrupts.txt

Example for a I2C device node:

	accelerometer@53 {
		compatible = "adi,adxl372";
		reg = <0x53>;
		interrupt-parent = <&gpio>;
		interrupts = <25 IRQ_TYPE_EDGE_FALLING>;
	};

Example for a SPI device node:

	accelerometer@0 {
		compatible = "adi,adxl372";
		reg = <0>;
		spi-max-frequency = <1000000>;
		interrupt-parent = <&gpio>;
		interrupts = <25 IRQ_TYPE_EDGE_FALLING>;
	};
```

## Documentation/devicetree/bindings/iio/accel/bma180.txt
```
* Bosch BMA023 / BMA150/ BMA180 / BMA25x / SMB380 triaxial acceleration sensor

https://media.digikey.com/pdf/Data%20Sheets/Bosch/BMA150.pdf
http://omapworld.com/BMA180_111_1002839.pdf
http://ae-bst.resource.bosch.com/media/products/dokumente/bma250/bst-bma250-ds002-05.pdf

Required properties:

  - compatible : should be one of:
    "bosch,bma023"
    "bosch,bma150"
    "bosch,bma180"
    "bosch,bma250"
    "bosch,bma254"
    "bosch,smb380"
  - reg : the I2C address of the sensor
  - vdd-supply : regulator phandle connected to the VDD pin
  - vddio-supply : regulator phandle connected to the VDDIO pin

Optional properties:

  - interrupts : interrupt mapping for GPIO IRQ, it should by configured with
		flags IRQ_TYPE_LEVEL_HIGH | IRQ_TYPE_EDGE_RISING
		For the bma250 the first interrupt listed must be the one
		connected to the INT1 pin, the second (optional) interrupt
		listed must be the one connected to the INT2 pin.

Example:

bma180@40 {
	compatible = "bosch,bma180";
	reg = <0x40>;
	interrupt-parent = <&gpio6>;
	interrupts = <18 (IRQ_TYPE_LEVEL_HIGH | IRQ_TYPE_EDGE_RISING)>;
};
```

## Documentation/devicetree/bindings/iio/accel/bosch,bma180.yaml
```yaml
# SPDX-License-Identifier: (GPL-2.0-only OR BSD-2-Clause)
%YAML 1.2
---
$id: http://devicetree.org/schemas/iio/accel/bosch,bma180.yaml#
$schema: http://devicetree.org/meta-schemas/core.yaml#

title: Bosch BMA023 / BMA150/ BMA180 / BMA250 / SMB380 triaxial accelerometers

maintainers:
  - Jonathan Cameron <jic23@kernel.org>

description: |
  https://media.digikey.com/pdf/Data%20Sheets/Bosch/BMA150.pdf
  http://omapworld.com/BMA180_111_1002839.pdf
  http://ae-bst.resource.bosch.com/media/products/dokumente/bma250/bst-bma250-ds002-05.pdf

properties:
  compatible:
    enum:
      - bosch,bma023
      - bosch,bma150
      - bosch,bma180
      - bosch,bma250
      - bosch,smb380

  reg:
    maxItems: 1

  vdd-supply: true

  vddio-supply: true

  interrupts:
    minItems: 1
    maxItems: 2
    description: |
      Type should be either IRQ_TYPE_LEVEL_HIGH or IRQ_TYPE_EDGE_RISING.
      For the bma250 the first interrupt listed must be the one
      connected to the INT1 pin, the second (optional) interrupt
      listed must be the one connected to the INT2 pin.

required:
  - compatible
  - reg

additionalProperties: false

examples:
  - |
    #include <dt-bindings/interrupt-controller/irq.h>
    i2c {
        #address-cells = <1>;
        #size-cells = <0>;
        accel@40 {
            compatible = "bosch,bma180";
            reg = <0x40>;
            interrupt-parent = <&gpio6>;
            interrupts = <18 (IRQ_TYPE_LEVEL_HIGH | IRQ_TYPE_EDGE_RISING)>;
        };
    };
...
```

## Documentation/devicetree/bindings/iio/accel/bosch,bma220.yaml
```yaml
# SPDX-License-Identifier: (GPL-2.0-only OR BSD-2-Clause)
%YAML 1.2
---
$id: http://devicetree.org/schemas/iio/accel/bosch,bma220.yaml#
$schema: http://devicetree.org/meta-schemas/core.yaml#

title: Bosch BMA220 Trixial Acceleration Sensor

maintainers:
  - Jonathan Cameron <Jonathan.Cameron@huawei.com>

properties:
  compatible:
    enum:
      - bosch,bma220

  reg:
    maxItems: 1

  interrupts:
    maxItems: 1

  vdda-supply: true
  vddd-supply: true
  vddio-supply: true

required:
  - compatible
  - reg

allOf:
  - $ref: /schemas/spi/spi-peripheral-props.yaml#

unevaluatedProperties: false

examples:
  - |
    #include <dt-bindings/interrupt-controller/irq.h>
    spi {
        #address-cells = <1>;
        #size-cells = <0>;

        accelerometer@0 {
            compatible = "bosch,bma220";
            reg = <0>;
            spi-max-frequency = <2500000>;
            interrupt-parent = <&gpio0>;
            interrupts = <0 IRQ_TYPE_LEVEL_HIGH>;
        };
    };
...
```

## Documentation/devicetree/bindings/iio/accel/bosch,bma255.yaml
```yaml
# SPDX-License-Identifier: (GPL-2.0 OR BSD-2-Clause)
%YAML 1.2
---
$id: http://devicetree.org/schemas/iio/accel/bosch,bma255.yaml#
$schema: http://devicetree.org/meta-schemas/core.yaml#

title: Bosch BMA255 and Similar Accelerometers

maintainers:
  - Linus Walleij <linus.walleij@linaro.org>
  - Stephan Gerhold <stephan@gerhold.net>

description:
  3 axis accelerometers with varying range and I2C or SPI
  4-wire interface.

properties:
  compatible:
    enum:
      # bmc150-accel driver in Linux
      - bosch,bma222
      - bosch,bma222e
      - bosch,bma250e
      - bosch,bma253
      - bosch,bma254
      - bosch,bma255
      - bosch,bma280
      - bosch,bmc150_accel
      - bosch,bmc156_accel
      - bosch,bmi055_accel

      # bma180 driver in Linux
      - bosch,bma023
      - bosch,bma150
      - bosch,bma180
      - bosch,bma250
      - bosch,smb380

  reg:
    maxItems: 1

  vdd-supply: true
  vddio-supply: true

  interrupts:
    minItems: 1
    maxItems: 2
    description: |
      Without interrupt-names, the first interrupt listed must be the one
      connected to the INT1 pin, the second (optional) interrupt listed must be
      the one connected to the INT2 pin (if available). The type should be
      IRQ_TYPE_EDGE_RISING.

      BMC156 does not have an INT1 pin, therefore the first interrupt pin is
      always treated as INT2.

  interrupt-names:
    minItems: 1
    maxItems: 2
    items:
      enum:
        - INT1
        - INT2

  mount-matrix:
    description: an optional 3x3 mounting rotation matrix.

  spi-max-frequency:
    maximum: 10000000

required:
  - compatible
  - reg

allOf:
  - $ref: /schemas/spi/spi-peripheral-props.yaml#

unevaluatedProperties: false

examples:
  - |
    #include <dt-bindings/interrupt-controller/irq.h>
    i2c {
        #address-cells = <1>;
        #size-cells = <0>;
        accelerometer@8 {
            compatible = "bosch,bma222";
            reg = <0x08>;
            vddio-supply = <&vddio>;
            vdd-supply = <&vdd>;
            interrupts = <57 IRQ_TYPE_EDGE_RISING>;
            interrupt-names = "INT1";
        };
    };
  - |
    #include <dt-bindings/interrupt-controller/irq.h>
    i2c {
        #address-cells = <1>;
        #size-cells = <0>;
        accelerometer@10 {
            compatible = "bosch,bmc156_accel";
            reg = <0x10>;
            vddio-supply = <&vddio>;
            vdd-supply = <&vdd>;
            interrupts = <116 IRQ_TYPE_EDGE_RISING>;
            interrupt-names = "INT2";
        };
    };
  - |
    # include <dt-bindings/interrupt-controller/irq.h>
    spi {
        #address-cells = <1>;
        #size-cells = <0>;
        accel@0 {
            compatible = "bosch,bma222";
            reg = <0>;
            spi-max-frequency = <10000000>;
        };
    };
...
```

## Documentation/devicetree/bindings/iio/accel/bosch,bma400.yaml
```yaml
# SPDX-License-Identifier: (GPL-2.0-only OR BSD-2-Clause)
%YAML 1.2
---
$id: http://devicetree.org/schemas/iio/accel/bosch,bma400.yaml#
$schema: http://devicetree.org/meta-schemas/core.yaml#

title: Bosch BMA400 triaxial acceleration sensor

maintainers:
  - Dan Robertson <dan@dlrobertson.com>

description: |
  Acceleration and temperature iio sensors with an i2c interface

  Specifications about the sensor can be found at:
    https://ae-bst.resource.bosch.com/media/_tech/media/datasheets/BST-BMA400-DS000.pdf

properties:
  compatible:
    enum:
      - bosch,bma400

  reg:
    maxItems: 1

  vdd-supply:
    description: phandle to the regulator that provides power to the accelerometer

  vddio-supply:
    description: phandle to the regulator that provides power to the sensor's IO

  interrupts:
    maxItems: 1

required:
  - compatible
  - reg

additionalProperties: false

examples:
  - |
    #include <dt-bindings/interrupt-controller/irq.h>
    i2c {
      #address-cells = <1>;
      #size-cells = <0>;
      accelerometer@14 {
        compatible = "bosch,bma400";
        reg = <0x14>;
        vdd-supply = <&vdd>;
        vddio-supply = <&vddio>;
        interrupt-parent = <&gpio0>;
        interrupts = <0 IRQ_TYPE_LEVEL_HIGH>;
      };
    };
```

## Documentation/devicetree/bindings/iio/accel/bosch,bmi088.yaml
```yaml
# SPDX-License-Identifier: (GPL-2.0-only OR BSD-2-Clause)
%YAML 1.2
---
$id: http://devicetree.org/schemas/iio/accel/bosch,bmi088.yaml#
$schema: http://devicetree.org/meta-schemas/core.yaml#

title: Bosch BMI088 IMU accelerometer part

maintainers:
  - Mike Looijmans <mike.looijmans@topic.nl>

description: |
  Acceleration part of the IMU sensor with an SPI interface
  Specifications about the sensor can be found at:
    https://www.bosch-sensortec.com/media/boschsensortec/downloads/datasheets/bst-bmi088-ds001.pdf

properties:
  compatible:
    enum:
      - bosch,bmi085-accel
      - bosch,bmi088-accel
      - bosch,bmi090l-accel

  reg:
    maxItems: 1

  spi-max-frequency: true

  vdd-supply: true

  vddio-supply: true

  interrupts:
    minItems: 1
    maxItems: 2
    description: |
      Type should be either IRQ_TYPE_LEVEL_HIGH or IRQ_TYPE_LEVEL_LOW.
      Two configurable interrupt lines exist.

  interrupt-names:
    description: Specify which interrupt line is in use.
    items:
      enum:
        - INT1
        - INT2
    minItems: 1
    maxItems: 2

required:
  - compatible
  - reg

additionalProperties: false

examples:
  - |
    #include <dt-bindings/interrupt-controller/irq.h>
    spi {
      #address-cells = <1>;
      #size-cells = <0>;
      bmi088-accel@1 {
        compatible = "bosch,bmi088-accel";
        reg = <1>;
        spi-max-frequency = <10000000>;
        interrupt-parent = <&gpio6>;
        interrupts = <19 IRQ_TYPE_LEVEL_LOW>;
        interrupt-names = "INT2";
      };
    };
...
```

## Documentation/devicetree/bindings/iio/accel/dmard06.txt
```
Device tree bindings for Domintech DMARD05, DMARD06, DMARD07 accelerometers

Required properties:
 - compatible		: Should be "domintech,dmard05"
				 or "domintech,dmard06"
				 or "domintech,dmard07"
 - reg			: I2C address of the chip. Should be 0x1c

Example:
	&i2c1 {
		/* ... */

		accelerometer@1c {
			compatible = "domintech,dmard06";
			reg = <0x1c>;
		};

		/* ... */
	};
```

## Documentation/devicetree/bindings/iio/accel/fsl,mma7455.yaml
```yaml
# SPDX-License-Identifier: (GPL-2.0 OR BSD-2-Clause)
%YAML 1.2
---
$id: http://devicetree.org/schemas/iio/accel/fsl,mma7455.yaml#
$schema: http://devicetree.org/meta-schemas/core.yaml#

title: Freescale MMA7455 and MMA7456 three axis accelerometers

maintainers:
  - Jonathan Cameron <jic23@kernel.org>

description:
  Devices support both SPI and I2C interfaces.

properties:
  compatible:
    enum:
      - fsl,mma7455
      - fsl,mma7456
  reg:
    maxItems: 1

  avdd-supply: true
  vddio-supply: true

  interrupts:
    minItems: 1
    maxItems: 2

  interrupt-names:
    description:
      Data ready is only available on INT1, but events can use either or
      both pins.  If not specified, first element assumed to correspond
      to INT1 and second (where present) to INT2.
    minItems: 1
    maxItems: 2
    items:
      enum:
        - INT1
        - INT2

required:
  - compatible
  - reg

allOf:
  - $ref: /schemas/spi/spi-peripheral-props.yaml#

unevaluatedProperties: false

examples:
  - |
    # include <dt-bindings/interrupt-controller/irq.h>
    i2c {
        #address-cells = <1>;
        #size-cells = <0>;

        accelerometer@18 {
            compatible = "fsl,mma7455";
            reg = <0x18>;
            vddio-supply = <&iovdd>;
            avdd-supply = <&avdd>;
            interrupts = <57 IRQ_TYPE_EDGE_FALLING>, <58 IRQ_TYPE_EDGE_FALLING>;
            interrupt-names = "INT2", "INT1";
        };
    };
  - |
    # include <dt-bindings/interrupt-controller/irq.h>
    spi {
        #address-cells = <1>;
        #size-cells = <0>;
        accelerometer@0 {
            compatible = "fsl,mma7456";
            reg = <0>;
            spi-max-frequency = <10000000>;
            vddio-supply = <&iovdd>;
            avdd-supply = <&avdd>;
            interrupts = <57 IRQ_TYPE_EDGE_FALLING>;
            interrupt-names = "INT1";
        };
    };
...
```

## Documentation/devicetree/bindings/iio/accel/fsl,mma8452.yaml
```yaml
# SPDX-License-Identifier: (GPL-2.0 OR BSD-2-Clause)
%YAML 1.2
---
$id: http://devicetree.org/schemas/iio/accel/fsl,mma8452.yaml#
$schema: http://devicetree.org/meta-schemas/core.yaml#

title:
  Freescale MMA8451Q, MMA8452Q, MMA8453Q, MMA8652FC, MMA8653FC or FXLS8471Q
  triaxial accelerometer

maintainers:
  - Martin Kepplinger <martin.kepplinger@theobroma-systems.com>

properties:
  compatible:
    enum:
      - fsl,mma8451
      - fsl,mma8452
      - fsl,mma8453
      - fsl,mma8652
      - fsl,mma8653
      - fsl,fxls8471

  reg:
    maxItems: 1

  interrupts:
    description:
      2 highly configurable interrupt lines exist.
    minItems: 1
    maxItems: 2

  interrupt-names:
    description: Specify which interrupt line is in use.
    items:
      enum:
        - INT1
        - INT2
    minItems: 1
    maxItems: 2

  vdd-supply: true
  vddio-supply: true

required:
  - compatible
  - reg

additionalProperties: false

examples:
  - |
    i2c {
        #address-cells = <1>;
        #size-cells = <0>;

        accel@1d {
            compatible = "fsl,mma8453";
            reg = <0x1d>;
            interrupt-parent = <&gpio1>;
            interrupts = <5 0>;
            interrupt-names = "INT2";
        };
    };
...
```

## Documentation/devicetree/bindings/iio/accel/kionix,kx022a.yaml
```yaml
# SPDX-License-Identifier: GPL-2.0-only OR BSD-2-Clause
%YAML 1.2
---
$id: http://devicetree.org/schemas/iio/accel/kionix,kx022a.yaml#
$schema: http://devicetree.org/meta-schemas/core.yaml#

title: ROHM/Kionix KX022A, KX132-1211 and KX132ACR-LBZ Accelerometers

maintainers:
  - Matti Vaittinen <mazziesaccount@gmail.com>

description: |
  KX022A, KX132ACR-LBZ and KX132-1211 are 3-axis accelerometers supporting
  +/- 2G, 4G, 8G and 16G ranges, variable output data-rates and a
  hardware-fifo buffering. These accelerometers can be accessed either
  via I2C or SPI.

properties:
  compatible:
    enum:
      - kionix,kx022a
      - kionix,kx132-1211
      - rohm,kx132acr-lbz

  reg:
    maxItems: 1

  interrupts:
    minItems: 1
    maxItems: 2

  interrupt-names:
    minItems: 1
    items:
      - enum: [INT1, INT2]
      - const: INT2

  vdd-supply: true
  io-vdd-supply: true

  mount-matrix:
    description: |
      an optional 3x3 mounting rotation matrix.

required:
  - compatible
  - reg
  - interrupts

additionalProperties: false

examples:
  - |
    #include <dt-bindings/interrupt-controller/irq.h>
    i2c {
        #address-cells = <1>;
        #size-cells = <0>;
        accel@1f {
            compatible = "kionix,kx022a";
            reg = <0x1f>;

            interrupt-parent = <&gpio1>;
            interrupts = <29 IRQ_TYPE_LEVEL_LOW>;
            interrupt-names = "INT1";

            io-vdd-supply = <&iovdd>;
            vdd-supply = <&vdd>;
        };
    };
```
