## Documentation/devicetree/bindings/iio/accel/adi,adis16201.yaml
```yaml
# SPDX-License-Identifier: (GPL-2.0-only OR BSD-2-Clause)
%YAML 1.2
---
$id: http://devicetree.org/schemas/iio/accel/adi,adis16201.yaml#
$schema: http://devicetree.org/meta-schemas/core.yaml#

title: ADIS16201 Dual Axis Inclinometer and similar

maintainers:
  - Jonathan Cameron <Jonathan.Cameron@huawei.com>

description: |
  Two similar parts from external interface point of view.
  SPI interface.
    https://www.analog.com/en/products/adis16201.html
    https://www.analog.com/en/products/adis16209.html

properties:
  compatible:
    enum:
      - adi,adis16201
      - adi,adis16209

  reg:
    maxItems: 1

  interrupts:
    maxItems: 1

  spi-max-frequency: true

  vdd-supply: true

required:
  - compatible
  - reg

additionalProperties: false

examples:
  - |
    #include <dt-bindings/interrupt-controller/irq.h>
    spi0 {
        #address-cells = <1>;
        #size-cells = <0>;

        accelerometer@0 {
            compatible = "adi,adis16201";
            reg = <0>;
            spi-max-frequency = <2500000>;
            interrupt-parent = <&gpio0>;
            interrupts = <0 IRQ_TYPE_LEVEL_HIGH>;
        };
    };
...
```

## Documentation/devicetree/bindings/iio/accel/adi,adis16240.yaml
```yaml
# SPDX-License-Identifier: (GPL-2.0-only OR BSD-2-Clause)
%YAML 1.2
---
$id: http://devicetree.org/schemas/iio/accel/adi,adis16240.yaml#
$schema: http://devicetree.org/meta-schemas/core.yaml#

title: ADIS16240 Programmable Impact Sensor and Recorder driver

maintainers:
  - Marcelo Schmitt <marcelo.schmitt@analog.com>
  - Nuno Sá <nuno.sa@analog.com>

description: |
  ADIS16240 Programmable Impact Sensor and Recorder driver that supports
  SPI interface.
    https://www.analog.com/en/products/adis16240.html

properties:
  compatible:
    enum:
      - adi,adis16240

  reg:
    maxItems: 1

  interrupts:
    maxItems: 1

required:
  - compatible
  - reg
  - interrupts

allOf:
  - $ref: /schemas/spi/spi-peripheral-props.yaml#

unevaluatedProperties: false

examples:
  - |
    #include <dt-bindings/interrupt-controller/irq.h>
    spi {
        #address-cells = <1>;
        #size-cells = <0>;

        /* Example for a SPI device node */
        accelerometer@0 {
            compatible = "adi,adis16240";
            reg = <0>;
            spi-max-frequency = <2500000>;
            interrupt-parent = <&gpio0>;
            interrupts = <0 IRQ_TYPE_LEVEL_HIGH>;
        };
    };
```

## Documentation/devicetree/bindings/iio/accel/adi,adxl313.yaml
```yaml
# SPDX-License-Identifier: GPL-2.0-only OR BSD-2-Clause
%YAML 1.2
---
$id: http://devicetree.org/schemas/iio/accel/adi,adxl313.yaml#
$schema: http://devicetree.org/meta-schemas/core.yaml#

title: Analog Devices ADXL312, ADXL313, and ADXL314 3-Axis Digital Accelerometers

maintainers:
  - Lucas Stankus <lucas.p.stankus@gmail.com>

description: |
  Analog Devices ADXL312, ADXL313, and ADXL314 3-Axis Digital Accelerometer that
  support both I2C & SPI interfaces.
    https://www.analog.com/en/products/adxl312.html
    https://www.analog.com/en/products/adxl313.html
    https://www.analog.com/en/products/adxl314.html

properties:
  compatible:
    enum:
      - adi,adxl312
      - adi,adxl313
      - adi,adxl314

  reg:
    maxItems: 1

  spi-3wire: true

  vs-supply:
    description: Regulator that supplies power to the accelerometer

  vdd-supply:
    description: Regulator that supplies the digital interface supply voltage

  interrupts:
    minItems: 1
    maxItems: 2

  interrupt-names:
    minItems: 1
    maxItems: 2
    items:
      enum:
        - INT1
        - INT2

required:
  - compatible
  - reg

allOf:
  - $ref: /schemas/spi/spi-peripheral-props.yaml#

unevaluatedProperties: false

examples:
  - |
    #include <dt-bindings/gpio/gpio.h>
    #include <dt-bindings/interrupt-controller/irq.h>
    i2c0 {
        #address-cells = <1>;
        #size-cells = <0>;

        /* Example for a I2C device node */
        accelerometer@53 {
            compatible = "adi,adxl313";
            reg = <0x53>;
            interrupt-parent = <&gpio0>;
            interrupts = <0 IRQ_TYPE_LEVEL_HIGH>;
            interrupt-names = "INT1";
        };
    };
  - |
    #include <dt-bindings/gpio/gpio.h>
    #include <dt-bindings/interrupt-controller/irq.h>
    spi {
        #address-cells = <1>;
        #size-cells = <0>;

        /* Example for a SPI device node */
        accelerometer@0 {
            compatible = "adi,adxl313";
            reg = <0>;
            spi-max-frequency = <5000000>;
            interrupt-parent = <&gpio0>;
            interrupts = <0 IRQ_TYPE_LEVEL_HIGH>;
            interrupt-names = "INT1";
        };
    };
```

## Documentation/devicetree/bindings/iio/accel/adi,adxl345.yaml
```yaml
# SPDX-License-Identifier: GPL-2.0
%YAML 1.2
---
$id: http://devicetree.org/schemas/iio/accel/adi,adxl345.yaml#
$schema: http://devicetree.org/meta-schemas/core.yaml#

title: Analog Devices ADXL345/ADXL375 3-Axis Digital Accelerometers

maintainers:
  - Michael Hennerich <michael.hennerich@analog.com>

description: |
  Analog Devices ADXL345/ADXL375 3-Axis Digital Accelerometers that supports
  both I2C & SPI interfaces.
    https://www.analog.com/en/products/mems/accelerometers/adxl345.html
    https://www.analog.com/en/products/sensors-mems/accelerometers/adxl375.html

properties:
  compatible:
    oneOf:
      - items:
          - const: adi,adxl346
          - const: adi,adxl345
      - enum:
          - adi,adxl345
          - adi,adxl375

  reg:
    maxItems: 1

  spi-cpha: true

  spi-cpol: true

  interrupts:
    maxItems: 1

required:
  - compatible
  - reg
  - interrupts

unevaluatedProperties: false

examples:
  - |
    #include <dt-bindings/gpio/gpio.h>
    #include <dt-bindings/interrupt-controller/irq.h>
    i2c0 {
        #address-cells = <1>;
        #size-cells = <0>;

        /* Example for a I2C device node */
        accelerometer@2a {
            compatible = "adi,adxl345";
            reg = <0x53>;
            interrupt-parent = <&gpio0>;
            interrupts = <0 IRQ_TYPE_LEVEL_HIGH>;
        };
    };
  - |
    #include <dt-bindings/gpio/gpio.h>
    #include <dt-bindings/interrupt-controller/irq.h>
    spi0 {
        #address-cells = <1>;
        #size-cells = <0>;

        /* Example for a SPI device node */
        accelerometer@0 {
            compatible = "adi,adxl345";
            reg = <0>;
            spi-max-frequency = <5000000>;
            spi-cpol;
            spi-cpha;
            interrupt-parent = <&gpio0>;
            interrupts = <0 IRQ_TYPE_LEVEL_HIGH>;
        };
    };
```

## Documentation/devicetree/bindings/iio/accel/adi,adxl355.yaml
```yaml
# SPDX-License-Identifier: GPL-2.0-only OR BSD-2-Clause
%YAML 1.2
---
$id: http://devicetree.org/schemas/iio/accel/adi,adxl355.yaml#
$schema: http://devicetree.org/meta-schemas/core.yaml#

title: Analog Devices ADXL355 and ADXL359 3-Axis, Low noise MEMS Accelerometers

maintainers:
  - Puranjay Mohan <puranjay12@gmail.com>

description: |
  Analog Devices ADXL355 and ADXL359 3-Axis, Low noise MEMS Accelerometers that
  support both I2C & SPI interfaces
    https://www.analog.com/en/products/adxl355.html
    https://www.analog.com/en/products/adxl359.html

properties:
  compatible:
    enum:
      - adi,adxl355
      - adi,adxl359

  reg:
    maxItems: 1

  interrupts:
    minItems: 1
    maxItems: 3
    description: |
      Type for DRDY should be IRQ_TYPE_EDGE_RISING.
      Three configurable interrupt lines exist.

  interrupt-names:
    description: Specify which interrupt line is in use.
    items:
      enum:
        - INT1
        - INT2
        - DRDY
    minItems: 1
    maxItems: 3

  vdd-supply:
    description: Regulator that provides power to the sensor

  vddio-supply:
    description: Regulator that provides power to the bus

required:
  - compatible
  - reg

allOf:
  - $ref: /schemas/spi/spi-peripheral-props.yaml#

unevaluatedProperties: false

examples:
  - |
    #include <dt-bindings/interrupt-controller/irq.h>
    i2c {
        #address-cells = <1>;
        #size-cells = <0>;

        /* Example for a I2C device node */
        accelerometer@1d {
            compatible = "adi,adxl355";
            reg = <0x1d>;
            interrupt-parent = <&gpio>;
            interrupts = <25 IRQ_TYPE_EDGE_RISING>;
            interrupt-names = "DRDY";
        };
    };
  - |
    #include <dt-bindings/interrupt-controller/irq.h>
    spi {
        #address-cells = <1>;
        #size-cells = <0>;

        accelerometer@0 {
            compatible = "adi,adxl355";
            reg = <0>;
            spi-max-frequency = <1000000>;
            interrupt-parent = <&gpio>;
            interrupts = <25 IRQ_TYPE_EDGE_RISING>;
            interrupt-names = "DRDY";
        };
    };
```

## Documentation/devicetree/bindings/iio/accel/adi,adxl367.yaml
```yaml
# SPDX-License-Identifier: (GPL-2.0-only OR BSD-2-Clause)
%YAML 1.2
---
$id: http://devicetree.org/schemas/iio/accel/adi,adxl367.yaml#
$schema: http://devicetree.org/meta-schemas/core.yaml#

title: Analog Devices ADXL367 3-Axis Digital Accelerometer

maintainers:
  - Cosmin Tanislav <cosmin.tanislav@analog.com>

description: |
  The ADXL367 is an ultralow power, 3-axis MEMS accelerometer.

  The ADXL367 does not alias input signals by to achieve ultralow power
  consumption, it samples the full bandwidth of the sensor at all
  data rates. Measurement ranges of +-2g, +-4g, and +-8g are available,
  with a resolution of 0.25mg/LSB on the +-2 g range.

  In addition to its ultralow power consumption, the ADXL367
  has many features to enable true system level power reduction.
  It includes a deep multimode output FIFO, a built-in micropower
  temperature sensor, and an internal ADC for synchronous conversion
  of an additional analog input.
    https://www.analog.com/en/products/adxl367.html

properties:
  compatible:
    enum:
      - adi,adxl367

  reg:
    maxItems: 1

  interrupts:
    maxItems: 1

  vdd-supply: true
  vddio-supply: true

required:
  - compatible
  - reg
  - interrupts

allOf:
  - $ref: /schemas/spi/spi-peripheral-props.yaml#

unevaluatedProperties: false

examples:
  - |
    #include <dt-bindings/interrupt-controller/irq.h>

    i2c {
      #address-cells = <1>;
      #size-cells = <0>;

      accelerometer@53 {
        compatible = "adi,adxl367";
        reg = <0x53>;
        interrupt-parent = <&gpio>;
        interrupts = <25 IRQ_TYPE_EDGE_RISING>;
      };
    };
  - |
    #include <dt-bindings/interrupt-controller/irq.h>

    spi {
      #address-cells = <1>;
      #size-cells = <0>;

      accelerometer@0 {
        compatible = "adi,adxl367";
        reg = <0>;
        spi-max-frequency = <1000000>;
        interrupt-parent = <&gpio>;
        interrupts = <25 IRQ_TYPE_EDGE_RISING>;
      };
    };
```

## Documentation/devicetree/bindings/iio/accel/adi,adxl372.yaml
```yaml
# SPDX-License-Identifier: GPL-2.0
%YAML 1.2
---
$id: http://devicetree.org/schemas/iio/accel/adi,adxl372.yaml#
$schema: http://devicetree.org/meta-schemas/core.yaml#

title: Analog Devices ADXL372 3-Axis, +/-(200g) Digital Accelerometer

maintainers:
  - Marcelo Schmitt <marcelo.schmitt@analog.com>
  - Nuno Sá <nuno.sa@analog.com>

description: |
  Analog Devices ADXL372 3-Axis, +/-(200g) Digital Accelerometer that supports
  both I2C & SPI interfaces
    https://www.analog.com/en/products/adxl372.html

properties:
  compatible:
    enum:
      - adi,adxl372

  reg:
    maxItems: 1

  interrupts:
    maxItems: 1

required:
  - compatible
  - reg
  - interrupts

allOf:
  - $ref: /schemas/spi/spi-peripheral-props.yaml#

unevaluatedProperties: false

examples:
  - |
    #include <dt-bindings/interrupt-controller/irq.h>
    i2c {
        #address-cells = <1>;
        #size-cells = <0>;

        /* Example for a I2C device node */
        accelerometer@53 {
            compatible = "adi,adxl372";
            reg = <0x53>;
            interrupt-parent = <&gpio>;
            interrupts = <25 IRQ_TYPE_EDGE_FALLING>;
        };
    };
  - |
    #include <dt-bindings/interrupt-controller/irq.h>
    spi {
        #address-cells = <1>;
        #size-cells = <0>;

        accelerometer@0 {
            compatible = "adi,adxl372";
            reg = <0>;
            spi-max-frequency = <1000000>;
            interrupt-parent = <&gpio>;
            interrupts = <25 IRQ_TYPE_EDGE_FALLING>;
        };
    };
```

## Documentation/devicetree/bindings/iio/accel/adi,adxl380.yaml
```yaml
# SPDX-License-Identifier: (GPL-2.0-only OR BSD-2-Clause)
%YAML 1.2
---
$id: http://devicetree.org/schemas/iio/accel/adi,adxl380.yaml#
$schema: http://devicetree.org/meta-schemas/core.yaml#

title: Analog Devices ADXL380/382 3-Axis Digital Accelerometer

maintainers:
  - Ramona Gradinariu <ramona.gradinariu@analog.com>
  - Antoniu Miclaus <antoniu.miclaus@analog.com>

description: |
  The ADXL380/ADXL382 is a low noise density, low power, 3-axis
  accelerometer with selectable measurement ranges. The ADXL380
  supports the ±4 g, ±8 g, and ±16 g ranges, and the ADXL382 supports
  ±15 g, ±30 g, and ±60 g ranges.

  https://www.analog.com/en/products/adxl380.html

properties:
  compatible:
    enum:
      - adi,adxl380
      - adi,adxl382

  reg:
    maxItems: 1

  interrupts:
    minItems: 1
    maxItems: 2

  interrupt-names:
    minItems: 1
    items:
      - enum: [INT0, INT1]
      - const: INT1

  vddio-supply: true

  vsupply-supply: true

required:
  - compatible
  - reg
  - interrupts
  - interrupt-names
  - vddio-supply
  - vsupply-supply

allOf:
  - $ref: /schemas/spi/spi-peripheral-props.yaml#

unevaluatedProperties: false

examples:
  - |
    #include <dt-bindings/interrupt-controller/irq.h>

    i2c {
      #address-cells = <1>;
      #size-cells = <0>;

      accelerometer@54 {
        compatible = "adi,adxl380";
        reg = <0x54>;
        vddio-supply = <&vddio>;
        vsupply-supply = <&vsupply>;
        interrupt-parent = <&gpio>;
        interrupts = <25 IRQ_TYPE_LEVEL_HIGH>;
        interrupt-names = "INT0";
      };
    };
  - |
    #include <dt-bindings/interrupt-controller/irq.h>

    spi {
      #address-cells = <1>;
      #size-cells = <0>;

      accelerometer@0 {
        compatible = "adi,adxl380";
        reg = <0>;
        spi-max-frequency = <8000000>;
        vddio-supply = <&vddio>;
        vsupply-supply = <&vsupply>;
        interrupt-parent = <&gpio>;
        interrupts = <25 IRQ_TYPE_LEVEL_HIGH>;
        interrupt-names = "INT0";
      };
    };
```

## Documentation/devicetree/bindings/iio/accel/adxl345.txt
```
Analog Devices ADXL345 3-Axis, +/-(2g/4g/8g/16g) Digital Accelerometer

http://www.analog.com/en/products/mems/accelerometers/adxl345.html

Required properties:
 - compatible : should be "adi,adxl345"
 - reg : the I2C address or SPI chip select number of the sensor

Required properties for SPI bus usage:
 - spi-max-frequency : set maximum clock frequency, must be 5000000
 - spi-cpol and spi-cpha : must be defined for adxl345 to enable SPI mode 3

Optional properties:
 - interrupt-parent : phandle to the parent interrupt controller as documented
   in Documentation/devicetree/bindings/interrupt-controller/interrupts.txt
 - interrupts: interrupt mapping for IRQ as documented in
   Documentation/devicetree/bindings/interrupt-controller/interrupts.txt

Example for a I2C device node:

	accelerometer@2a {
		compatible = "adi,adxl345";
		reg = <0x53>;
		interrupt-parent = <&gpio1>;
		interrupts = <0 IRQ_TYPE_LEVEL_HIGH>;
	};

Example for a SPI device node:

	accelerometer@0 {
		compatible = "adi,adxl345";
		reg = <0>;
		spi-max-frequency = <5000000>;
		spi-cpol;
		spi-cpha;
		interrupt-parent = <&gpio1>;
		interrupts = <0 IRQ_TYPE_LEVEL_HIGH>;
	};
```
