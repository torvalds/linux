## Documentation/devicetree/bindings/iio/health/ti,afe4403.yaml
```yaml
# SPDX-License-Identifier: (GPL-2.0 OR BSD-2-Clause)
%YAML 1.2
---
$id: http://devicetree.org/schemas/iio/health/ti,afe4403.yaml#
$schema: http://devicetree.org/meta-schemas/core.yaml#

title: Texas Instruments AFE4403 Heart rate and Pulse Oximeter

maintainers:
  - Jonathan Cameron <jic23@kernel.org>

properties:
  compatible:
    const: ti,afe4403

  reg:
    maxItems: 1

  tx-supply:
    description: Supply to transmitting LEDs.

  interrupts:
    maxItems: 1
    description: Connected to ADC_RDY pin.

  reset-gpios: true

  spi-max-frequency: true

additionalProperties: false

required:
  - compatible
  - reg

examples:
  - |
    #include <dt-bindings/gpio/gpio.h>
    #include <dt-bindings/interrupt-controller/irq.h>
    spi {
        #address-cells = <1>;
        #size-cells = <0>;

        heart_mon@0 {
            compatible = "ti,afe4403";
            reg = <0>;
            spi-max-frequency = <10000000>;
            tx-supply = <&vbat>;
            interrupt-parent = <&gpio1>;
            interrupts = <28 IRQ_TYPE_EDGE_RISING>;
            reset-gpios = <&gpio1 16 GPIO_ACTIVE_LOW>;
        };
    };
...
```

## Documentation/devicetree/bindings/iio/humidity/dht11.txt
```
* DHT11 humidity/temperature sensor (and compatibles like DHT22)

Required properties:
  - compatible: Should be "dht11"
  - gpios: Should specify the GPIO connected to the sensor's data
    line, see "gpios property" in
    Documentation/devicetree/bindings/gpio/gpio.txt.

Example:

humidity_sensor {
	compatible = "dht11";
	gpios = <&gpio0 6 0>;
}
```

## Documentation/devicetree/bindings/iio/humidity/dht11.yaml
```yaml
# SPDX-License-Identifier: (GPL-2.0 OR BSD-2-Clause)
%YAML 1.2
---
$id: http://devicetree.org/schemas/iio/humidity/dht11.yaml#
$schema: http://devicetree.org/meta-schemas/core.yaml#

title: DHT11 humidity + temperature sensor

maintainers:
  - Harald Geyer <harald@ccbib.org>

description: |
   A simple and low cost module providing a non standard single GPIO based
   interface.  It is believed the part is made by aosong but don't have
   absolute confirmation of this, or what the aosong part number is.

properties:
  compatible:
    const: dht11

  reg:
    maxItems: 1

  gpios:
    maxItems: 1
    description:
      Single, interrupt capable, GPIO used to communicate with the device.

required:
  - compatible
  - gpios

additionalProperties: false

examples:
  - |
    humidity-sensor {
        compatible = "dht11";
        gpios = <&gpio0 6 0>;
    };
...
```

## Documentation/devicetree/bindings/iio/humidity/hdc100x.txt
```
* HDC100x temperature + humidity sensors

Required properties:
  - compatible: Should contain one of the following:
	ti,hdc1000
	ti,hdc1008
	ti,hdc1010
	ti,hdc1050
	ti,hdc1080
  - reg: i2c address of the sensor

Example:

hdc100x@40 {
	compatible = "ti,hdc1000";
	reg = <0x40>;
};
```

## Documentation/devicetree/bindings/iio/humidity/hts221.txt
```
* HTS221 STM humidity + temperature sensor

Required properties:
- compatible: should be "st,hts221"
- reg: i2c address of the sensor / spi cs line

Optional properties:
- drive-open-drain: the interrupt/data ready line will be configured
  as open drain, which is useful if several sensors share the same
  interrupt line. This is a boolean property.
  If the requested interrupt is configured as IRQ_TYPE_LEVEL_HIGH or
  IRQ_TYPE_EDGE_RISING a pull-down resistor is needed to drive the line
  when it is not active, whereas a pull-up one is needed when interrupt
  line is configured as IRQ_TYPE_LEVEL_LOW or IRQ_TYPE_EDGE_FALLING.
  Refer to pinctrl/pinctrl-bindings.txt for the property description.
- interrupts: interrupt mapping for IRQ. It should be configured with
  flags IRQ_TYPE_LEVEL_HIGH, IRQ_TYPE_EDGE_RISING, IRQ_TYPE_LEVEL_LOW or
  IRQ_TYPE_EDGE_FALLING.

  Refer to interrupt-controller/interrupts.txt for generic interrupt
  client node bindings.

Example:

hts221@5f {
	compatible = "st,hts221";
	reg = <0x5f>;
	interrupt-parent = <&gpio0>;
	interrupts = <0 IRQ_TYPE_EDGE_RISING>;
};
```

## Documentation/devicetree/bindings/iio/humidity/htu21.txt
```
*HTU21 - Measurement-Specialties htu21 temperature & humidity sensor and humidity part of MS8607 sensor

Required properties:

	- compatible: should be "meas,htu21" or "meas,ms8607-humidity"
	- reg: I2C address of the sensor

Example:

htu21@40 {
	compatible = "meas,htu21";
	reg = <0x40>;
};
```

## Documentation/devicetree/bindings/iio/humidity/sciosense,ens210.yaml
```yaml
# SPDX-License-Identifier: (GPL-2.0 OR BSD-2-Clause)
%YAML 1.2
---
$id: http://devicetree.org/schemas/iio/humidity/sciosense,ens210.yaml#
$schema: http://devicetree.org/meta-schemas/core.yaml#

title: ScioSense ENS210 temperature and humidity sensor

maintainers:
  - Joshua Felmeden <jfelmeden@thegoodpenguin.co.uk>

description: |
  Temperature and Humidity sensor.

  Datasheet:
    https://www.sciosense.com/wp-content/uploads/2024/04/ENS21x-Datasheet.pdf
    https://www.sciosense.com/wp-content/uploads/2023/12/ENS210-Datasheet.pdf

properties:
  compatible:
    oneOf:
      - items:
          - enum:
              - sciosense,ens210a
              - sciosense,ens211
              - sciosense,ens212
              - sciosense,ens213a
              - sciosense,ens215
          - const: sciosense,ens210
      - const: sciosense,ens210

  reg:
    maxItems: 1

  vdd-supply: true

required:
  - compatible
  - reg

additionalProperties: false

examples:
  - |
    i2c {
        #address-cells = <1>;
        #size-cells = <0>;

        temperature-sensor@43 {
            compatible = "sciosense,ens210";
            reg = <0x43>;
        };
    };
...
```

## Documentation/devicetree/bindings/iio/humidity/st,hts221.yaml
```yaml
# SPDX-License-Identifier: (GPL-2.0 OR BSD-2-Clause)
%YAML 1.2
---
$id: http://devicetree.org/schemas/iio/humidity/st,hts221.yaml#
$schema: http://devicetree.org/meta-schemas/core.yaml#

title: HTS221 STM humidity + temperature sensor

maintainers:
  - Lorenzo Bianconi <lorenzo@kernel.org>

description: |
   Humidity and temperature sensor with I2C interface and data ready
   interrupt.

properties:
  compatible:
    const: st,hts221

  reg:
    maxItems: 1

  drive-open-drain:
    type: boolean
    description:
      The interrupt/data ready line will be configured as open drain, which
      is useful if several sensors share the same interrupt line.

  vdd-supply: true

  interrupts:
    maxItems: 1

required:
  - compatible
  - reg

additionalProperties: false

examples:
  - |
    #include <dt-bindings/interrupt-controller/irq.h>
    i2c {
        #address-cells = <1>;
        #size-cells = <0>;

        hts221@5f {
            compatible = "st,hts221";
            reg = <0x5f>;
            interrupt-parent = <&gpio0>;
            interrupts = <0 IRQ_TYPE_EDGE_RISING>;
        };
    };
...
```

## Documentation/devicetree/bindings/iio/humidity/ti,hdc2010.yaml
```yaml
# SPDX-License-Identifier: (GPL-2.0-only OR BSD-2-Clause)
%YAML 1.2
---
$id: http://devicetree.org/schemas/iio/humidity/ti,hdc2010.yaml#
$schema: http://devicetree.org/meta-schemas/core.yaml#

title: HDC2010/HDC2080 humidity and temperature iio sensors

maintainers:
  - Eugene Zaikonnikov <ez@norophonic.com>

description: |
  Relative humidity and tempereature sensors on I2C bus

  Datasheets are available at:
    http://www.ti.com/product/HDC2010/datasheet
    http://www.ti.com/product/HDC2080/datasheet

properties:
  compatible:
    enum:
      - ti,hdc2010
      - ti,hdc2080

  vdd-supply: true

  reg:
    maxItems: 1

required:
  - compatible
  - reg

additionalProperties: false

examples:
  - |
    i2c0 {
      #address-cells = <1>;
      #size-cells = <0>;

      humidity@40 {
          compatible = "ti,hdc2010";
          reg = <0x40>;
      };
    };
```

## Documentation/devicetree/bindings/iio/humidity/ti,hdc3020.yaml
```yaml
# SPDX-License-Identifier: (GPL-2.0-only OR BSD-2-Clause)
%YAML 1.2
---
$id: http://devicetree.org/schemas/iio/humidity/ti,hdc3020.yaml#
$schema: http://devicetree.org/meta-schemas/core.yaml#

title: HDC3020/HDC3021/HDC3022 humidity and temperature iio sensors

maintainers:
  - Li peiyu <579lpy@gmail.com>
  - Javier Carrasco <javier.carrasco.cruz@gmail.com>

description:
  https://www.ti.com/lit/ds/symlink/hdc3020.pdf

  The HDC302x is an integrated capacitive based relative humidity (RH)
  and temperature sensor.

properties:
  compatible:
    oneOf:
      - items:
          - enum:
              - ti,hdc3021
              - ti,hdc3022
          - const: ti,hdc3020
      - const: ti,hdc3020

  interrupts:
    maxItems: 1

  vdd-supply: true

  reg:
    maxItems: 1

required:
  - compatible
  - reg
  - vdd-supply

additionalProperties: false

examples:
  - |
    i2c {
        #address-cells = <1>;
        #size-cells = <0>;

        humidity-sensor@47 {
            compatible = "ti,hdc3021", "ti,hdc3020";
            reg = <0x47>;
            vdd-supply = <&vcc_3v3>;
        };
    };
```

## Documentation/devicetree/bindings/iio/iio-bindings.txt
```
This binding is derived from clock bindings, and based on suggestions
from Lars-Peter Clausen [1].

Sources of IIO channels can be represented by any node in the device
tree. Those nodes are designated as IIO providers. IIO consumer
nodes use a phandle and IIO specifier pair to connect IIO provider
outputs to IIO inputs. Similar to the gpio specifiers, an IIO
specifier is an array of one or more cells identifying the IIO
output on a device. The length of an IIO specifier is defined by the
value of a #io-channel-cells property in the IIO provider node.

[1] http://marc.info/?l=linux-iio&m=135902119507483&w=2

==IIO providers==

Required properties:
#io-channel-cells: Number of cells in an IIO specifier; Typically 0 for nodes
		   with a single IIO output and 1 for nodes with multiple
		   IIO outputs.

Example for a simple configuration with no trigger:

	adc: voltage-sensor@35 {
		compatible = "maxim,max1139";
		reg = <0x35>;
		#io-channel-cells = <1>;
	};

Example for a configuration with trigger:

	adc@35 {
		compatible = "some-vendor,some-adc";
		reg = <0x35>;

		adc1: iio-device@0 {
			#io-channel-cells = <1>;
			/* other properties */
		};
		adc2: iio-device@1 {
			#io-channel-cells = <1>;
			/* other properties */
		};
	};

==IIO consumers==

Required properties:
io-channels:	List of phandle and IIO specifier pairs, one pair
		for each IIO input to the device. Note: if the
		IIO provider specifies '0' for #io-channel-cells,
		then only the phandle portion of the pair will appear.

Optional properties:
io-channel-names:
		List of IIO input name strings sorted in the same
		order as the io-channels property. Consumers drivers
		will use io-channel-names to match IIO input names
		with IIO specifiers.
io-channel-ranges:
		Empty property indicating that child nodes can inherit named
		IIO channels from this node. Useful for bus nodes to provide
		and IIO channel to their children.

For example:

	device {
		io-channels = <&adc 1>, <&ref 0>;
		io-channel-names = "vcc", "vdd";
	};

This represents a device with two IIO inputs, named "vcc" and "vdd".
The vcc channel is connected to output 1 of the &adc device, and the
vdd channel is connected to output 0 of the &ref device.

==Example==

	adc: max1139@35 {
		compatible = "maxim,max1139";
		reg = <0x35>;
		#io-channel-cells = <1>;
	};

	...

	iio-hwmon {
		compatible = "iio-hwmon";
		io-channels = <&adc 0>, <&adc 1>, <&adc 2>,
			<&adc 3>, <&adc 4>, <&adc 5>,
			<&adc 6>, <&adc 7>, <&adc 8>,
			<&adc 9>;
	};

	some_consumer {
		compatible = "some-consumer";
		io-channels = <&adc 10>, <&adc 11>;
		io-channel-names = "adc1", "adc2";
	};
```

## Documentation/devicetree/bindings/iio/impedance-analyzer/ad5933.txt
```
Analog Devices AD5933/AD5934 Impedance Converter, Network Analyzer

https://www.analog.com/media/en/technical-documentation/data-sheets/AD5933.pdf
https://www.analog.com/media/en/technical-documentation/data-sheets/AD5934.pdf

Required properties:
 - compatible : should be one of
		"adi,ad5933"
		"adi,ad5934"
 - reg : the I2C address.
 - vdd-supply : The regulator supply for DVDD, AVDD1 and AVDD2 when they
   are connected together.

Optional properties:
- clocks : external clock reference.
- clock-names : must be "mclk" if clocks is set.

Example for a I2C device node:

	impedance-analyzer@0d {
		compatible = "adi,adxl345";
		reg = <0x0d>;
		vdd-supply = <&vdd_supply>;
		clocks = <&ref_clk>;
		clock-names = "mclk";
	};
```

## Documentation/devicetree/bindings/iio/impedance-analyzer/adi,ad5933.yaml
```yaml
# SPDX-License-Identifier: (GPL-2.0 OR BSD-2-Clause)
%YAML 1.2
---
$id: http://devicetree.org/schemas/iio/impedance-analyzer/adi,ad5933.yaml#
$schema: http://devicetree.org/meta-schemas/core.yaml#

title: Analog Devices AD5933/AD5934 Impedance Converter, Network Analyzer

maintainers:
  - Marcelo Schmitt <marcelo.schmitt1@gmail.com>
  - Gabriel Capella <gabriel@capella.pro>

description: |
  https://www.analog.com/media/en/technical-documentation/data-sheets/AD5933.pdf
  https://www.analog.com/media/en/technical-documentation/data-sheets/AD5934.pdf

properties:
  compatible:
    enum:
      - adi,ad5933
      - adi,ad5934

  reg:
    maxItems: 1

  vdd-supply:
    description: |
      The regulator supply for DVDD, AVDD1 and AVDD2 when they
      are connected together.  Used to calculate voltage scaling of measurement
      channels.

  clocks:
    maxItems: 1

  clock-names:
    const: mclk

additionalProperties: false

required:
  - compatible
  - reg
  - vdd-supply

examples:
  - |
    i2c {
        #address-cells = <1>;
        #size-cells = <0>;

        impedance-analyzer@d {
            compatible = "adi,ad5933";
            reg = <0x0d>;
            vdd-supply = <&vdd_supply>;
            clocks = <&ref_clk>;
            clock-names = "mclk";
        };
    };
...
```

## Documentation/devicetree/bindings/iio/imu/adi,adis16460.yaml
```yaml
# SPDX-License-Identifier: GPL-2.0
%YAML 1.2
---
$id: http://devicetree.org/schemas/iio/imu/adi,adis16460.yaml#
$schema: http://devicetree.org/meta-schemas/core.yaml#

title: Analog Devices ADIS16460 and similar IMUs

maintainers:
  - Dragos Bogdan <dragos.bogdan@analog.com>

description: |
  Analog Devices ADIS16460 and similar IMUs
  https://www.analog.com/media/en/technical-documentation/data-sheets/ADIS16460.pdf

properties:
  compatible:
    enum:
      - adi,adis16460

  reg:
    maxItems: 1

  spi-cpha: true

  spi-cpol: true

  spi-cs-inactive-delay-ns:
    minimum: 16000
    default: 16000

  interrupts:
    maxItems: 1

required:
  - compatible
  - reg
  - interrupts

allOf:
  - $ref: /schemas/spi/spi-peripheral-props.yaml#

unevaluatedProperties: false

examples:
  - |
    #include <dt-bindings/interrupt-controller/irq.h>
    spi {
        #address-cells = <1>;
        #size-cells = <0>;

        imu@0 {
            compatible = "adi,adis16460";
            reg = <0>;
            spi-max-frequency = <5000000>;
            spi-cpol;
            spi-cpha;
            interrupt-parent = <&gpio0>;
            interrupts = <0 IRQ_TYPE_LEVEL_HIGH>;
        };
    };
```
