## Documentation/devicetree/bindings/iio/imu/adi,adis16475.yaml
```yaml
# SPDX-License-Identifier: (GPL-2.0-only OR BSD-2-Clause)
%YAML 1.2
---
$id: http://devicetree.org/schemas/iio/imu/adi,adis16475.yaml#
$schema: http://devicetree.org/meta-schemas/core.yaml#

title: Analog Devices ADIS16475 and similar IMUs

maintainers:
  - Nuno Sá <nuno.sa@analog.com>

description: |
  Analog Devices ADIS16475 and similar IMUs
  https://www.analog.com/media/en/technical-documentation/data-sheets/ADIS16475.pdf

properties:
  compatible:
    enum:
      - adi,adis16475-1
      - adi,adis16475-2
      - adi,adis16475-3
      - adi,adis16477-1
      - adi,adis16477-2
      - adi,adis16477-3
      - adi,adis16470
      - adi,adis16465-1
      - adi,adis16465-2
      - adi,adis16465-3
      - adi,adis16467-1
      - adi,adis16467-2
      - adi,adis16467-3
      - adi,adis16500
      - adi,adis16505-1
      - adi,adis16505-2
      - adi,adis16505-3
      - adi,adis16507-1
      - adi,adis16507-2
      - adi,adis16507-3

  reg:
    maxItems: 1

  spi-cpha: true

  spi-cpol: true

  spi-max-frequency:
    maximum: 2000000

  interrupts:
    maxItems: 1

  clocks:
    maxItems: 1

  reset-gpios:
    description:
      Must be the device tree identifier of the RESET pin. If specified,
      it will be asserted during driver probe. As the line is active low,
      it should be marked GPIO_ACTIVE_LOW.
    maxItems: 1

  adi,sync-mode:
    description:
      Configures the device SYNC pin. The following modes are supported
      0 - output_sync
      1 - direct_sync
      2 - scaled_sync
      3 - pulse_sync
    $ref: /schemas/types.yaml#/definitions/uint32
    minimum: 0
    maximum: 3

required:
  - compatible
  - reg
  - interrupts
  - spi-cpha
  - spi-cpol

allOf:
  - if:
      properties:
        compatible:
          contains:
            enum:
              - adi,adis16500
              - adi,adis16505-1
              - adi,adis16505-2
              - adi,adis16505-3
              - adi,adis16507-1
              - adi,adis16507-2
              - adi,adis16507-3

    then:
      properties:
        adi,sync-mode:
          minimum: 0
          maximum: 2

  - if:
      properties:
        adi,sync-mode:
          enum: [1, 2, 3]

    then:
      dependencies:
        adi,sync-mode: [ clocks ]

additionalProperties: false

examples:
  - |
    #include <dt-bindings/interrupt-controller/irq.h>
    spi {
            #address-cells = <1>;
            #size-cells = <0>;

            adis16475: adis16475-3@0 {
                    compatible = "adi,adis16475-3";
                    reg = <0>;
                    spi-cpha;
                    spi-cpol;
                    spi-max-frequency = <2000000>;
                    interrupts = <4 IRQ_TYPE_EDGE_RISING>;
                    interrupt-parent = <&gpio>;
            };
    };
...
```

## Documentation/devicetree/bindings/iio/imu/adi,adis16480.txt
```
Analog Devices ADIS16480 and similar IMUs

Required properties for the ADIS16480:

- compatible: Must be one of
	* "adi,adis16375"
	* "adi,adis16480"
	* "adi,adis16485"
	* "adi,adis16488"
	* "adi,adis16490"
	* "adi,adis16495-1"
	* "adi,adis16495-2"
	* "adi,adis16495-3"
	* "adi,adis16497-1"
	* "adi,adis16497-2"
	* "adi,adis16497-3"
- reg: SPI chip select number for the device
- spi-max-frequency: Max SPI frequency to use
	see: Documentation/devicetree/bindings/spi/spi-bus.txt
- spi-cpha: See Documentation/devicetree/bindings/spi/spi-bus.txt
- spi-cpol: See Documentation/devicetree/bindings/spi/spi-bus.txt
- interrupts: interrupt mapping for IRQ, accepted values are:
	* IRQF_TRIGGER_RISING
	* IRQF_TRIGGER_FALLING

Optional properties:

- interrupt-names: Data ready line selection. Valid values are:
	* DIO1
	* DIO2
	* DIO3
	* DIO4
	If this field is left empty, DIO1 is assigned as default data ready
	signal.
- reset-gpios: must be the device tree identifier of the RESET pin. As the line
	is active low, it should be marked GPIO_ACTIVE_LOW.
- clocks: phandle to the external clock. Should be set according to
	"clock-names".
	If this field is left empty together with the "clock-names" field, then
	the internal clock is used.
- clock-names: The name of the external clock to be used. Valid values are:
	* sync: In sync mode, the internal clock is disabled and the frequency
		of the external clock signal establishes therate of data
		collection and processing. See Fig 14 and 15 in the datasheet.
		The clock-frequency must be:
		* 3000 to 4500 Hz for adis1649x devices.
		* 700 to 2400 Hz for adis1648x devices.
	* pps: In Pulse Per Second (PPS) Mode, the rate of data collection and
	       production is equal to the product of the external clock
	       frequency and the scale factor in the SYNC_SCALE register, see
	       Table 154 in the datasheet.
	       The clock-frequency must be:
	       * 1 to 128 Hz for adis1649x devices.
	       * This mode is not supported by adis1648x devices.
	If this field is left empty together with the "clocks" field, then the
	internal clock is used.
- adi,ext-clk-pin: The DIOx line to be used as an external clock input.
	Valid values are:
	* DIO1
	* DIO2
	* DIO3
	* DIO4
	Each DIOx pin supports only one function at a time (data ready line
	selection or external clock input). When a single pin has two
	two assignments, the enable bit for the lower priority function
	automatically resets to zero (disabling the lower priority function).
	Data ready has highest priority.
	If this field is left empty, DIO2 is assigned as default external clock
	input pin.

Example:

	imu@0 {
		compatible = "adi,adis16495-1";
		reg = <0>;
		spi-max-frequency = <3200000>;
		spi-cpol;
		spi-cpha;
		interrupts = <25 IRQF_TRIGGER_FALLING>;
		interrupt-parent = <&gpio>;
		interrupt-names = "DIO2";
		clocks = <&adis16495_sync>;
		clock-names = "sync";
		adi,ext-clk-pin = "DIO1";
	};
```

## Documentation/devicetree/bindings/iio/imu/adi,adis16480.yaml
```yaml
# SPDX-License-Identifier: (GPL-2.0 OR BSD-2-Clause)
%YAML 1.2
---
$id: http://devicetree.org/schemas/iio/imu/adi,adis16480.yaml#
$schema: http://devicetree.org/meta-schemas/core.yaml#

title: Analog Devices ADIS16480 and similar IMUs

maintainers:
  - Alexandru Tachici <alexandru.tachici@analog.com>

properties:
  compatible:
    enum:
      - adi,adis16375
      - adi,adis16480
      - adi,adis16485
      - adi,adis16488
      - adi,adis16490
      - adi,adis16495-1
      - adi,adis16495-2
      - adi,adis16495-3
      - adi,adis16497-1
      - adi,adis16497-2
      - adi,adis16497-3
      - adi,adis16545-1
      - adi,adis16545-2
      - adi,adis16545-3
      - adi,adis16547-1
      - adi,adis16547-2
      - adi,adis16547-3

  reg:
    maxItems: 1

  interrupts:
    minItems: 1
    maxItems: 2
    description: |
      Accepted interrupt types are:
      * IRQ_TYPE_EDGE_RISING
      * IRQ_TYPE_EDGE_FALLING

  interrupt-names:
    minItems: 1
    maxItems: 2
    description:
      Default if not supplied is DIO1.
    items:
      enum:
        - DIO1
        - DIO2
        - DIO3
        - DIO4

  spi-cpha: true
  spi-cpol: true

  reset-gpios:
    maxItems: 1
    description: Connected to RESET pin which is active low.

  clocks:
    maxItems: 1
    description: If not provided, then the internal clock is used.

  clock-names:
    description: |
      sync: In sync mode, the internal clock is disabled and the frequency
            of the external clock signal establishes therate of data
            collection and processing. See Fig 14 and 15 in the datasheet.
            The clock-frequency must be:
            * 3000 to 4500 Hz for adis1649x devices.
            * 700 to 2400 Hz for adis1648x devices.
      pps:  In Pulse Per Second (PPS) Mode, the rate of data collection and
            production is equal to the product of the external clock
            frequency and the scale factor in the SYNC_SCALE register, see
            Table 154 in the datasheet.
            The clock-frequency must be:
            * 1 to 128 Hz for adis1649x devices.
            * This mode is not supported by adis1648x devices.
    enum:
      - sync
      - pps

  adi,ext-clk-pin:
    $ref: /schemas/types.yaml#/definitions/string
    description: |
      The DIOx line to be used as an external clock input.
      Each DIOx pin supports only one function at a time (data ready line
      selection or external clock input). When a single pin has two
      two assignments, the enable bit for the lower priority function
      automatically resets to zero (disabling the lower priority function).
      Data ready has highest priority.
      If not provided then DIO2 is assigned as default external clock
      input pin.
    enum:
      - DIO1
      - DIO2
      - DIO3
      - DIO4

required:
  - compatible
  - reg
  - interrupts
  - spi-cpha
  - spi-cpol
  - spi-max-frequency

allOf:
  - $ref: /schemas/spi/spi-peripheral-props.yaml#

unevaluatedProperties: false

examples:
  - |
    #include <dt-bindings/interrupt-controller/irq.h>
    spi {
        #address-cells = <1>;
        #size-cells = <0>;

        imu@0 {
            compatible = "adi,adis16495-1";
            reg = <0>;
            spi-max-frequency = <3200000>;
            spi-cpol;
            spi-cpha;
            interrupts = <25 IRQ_TYPE_EDGE_FALLING>;
            interrupt-parent = <&gpio>;
            interrupt-names = "DIO2";
            clocks = <&adis16495_sync>;
            clock-names = "sync";
            adi,ext-clk-pin = "DIO1";
        };
    };
...
```

## Documentation/devicetree/bindings/iio/imu/adi,adis16550.yaml
```yaml
# SPDX-License-Identifier: (GPL-2.0 OR BSD-2-Clause)
%YAML 1.2
---
$id: http://devicetree.org/schemas/iio/imu/adi,adis16550.yaml#
$schema: http://devicetree.org/meta-schemas/core.yaml#

title: Analog Devices ADIS16550 and similar IMUs

maintainers:
  - Nuno Sa <nuno.sa@analog.com>
  - Ramona Gradinariu <ramona.gradinariu@analog.com>
  - Antoniu Miclaus <antoniu.miclaus@analog.com>
  - Robert Budai <robert.budai@analog.com>

properties:
  compatible:
    enum:
      - adi,adis16550

  reg:
    maxItems: 1

  spi-cpha: true

  spi-cpol: true

  spi-max-frequency:
    maximum: 15000000

  vdd-supply: true

  interrupts:
    maxItems: 1

  reset-gpios:
    description:
      Active low RESET pin.
    maxItems: 1

  clocks:
    description: If not provided, then the internal clock is used.
    maxItems: 1

required:
  - compatible
  - reg
  - interrupts
  - spi-cpha
  - spi-cpol
  - spi-max-frequency
  - vdd-supply

allOf:
  - $ref: /schemas/spi/spi-peripheral-props.yaml#

unevaluatedProperties: false

examples:
  - |
    #include <dt-bindings/interrupt-controller/irq.h>
    spi {
        #address-cells = <1>;
        #size-cells = <0>;
        imu@0 {
            compatible = "adi,adis16550";
            reg = <0>;
            spi-max-frequency = <15000000>;
            spi-cpol;
            spi-cpha;
            vdd-supply = <&vdd>;
            interrupts = <4 IRQ_TYPE_EDGE_FALLING>;
            interrupt-parent = <&gpio>;
        };
    };
```

## Documentation/devicetree/bindings/iio/imu/bmi160.txt
```
Bosch BMI160 - Inertial Measurement Unit with Accelerometer, Gyroscope
and externally connectable Magnetometer

https://www.bosch-sensortec.com/bst/products/all_products/bmi160

Required properties:
 - compatible : should be "bosch,bmi160"
 - reg : the I2C address or SPI chip select number of the sensor
 - spi-max-frequency : set maximum clock frequency (only for SPI)

Optional properties:
 - interrupt-parent : should be the phandle of the interrupt controller
 - interrupts : interrupt mapping for IRQ, must be IRQ_TYPE_LEVEL_LOW
 - interrupt-names : set to "INT1" if INT1 pin should be used as interrupt
   input, set to "INT2" if INT2 pin should be used instead

Examples:

bmi160@68 {
	compatible = "bosch,bmi160";
	reg = <0x68>;

	interrupt-parent = <&gpio4>;
	interrupts = <12 IRQ_TYPE_LEVEL_LOW>;
	interrupt-names = "INT1";
};

bmi160@0 {
	compatible = "bosch,bmi160";
	reg = <0>;
	spi-max-frequency = <10000000>;

	interrupt-parent = <&gpio2>;
	interrupts = <12 IRQ_TYPE_LEVEL_LOW>;
	interrupt-names = "INT2";
};
```

## Documentation/devicetree/bindings/iio/imu/bosch,bmi160.yaml
```yaml
# SPDX-License-Identifier: (GPL-2.0 OR BSD-2-Clause)
%YAML 1.2
---
$id: http://devicetree.org/schemas/iio/imu/bosch,bmi160.yaml#
$schema: http://devicetree.org/meta-schemas/core.yaml#

title: Bosch BMI160

maintainers:
  - Jonathan Cameron <jic23@kernel.org>

description: |
  Inertial Measurement Unit with Accelerometer, Gyroscope and externally
  connectable Magnetometer
  https://www.bosch-sensortec.com/bst/products/all_products/bmi160

properties:
  compatible:
    oneOf:
      - const: bosch,bmi160
      - items:
          - const: bosch,bmi120
          - const: bosch,bmi160

  reg:
    maxItems: 1

  interrupts:
    maxItems: 1

  interrupt-names:
    enum:
      - INT1
      - INT2
    description: |
      set to "INT1" if INT1 pin should be used as interrupt input, set
      to "INT2" if INT2 pin should be used instead

  drive-open-drain:
    type: boolean
    description: |
      set if the specified interrupt pin should be configured as
      open drain. If not set, defaults to push-pull.

  vdd-supply:
    description: provide VDD power to the sensor.

  vddio-supply:
    description: provide VDD IO power to the sensor.

  mount-matrix:
    description: an optional 3x3 mounting rotation matrix

required:
  - compatible
  - reg

allOf:
  - $ref: /schemas/spi/spi-peripheral-props.yaml#

unevaluatedProperties: false

examples:
  - |
    // Example for I2C
    #include <dt-bindings/interrupt-controller/irq.h>
    i2c {
        #address-cells = <1>;
        #size-cells = <0>;

        bmi160@68 {
            compatible = "bosch,bmi160";
            reg = <0x68>;
            vdd-supply = <&pm8916_l17>;
            vddio-supply = <&pm8916_l6>;
            interrupt-parent = <&gpio4>;
            interrupts = <12 IRQ_TYPE_EDGE_RISING>;
            interrupt-names = "INT1";
            mount-matrix = "0", "1", "0",
                           "-1", "0", "0",
                           "0", "0", "1";
        };
    };
  - |
    // Example for SPI
    #include <dt-bindings/interrupt-controller/irq.h>
    spi {
        #address-cells = <1>;
        #size-cells = <0>;

        bmi160@0 {
            compatible = "bosch,bmi160";
            reg = <0>;
            spi-max-frequency = <10000000>;
            interrupt-parent = <&gpio2>;
            interrupts = <12 IRQ_TYPE_EDGE_RISING>;
            interrupt-names = "INT2";
        };
    };
```
