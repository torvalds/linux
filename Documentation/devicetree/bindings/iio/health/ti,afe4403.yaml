## Documentation/devicetree/bindings/iio/imu/bosch,bmi270.yaml
```yaml
# SPDX-License-Identifier: (GPL-2.0 OR BSD-2-Clause)
%YAML 1.2
---
$id: http://devicetree.org/schemas/iio/imu/bosch,bmi270.yaml#
$schema: http://devicetree.org/meta-schemas/core.yaml#

title: Bosch BMI270 6-Axis IMU

maintainers:
  - Alex Lanzano <lanzano.alex@gmail.com>

description: |
  BMI270 is a 6-axis inertial measurement unit that can measure acceleration and
  angular velocity. The sensor also supports configurable interrupt events such
  as motion, step counter, and wrist motion gestures. The sensor can communicate
  I2C or SPI.
  https://www.bosch-sensortec.com/products/motion-sensors/imus/bmi270/

properties:
  compatible:
    enum:
      - bosch,bmi260
      - bosch,bmi270

  reg:
    maxItems: 1

  vdd-supply: true
  vddio-supply: true

  interrupts:
    minItems: 1
    maxItems: 2

  interrupt-names:
    minItems: 1
    maxItems: 2
    items:
      enum:
        - INT1
        - INT2

  drive-open-drain:
    type: boolean
    description:
      set if the specified interrupt pins should be configured as
      open drain. If not set, defaults to push-pull.

  mount-matrix:
    description:
      an optional 3x3 mounting rotation matrix.

required:
  - compatible
  - reg
  - vdd-supply
  - vddio-supply

allOf:
  - $ref: /schemas/spi/spi-peripheral-props.yaml#

unevaluatedProperties: false

examples:
  - |
    #include <dt-bindings/interrupt-controller/irq.h>
    i2c {
        #address-cells = <1>;
        #size-cells = <0>;

        imu@68 {
            compatible = "bosch,bmi270";
            reg = <0x68>;
            vdd-supply = <&vdd>;
            vddio-supply = <&vddio>;
            interrupt-parent = <&gpio1>;
            interrupts = <16 IRQ_TYPE_EDGE_RISING>;
            interrupt-names = "INT1";
        };
    };
```

## Documentation/devicetree/bindings/iio/imu/bosch,bmi323.yaml
```yaml
# SPDX-License-Identifier: (GPL-2.0 OR BSD-2-Clause)
%YAML 1.2
---
$id: http://devicetree.org/schemas/iio/imu/bosch,bmi323.yaml#
$schema: http://devicetree.org/meta-schemas/core.yaml#

title: Bosch BMI323 6-Axis IMU

maintainers:
  - Jagath Jog J <jagathjog1996@gmail.com>

description:
  BMI323 is a 6-axis inertial measurement unit that supports acceleration and
  gyroscopic measurements with hardware fifo buffering. Sensor also provides
  events information such as motion, steps, orientation, single and double
  tap detection.

properties:
  compatible:
    const: bosch,bmi323

  reg:
    maxItems: 1

  vdd-supply: true
  vddio-supply: true

  interrupts:
    minItems: 1
    maxItems: 2

  interrupt-names:
    minItems: 1
    maxItems: 2
    items:
      enum:
        - INT1
        - INT2

  drive-open-drain:
    description:
      set if the specified interrupt pin should be configured as
      open drain. If not set, defaults to push-pull.

  mount-matrix:
    description:
      an optional 3x3 mounting rotation matrix.

required:
  - compatible
  - reg
  - vdd-supply
  - vddio-supply

allOf:
  - $ref: /schemas/spi/spi-peripheral-props.yaml#

unevaluatedProperties: false

examples:
  - |
    // Example for I2C
    #include <dt-bindings/interrupt-controller/irq.h>
    i2c {
        #address-cells = <1>;
        #size-cells = <0>;

        imu@68 {
            compatible = "bosch,bmi323";
            reg = <0x68>;
            vddio-supply = <&vddio>;
            vdd-supply = <&vdd>;
            interrupt-parent = <&gpio1>;
            interrupts = <29 IRQ_TYPE_EDGE_RISING>;
            interrupt-names = "INT1";
        };
    };
```

## Documentation/devicetree/bindings/iio/imu/bosch,bno055.yaml
```yaml
# SPDX-License-Identifier: (GPL-2.0-only OR BSD-2-Clause)
%YAML 1.2
---
$id: http://devicetree.org/schemas/iio/imu/bosch,bno055.yaml#
$schema: http://devicetree.org/meta-schemas/core.yaml#

title: Bosch BNO055

maintainers:
  - Andrea Merello <andrea.merello@iit.it>

description: |
  Inertial Measurement Unit with Accelerometer, Gyroscope, Magnetometer and
  internal MCU for sensor fusion
  https://www.bosch-sensortec.com/products/smart-sensors/bno055/

properties:
  compatible:
    enum:
      - bosch,bno055

  reg:
    maxItems: 1

  reset-gpios:
    maxItems: 1

  clocks:
    maxItems: 1

required:
  - compatible

additionalProperties: false

examples:
  - |
    #include <dt-bindings/gpio/gpio.h>
    serial {
      imu {
        compatible = "bosch,bno055";
        reset-gpios = <&gpio0 54 GPIO_ACTIVE_LOW>;
        clocks = <&imu_clk>;
      };
    };

  - |
    #include <dt-bindings/gpio/gpio.h>
    i2c {
      #address-cells = <1>;
      #size-cells = <0>;

      imu@28 {
        compatible = "bosch,bno055";
        reg = <0x28>;
        reset-gpios = <&gpio0 54 GPIO_ACTIVE_LOW>;
        clocks = <&imu_clk>;
      };
    };
```

## Documentation/devicetree/bindings/iio/imu/bosch,smi240.yaml
```yaml
# SPDX-License-Identifier: (GPL-2.0 OR BSD-2-Clause)
%YAML 1.2
---
$id: http://devicetree.org/schemas/iio/imu/bosch,smi240.yaml#
$schema: http://devicetree.org/meta-schemas/core.yaml#

title: Bosch smi240 imu

maintainers:
  - Jianping Shen <Jianping.Shen@de.bosch.com>

description:
  Inertial Measurement Unit with Accelerometer and Gyroscope
  with a measurement range of +/-300°/s and up to 16g.
  https://www.bosch-semiconductors.com/mems-sensors/highly-automated-driving/smi240/

properties:
  compatible:
    const: bosch,smi240

  reg:
    maxItems: 1

  vdd-supply: true
  vddio-supply: true

required:
  - compatible
  - reg
  - vdd-supply
  - vddio-supply

allOf:
  - $ref: /schemas/spi/spi-peripheral-props.yaml#

unevaluatedProperties: false

examples:
  - |
    spi {
        #address-cells = <1>;
        #size-cells = <0>;

        imu@0 {
            compatible = "bosch,smi240";
            reg = <0>;
            vdd-supply = <&vdd>;
            vddio-supply = <&vddio>;
            spi-max-frequency = <10000000>;
        };
    };
```

## Documentation/devicetree/bindings/iio/imu/bosch,smi330.yaml
```yaml
# SPDX-License-Identifier: (GPL-2.0 OR BSD-2-Clause)
%YAML 1.2
---
$id: http://devicetree.org/schemas/iio/imu/bosch,smi330.yaml#
$schema: http://devicetree.org/meta-schemas/core.yaml#

title: Bosch SMI330 6-Axis IMU

maintainers:
  - Stefan Gutmann <stefam.gutmann@de.bosch.com>

description:
  SMI330 is a 6-axis inertial measurement unit that supports acceleration and
  gyroscopic measurements with hardware fifo buffering. Sensor also provides
  events information such as motion, no-motion and tilt detection.

properties:
  compatible:
    const: bosch,smi330

  reg:
    maxItems: 1

  vdd-supply:
    description: provide VDD power to the sensor.

  vddio-supply:
    description: provide VDD IO power to the sensor.

  interrupts:
    minItems: 1
    maxItems: 2

  interrupt-names:
    minItems: 1
    maxItems: 2
    items:
      enum:
        - INT1
        - INT2

  drive-open-drain:
    type: boolean
    description:
      set if the interrupt pin(s) should be configured as
      open drain. If not set, defaults to push-pull.

required:
  - compatible
  - reg

allOf:
  - $ref: /schemas/spi/spi-peripheral-props.yaml#

unevaluatedProperties: false

examples:
  - |
    // Example for I2C
    #include <dt-bindings/interrupt-controller/irq.h>
    i2c {
        #address-cells = <1>;
        #size-cells = <0>;

        imu@68 {
            compatible = "bosch,smi330";
            reg = <0x68>;
            vddio-supply = <&vddio>;
            vdd-supply = <&vdd>;
            interrupt-parent = <&gpio>;
            interrupts = <26 IRQ_TYPE_EDGE_RISING>;
            interrupt-names = "INT1";
        };
    };

    // Example for SPI
    #include <dt-bindings/interrupt-controller/irq.h>
    spi {
        #address-cells = <1>;
        #size-cells = <0>;

        imu@0 {
            compatible = "bosch,smi330";
            reg = <0>;
            spi-max-frequency = <10000000>;
            interrupt-parent = <&gpio>;
            interrupts = <26 IRQ_TYPE_EDGE_RISING>;
            interrupt-names = "INT1";
        };
    };
```
