## Documentation/devicetree/bindings/iio/potentiostat/lmp91000.txt
```
* Texas Instruments LMP91000 series of potentiostats

LMP91000: https://www.ti.com/lit/ds/symlink/lmp91000.pdf
LMP91002: https://www.ti.com/lit/ds/symlink/lmp91002.pdf

Required properties:

  - compatible: should be one of the following:
                 "ti,lmp91000"
                 "ti,lmp91002"
  - reg: the I2C address of the device
  - io-channels: the phandle of the iio provider

  - ti,external-tia-resistor: if the property ti,tia-gain-ohm is not defined this
    needs to be set to signal that an external resistor value is being used.

Optional properties:

  - ti,tia-gain-ohm: ohm value of the internal resistor for the transimpedance
    amplifier. Must be 2750, 3500, 7000, 14000, 35000, 120000, or 350000 ohms.

  - ti,rload-ohm: ohm value of the internal resistor load applied to the gas
    sensor. Must be 10, 33, 50, or 100 (default) ohms.

Example:

lmp91000@48 {
	compatible = "ti,lmp91000";
	reg = <0x48>;
	ti,tia-gain-ohm = <7500>;
	ti,rload = <100>;
	io-channels = <&adc>;
};
```

## Documentation/devicetree/bindings/iio/potentiostat/ti,lmp91000.yaml
```yaml
# SPDX-License-Identifier: (GPL-2.0 OR BSD-2-Clause)
%YAML 1.2
---
$id: http://devicetree.org/schemas/iio/potentiostat/ti,lmp91000.yaml#
$schema: http://devicetree.org/meta-schemas/core.yaml#

title: Texas Instruments LMP91000 series of potentiostats with I2C control

maintainers:
  - Matt Ranostay <matt.ranostay@konsulko.com>

description: |
  Typically used as a signal conditioner for chemical sensors.
  LMP91000: https://www.ti.com/lit/ds/symlink/lmp91000.pdf
  LMP91002: https://www.ti.com/lit/ds/symlink/lmp91002.pdf

properties:
  compatible:
    enum:
      - ti,lmp91000
      - ti,lmp91002

  reg:
    maxItems: 1

  io-channels:
    maxItems: 1

  ti,external-tia-resistor:
    $ref: /schemas/types.yaml#/definitions/flag
    description:
      If the property ti,tia-gain-ohm is not defined this needs to be set to
      signal that an external resistor value is being used.

  ti,tia-gain-ohm:
    $ref: /schemas/types.yaml#/definitions/uint32
    enum: [2750, 3500, 7000, 14000, 35000, 120000, 350000]
    description:
      Internal resistor for the transimpedance amplifier.

  ti,rload-ohm:
    $ref: /schemas/types.yaml#/definitions/uint32
    enum: [10, 33, 50, 100]
    description:
      Internal resistor load applied to the gas sensor.
      Default 100 Ohms.

required:
  - compatible
  - reg
  - io-channels

additionalProperties: false

examples:
  - |
    i2c {
        #address-cells = <1>;
        #size-cells = <0>;
        lmp91000@48 {
            compatible = "ti,lmp91000";
            reg = <0x48>;
            ti,tia-gain-ohm = <7000>;
            ti,rload-ohm = <100>;
            io-channels = <&adc>;
        };
    };
...
```

## Documentation/devicetree/bindings/iio/pressure/aosong,adp810.yaml
```yaml
# SPDX-License-Identifier: (GPL-2.0 OR BSD-2-Clause)
%YAML 1.2
---
$id: http://devicetree.org/schemas/iio/pressure/aosong,adp810.yaml#
$schema: http://devicetree.org/meta-schemas/core.yaml#

title: aosong adp810 differential pressure sensor

maintainers:
  - Akhilesh Patil <akhilesh@ee.iitb.ac.in>

description:
  ADP810 is differential pressure and temperature sensor. It has I2C bus
  interface with fixed address of 0x25. This sensor supports 8 bit CRC for
  reliable data transfer. It can measure differential pressure in the
  range -500 to 500Pa and temperate in the range -40 to +85 degree celsius.

properties:
  compatible:
    enum:
      - aosong,adp810

  reg:
    maxItems: 1

  vdd-supply: true

required:
  - compatible
  - reg
  - vdd-supply

additionalProperties: false

examples:
  - |
    i2c {
        #address-cells = <1>;
        #size-cells = <0>;
        pressure-sensor@25 {
            compatible = "aosong,adp810";
            reg = <0x25>;
            vdd-supply = <&vdd_regulator>;
        };
    };
```

## Documentation/devicetree/bindings/iio/pressure/asc,dlhl60d.yaml
```yaml
# SPDX-License-Identifier: (GPL-2.0-only OR BSD-2-Clause)
%YAML 1.2
---
$id: http://devicetree.org/schemas/iio/pressure/asc,dlhl60d.yaml#
$schema: http://devicetree.org/meta-schemas/core.yaml#

title: All Sensors DLH series low voltage digital pressure sensors

maintainers:
  - Tomislav Denis <tomislav.denis@avl.com>

description: |
  Bindings for the All Sensors DLH series pressure sensors.

  Specifications about the sensors can be found at:
    https://www.allsensors.com/cad/DS-0355_Rev_B.PDF

properties:
  compatible:
    enum:
      - asc,dlhl60d
      - asc,dlhl60g

  reg:
    description: I2C device address
    maxItems: 1

  interrupts:
    description: interrupt mapping for EOC(data ready) pin
    maxItems: 1

required:
  - compatible
  - reg

additionalProperties: false

examples:
  - |
    #include <dt-bindings/interrupt-controller/irq.h>

    i2c0 {
        #address-cells = <1>;
        #size-cells = <0>;

        pressure@29 {
            compatible = "asc,dlhl60d";
            reg = <0x29>;
            interrupt-parent = <&gpio0>;
            interrupts = <10 IRQ_TYPE_EDGE_RISING>;
        };
    };
...
```

## Documentation/devicetree/bindings/iio/pressure/bmp085.txt
```
BMP085/BMP18x/BMP28x digital pressure sensors

Required properties:
- compatible: must be one of:
  "bosch,bmp085"
  "bosch,bmp180"
  "bosch,bmp280"
  "bosch,bme280"

Optional properties:
- interrupts: interrupt mapping for IRQ
- reset-gpios: a GPIO line handling reset of the sensor: as the line is
  active low, it should be marked GPIO_ACTIVE_LOW (see gpio/gpio.txt)
- vddd-supply: digital voltage regulator (see regulator/regulator.txt)
- vdda-supply: analog voltage regulator (see regulator/regulator.txt)

Example:

pressure@77 {
	compatible = "bosch,bmp085";
	reg = <0x77>;
	interrupt-parent = <&gpio0>;
	interrupts = <25 IRQ_TYPE_EDGE_RISING>;
	reset-gpios = <&gpio0 26 GPIO_ACTIVE_LOW>;
	vddd-supply = <&foo>;
	vdda-supply = <&bar>;
};
```

## Documentation/devicetree/bindings/iio/pressure/bmp085.yaml
```yaml
# SPDX-License-Identifier: GPL-2.0
%YAML 1.2
---
$id: http://devicetree.org/schemas/iio/pressure/bmp085.yaml#
$schema: http://devicetree.org/meta-schemas/core.yaml#

title: BMP085/BMP180/BMP280/BME280/BMP380 pressure iio sensors

maintainers:
  - Andreas Klinger <ak@it-klinger.de>

description: |
  Pressure, temperature and humidity iio sensors with i2c and spi interfaces

  Specifications about the sensor can be found at:
    https://www.bosch-sensortec.com/bst/products/all_products/bmp180
    https://www.bosch-sensortec.com/bst/products/all_products/bmp280
    https://www.bosch-sensortec.com/bst/products/all_products/bme280
    https://www.bosch-sensortec.com/bst/products/all_products/bmp380
    https://www.bosch-sensortec.com/bst/products/all_products/bmp580

properties:
  compatible:
    enum:
      - bosch,bmp085
      - bosch,bmp180
      - bosch,bmp280
      - bosch,bme280
      - bosch,bmp380
      - bosch,bmp580

  reg:
    maxItems: 1

  vddd-supply:
    description:
      digital voltage regulator (see regulator/regulator.txt)

  vdda-supply:
    description:
      analog voltage regulator (see regulator/regulator.txt)

  reset-gpios:
    description:
      A GPIO line handling reset of the sensor. As the line is active low,
      it should be marked GPIO_ACTIVE_LOW (see gpio/gpio.txt)
    maxItems: 1

  interrupts:
    maxItems: 1

  drive-open-drain:
    description:
      set if the interrupt pin should be configured as open drain.
      If not set, defaults to push-pull configuration.
    type: boolean

  spi-max-frequency:
    maximum: 10000000

required:
  - compatible
  - vddd-supply
  - vdda-supply

allOf:
  - $ref: /schemas/spi/spi-peripheral-props.yaml#
  - if:
      properties:
        compatible:
          not:
            contains:
              enum:
                - bosch,bmp085
                - bosch,bmp380
                - bosch,bmp580
    then:
      properties:
        interrupts: false
  - if:
      properties:
        compatible:
          contains:
            enum:
              - bosch,bmp085
              - bosch,bmp180
    then:
      properties:
        spi-max-frequency: false

additionalProperties: false

examples:
  - |
    #include <dt-bindings/gpio/gpio.h>
    #include <dt-bindings/interrupt-controller/irq.h>
    i2c {
        #address-cells = <1>;
        #size-cells = <0>;
        pressure@77 {
            compatible = "bosch,bmp085";
            reg = <0x77>;
            interrupt-parent = <&gpio0>;
            interrupts = <25 IRQ_TYPE_EDGE_RISING>;
            reset-gpios = <&gpio0 26 GPIO_ACTIVE_LOW>;
            vddd-supply = <&foo>;
            vdda-supply = <&bar>;
        };
    };
  - |
    # include <dt-bindings/gpio/gpio.h>
    spi {
        #address-cells = <1>;
        #size-cells = <0>;
        pressure@0 {
            compatible = "bosch,bmp280";
            reg = <0>;
            spi-max-frequency = <10000000>;
            reset-gpios = <&gpio0 26 GPIO_ACTIVE_LOW>;
            vddd-supply = <&foo>;
            vdda-supply = <&bar>;
        };
    };
```

## Documentation/devicetree/bindings/iio/pressure/fsl,mpl3115.yaml
```yaml
# SPDX-License-Identifier: (GPL-2.0 OR BSD-2-Clause)
%YAML 1.2
---
$id: http://devicetree.org/schemas/iio/pressure/fsl,mpl3115.yaml#
$schema: http://devicetree.org/meta-schemas/core.yaml#

title: MPL3115 precision pressure sensor with altimetry

maintainers:
  - Antoni Pokusinski <apokusinski01@gmail.com>

description: |
  MPL3115 is a pressure/altitude and temperature sensor with I2C interface.
  It features two programmable interrupt lines which indicate events such as
  data ready or pressure/temperature threshold reached.
  https://www.nxp.com/docs/en/data-sheet/MPL3115A2.pdf

properties:
  compatible:
    const: fsl,mpl3115

  reg:
    maxItems: 1

  vdd-supply: true

  vddio-supply: true

  interrupts:
    minItems: 1
    maxItems: 2

  interrupt-names:
    minItems: 1
    maxItems: 2
    items:
      enum:
        - INT1
        - INT2

  drive-open-drain:
    type: boolean
    description:
      set if the specified interrupt pins should be configured as
      open drain. If not set, defaults to push-pull.

required:
  - compatible
  - reg
  - vdd-supply
  - vddio-supply

additionalProperties: false

examples:
  - |
    #include <dt-bindings/interrupt-controller/irq.h>
    i2c {
        #address-cells = <1>;
        #size-cells = <0>;

        pressure@60 {
            compatible = "fsl,mpl3115";
            reg = <0x60>;
            vdd-supply = <&vdd>;
            vddio-supply = <&vddio>;
            interrupt-parent = <&gpio1>;
            interrupts = <4 IRQ_TYPE_EDGE_FALLING>;
            interrupt-names = "INT2";
        };
    };
```

## Documentation/devicetree/bindings/iio/pressure/honeywell,abp2030pa.yaml
```yaml
# SPDX-License-Identifier: (GPL-2.0-only OR BSD-2-Clause)
%YAML 1.2
---
$id: http://devicetree.org/schemas/iio/pressure/honeywell,abp2030pa.yaml#
$schema: http://devicetree.org/meta-schemas/core.yaml#

title: Honeywell abp2030pa pressure sensor

maintainers:
  - Petre Rodan <petre.rodan@subdimension.ro>

description: |
  Honeywell pressure sensor of model abp2030pa.

  This sensor has an I2C and SPI interface.

  There are many models with different pressure ranges available. The vendor
  calls them "ABP2 series". All of them have an identical programming model and
  differ in the pressure range and measurement unit.

  To support different models one needs to specify its pressure triplet.

  For custom silicon chips not covered by the Honeywell ABP2 series datasheet,
  the pressure values can be specified manually via honeywell,pmin-pascal and
  honeywell,pmax-pascal.

  Specifications about the devices can be found at:
  https://prod-edam.honeywell.com/content/dam/honeywell-edam/sps/siot/en-us/products/sensors/pressure-sensors/board-mount-pressure-sensors/basic-abp2-series/documents/sps-siot-abp2-series-datasheet-32350268-en.pdf

properties:
  compatible:
    const: honeywell,abp2030pa

  reg:
    maxItems: 1

  interrupts:
    description:
      Optional interrupt for indicating end of conversion.
      SPI variants of ABP2 chips do not provide this feature.
    maxItems: 1

  honeywell,pressure-triplet:
    description: |
      Case-sensitive five character string that defines pressure range, unit
      and type as part of the device nomenclature. In the unlikely case of a
      custom chip, unset and provide pmin-pascal and pmax-pascal instead.
    enum: [001BA, 1.6BA, 2.5BA, 004BA, 006BA, 008BA, 010BA, 012BA, 001BD,
           1.6BD, 2.5BD, 004BD, 001BG, 1.6BG, 2.5BG, 004BG, 006BG, 008BG,
           010BG, 012BG, 001GG, 1.2GG, 100KA, 160KA, 250KA, 001KD, 1.6KD,
           2.5KD, 004KD, 006KD, 010KD, 016KD, 025KD, 040KD, 060KD, 100KD,
           160KD, 250KD, 400KD, 001KG, 1.6KG, 2.5KG, 004KG, 006KG, 010KG,
           016KG, 025KG, 040KG, 060KG, 100KG, 160KG, 250KG, 400KG, 600KG,
           800KG, 250LD, 600LD, 600LG, 2.5MD, 006MD, 010MD, 016MD, 025MD,
           040MD, 060MD, 100MD, 160MD, 250MD, 400MD, 600MD, 006MG, 010MG,
           016MG, 025MG, 040MG, 060MG, 100MG, 160MG, 250MG, 400MG, 600MG,
           001ND, 002ND, 004ND, 005ND, 010ND, 020ND, 030ND, 002NG, 004NG,
           005NG, 010NG, 020NG, 030NG, 015PA, 030PA, 060PA, 100PA, 150PA,
           175PA, 001PD, 005PD, 015PD, 030PD, 060PD, 001PG, 005PG, 015PG,
           030PG, 060PG, 100PG, 150PG, 175PG]
    $ref: /schemas/types.yaml#/definitions/string

  honeywell,pmin-pascal:
    description:
      Minimum pressure value the sensor can measure in pascal.

  honeywell,pmax-pascal:
    description:
      Maximum pressure value the sensor can measure in pascal.

  spi-max-frequency:
    maximum: 800000

  vdd-supply: true

required:
  - compatible
  - reg
  - vdd-supply

oneOf:
  - required:
      - honeywell,pressure-triplet
  - required:
      - honeywell,pmin-pascal
      - honeywell,pmax-pascal

allOf:
  - $ref: /schemas/spi/spi-peripheral-props.yaml
  - if:
      required:
        - honeywell,pressure-triplet
    then:
      properties:
        honeywell,pmin-pascal: false
        honeywell,pmax-pascal: false

additionalProperties: false

examples:
  - |
    #include <dt-bindings/gpio/gpio.h>
    #include <dt-bindings/interrupt-controller/irq.h>
    i2c {
        #address-cells = <1>;
        #size-cells = <0>;

        pressure@18 {
            compatible = "honeywell,abp2030pa";
            reg = <0x18>;
            interrupt-parent = <&gpio3>;
            interrupts = <21 IRQ_TYPE_EDGE_RISING>;

            honeywell,pressure-triplet = "001BA";
            vdd-supply = <&vcc_3v3>;
        };
    };
  - |
    spi {
        #address-cells = <1>;
        #size-cells = <0>;

        pressure@0 {
            compatible = "honeywell,abp2030pa";
            reg = <0>;
            spi-max-frequency = <800000>;

            honeywell,pressure-triplet = "001PD";
            vdd-supply = <&vcc_3v3>;
        };
    };
...
```
