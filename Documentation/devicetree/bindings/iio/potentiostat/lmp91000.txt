## Documentation/devicetree/bindings/iio/pressure/honeywell,hsc030pa.yaml
```yaml
# SPDX-License-Identifier: (GPL-2.0-only OR BSD-2-Clause)
%YAML 1.2
---
$id: http://devicetree.org/schemas/iio/pressure/honeywell,hsc030pa.yaml#
$schema: http://devicetree.org/meta-schemas/core.yaml#

title: Honeywell TruStability HSC and SSC pressure sensor series

description: |
  support for Honeywell TruStability HSC and SSC digital pressure sensor
  series.

  These sensors have either an I2C, an SPI or an analog interface. Only the
  digital versions are supported by this driver.

  There are 118 models with different pressure ranges available in each family.
  The vendor calls them "HSC series" and "SSC series". All of them have an
  identical programming model but differ in pressure range, unit and transfer
  function.

  To support different models one needs to specify the pressure range as well
  as the transfer function. Pressure range can either be provided via
  pressure-triplet (directly extracted from the part number) or in case it's
  a custom chip via numerical range limits converted to pascals.

  The transfer function defines the ranges of raw conversion values delivered
  by the sensor. pmin-pascal and pmax-pascal corespond to the minimum and
  maximum pressure that can be measured.

  Please note that in case of an SPI-based sensor, the clock signal should not
  exceed 800kHz and the MOSI signal is not required.

  Specifications about the devices can be found at:
  https://prod-edam.honeywell.com/content/dam/honeywell-edam/sps/siot/en-us/products/sensors/pressure-sensors/board-mount-pressure-sensors/trustability-hsc-series/documents/sps-siot-trustability-hsc-series-high-accuracy-board-mount-pressure-sensors-50099148-a-en-ciid-151133.pdf
  https://prod-edam.honeywell.com/content/dam/honeywell-edam/sps/siot/en-us/products/sensors/pressure-sensors/board-mount-pressure-sensors/trustability-ssc-series/documents/sps-siot-trustability-ssc-series-standard-accuracy-board-mount-pressure-sensors-50099533-a-en-ciid-151134.pdf

maintainers:
  - Petre Rodan <petre.rodan@subdimension.ro>

properties:
  compatible:
    const: honeywell,hsc030pa

  reg:
    maxItems: 1

  honeywell,transfer-function:
    description: |
      Transfer function which defines the range of valid values delivered by
      the sensor.
      0 - A, 10% to 90% of 2^14
      1 - B, 5% to 95% of 2^14
      2 - C, 5% to 85% of 2^14
      3 - F, 4% to 94% of 2^14
    enum: [0, 1, 2, 3]
    $ref: /schemas/types.yaml#/definitions/uint32

  honeywell,pressure-triplet:
    description: |
      Case-sensitive five character string that defines pressure range, unit
      and type as part of the device nomenclature. In the unlikely case of a
      custom chip, set to "NA" and provide pmin-pascal and pmax-pascal.
    enum: [001BA, 1.6BA, 2.5BA, 004BA, 006BA, 010BA, 1.6MD, 2.5MD, 004MD,
           006MD, 010MD, 016MD, 025MD, 040MD, 060MD, 100MD, 160MD, 250MD,
           400MD, 600MD, 001BD, 1.6BD, 2.5BD, 004BD, 2.5MG, 004MG, 006MG,
           010MG, 016MG, 025MG, 040MG, 060MG, 100MG, 160MG, 250MG, 400MG,
           600MG, 001BG, 1.6BG, 2.5BG, 004BG, 006BG, 010BG, 100KA, 160KA,
           250KA, 400KA, 600KA, 001GA, 160LD, 250LD, 400LD, 600LD, 001KD,
           1.6KD, 2.5KD, 004KD, 006KD, 010KD, 016KD, 025KD, 040KD, 060KD,
           100KD, 160KD, 250KD, 400KD, 250LG, 400LG, 600LG, 001KG, 1.6KG,
           2.5KG, 004KG, 006KG, 010KG, 016KG, 025KG, 040KG, 060KG, 100KG,
           160KG, 250KG, 400KG, 600KG, 001GG, 015PA, 030PA, 060PA, 100PA,
           150PA, 0.5ND, 001ND, 002ND, 004ND, 005ND, 010ND, 020ND, 030ND,
           001PD, 005PD, 015PD, 030PD, 060PD, 001NG, 002NG, 004NG, 005NG,
           010NG, 020NG, 030NG, 001PG, 005PG, 015PG, 030PG, 060PG, 100PG,
           150PG, NA]
    $ref: /schemas/types.yaml#/definitions/string

  honeywell,pmin-pascal:
    description: |
      Minimum pressure value the sensor can measure in pascal.
      To be specified only if honeywell,pressure-triplet is set to "NA".

  honeywell,pmax-pascal:
    description: |
      Maximum pressure value the sensor can measure in pascal.
      To be specified only if honeywell,pressure-triplet is set to "NA".

  vdd-supply:
    description:
      Provide VDD power to the sensor (either 3.3V or 5V depending on the chip)

  spi-max-frequency:
    maximum: 800000

required:
  - compatible
  - reg
  - honeywell,transfer-function
  - honeywell,pressure-triplet

allOf:
  - $ref: /schemas/spi/spi-peripheral-props.yaml

unevaluatedProperties: false

dependentSchemas:
  honeywell,pmin-pascal:
    properties:
      honeywell,pressure-triplet:
        const: NA
  honeywell,pmax-pascal:
    properties:
      honeywell,pressure-triplet:
        const: NA

examples:
  - |
    i2c {
        #address-cells = <1>;
        #size-cells = <0>;

        pressure@28 {
            compatible = "honeywell,hsc030pa";
            reg = <0x28>;
            honeywell,transfer-function = <0>;
            honeywell,pressure-triplet = "030PA";
        };
    };
  - |
    spi {
        #address-cells = <1>;
        #size-cells = <0>;

        pressure@0 {
            compatible = "honeywell,hsc030pa";
            reg = <0>;
            spi-max-frequency = <800000>;
            honeywell,transfer-function = <0>;
            honeywell,pressure-triplet = "NA";
            honeywell,pmin-pascal = <0>;
            honeywell,pmax-pascal = <200000>;
        };
    };
...
```

## Documentation/devicetree/bindings/iio/pressure/honeywell,mprls0025pa.yaml
```yaml
# SPDX-License-Identifier: (GPL-2.0-only OR BSD-2-Clause)
%YAML 1.2
---
$id: http://devicetree.org/schemas/iio/pressure/honeywell,mprls0025pa.yaml#
$schema: http://devicetree.org/meta-schemas/core.yaml#

title: Honeywell mprls0025pa pressure sensor

maintainers:
  - Andreas Klinger <ak@it-klinger.de>
  - Petre Rodan <petre.rodan@subdimension.ro>

description: |
  Honeywell pressure sensor of model mprls0025pa.

  This sensor has an I2C and SPI interface.

  There are many models with different pressure ranges available. The vendor
  calls them "mpr series". All of them have the identical programming model and
  differ in the pressure range, unit and transfer function.

  To support different models one need to specify its pressure triplet as well
  as the transfer function.

  For custom silicon chips not covered by the Honeywell MPR series datasheet,
  the pressure values can be specified manually via honeywell,pmin-pascal and
  honeywell,pmax-pascal.
  The minimal range value stands for the minimum pressure and the maximum value
  also for the maximum pressure with linear relation inside the range.

  The transfer function defines the ranges of numerical values delivered by the
  sensor.

  Specifications about the devices can be found at:
    https://prod-edam.honeywell.com/content/dam/honeywell-edam/sps/siot/en-us/
      products/sensors/pressure-sensors/board-mount-pressure-sensors/
      micropressure-mpr-series/documents/
      sps-siot-mpr-series-datasheet-32332628-ciid-172626.pdf

properties:
  compatible:
    const: honeywell,mprls0025pa

  reg:
    maxItems: 1

  interrupts:
    description:
      Optional interrupt for indicating End-of-conversion.
      If not present, the driver loops for a while until the received status
      byte indicates correct measurement.
    maxItems: 1

  reset-gpios:
    description:
      Optional GPIO for resetting the device.
      If not present the device is not reset during the probe.
    maxItems: 1

  honeywell,transfer-function:
    description: |
      Transfer function which defines the range of valid values delivered by the
      sensor.
      1 - A, 10% to 90% of 2^24 (1677722 .. 15099494)
      2 - B, 2.5% to 22.5% of 2^24 (419430 .. 3774874)
      3 - C, 20% to 80% of 2^24 (3355443 .. 13421773)
    enum: [1, 2, 3]
    $ref: /schemas/types.yaml#/definitions/uint32

  honeywell,pressure-triplet:
    description: |
      Case-sensitive five character string that defines pressure range, unit
      and type as part of the device nomenclature. In the unlikely case of a
      custom chip, unset and provide pmin-pascal and pmax-pascal instead.
    enum: [0001BA, 01.6BA, 02.5BA, 0060MG, 0100MG, 0160MG, 0250MG, 0400MG,
           0600MG, 0001BG, 01.6BG, 02.5BG, 0100KA, 0160KA, 0250KA, 0006KG,
           0010KG, 0016KG, 0025KG, 0040KG, 0060KG, 0100KG, 0160KG, 0250KG,
           0015PA, 0025PA, 0030PA, 0001PG, 0005PG, 0015PG, 0030PG, 0300YG]
    $ref: /schemas/types.yaml#/definitions/string

  honeywell,pmin-pascal:
    description:
      Minimum pressure value the sensor can measure in pascal.

  honeywell,pmax-pascal:
    description:
      Maximum pressure value the sensor can measure in pascal.

  spi-max-frequency:
    maximum: 800000

  vdd-supply:
    description: provide VDD power to the sensor.

required:
  - compatible
  - reg
  - honeywell,transfer-function
  - vdd-supply

oneOf:
  - required:
      - honeywell,pressure-triplet
  - required:
      - honeywell,pmin-pascal
      - honeywell,pmax-pascal

allOf:
  - $ref: /schemas/spi/spi-peripheral-props.yaml
  - if:
      required:
        - honeywell,pressure-triplet
    then:
      properties:
        honeywell,pmin-pascal: false
        honeywell,pmax-pascal: false

unevaluatedProperties: false

examples:
  - |
    #include <dt-bindings/gpio/gpio.h>
    #include <dt-bindings/interrupt-controller/irq.h>
    i2c {
        #address-cells = <1>;
        #size-cells = <0>;

        pressure@18 {
            compatible = "honeywell,mprls0025pa";
            reg = <0x18>;
            reset-gpios = <&gpio3 19 GPIO_ACTIVE_HIGH>;
            interrupt-parent = <&gpio3>;
            interrupts = <21 IRQ_TYPE_EDGE_RISING>;

            honeywell,pressure-triplet = "0025PA";
            honeywell,transfer-function = <1>;
            vdd-supply = <&vcc_3v3>;
        };
    };
  - |
    spi {
        #address-cells = <1>;
        #size-cells = <0>;

        pressure@0 {
            compatible = "honeywell,mprls0025pa";
            reg = <0>;
            spi-max-frequency = <800000>;
            reset-gpios = <&gpio1 28 GPIO_ACTIVE_HIGH>;
            interrupt-parent = <&gpio0>;
            interrupts = <30 IRQ_TYPE_EDGE_RISING>;

            honeywell,pressure-triplet = "0015PA";
            honeywell,transfer-function = <1>;
            vdd-supply = <&vcc_3v3>;
        };
    };
...
```

## Documentation/devicetree/bindings/iio/pressure/hoperf,hp03.yaml
```yaml
# SPDX-License-Identifier: (GPL-2.0 OR BSD-2-Clause)
%YAML 1.2
---
$id: http://devicetree.org/schemas/iio/pressure/hoperf,hp03.yaml#
$schema: http://devicetree.org/meta-schemas/core.yaml#

title: HopeRF HP03 digital pressure/temperature sensors

maintainers:
  - Marek Vasut <marex@denx.de>

description: |
  Digital pressure and temperature sensor with an I2C interface.

properties:
  compatible:
    const: hoperf,hp03

  reg:
    maxItems: 1

  xclr-gpios:
    description:
      The XCLR pin is a reset of the ADC in the chip, it must be pulled
      HI before the conversion and readout of the value from the ADC
      registers and pulled LO afterward.
    maxItems: 1

required:
  - compatible
  - reg

additionalProperties: false

examples:
  - |
    i2c {
        #address-cells = <1>;
        #size-cells = <0>;

        pressure@77 {
            compatible = "hoperf,hp03";
            reg = <0x77>;
            xclr-gpios = <&portc 0 0x0>;
        };
    };
...
```

## Documentation/devicetree/bindings/iio/pressure/hp03.txt
```
HopeRF HP03 digital pressure/temperature sensors

Required properties:
- compatible: must be "hoperf,hp03"
- xclr-gpio: must be device tree identifier of the XCLR pin.
             The XCLR pin is a reset of the ADC in the chip,
             it must be pulled HI before the conversion and
             readout of the value from the ADC registers and
             pulled LO afterward.

Example:

hp03@0x77 {
	compatible = "hoperf,hp03";
	reg = <0x77>;
	xclr-gpio = <&portc 0 0x0>;
};
```

## Documentation/devicetree/bindings/iio/pressure/infineon,dps310.yaml
```yaml
# SPDX-License-Identifier: GPL-2.0-only OR BSD-2-Clause
%YAML 1.2
---
$id: http://devicetree.org/schemas/iio/pressure/infineon,dps310.yaml#
$schema: http://devicetree.org/meta-schemas/core.yaml#

title: Infineon DPS310 barometric pressure and temperature sensor

maintainers:
  - Eddie James <eajames@linux.ibm.com>

description:
  The DPS310 is a barometric pressure and temperature sensor with an I2C
  interface.

properties:
  compatible:
    enum:
      - infineon,dps310

  reg:
    maxItems: 1

  "#io-channel-cells":
    const: 0

  vdd-supply:
    description:
      Voltage supply for the chip's analog blocks.

  vddio-supply:
    description:
      Digital voltage supply for the chip's digital blocks and I/O interface.

required:
  - compatible
  - reg

additionalProperties: false

examples:
  - |
    i2c {
        #address-cells = <1>;
        #size-cells = <0>;

        dps: pressure-sensor@76 {
          compatible = "infineon,dps310";
          reg = <0x76>;
          #io-channel-cells = <0>;
          vdd-supply = <&vref1>;
          vddio-supply = <&vref2>;
        };
    };
```

## Documentation/devicetree/bindings/iio/pressure/invensense,icp10100.yaml
```yaml
# SPDX-License-Identifier: (GPL-2.0-only OR BSD-2-Clause)
%YAML 1.2
---
$id: http://devicetree.org/schemas/iio/pressure/invensense,icp10100.yaml#
$schema: http://devicetree.org/meta-schemas/core.yaml#

title: InvenSense ICP-101xx Barometric Pressure Sensors

maintainers:
  - Jean-Baptiste Maneyrol <jean-baptiste.maneyrol@tdk.com>

description: |
  Support for ICP-101xx family: ICP-10100, ICP-10101, ICP-10110, ICP-10111.
  Those devices uses a simple I2C communication bus, measuring the pressure
  in a ultra-low noise at the lowest power.
  Datasheet: https://product.tdk.com/system/files/dam/doc/product/sensor/pressure/capacitive-pressure/data_sheet/ds-000186-icp-101xx.pdf

properties:
  compatible:
    oneOf:
      - items:
          - enum:
              - invensense,icp10101
              - invensense,icp10110
              - invensense,icp10111
          - const: invensense,icp10100
      - const: invensense,icp10100

  reg:
    maxItems: 1

  vdd-supply: true

required:
  - compatible
  - reg
  - vdd-supply

additionalProperties: false

examples:
  - |
    i2c {
        #address-cells = <1>;
        #size-cells = <0>;
        pressure@63 {
            compatible = "invensense,icp10101", "invensense,icp10100";
            reg = <0x63>;
            vdd-supply = <&vdd_1v8>;
        };
    };
...
```

## Documentation/devicetree/bindings/iio/pressure/meas,ms5611.yaml
```yaml
# SPDX-License-Identifier: (GPL-2.0 OR BSD-2-Clause)
%YAML 1.2
---
$id: http://devicetree.org/schemas/iio/pressure/meas,ms5611.yaml#
$schema: http://devicetree.org/meta-schemas/core.yaml#

title: Measurement Specialities ms5611 and similar pressure sensors

maintainers:
  - Tomasz Duszynski <tduszyns@gmail.com>

description: |
  Pressure sensors from MEAS Switzerland with SPI and I2C bus interfaces.

properties:
  compatible:
    enum:
      - meas,ms5607
      - meas,ms5611

  reg:
    maxItems: 1

  vdd-supply: true

  spi-max-frequency:
    maximum: 20000000

required:
  - compatible
  - reg

allOf:
  - $ref: /schemas/spi/spi-peripheral-props.yaml#

unevaluatedProperties: false

examples:
  - |
    i2c {
        #address-cells = <1>;
        #size-cells = <0>;

        pressure@77 {
            compatible = "meas,ms5607";
            reg = <0x77>;
            vdd-supply = <&ldo_3v3_gnss>;
        };
    };
  - |
    spi {
        #address-cells = <1>;
        #size-cells = <0>;
        pressure@0 {
            compatible = "meas,ms5611";
            reg = <0>;
            vdd-supply = <&ldo_3v3_gnss>;
            spi-max-frequency = <20000000>;
        };
    };
...
```
