## Documentation/devicetree/bindings/iio/pressure/ms5611.txt
```
MEAS ms5611 family pressure sensors

Pressure sensors from MEAS Switzerland with SPI and I2C bus interfaces.

Required properties:
- compatible: "meas,ms5611" or "meas,ms5607"
- reg: the I2C address or SPI chip select the device will respond to

Optional properties:
- vdd-supply: an optional regulator that needs to be on to provide VDD
  power to the sensor.

Example:

ms5607@77 {
	compatible = "meas,ms5607";
	reg = <0x77>;
	vdd-supply = <&ldo_3v3_gnss>;
};
```

## Documentation/devicetree/bindings/iio/pressure/ms5637.txt
```
* MS5637 - Measurement-Specialties MS5637, MS5805, MS5837 and MS8607 pressure & temperature sensor

Required properties:

	-compatible: should be one of the following
		meas,ms5637
		meas,ms5805
		meas,ms5837
		meas,ms8607-temppressure
	-reg: I2C address of the sensor

Example:

ms5637@76 {
	compatible = "meas,ms5637";
	reg = <0x76>;
};
```

## Documentation/devicetree/bindings/iio/pressure/murata,zpa2326.yaml
```yaml
# SPDX-License-Identifier: (GPL-2.0 OR BSD-2-Clause)
%YAML 1.2
---
$id: http://devicetree.org/schemas/iio/pressure/murata,zpa2326.yaml#
$schema: http://devicetree.org/meta-schemas/core.yaml#

title: Murata ZPA2326 pressure sensor

maintainers:
  - Jonathan Cameron <jic23@kernel.org>

description: |
  Pressure sensor from Murata with SPI and I2C bus interfaces.


properties:
  compatible:
    const: murata,zpa2326

  reg:
    maxItems: 1

  vdd-supply: true
  vref-supply: true

  interrupts:
    maxItems: 1

  spi-max-frequency:
    maximum: 1000000

required:
  - compatible
  - reg

allOf:
  - $ref: /schemas/spi/spi-peripheral-props.yaml#

unevaluatedProperties: false

examples:
  - |
    i2c {
        #address-cells = <1>;
        #size-cells = <0>;

        pressure@5c {
            compatible = "murata,zpa2326";
            reg = <0x5c>;
            interrupt-parent = <&gpio>;
            interrupts = <12>;
            vdd-supply = <&ldo_1v8_gnss>;
        };
    };
  - |
    spi {
        #address-cells = <1>;
        #size-cells = <0>;
        pressure@0 {
            compatible = "murata,zpa2326";
            reg = <0>;
            spi-max-frequency = <500000>;
        };
    };
...
```

## Documentation/devicetree/bindings/iio/pressure/rohm,bm1390.yaml
```yaml
# SPDX-License-Identifier: GPL-2.0-only OR BSD-2-Clause
%YAML 1.2
---
$id: http://devicetree.org/schemas/iio/pressure/rohm,bm1390.yaml#
$schema: http://devicetree.org/meta-schemas/core.yaml#

title: ROHM BM1390 pressure sensor

maintainers:
  - Matti Vaittinen <mazziesaccount@gmail.com>

description:
  BM1390GLV-Z is a pressure sensor which performs internal temperature
  compensation for the MEMS. Pressure range is from 300 hPa to 1300 hPa
  and sample averaging and IIR filtering is built in. Temperature
  measurement is also supported.

properties:
  compatible:
    const: rohm,bm1390glv-z

  reg:
    maxItems: 1

  interrupts:
    maxItems: 1

  vdd-supply: true

required:
  - compatible
  - reg
  - vdd-supply

additionalProperties: false

examples:
  - |
    #include <dt-bindings/interrupt-controller/irq.h>
    i2c {
        #address-cells = <1>;
        #size-cells = <0>;
        pressure-sensor@5d {
            compatible = "rohm,bm1390glv-z";
            reg = <0x5d>;

            interrupt-parent = <&gpio1>;
            interrupts = <29 IRQ_TYPE_LEVEL_LOW>;

            vdd-supply = <&vdd>;
        };
    };
```

## Documentation/devicetree/bindings/iio/pressure/sensirion,sdp500.yaml
```yaml
# SPDX-License-Identifier: (GPL-2.0-only OR BSD-2-Clause)
%YAML 1.2
---
$id: http://devicetree.org/schemas/iio/pressure/sensirion,sdp500.yaml#
$schema: http://devicetree.org/meta-schemas/core.yaml#

title: sdp500/sdp510 pressure sensor with I2C bus interface

maintainers:
  - Petar Stoykov <petar.stoykov@prodrive-technologies.com>

description: |
  Pressure sensor from Sensirion with I2C bus interface.
  There is no software difference between sdp500 and sdp510.

properties:
  compatible:
    oneOf:
      - items:
          - const: sensirion,sdp510
          - const: sensirion,sdp500
      - const: sensirion,sdp500

  reg:
    maxItems: 1

  vdd-supply: true

required:
  - compatible
  - reg
  - vdd-supply

additionalProperties: false

examples:
  - |
    i2c {
      #address-cells = <1>;
      #size-cells = <0>;
      pressure@40 {
        compatible = "sensirion,sdp500";
        reg = <0x40>;
        vdd-supply = <&foo>;
      };
    };
```

## Documentation/devicetree/bindings/iio/pressure/zpa2326.txt
```
Murata ZPA2326 pressure sensor

Pressure sensor from Murata with SPI and I2C bus interfaces.

Required properties:
- compatible: "murata,zpa2326"
- reg: the I2C address or SPI chip select the device will respond to

Recommended properties for SPI bus usage:
- spi-max-frequency: maximum SPI bus frequency as documented in
  Documentation/devicetree/bindings/spi/spi-bus.txt

Optional properties:
- vref-supply: an optional regulator that needs to be on to provide VREF
  power to the sensor
- vdd-supply: an optional regulator that needs to be on to provide VDD
  power to the sensor
- interrupts: interrupt mapping for IRQ as documented in
  Documentation/devicetree/bindings/interrupt-controller/interrupts.txt

Example:

zpa2326@5c {
	compatible = "murata,zpa2326";
	reg = <0x5c>;
	interrupt-parent = <&gpio>;
	interrupts = <12>;
	vdd-supply = <&ldo_1v8_gnss>;
};
```

## Documentation/devicetree/bindings/iio/proximity/ams,as3935.yaml
```yaml
# SPDX-License-Identifier: (GPL-2.0 OR BSD-2-Clause)
%YAML 1.2
---
$id: http://devicetree.org/schemas/iio/proximity/ams,as3935.yaml#
$schema: http://devicetree.org/meta-schemas/core.yaml#

title: Austrian Microsystems AS3935 Franklin lightning sensor

maintainers:
  - Matt Ranostay <matt.ranostay@konsulko.com>

description:
  This lightening distance sensor uses an I2C or SPI interface. The
  binding currently only covers the SPI option.

properties:
  compatible:
    const: ams,as3935

  reg:
    maxItems: 1

  spi-max-frequency:
    maximum: 2000000

  spi-cpha: true

  interrupts:
    maxItems: 1

  ams,tuning-capacitor-pf:
    $ref: /schemas/types.yaml#/definitions/uint32
    description:
      Calibration tuning capacitor stepping value. This will require using
      the calibration data from the manufacturer.
    minimum: 0
    maximum: 120

  ams,nflwdth:
    $ref: /schemas/types.yaml#/definitions/uint32
    description:
      Set the noise and watchdog threshold register on startup. This will
      need to set according to the noise from the MCU board, and possibly
      the local environment. Refer to the datasheet for the threshold settings.

required:
  - compatible
  - reg
  - spi-cpha
  - interrupts

additionalProperties: false

examples:
  - |
    spi {
        #address-cells = <1>;
        #size-cells = <0>;

    lightning@0 {
            compatible = "ams,as3935";
            reg = <0>;
            spi-max-frequency = <400000>;
            spi-cpha;
            interrupt-parent = <&gpio1>;
            interrupts = <16 1>;
            ams,tuning-capacitor-pf = <80>;
            ams,nflwdth = <0x44>;
        };
    };
...
```

## Documentation/devicetree/bindings/iio/proximity/as3935.txt
```
Austrian Microsystems AS3935 Franklin lightning sensor device driver

Required properties:
	- compatible: must be "ams,as3935"
	- reg: SPI chip select number for the device
	- spi-max-frequency: specifies maximum SPI clock frequency
	- spi-cpha: SPI Mode 1. Refer to spi/spi-bus.txt for generic SPI
	slave node bindings.
	- interrupt-parent : should be the phandle for the interrupt controller
	- interrupts : the sole interrupt generated by the device

	Refer to interrupt-controller/interrupts.txt for generic
	interrupt client node bindings.

Optional properties:
	- ams,tuning-capacitor-pf: Calibration tuning capacitor stepping
	  value 0 - 120pF. This will require using the calibration data from
	  the manufacturer.
	- ams,nflwdth: Set the noise and watchdog threshold register on
	  startup. This will need to set according to the noise from the
	  MCU board, and possibly the local environment. Refer to the
	  datasheet for the threshold settings.

Example:

as3935@0 {
	compatible = "ams,as3935";
	reg = <0>;
	spi-max-frequency = <400000>;
	spi-cpha;
	interrupt-parent = <&gpio1>;
	interrupts = <16 1>;
	ams,tuning-capacitor-pf = <80>;
	ams,nflwdth = <0x44>;
};
```

## Documentation/devicetree/bindings/iio/proximity/awinic,aw96103.yaml
```yaml
# SPDX-License-Identifier: (GPL-2.0-only OR BSD-2-Clause)
%YAML 1.2
---
$id: http://devicetree.org/schemas/iio/proximity/awinic,aw96103.yaml#
$schema: http://devicetree.org/meta-schemas/core.yaml#

title: Awinic's AW96103 capacitive proximity sensor and similar

maintainers:
  - Wang Shuaijie <wangshuaijie@awinic.com>

description: |
  Awinic's AW96103/AW96105 proximity sensor.
  The specific absorption rate (SAR) is a metric that measures
  the degree of absorption of electromagnetic radiation emitted by
  wireless devices, such as mobile phones and tablets, by human tissue.
  In mobile phone applications, the proximity sensor is primarily
  used to detect the proximity of the human body to the phone. When the
  phone approaches the human body, it will actively reduce the transmit
  power of the antenna to keep the SAR within a safe range. Therefore,
  we also refer to the proximity sensor as a SAR sensor.

properties:
  compatible:
    enum:
      - awinic,aw96103
      - awinic,aw96105

  reg:
    maxItems: 1

  interrupts:
    description:
      Generated by the device to announce that a close/far
      proximity event has happened.
    maxItems: 1

  vcc-supply: true

required:
  - compatible
  - reg
  - interrupts
  - vcc-supply

additionalProperties: false

examples:
  - |
    #include <dt-bindings/interrupt-controller/irq.h>
    i2c {
        #address-cells = <1>;
        #size-cells = <0>;
        proximity@12 {
            compatible = "awinic,aw96103";
            reg = <0x12>;
            interrupt-parent = <&gpio>;
            interrupts = <23 IRQ_TYPE_EDGE_FALLING>;
            vcc-supply = <&pp1800_prox>;
        };
    };
```

## Documentation/devicetree/bindings/iio/proximity/devantech-srf04.txt
```
* Devantech SRF04 ultrasonic range finder
  Bit-banging driver using two GPIOs

Required properties:
 - compatible:	Should be "devantech,srf04"

 - trig-gpios:	Definition of the GPIO for the triggering (output)
		This GPIO is set for about 10 us by the driver to tell the
		device it should initiate the measurement cycle.

 - echo-gpios:	Definition of the GPIO for the echo (input)
		This GPIO is set by the device as soon as an ultrasonic
		burst is sent out and reset when the first echo is
		received.
		Thus this GPIO is set while the ultrasonic waves are doing
		one round trip.
		It needs to be an GPIO which is able to deliver an
		interrupt because the time between two interrupts is
		measured in the driver.
		See Documentation/devicetree/bindings/gpio/gpio.txt for
		information on how to specify a consumer gpio.

Example:
srf04@0 {
	compatible = "devantech,srf04";
	trig-gpios = <&gpio1 15 GPIO_ACTIVE_HIGH>;
	echo-gpios = <&gpio2  6 GPIO_ACTIVE_HIGH>;
};
```
