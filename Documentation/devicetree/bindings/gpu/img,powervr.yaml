## Documentation/devicetree/bindings/hwinfo/samsung,s5pv210-chipid.yaml
```yaml
# SPDX-License-Identifier: GPL-2.0 OR BSD-2-Clause
%YAML 1.2
---
$id: http://devicetree.org/schemas/hwinfo/samsung,s5pv210-chipid.yaml#
$schema: http://devicetree.org/meta-schemas/core.yaml#

title: Samsung S5PV210 SoC ChipID

maintainers:
  - Krzysztof Kozlowski <krzk@kernel.org>

properties:
  compatible:
    const: samsung,s5pv210-chipid

  reg:
    maxItems: 1

required:
  - compatible
  - reg

additionalProperties: false

examples:
  - |
    chipid@e0000000 {
        compatible = "samsung,s5pv210-chipid";
        reg = <0xe0000000 0x1000>;
    };
```

## Documentation/devicetree/bindings/hwinfo/via,vt8500-scc-id.yaml
```yaml
# SPDX-License-Identifier: (GPL-2.0-only OR BSD-2-Clause)
%YAML 1.2
---
$id: http://devicetree.org/schemas/hwinfo/via,vt8500-scc-id.yaml#
$schema: http://devicetree.org/meta-schemas/core.yaml#

title: VIA/WonderMedia SoC system configuration information

maintainers:
  - Alexey Charkov <alchark@gmail.com>

description:
  The system configuration controller on VIA/WonderMedia SoC's contains a chip
  identifier and revision used to differentiate between different hardware
  versions of on-chip IP blocks having their own peculiarities which may or
  may not be captured by their respective DT compatible strings

properties:
  compatible:
    items:
      - const: via,vt8500-scc-id

  reg:
    maxItems: 1

required:
  - compatible
  - reg

additionalProperties: false

examples:
  - |
    chipid@d8120000 {
        compatible = "via,vt8500-scc-id";
        reg = <0xd8120000 0x4>;
    };
```

## Documentation/devicetree/bindings/hwlock/allwinner,sun6i-a31-hwspinlock.yaml
```yaml
# SPDX-License-Identifier: (GPL-2.0-only or BSD-2-Clause)
%YAML 1.2
---
$id: http://devicetree.org/schemas/hwlock/allwinner,sun6i-a31-hwspinlock.yaml#
$schema: http://devicetree.org/meta-schemas/core.yaml#

title: SUN6I hardware spinlock driver for Allwinner sun6i compatible SoCs

maintainers:
  - Wilken Gottwalt <wilken.gottwalt@posteo.net>

description:
  The hardware unit provides semaphores between the ARM cores and the embedded
  companion core on the SoC.

properties:
  compatible:
    const: allwinner,sun6i-a31-hwspinlock

  reg:
    maxItems: 1

  clocks:
    maxItems: 1

  resets:
    maxItems: 1

required:
  - compatible
  - reg
  - clocks
  - resets

additionalProperties: false

examples:
  - |
    #include <dt-bindings/clock/sun8i-a23-a33-ccu.h>
    #include <dt-bindings/reset/sun8i-a23-a33-ccu.h>

    hwlock@1c18000 {
        compatible = "allwinner,sun6i-a31-hwspinlock";
        reg = <0x01c18000 0x1000>;
        clocks = <&ccu CLK_BUS_SPINLOCK>;
        resets = <&ccu RST_BUS_SPINLOCK>;
    };
...
```

## Documentation/devicetree/bindings/hwlock/hwlock.txt
```
Generic hwlock bindings
=======================

Generic bindings that are common to all the hwlock platform specific driver
implementations.

Please also look through the individual platform specific hwlock binding
documentations for identifying any additional properties specific to that
platform.

hwlock providers:
=================

Required properties:
- #hwlock-cells:        Specifies the number of cells needed to represent a
                        specific lock.

hwlock users:
=============

Consumers that require specific hwlock(s) should specify them using the
property "hwlocks", and an optional "hwlock-names" property.

Required properties:
- hwlocks:              List of phandle to a hwlock provider node and an
                        associated hwlock args specifier as indicated by
                        #hwlock-cells. The list can have just a single hwlock
                        or multiple hwlocks, with each hwlock represented by
                        a phandle and a corresponding args specifier.

Optional properties:
- hwlock-names:         List of hwlock name strings defined in the same order
                        as the hwlocks, with one name per hwlock. Consumers can
                        use the hwlock-names to match and get a specific hwlock.


1. Example of a node using a single specific hwlock:

The following example has a node requesting a hwlock in the bank defined by
the node hwlock1. hwlock1 is a hwlock provider with an argument specifier
of length 1.

	node {
		...
		hwlocks = <&hwlock1 2>;
		...
	};

2. Example of a node using multiple specific hwlocks:

The following example has a node requesting two hwlocks, a hwlock within
the hwlock device node 'hwlock1' with #hwlock-cells value of 1, and another
hwlock within the hwlock device node 'hwlock2' with #hwlock-cells value of 2.

	node {
		...
		hwlocks = <&hwlock1 2>, <&hwlock2 0 3>;
		...
	};
```

## Documentation/devicetree/bindings/hwlock/omap-hwspinlock.txt
```
TI HwSpinlock for OMAP and K3 based SoCs
=========================================

Required properties:
- compatible:		Should be one of the following,
			  "ti,omap4-hwspinlock" for
				OMAP44xx, OMAP54xx, AM33xx, AM43xx, DRA7xx SoCs
			  "ti,am654-hwspinlock" for
				K3 AM65x and J721E SoCs
- reg:			Contains the hwspinlock module register address space
			(base address and length)
- ti,hwmods:		Name of the hwmod associated with the hwspinlock device
			(for OMAP architecture based SoCs only)
- #hwlock-cells:	Should be 1. The OMAP hwspinlock users will use a
			0-indexed relative hwlock number as the argument
			specifier value for requesting a specific hwspinlock
			within a hwspinlock bank.

Please look at the generic hwlock binding for usage information for consumers,
"Documentation/devicetree/bindings/hwlock/hwlock.txt"

Example:

1. OMAP4 SoCs
hwspinlock: spinlock@4a0f6000 {
	compatible = "ti,omap4-hwspinlock";
	reg = <0x4a0f6000 0x1000>;
	ti,hwmods = "spinlock";
	#hwlock-cells = <1>;
};

2. AM65x SoCs and J721E SoCs
&cbass_main {
	cbass_main_navss: interconnect0 {
		hwspinlock: spinlock@30e00000 {
			compatible = "ti,am654-hwspinlock";
			reg = <0x00 0x30e00000 0x00 0x1000>;
			#hwlock-cells = <1>;
		};
	};
};
```

## Documentation/devicetree/bindings/hwlock/qcom-hwspinlock.txt
```
Qualcomm Hardware Mutex Block:

The hardware block provides mutexes utilized between different processors on
the SoC as part of the communication protocol used by these processors.

- compatible:
	Usage: required
	Value type: <string>
	Definition: must be one of:
		    "qcom,sfpb-mutex",
		    "qcom,tcsr-mutex"

- syscon:
	Usage: required
	Value type: <prop-encoded-array>
	Definition: one cell containing:
		    syscon phandle
		    offset of the hwmutex block within the syscon
		    stride of the hwmutex registers

- #hwlock-cells:
	Usage: required
	Value type: <u32>
	Definition: must be 1, the specified cell represent the lock id
		    (hwlock standard property, see hwlock.txt)

Example:

	tcsr_mutex_block: syscon@fd484000 {
		compatible = "syscon";
		reg = <0xfd484000 0x2000>;
	};

	hwlock@fd484000 {
		compatible = "qcom,tcsr-mutex";
		syscon = <&tcsr_mutex_block 0 0x80>;

		#hwlock-cells = <1>;
	};
```
