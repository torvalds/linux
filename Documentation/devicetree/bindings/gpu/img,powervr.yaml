## Documentation/devicetree/bindings/gpu/samsung-rotator.txt
```
* Samsung Image Rotator

Required properties:
  - compatible : value should be one of the following:
	(a) "samsung,exynos4210-rotator" for Rotator IP in Exynos4210
	(b) "samsung,exynos4212-rotator" for Rotator IP in Exynos4212/4412
	(c) "samsung,exynos5250-rotator" for Rotator IP in Exynos5250

  - reg : Physical base address of the IP registers and length of memory
	  mapped region.

  - interrupts : Interrupt specifier for rotator interrupt, according to format
		 specific to interrupt parent.

  - clocks : Clock specifier for rotator clock, according to generic clock
	     bindings. (See Documentation/devicetree/bindings/clock/exynos*.txt)

  - clock-names : Names of clocks. For exynos rotator, it should be "rotator".

Example:
	rotator@12810000 {
		compatible = "samsung,exynos4210-rotator";
		reg = <0x12810000 0x1000>;
		interrupts = <0 83 0>;
		clocks = <&clock 278>;
		clock-names = "rotator";
	};
```

## Documentation/devicetree/bindings/gpu/samsung-rotator.yaml
```yaml
# SPDX-License-Identifier: GPL-2.0
%YAML 1.2
---
$id: http://devicetree.org/schemas/gpu/samsung-rotator.yaml#
$schema: http://devicetree.org/meta-schemas/core.yaml#

title: Samsung SoC Image Rotator

maintainers:
  - Inki Dae <inki.dae@samsung.com>

properties:
  compatible:
    enum:
      - "samsung,s5pv210-rotator"
      - "samsung,exynos4210-rotator"
      - "samsung,exynos4212-rotator"
      - "samsung,exynos5250-rotator"
  reg:
    maxItems: 1

  interrupts:
    maxItems: 1

  clocks:
    maxItems: 1

  clock-names:
    items:
      - const: rotator

required:
  - compatible
  - reg
  - interrupts
  - clocks
  - clock-names

additionalProperties: false

examples:
  - |
    rotator@12810000 {
        compatible = "samsung,exynos4210-rotator";
        reg = <0x12810000 0x1000>;
        interrupts = <0 83 0>;
        clocks = <&clock 278>;
        clock-names = "rotator";
    };
```

## Documentation/devicetree/bindings/gpu/samsung-scaler.txt
```
* Samsung Exynos Image Scaler

Required properties:
  - compatible : value should be one of the following:
	(a) "samsung,exynos5420-scaler" for Scaler IP in Exynos5420
	(b) "samsung,exynos5433-scaler" for Scaler IP in Exynos5433

  - reg : Physical base address of the IP registers and length of memory
	  mapped region.

  - interrupts : Interrupt specifier for scaler interrupt, according to format
		 specific to interrupt parent.

  - clocks : Clock specifier for scaler clock, according to generic clock
	     bindings. (See Documentation/devicetree/bindings/clock/exynos*.txt)

  - clock-names : Names of clocks. For exynos scaler, it should be "mscl"
		  on 5420 and "pclk", "aclk" and "aclk_xiu" on 5433.

Example:
	scaler@12800000 {
		compatible = "samsung,exynos5420-scaler";
		reg = <0x12800000 0x1294>;
		interrupts = <0 220 IRQ_TYPE_LEVEL_HIGH>;
		clocks = <&clock CLK_MSCL0>;
		clock-names = "mscl";
	};
```

## Documentation/devicetree/bindings/gpu/samsung-scaler.yaml
```yaml
# SPDX-License-Identifier: GPL-2.0
%YAML 1.2
---
$id: http://devicetree.org/schemas/gpu/samsung-scaler.yaml#
$schema: http://devicetree.org/meta-schemas/core.yaml#

title: Samsung Exynos SoC Image Scaler

maintainers:
  - Inki Dae <inki.dae@samsung.com>

properties:
  compatible:
    enum:
      - samsung,exynos5420-scaler
      - samsung,exynos5433-scaler

  reg:
    maxItems: 1

  interrupts:
    maxItems: 1

  clocks: {}
  clock-names: {}
  iommus: {}
  power-domains: {}

if:
  properties:
    compatible:
      contains:
        const: samsung,exynos5420-scaler

then:
  properties:
    clocks:
      items:
        - description: mscl clock

    clock-names:
      items:
        - const: mscl

else:
  properties:
    clocks:
      items:
        - description: pclk clock
        - description: aclk clock
        - description: aclk_xiu clock

    clock-names:
      items:
        - const: pclk
        - const: aclk
        - const: aclk_xiu

required:
  - compatible
  - reg
  - interrupts
  - clocks
  - clock-names

additionalProperties: false

examples:
  - |
    #include <dt-bindings/clock/exynos5420.h>
    #include <dt-bindings/interrupt-controller/arm-gic.h>

    scaler@12800000 {
        compatible = "samsung,exynos5420-scaler";
        reg = <0x12800000 0x1294>;
        interrupts = <GIC_SPI 220 IRQ_TYPE_LEVEL_HIGH>;
        clocks = <&clock CLK_MSCL0>;
        clock-names = "mscl";
    };

...
```

## Documentation/devicetree/bindings/gpu/vivante,gc.yaml
```yaml
# SPDX-License-Identifier: GPL-2.0
%YAML 1.2
---
$id: http://devicetree.org/schemas/gpu/vivante,gc.yaml#
$schema: http://devicetree.org/meta-schemas/core.yaml#

title: Vivante GPU Bindings

description: Vivante GPU core devices

maintainers:
  - Lucas Stach <l.stach@pengutronix.de>

properties:
  compatible:
    const: vivante,gc

  reg:
    maxItems: 1

  interrupts:
    maxItems: 1

  clocks:
    items:
      - description: AXI/master interface clock
      - description: GPU core clock
      - description: Shader clock (only required if GPU has feature PIPE_3D)
      - description: AHB/slave interface clock (only required if GPU can gate slave interface independently)
    minItems: 1
    maxItems: 4

  clock-names:
    items:
      enum: [ bus, core, shader, reg ]
    minItems: 1
    maxItems: 4

  resets:
    maxItems: 1

  power-domains:
    maxItems: 1

required:
  - compatible
  - reg
  - interrupts
  - clocks
  - clock-names

additionalProperties: false

examples:
  - |
    #include <dt-bindings/clock/imx6qdl-clock.h>
    #include <dt-bindings/interrupt-controller/arm-gic.h>
    gpu@130000 {
      compatible = "vivante,gc";
      reg = <0x00130000 0x4000>;
      interrupts = <0 9 IRQ_TYPE_LEVEL_HIGH>;
      clocks = <&clks IMX6QDL_CLK_GPU3D_AXI>,
               <&clks IMX6QDL_CLK_GPU3D_CORE>,
               <&clks IMX6QDL_CLK_GPU3D_SHADER>;
      clock-names = "bus", "core", "shader";
      power-domains = <&gpc 1>;
    };

...
```

## Documentation/devicetree/bindings/h8300/cpu.txt
```
* H8/300 CPU bindings

Required properties:

- compatible: Compatible property value should be "renesas,h8300".
- clock-frequency: Contains the clock frequency for CPU, in Hz.

Example:

		cpu@0 {
			compatible = "renesas,h8300";
			clock-frequency = <20000000>;
		};
```

## Documentation/devicetree/bindings/hid/hid-over-i2c.txt
```
* HID over I2C Device-Tree bindings

HID over I2C provides support for various Human Interface Devices over the
I2C bus. These devices can be for example touchpads, keyboards, touch screens
or sensors.

The specification has been written by Microsoft and is currently available here:
http://msdn.microsoft.com/en-us/library/windows/hardware/hh852380.aspx

If this binding is used, the kernel module i2c-hid will handle the communication
with the device and the generic hid core layer will handle the protocol.

Required properties:
- compatible: must be "hid-over-i2c"
- reg: i2c slave address
- hid-descr-addr: HID descriptor address
- interrupt-parent: the phandle for the interrupt controller
- interrupts: interrupt line

Example:

	i2c-hid-dev@2c {
		compatible = "hid-over-i2c";
		reg = <0x2c>;
		hid-descr-addr = <0x0020>;
		interrupt-parent = <&gpx3>;
		interrupts = <3 2>;
	};
```

## Documentation/devicetree/bindings/hsi/client-devices.txt
```
Each HSI port is supposed to have one child node, which
symbols the remote device connected to the HSI port. The
following properties are standardized for HSI clients:

Required HSI configuration properties:

- hsi-channel-ids:	A list of channel ids

- hsi-rx-mode:		Receiver Bit transmission mode ("stream" or "frame")
- hsi-tx-mode:		Transmitter Bit transmission mode ("stream" or "frame")
- hsi-mode:		May be used instead hsi-rx-mode and hsi-tx-mode if
			the transmission mode is the same for receiver and
			transmitter
- hsi-speed-kbps:	Max bit transmission speed in kbit/s
- hsi-flow:		RX flow type ("synchronized" or "pipeline")
- hsi-arb-mode:		Arbitration mode for TX frame ("round-robin", "priority")

Optional HSI configuration properties:

- hsi-channel-names:	A list with one name per channel specified in the
			hsi-channel-ids property


Device Tree node example for an HSI client:

hsi-controller {
	hsi-port {
		modem: hsi-client {
			compatible = "nokia,n900-modem";

			hsi-channel-ids = <0>, <1>, <2>, <3>;
			hsi-channel-names = "mcsaab-control",
					    "speech-control",
					    "speech-data",
					    "mcsaab-data";
			hsi-speed-kbps = <55000>;
			hsi-mode = "frame";
			hsi-flow = "synchronized";
			hsi-arb-mode = "round-robin";

			/* more client specific properties */
		};
	};
};
```

## Documentation/devicetree/bindings/hsi/nokia-modem.txt
```
Nokia modem client bindings

The Nokia modem HSI client follows the common HSI client binding
and inherits all required properties. The following additional
properties are needed by the Nokia modem HSI client:

Required properties:
- compatible:		Should be one of
      "nokia,n900-modem"
- hsi-channel-names:	Should contain the following strings
      "mcsaab-control"
      "speech-control"
      "speech-data"
      "mcsaab-data"
- gpios:		Should provide a GPIO handler for each GPIO listed in
                        gpio-names
- gpio-names:		Should contain the following strings
      "cmt_apeslpx"
      "cmt_rst_rq"
      "cmt_en"
      "cmt_rst"
      "cmt_bsi"
- interrupts:		Should be IRQ handle for modem's reset indication

Example:

&ssi_port {
	modem: hsi-client {
		compatible = "nokia,n900-modem";

		pinctrl-names = "default";
		pinctrl-0 = <&modem_pins>;

		hsi-channel-ids = <0>, <1>, <2>, <3>;
		hsi-channel-names = "mcsaab-control",
				    "speech-control",
				    "speech-data",
				    "mcsaab-data";
		hsi-speed-kbps = <55000>;
		hsi-mode = "frame";
		hsi-flow = "synchronized";
		hsi-arb-mode = "round-robin";

		interrupts-extended = <&gpio3 8 IRQ_TYPE_EDGE_FALLING>; /* 72 */

		gpios = <&gpio3  6 GPIO_ACTIVE_HIGH>, /* 70 */
			<&gpio3  9 GPIO_ACTIVE_HIGH>, /* 73 */
			<&gpio3 10 GPIO_ACTIVE_HIGH>, /* 74 */
			<&gpio3 11 GPIO_ACTIVE_HIGH>, /* 75 */
			<&gpio5 29 GPIO_ACTIVE_HIGH>; /* 157 */
		gpio-names = "cmt_apeslpx",
			     "cmt_rst_rq",
			     "cmt_en",
			     "cmt_rst",
			     "cmt_bsi";
	};
};
```

## Documentation/devicetree/bindings/hsi/omap-ssi.txt
```
OMAP SSI controller bindings

OMAP3's Synchronous Serial Interface (SSI) controller implements a
legacy variant of MIPI's High Speed Synchronous Serial Interface (HSI),
while the controller found inside OMAP4 is supposed to be fully compliant
with the HSI standard.

Required properties:
- compatible:		Should include "ti,omap3-ssi" or "ti,omap4-hsi"
- reg-names:		Contains the values "sys" and "gdd" (in this order).
- reg:			Contains a matching register specifier for each entry
			in reg-names.
- interrupt-names:	Contains the value "gdd_mpu".
- interrupts: 		Contains matching interrupt information for each entry
			in interrupt-names.
- ranges:		Represents the bus address mapping between the main
			controller node and the child nodes below.
- clock-names:		Must include the following entries:
  "ssi_ssr_fck": The OMAP clock of that name
  "ssi_sst_fck": The OMAP clock of that name
  "ssi_ick": The OMAP clock of that name
- clocks:		Contains a matching clock specifier for each entry in
			clock-names.
- #address-cells:	Should be set to <1>
- #size-cells:		Should be set to <1>

Each port is represented as a sub-node of the ti,omap3-ssi device.

Required Port sub-node properties:
- compatible:		Should be set to the following value
			ti,omap3-ssi-port (applicable to OMAP34xx devices)
			ti,omap4-hsi-port (applicable to OMAP44xx devices)
- reg-names:		Contains the values "tx" and "rx" (in this order).
- reg:			Contains a matching register specifier for each entry
			in reg-names.
- interrupt-parent	Should be a phandle for the interrupt controller
- interrupts:		Should contain interrupt specifiers for mpu interrupts
			0 and 1 (in this order).
- ti,ssi-cawake-gpio:	Defines which GPIO pin is used to signify CAWAKE
			events for the port. This is an optional board-specific
			property. If it's missing the port will not be
			enabled.

Optional properties:
- ti,hwmods:		Shall contain TI interconnect module name if needed
			by the SoC

Example for Nokia N900:

ssi-controller@48058000 {
	compatible = "ti,omap3-ssi";

	/* needed until hwmod is updated to use the compatible string */
	ti,hwmods = "ssi";

	reg = <0x48058000 0x1000>,
	      <0x48059000 0x1000>;
	reg-names = "sys",
		    "gdd";

	interrupts = <55>;
	interrupt-names = "gdd_mpu";

	clocks = <&ssi_ssr_fck>,
		 <&ssi_sst_fck>,
		 <&ssi_ick>;
	clock-names = "ssi_ssr_fck",
		      "ssi_sst_fck",
		      "ssi_ick";

	#address-cells = <1>;
	#size-cells = <1>;
	ranges;

	ssi-port@4805a000 {
		compatible = "ti,omap3-ssi-port";

		reg = <0x4805a000 0x800>,
		      <0x4805a800 0x800>;
		reg-names = "tx",
			    "rx";

		interrupt-parent = <&intc>;
		interrupts = <67>,
			     <68>;

		ti,ssi-cawake-gpio = <&gpio5 23 GPIO_ACTIVE_HIGH>; /* 151 */
	}

	ssi-port@4805a000 {
		compatible = "ti,omap3-ssi-port";

		reg = <0x4805b000 0x800>,
		      <0x4805b800 0x800>;
		reg-names = "tx",
			    "rx";

		interrupt-parent = <&intc>;
		interrupts = <69>,
			     <70>;

	}
}
```

## Documentation/devicetree/bindings/hwinfo/loongson,ls2k-chipid.yaml
```yaml
# SPDX-License-Identifier: (GPL-2.0-only OR BSD-2-Clause)
%YAML 1.2
---
$id: http://devicetree.org/schemas/hwinfo/loongson,ls2k-chipid.yaml#
$schema: http://devicetree.org/meta-schemas/core.yaml#

title: Loongson-2 SoC ChipID

maintainers:
  - Yinbo Zhu <zhuyinbo@loongson.cn>

description: |
  Loongson-2 SoC contains many groups of global utilities register
  blocks, of which the ChipID group registers record SoC version,
  feature, vendor and id information.

properties:
  compatible:
    const: loongson,ls2k-chipid

  reg:
    maxItems: 1

  little-endian: true

required:
  - compatible
  - reg

additionalProperties: false

examples:
  - |
    chipid: chipid@1fe00000 {
        compatible = "loongson,ls2k-chipid";
        reg = <0x1fe00000 0x3ffc>;
        little-endian;
    };
```

## Documentation/devicetree/bindings/hwinfo/samsung,exynos-chipid.yaml
```yaml
# SPDX-License-Identifier: GPL-2.0
%YAML 1.2
---
$id: http://devicetree.org/schemas/hwinfo/samsung,exynos-chipid.yaml#
$schema: http://devicetree.org/meta-schemas/core.yaml#

title: Samsung Exynos SoC series Chipid driver

maintainers:
  - Krzysztof Kozlowski <krzk@kernel.org>

properties:
  compatible:
    oneOf:
      - enum:
          - samsung,exynos4210-chipid
          - samsung,exynos850-chipid
      - items:
          - enum:
              - samsung,exynos5433-chipid
              - samsung,exynos7-chipid
          - const: samsung,exynos4210-chipid
      - items:
          - enum:
              - samsung,exynos7885-chipid
              - samsung,exynos8895-chipid
              - samsung,exynosautov9-chipid
              - samsung,exynosautov920-chipid
          - const: samsung,exynos850-chipid

  reg:
    maxItems: 1

  samsung,asv-bin:
    description:
      Adaptive Supply Voltage bin selection. This can be used
      to determine the ASV bin of an SoC if respective information
      is missing in the CHIPID registers or in the OTP memory.
    $ref: /schemas/types.yaml#/definitions/uint32
    enum: [0, 1, 2, 3]

required:
  - compatible
  - reg

additionalProperties: false

examples:
  - |
    chipid@10000000 {
        compatible = "samsung,exynos4210-chipid";
        reg = <0x10000000 0x100>;
        samsung,asv-bin = <2>;
    };
```
