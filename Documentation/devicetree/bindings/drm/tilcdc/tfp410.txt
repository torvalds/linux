## Documentation/devicetree/bindings/edac/altr,socfpga-ecc-manager.yaml
```yaml
# SPDX-License-Identifier: (GPL-2.0 OR BSD-2-Clause)
# Copyright (C) 2025 Altera Corporation
%YAML 1.2
---
$id: http://devicetree.org/schemas/edac/altr,socfpga-ecc-manager.yaml#
$schema: http://devicetree.org/meta-schemas/core.yaml#

title: Altera SoCFPGA ECC Manager

maintainers:
  - Matthew Gerlach <matthew.gerlach@altera.com>

description:
  This binding describes the device tree nodes required for the Altera SoCFPGA
  ECC Manager for the Cyclone5, Arria5, Arria10, Stratix10, and Agilex chip
  families.

properties:

  compatible:
    oneOf:
      - items:
          - const: altr,socfpga-s10-ecc-manager
          - const: altr,socfpga-a10-ecc-manager
      - const: altr,socfpga-a10-ecc-manager
      - const: altr,socfpga-ecc-manager

  "#address-cells":
    const: 1

  "#size-cells":
    const: 1

  interrupts:
    minItems: 1
    maxItems: 2

  interrupt-controller: true

  "#interrupt-cells":
    const: 2

  ranges: true

  altr,sysmgr-syscon:
    $ref: /schemas/types.yaml#/definitions/phandle
    description: phandle to Stratix10 System Manager Block with the ECC manager registers

  sdramedac:
    type: object
    additionalProperties: false

    properties:
      compatible:
        enum:
          - altr,sdram-edac
          - altr,sdram-edac-a10
          - altr,sdram-edac-s10

      interrupts:
        minItems: 1
        maxItems: 2

      altr,sdr-syscon:
        $ref: /schemas/types.yaml#/definitions/phandle
        description: phandle to SDRAM parent

    required:
      - compatible
      - interrupts
      - altr,sdr-syscon

patternProperties:
  "^ocram-ecc@[a-f0-9]+$":
    type: object
    additionalProperties: false

    properties:
      compatible:
        oneOf:
          - items:
              - const: altr,socfpga-s10-ocram-ecc
              - const: altr,socfpga-a10-ocram-ecc
          - const: altr,socfpga-a10-ocram-ecc
          - const: altr,socfpga-ocram-ecc

      reg:
        maxItems: 1

      interrupts:
        minItems: 1
        maxItems: 2

      iram:
        $ref: /schemas/types.yaml#/definitions/phandle
        description: phandle to OCRAM parent

      altr,ecc-parent:
        $ref: /schemas/types.yaml#/definitions/phandle
        description: phandle to OCRAM parent

    required:
      - compatible
      - reg
      - interrupts

  "^usb[0-9]-ecc@[a-f0-9]+$":
    type: object
    additionalProperties: false

    properties:
      compatible:
        oneOf:
          - items:
              - const: altr,socfpga-s10-usb-ecc
              - const: altr,socfpga-usb-ecc
          - const: altr,socfpga-usb-ecc

      reg:
        maxItems: 1

      interrupts:
        minItems: 1
        maxItems: 2

      altr,ecc-parent:
        $ref: /schemas/types.yaml#/definitions/phandle
        description: phandle to USB parent

    required:
      - compatible
      - reg
      - interrupts
      - altr,ecc-parent

  "^emac[0-9]-[t,r]x-ecc@[a-f0-9]+$":
    type: object
    additionalProperties: false

    properties:
      compatible:
        oneOf:
          - items:
              - const: altr,socfpga-s10-eth-mac-ecc
              - const: altr,socfpga-eth-mac-ecc
          - const: altr,socfpga-eth-mac-ecc

      reg:
        maxItems: 1

      interrupts:
        minItems: 1
        maxItems: 2

      altr,ecc-parent:
        $ref: /schemas/types.yaml#/definitions/phandle
        description: phandle to ethernet parent

    required:
      - compatible
      - reg
      - interrupts
      - altr,ecc-parent

  "^sdmmc[a-f]-ecc@[a-f0-9]+$":
    type: object
    additionalProperties: false

    properties:
      compatible:
        oneOf:
          - items:
              - const: altr,socfpga-s10-sdmmc-ecc
              - const: altr,socfpga-sdmmc-ecc
          - const: altr,socfpga-sdmmc-ecc

      reg:
        maxItems: 1

      interrupts:
        minItems: 2
        maxItems: 4

      altr,ecc-parent:
        $ref: /schemas/types.yaml#/definitions/phandle
        description: phandle to SD/MMC parent

    required:
      - compatible
      - reg
      - interrupts
      - altr,ecc-parent

  "^l2-ecc@[a-f0-9]+$":
    type: object
    additionalProperties: false

    properties:
      compatible:
        enum:
          - altr,socfpga-a10-l2-ecc
          - altr,socfpga-l2-ecc

      reg:
        maxItems: 1

      interrupts:
        maxItems: 2

    required:
      - compatible
      - reg
      - interrupts

  "^dma-ecc@[a-f0-9]+$":
    type: object
    additionalProperties: false

    properties:
      compatible:
        const: altr,socfpga-dma-ecc
      reg:
        maxItems: 1

      interrupts:
        maxItems: 2

      altr,ecc-parent:
        $ref: /schemas/types.yaml#/definitions/phandle
        description: phandle to SD/MMC parent

    required:
      - compatible
      - reg
      - interrupts
      - altr,ecc-parent

if:
  properties:
    compatible:
      contains:
        const: altr,socfpga-ecc-manager
then:
  required:
    - compatible
    - "#address-cells"
    - "#size-cells"
    - ranges

else:
  required:
    - compatible
    - "#address-cells"
    - "#size-cells"
    - interrupts
    - interrupt-controller
    - "#interrupt-cells"
    - ranges
    - altr,sysmgr-syscon

additionalProperties: false

examples:
  - |
    #include <dt-bindings/interrupt-controller/arm-gic.h>
    #include <dt-bindings/interrupt-controller/irq.h>
    eccmgr {
        compatible = "altr,socfpga-s10-ecc-manager",
                     "altr,socfpga-a10-ecc-manager";
        altr,sysmgr-syscon = <&sysmgr>;
        #address-cells = <1>;
        #size-cells = <1>;
        interrupts = <GIC_SPI 15 IRQ_TYPE_LEVEL_HIGH>;
        interrupt-controller;
        #interrupt-cells = <2>;
        ranges;

        sdramedac {
            compatible = "altr,sdram-edac-s10";
            altr,sdr-syscon = <&sdr>;
            interrupts = <16 IRQ_TYPE_LEVEL_HIGH>;
        };

        ocram-ecc@ff8cc000 {
            compatible = "altr,socfpga-s10-ocram-ecc",
                         "altr,socfpga-a10-ocram-ecc";
            reg = <0xff8cc000 0x100>;
            altr,ecc-parent = <&ocram>;
            interrupts = <1 IRQ_TYPE_LEVEL_HIGH>;
        };

        usb0-ecc@ff8c4000 {
            compatible = "altr,socfpga-s10-usb-ecc",
                         "altr,socfpga-usb-ecc";
            reg = <0xff8c4000 0x100>;
            altr,ecc-parent = <&usb0>;
            interrupts = <2 IRQ_TYPE_LEVEL_HIGH>;
        };

        emac0-rx-ecc@ff8c0000 {
            compatible = "altr,socfpga-s10-eth-mac-ecc",
                         "altr,socfpga-eth-mac-ecc";
            reg = <0xff8c0000 0x100>;
            altr,ecc-parent = <&gmac0>;
            interrupts = <4 IRQ_TYPE_LEVEL_HIGH>;
        };

        emac0-tx-ecc@ff8c0400 {
            compatible = "altr,socfpga-s10-eth-mac-ecc",
                         "altr,socfpga-eth-mac-ecc";
            reg = <0xff8c0400 0x100>;
            altr,ecc-parent = <&gmac0>;
            interrupts = <5 IRQ_TYPE_LEVEL_HIGH>;
        };

        sdmmca-ecc@ff8c8c00 {
            compatible = "altr,socfpga-s10-sdmmc-ecc",
                         "altr,socfpga-sdmmc-ecc";
            reg = <0xff8c8c00 0x100>;
            altr,ecc-parent = <&mmc>;
            interrupts = <14 IRQ_TYPE_LEVEL_HIGH>,
                         <15 IRQ_TYPE_LEVEL_HIGH>;
        };
    };
```

## Documentation/devicetree/bindings/edac/amazon,al-mc-edac.yaml
```yaml
# SPDX-License-Identifier: GPL-2.0-only OR BSD-2-Clause
%YAML 1.2
---
$id: http://devicetree.org/schemas/edac/amazon,al-mc-edac.yaml#
$schema: http://devicetree.org/meta-schemas/core.yaml#

title: Amazon's Annapurna Labs Memory Controller EDAC

maintainers:
  - Talel Shenhar <talel@amazon.com>
  - Talel Shenhar <talelshenhar@gmail.com>

description: |
  EDAC node is defined to describe on-chip error detection and correction for
  Amazon's Annapurna Labs Memory Controller.

properties:

  compatible:
    const: amazon,al-mc-edac

  reg:
    maxItems: 1

  "#address-cells":
    const: 2

  "#size-cells":
    const: 2

  interrupts:
    minItems: 1
    maxItems: 2
    items:
      - description: uncorrectable error interrupt
      - description: correctable error interrupt

  interrupt-names:
    minItems: 1
    maxItems: 2
    items:
      - const: ue
      - const: ce

required:
  - compatible
  - reg
  - "#address-cells"
  - "#size-cells"

additionalProperties: false

examples:
  - |
    #include <dt-bindings/interrupt-controller/irq.h>
    soc {
        #address-cells = <2>;
        #size-cells = <2>;
        edac@f0080000 {
          #address-cells = <2>;
          #size-cells = <2>;
          compatible = "amazon,al-mc-edac";
          reg = <0x0 0xf0080000 0x0 0x00010000>;
          interrupt-parent = <&amazon_al_system_fabric>;
          interrupt-names = "ue";
          interrupts = <20 IRQ_TYPE_LEVEL_HIGH>;
        };
    };
```

## Documentation/devicetree/bindings/edac/apm,xgene-edac.yaml
```yaml
# SPDX-License-Identifier: (GPL-2.0-only OR BSD-2-Clause)
%YAML 1.2
---
$id: http://devicetree.org/schemas/edac/apm,xgene-edac.yaml#
$schema: http://devicetree.org/meta-schemas/core.yaml#

title: APM X-Gene SoC EDAC

maintainers:
  - Khuong Dinh <khuong@os.amperecomputing.com>

description: >
  EDAC node is defined to describe on-chip error detection and correction.

  The following error types are supported:

    memory controller  - Memory controller
    PMD (L1/L2)        - Processor module unit (PMD) L1/L2 cache
    L3                 - L3 cache controller
    SoC                - SoC IPs such as Ethernet, SATA, etc

properties:
  compatible:
    const: apm,xgene-edac

  reg:
    items:
      - description: CPU bus (PCP) resource

  '#address-cells':
    const: 2

  '#size-cells':
    const: 2

  ranges: true

  interrupts:
    description: Interrupt-specifier for MCU, PMD, L3, or SoC error IRQ(s).
    items:
      - description: MCU error IRQ
      - description: PMD error IRQ
      - description: L3 error IRQ
      - description: SoC error IRQ
    minItems: 1

  regmap-csw:
    description: Regmap of the CPU switch fabric (CSW) resource.
    $ref: /schemas/types.yaml#/definitions/phandle

  regmap-mcba:
    description: Regmap of the MCB-A (memory bridge) resource.
    $ref: /schemas/types.yaml#/definitions/phandle

  regmap-mcbb:
    description: Regmap of the MCB-B (memory bridge) resource.
    $ref: /schemas/types.yaml#/definitions/phandle

  regmap-efuse:
    description: Regmap of the PMD efuse resource.
    $ref: /schemas/types.yaml#/definitions/phandle

  regmap-rb:
    description: Regmap of the register bus resource (optional for compatibility).
    $ref: /schemas/types.yaml#/definitions/phandle

required:
  - compatible
  - regmap-csw
  - regmap-mcba
  - regmap-mcbb
  - regmap-efuse
  - reg
  - interrupts

# Child-node bindings
patternProperties:
  '^edacmc@':
    description: Memory controller subnode
    type: object
    additionalProperties: false

    properties:
      compatible:
        const: apm,xgene-edac-mc

      reg:
        maxItems: 1

      memory-controller:
        description: Instance number of the memory controller.
        $ref: /schemas/types.yaml#/definitions/uint32
        maximum: 3

    required:
      - compatible
      - reg
      - memory-controller


  '^edacpmd@':
    description: PMD subnode
    type: object
    additionalProperties: false

    properties:
      compatible:
        const: apm,xgene-edac-pmd

      reg:
        maxItems: 1

      pmd-controller:
        description: Instance number of the PMD controller.
        $ref: /schemas/types.yaml#/definitions/uint32
        maximum: 3

    required:
      - compatible
      - reg
      - pmd-controller

  '^edacl3@':
    description: L3 subnode
    type: object
    additionalProperties: false

    properties:
      compatible:
        enum:
          - apm,xgene-edac-l3
          - apm,xgene-edac-l3-v2

      reg:
        maxItems: 1

    required:
      - compatible
      - reg

  '^edacsoc@':
    description: SoC subnode
    type: object
    additionalProperties: false

    properties:
      compatible:
        enum:
          - apm,xgene-edac-soc
          - apm,xgene-edac-soc-v1

      reg:
        maxItems: 1

    required:
      - compatible
      - reg

additionalProperties: false

examples:
  - |
    bus {
        #address-cells = <2>;
        #size-cells = <2>;

        edac@78800000 {
            compatible = "apm,xgene-edac";
            reg = <0x0 0x78800000 0x0 0x100>;
            #address-cells = <2>;
            #size-cells = <2>;
            ranges;
            interrupts = <0x0 0x20 0x4>, <0x0 0x21 0x4>, <0x0 0x27 0x4>;

            regmap-csw = <&csw>;
            regmap-mcba = <&mcba>;
            regmap-mcbb = <&mcbb>;
            regmap-efuse = <&efuse>;
            regmap-rb = <&rb>;

            edacmc@7e800000 {
                compatible = "apm,xgene-edac-mc";
                reg = <0x0 0x7e800000 0x0 0x1000>;
                memory-controller = <0>;
            };

            edacpmd@7c000000 {
                compatible = "apm,xgene-edac-pmd";
                reg = <0x0 0x7c000000 0x0 0x200000>;
                pmd-controller = <0>;
            };

            edacl3@7e600000 {
                compatible = "apm,xgene-edac-l3";
                reg = <0x0 0x7e600000 0x0 0x1000>;
            };

            edacsoc@7e930000 {
                compatible = "apm,xgene-edac-soc-v1";
                reg = <0x0 0x7e930000 0x0 0x1000>;
            };
        };
    };
```

## Documentation/devicetree/bindings/edac/apm-xgene-edac.txt
```
* APM X-Gene SoC EDAC node

EDAC node is defined to describe on-chip error detection and correction.
The follow error types are supported:

  memory controller	- Memory controller
  PMD (L1/L2)		- Processor module unit (PMD) L1/L2 cache

The following section describes the EDAC DT node binding.

Required properties:
- compatible		: Shall be "apm,xgene-edac".
- regmap-csw		: Regmap of the CPU switch fabric (CSW) resource.
- regmap-mcba		: Regmap of the MCB-A (memory bridge) resource.
- regmap-mcbb		: Regmap of the MCB-B (memory bridge) resource.
- regmap-efuse		: Regmap of the PMD efuse resource.
- reg			: First resource shall be the CPU bus (PCP) resource.
- interrupts            : Interrupt-specifier for MCU, PMD, L3, or SoC error
			  IRQ(s).

Required properties for memory controller subnode:
- compatible		: Shall be "apm,xgene-edac-mc".
- reg			: First resource shall be the memory controller unit
                          (MCU) resource.
- memory-controller	: Instance number of the memory controller.

Required properties for PMD subnode:
- compatible		: Shall be "apm,xgene-edac-pmd" or
                          "apm,xgene-edac-pmd-v2".
- reg			: First resource shall be the PMD resource.
- pmd-controller	: Instance number of the PMD controller.

Example:
	csw: csw@7e200000 {
		compatible = "apm,xgene-csw", "syscon";
		reg = <0x0 0x7e200000 0x0 0x1000>;
	};

	mcba: mcba@7e700000 {
		compatible = "apm,xgene-mcb", "syscon";
		reg = <0x0 0x7e700000 0x0 0x1000>;
	};

	mcbb: mcbb@7e720000 {
		compatible = "apm,xgene-mcb", "syscon";
		reg = <0x0 0x7e720000 0x0 0x1000>;
	};

	efuse: efuse@1054a000 {
		compatible = "apm,xgene-efuse", "syscon";
		reg = <0x0 0x1054a000 0x0 0x20>;
	};

	edac@78800000 {
		compatible = "apm,xgene-edac";
		#address-cells = <2>;
		#size-cells = <2>;
		ranges;
		regmap-csw = <&csw>;
		regmap-mcba = <&mcba>;
		regmap-mcbb = <&mcbb>;
		regmap-efuse = <&efuse>;
		reg = <0x0 0x78800000 0x0 0x100>;
		interrupts = <0x0 0x20 0x4>,
			     <0x0 0x21 0x4>,
			     <0x0 0x27 0x4>;

		edacmc@7e800000 {
			compatible = "apm,xgene-edac-mc";
			reg = <0x0 0x7e800000 0x0 0x1000>;
			memory-controller = <0>;
		};

		edacpmd@7c000000 {
			compatible = "apm,xgene-edac-pmd";
			reg = <0x0 0x7c000000 0x0 0x200000>;
			pmd-controller = <0>;
		};
	};
```
