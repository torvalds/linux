## Documentation/devicetree/bindings/timer/arm,mps2-timer.yaml
```yaml
# SPDX-License-Identifier: (GPL-2.0-only OR BSD-2-Clause)
%YAML 1.2
---
$id: http://devicetree.org/schemas/arm,mps2-timer.yaml#
$schema: http://devicetree.org/meta-schemas/core.yaml#

title: ARM MPS2 timer

maintainers:
  - Vladimir Murzin <vladimir.murzin@arm.com>

description:
  The MPS2 platform has simple general-purpose 32 bits timers.

properties:
  compatible:
    const: arm,mps2-timer

  reg:
    maxItems: 1

  interrupts:
    maxItems: 1

  clocks:
    maxItems: 1

  clock-frequency:
    description: Rate in Hz of the timer input clock

oneOf:
  - required: [clocks]
  - required: [clock-frequency]

required:
  - compatible
  - reg
  - interrupts

additionalProperties: false

examples:
  - |
    timer@40000000 {
        compatible = "arm,mps2-timer";
        reg = <0x40000000 0x1000>;
        interrupts = <8>;
        clocks = <&sysclk>;
    };
```

## Documentation/devicetree/bindings/timer/arm,sp804.txt
```
ARM sp804 Dual Timers
---------------------------------------

Required properties:
- compatible: Should be "arm,sp804" & "arm,primecell"
- interrupts: Should contain the list of Dual Timer interrupts. This is the
	interrupt for timer 1 and timer 2. In the case of a single entry, it is
	the combined interrupt or if "arm,sp804-has-irq" is present that
	specifies which timer interrupt is connected.
- reg: Should contain location and length for dual timer register.
- clocks: clocks driving the dual timer hardware. This list should be 1 or 3
	clocks.	With 3 clocks, the order is timer0 clock, timer1 clock,
	apb_pclk. A single clock can also be specified if the same clock is
	used for all clock inputs.

Optional properties:
- arm,sp804-has-irq = <#>: In the case of only 1 timer irq line connected, this
	specifies if the irq connection is for timer 1 or timer 2. A value of 1
	or 2 should be used.

Example:

	timer0: timer@fc800000 {
		compatible = "arm,sp804", "arm,primecell";
		reg = <0xfc800000 0x1000>;
		interrupts = <0 0 4>, <0 1 4>;
		clocks = <&timclk1 &timclk2 &pclk>;
		clock-names = "timer1", "timer2", "apb_pclk";
	};
```

## Documentation/devicetree/bindings/timer/arm,sp804.yaml
```yaml
# SPDX-License-Identifier: GPL-2.0
%YAML 1.2
---
$id: http://devicetree.org/schemas/timer/arm,sp804.yaml#
$schema: http://devicetree.org/meta-schemas/core.yaml#

title: ARM sp804 Dual Timers

maintainers:
  - Haojian Zhuang <haojian.zhuang@linaro.org>

description: |+
  The Arm SP804 IP implements two independent timers, configurable for
  16 or 32 bit operation and capable of running in one-shot, periodic, or
  free-running mode. The input clock is shared, but can be gated and prescaled
  independently for each timer.

  There is a viriant of Arm SP804: Hisilicon 64-bit SP804 timer. Some Hisilicon
  SoCs, such as Hi1212, should use the dedicated compatible: "hisilicon,sp804".

# Need a custom select here or 'arm,primecell' will match on lots of nodes
select:
  properties:
    compatible:
      contains:
        oneOf:
          - const: arm,sp804
          - const: hisilicon,sp804
  required:
    - compatible

properties:
  compatible:
    items:
      - enum:
        - arm,sp804
        - hisilicon,sp804
      - const: arm,primecell

  interrupts:
    description: |
      If two interrupts are listed, those are the interrupts for timer
      1 and 2, respectively. If there is only a single interrupt, it is
      either a combined interrupt or the sole interrupt of one timer, as
      specified by the "arm,sp804-has-irq" property.
    minItems: 1
    maxItems: 2

  reg:
    description: The physical base address of the SP804 IP.
    maxItems: 1

  clocks:
    description: |
      Clocks driving the dual timer hardware. This list should
      be 1 or 3 clocks. With 3 clocks, the order is timer0 clock, timer1
      clock, apb_pclk. A single clock can also be specified if the same
      clock is used for all clock inputs.
    oneOf:
      - items:
        - description: clock for timer 1
        - description: clock for timer 2
        - description: bus clock
      - items:
        - description: unified clock for both timers and the bus

  clock-names: true
    # The original binding did not specify any clock names, and there is no
    # consistent naming used in the existing DTs. The primecell binding
    # requires the "apb_pclk" name, so we need this property.
    # Use "timer0clk", "timer1clk", "apb_pclk" for new DTs.

  arm,sp804-has-irq:
    description: If only one interrupt line is connected to the interrupt
      controller, this property specifies which timer is connected to this
      line.
    $ref: /schemas/types.yaml#/definitions/uint32
    minimum: 1
    maximum: 2

required:
  - compatible
  - interrupts
  - reg
  - clocks

additionalProperties: false

examples:
  - |
    timer0: timer@fc800000 {
        compatible = "arm,sp804", "arm,primecell";
        reg = <0xfc800000 0x1000>;
        interrupts = <0 0 4>, <0 1 4>;
        clocks = <&timclk1>, <&timclk2>, <&pclk>;
        clock-names = "timer1", "timer2", "apb_pclk";
    };
```

## Documentation/devicetree/bindings/timer/arm,twd-timer.yaml
```yaml
# SPDX-License-Identifier: (GPL-2.0-only OR BSD-2-Clause)
%YAML 1.2
---
$id: http://devicetree.org/schemas/timer/arm,twd-timer.yaml#
$schema: http://devicetree.org/meta-schemas/core.yaml#

title: ARM Timer-Watchdog Timer

maintainers:
  - Rob Herring <robh@kernel.org>

description:
  ARM 11MP, Cortex-A5 and Cortex-A9 are often associated with a per-core
  Timer-Watchdog (aka TWD), which provides both a per-cpu local timer
  and watchdog.

  The TWD is usually attached to a GIC to deliver its two per-processor
  interrupts.

properties:
  compatible:
    enum:
      - arm,cortex-a9-twd-timer
      - arm,cortex-a5-twd-timer
      - arm,arm11mp-twd-timer

  reg:
    maxItems: 1

  interrupts:
    maxItems: 1

  clocks:
    maxItems: 1

  always-on:
    description:
      If present, the timer is powered through an always-on power domain,
      therefore it never loses context.

required:
  - compatible
  - reg
  - interrupts

additionalProperties: false

examples:
  - |
    #include <dt-bindings/interrupt-controller/arm-gic.h>

    timer@2c000600 {
            compatible = "arm,arm11mp-twd-timer";
            reg = <0x2c000600 0x20>;
            interrupts = <GIC_PPI 13 0xf01>;
    };
```

## Documentation/devicetree/bindings/timer/brcm,bcm2835-system-timer.txt
```
BCM2835 System Timer

The System Timer peripheral provides four 32-bit timer channels and a
single 64-bit free running counter. Each channel has an output compare
register, which is compared against the 32 least significant bits of the
free running counter values, and generates an interrupt.

Required properties:

- compatible : should be "brcm,bcm2835-system-timer"
- reg : Specifies base physical address and size of the registers.
- interrupts : A list of 4 interrupt sinks; one per timer channel.
- clock-frequency : The frequency of the clock that drives the counter, in Hz.

Example:

timer {
	compatible = "brcm,bcm2835-system-timer";
	reg = <0x7e003000 0x1000>;
	interrupts = <1 0>, <1 1>, <1 2>, <1 3>;
	clock-frequency = <1000000>;
};
```

## Documentation/devicetree/bindings/timer/brcm,bcm2835-system-timer.yaml
```yaml
# SPDX-License-Identifier: (GPL-2.0-only OR BSD-2-Clause)
%YAML 1.2
---
$id: http://devicetree.org/schemas/timer/brcm,bcm2835-system-timer.yaml#
$schema: http://devicetree.org/meta-schemas/core.yaml#

title: BCM2835 System Timer

maintainers:
  - Stefan Wahren <wahrenst@gmx.net>
  - Raspberry Pi Kernel Maintenance <kernel-list@raspberrypi.com>

description:
  The System Timer peripheral provides four 32-bit timer channels and a
  single 64-bit free running counter. Each channel has an output compare
  register, which is compared against the 32 least significant bits of the
  free running counter values, and generates an interrupt.

properties:
  compatible:
    const: brcm,bcm2835-system-timer

  reg:
    maxItems: 1

  interrupts:
    items:
      - description: System Timer Compare 0 match (used by VideoCore GPU)
      - description: System Timer Compare 1 match (usable for ARM core)
      - description: System Timer Compare 2 match (used by VideoCore GPU)
      - description: System Timer Compare 3 match (usable for ARM core)

  clock-frequency: true

required:
  - compatible
  - reg
  - interrupts

additionalProperties: false

examples:
  - |
    timer@7e003000 {
      compatible = "brcm,bcm2835-system-timer";
      reg = <0x7e003000 0x1000>;
      interrupts = <1 0>, <1 1>, <1 2>, <1 3>;
      clock-frequency = <1000000>;
    };
...
```

## Documentation/devicetree/bindings/timer/brcm,bcmbca-timer.yaml
```yaml
# SPDX-License-Identifier: GPL-2.0-only OR BSD-2-Clause
%YAML 1.2
---
$id: http://devicetree.org/schemas/timer/brcm,bcmbca-timer.yaml#
$schema: http://devicetree.org/meta-schemas/core.yaml#

title: Broadcom Broadband SoC timer

maintainers:
  - Rafał Miłecki <rafal@milecki.pl>

properties:
  compatible:
    oneOf:
      - const: brcm,bcm6345-timer
        description: >
          An old block with 3 timers.

          It can be found in BCM6345, BCM6838 and BCM63268.
      - const: brcm,bcm63138-timer
        description: >
          Updated block with 4 timers and control regs at the beginning.

          It can be found in newer SoCs, e.g. BCM63138, BCM63148, BCM63381,
          BCM68360, BCM6848, BCM6858, BCM4908.

  reg:
    maxItems: 1

additionalProperties: false

required:
  - reg

examples:
  - |
    timer@fffe0200 {
      compatible = "brcm,bcm6345-timer";
      reg = <0xfffe0200 0x1c>;
    };
```

## Documentation/devicetree/bindings/timer/brcm,kona-timer.txt
```
Broadcom Kona Family timer
-----------------------------------------------------
This timer is used in the following Broadcom SoCs:
 BCM11130, BCM11140, BCM11351, BCM28145, BCM28155

Required properties:
- compatible : "brcm,kona-timer"
- DEPRECATED: compatible : "bcm,kona-timer"
- reg : Register range for the timer
- interrupts : interrupt for the timer
- clocks: phandle + clock specifier pair of the external clock
- clock-frequency: frequency that the clock operates

Only one of clocks or clock-frequency should be specified.

Refer to clocks/clock-bindings.txt for generic clock consumer properties.

Example:
	timer@35006000 {
		compatible = "brcm,kona-timer";
		reg = <0x35006000 0x1000>;
		interrupts = <0x0 7 0x4>;
		clocks = <&hub_timer_clk>;
	};
```

## Documentation/devicetree/bindings/timer/brcm,kona-timer.yaml
```yaml
# SPDX-License-Identifier: GPL-2.0-only OR BSD-2-Clause
%YAML 1.2
---
$id: http://devicetree.org/schemas/timer/brcm,kona-timer.yaml#
$schema: http://devicetree.org/meta-schemas/core.yaml#

title: Broadcom Kona family timer

maintainers:
  - Florian Fainelli <f.fainelli@gmail.com>

properties:
  compatible:
    const: brcm,kona-timer

  reg:
    maxItems: 1

  interrupts:
    maxItems: 1

  clocks:
    maxItems: 1

  clock-frequency: true

oneOf:
  - required:
      - clocks
  - required:
      - clock-frequency

required:
  - compatible
  - reg
  - interrupts

additionalProperties: false

examples:
  - |
    #include <dt-bindings/clock/bcm281xx.h>
    #include <dt-bindings/interrupt-controller/arm-gic.h>
    #include <dt-bindings/interrupt-controller/irq.h>

    timer@35006000 {
        compatible = "brcm,kona-timer";
        reg = <0x35006000 0x1000>;
        interrupts = <GIC_SPI 7 IRQ_TYPE_LEVEL_HIGH>;
        clocks = <&aon_ccu BCM281XX_AON_CCU_HUB_TIMER>;
    };
...
```

## Documentation/devicetree/bindings/timer/cadence,ttc-timer.txt
```
Cadence TTC - Triple Timer Counter

Required properties:
- compatible : Should be "cdns,ttc".
- reg : Specifies base physical address and size of the registers.
- interrupts : A list of 3 interrupts; one per timer channel.
- clocks: phandle to the source clock

Optional properties:
- timer-width: Bit width of the timer, necessary if not 16.

Example:

ttc0: ttc0@f8001000 {
	interrupt-parent = <&intc>;
	interrupts = < 0 10 4 0 11 4 0 12 4 >;
	compatible = "cdns,ttc";
	reg = <0xF8001000 0x1000>;
	clocks = <&cpu_clk 3>;
	timer-width = <32>;
};
```

## Documentation/devicetree/bindings/timer/cdns,ttc.yaml
```yaml
# SPDX-License-Identifier: (GPL-2.0-only OR BSD-2-Clause)
%YAML 1.2
---
$id: http://devicetree.org/schemas/timer/cdns,ttc.yaml#
$schema: http://devicetree.org/meta-schemas/core.yaml#

title: Cadence TTC - Triple Timer Counter

maintainers:
  - Michal Simek <michal.simek@amd.com>

properties:
  compatible:
    const: cdns,ttc

  reg:
    maxItems: 1

  interrupts:
    maxItems: 3
    description: |
      A list of 3 interrupts; one per timer channel.

  clocks:
    maxItems: 1

  power-domains:
    maxItems: 1

  timer-width:
    $ref: /schemas/types.yaml#/definitions/uint32
    description: |
      Bit width of the timer, necessary if not 16.

  "#pwm-cells":
    const: 3

required:
  - compatible
  - reg
  - clocks

allOf:
  - if:
      not:
        required:
          - "#pwm-cells"
    then:
      required:
        - interrupts

additionalProperties: false

examples:
  - |
    ttc0: ttc0@f8001000 {
        interrupt-parent = <&intc>;
        interrupts = <0 10 4>, <0 11 4>, <0 12 4>;
        compatible = "cdns,ttc";
        reg = <0xF8001000 0x1000>;
        clocks = <&cpu_clk 3>;
        timer-width = <32>;
    };

  - |
    pwm: pwm@f8002000 {
        compatible = "cdns,ttc";
        reg = <0xf8002000 0x1000>;
        clocks = <&cpu_clk 3>;
        timer-width = <32>;
        #pwm-cells = <3>;
    };
```

## Documentation/devicetree/bindings/timer/cirrus,clps711x-timer.txt
```
* Cirrus Logic CLPS711X Timer Counter

Required properties:
- compatible: Shall contain "cirrus,ep7209-timer".
- reg       : Address and length of the register set.
- interrupts: The interrupt number of the timer.
- clocks    : phandle of timer reference clock.

Note: Each timer should have an alias correctly numbered in "aliases" node.

Example:
	aliases {
		timer0 = &timer1;
		timer1 = &timer2;
	};

	timer1: timer@80000300 {
		compatible = "cirrus,ep7312-timer", "cirrus,ep7209-timer";
		reg = <0x80000300 0x4>;
		interrupts = <8>;
		clocks = <&clks 5>;
	};

	timer2: timer@80000340 {
		compatible = "cirrus,ep7312-timer", "cirrus,ep7209-timer";
		reg = <0x80000340 0x4>;
		interrupts = <9>;
		clocks = <&clks 6>;
	};
```

## Documentation/devicetree/bindings/timer/cirrus,clps711x-timer.yaml
```yaml
# SPDX-License-Identifier: (GPL-2.0-only OR BSD-2-Clause)
%YAML 1.2
---
$id: http://devicetree.org/schemas/timer/cirrus,clps711x-timer.yaml#
$schema: http://devicetree.org/meta-schemas/core.yaml#

title: Cirrus Logic CLPS711X Timer Counter

maintainers:
  - Alexander Shiyan <shc_work@mail.ru>

properties:
  compatible:
    oneOf:
      - items:
          - enum:
              - cirrus,ep7312-timer
          - const: cirrus,ep7209-timer
      - const: cirrus,ep7209-timer

  reg:
    maxItems: 1

  clocks:
    maxItems: 1

  interrupts:
    maxItems: 1

required:
  - compatible
  - reg
  - clocks
  - interrupts

additionalProperties: false

examples:
  - |
    timer@80000300 {
        compatible = "cirrus,ep7312-timer", "cirrus,ep7209-timer";
        reg = <0x80000300 0x4>;
        interrupts = <8>;
        clocks = <&clks 5>;
    };
```
