## Documentation/devicetree/bindings/timer/amlogic,meson6-timer.txt
```
Amlogic Meson6 SoCs Timer Controller

Required properties:

- compatible : should be "amlogic,meson6-timer"
- reg : Specifies base physical address and size of the registers.
- interrupts : The four interrupts, one for each timer event
- clocks : phandles to the pclk (system clock) and XTAL clocks
- clock-names : must contain "pclk" and "xtal"

Example:

timer@c1109940 {
	compatible = "amlogic,meson6-timer";
	reg = <0xc1109940 0x14>;
	interrupts = <GIC_SPI 10 IRQ_TYPE_EDGE_RISING>,
		     <GIC_SPI 11 IRQ_TYPE_EDGE_RISING>,
		     <GIC_SPI 6 IRQ_TYPE_EDGE_RISING>,
		     <GIC_SPI 29 IRQ_TYPE_EDGE_RISING>;
	clocks = <&xtal>, <&clk81>;
	clock-names = "xtal", "pclk";
};
```

## Documentation/devicetree/bindings/timer/amlogic,meson6-timer.yaml
```yaml
# SPDX-License-Identifier: (GPL-2.0-only OR BSD-2-Clause)
%YAML 1.2
---
$id: http://devicetree.org/schemas/timer/amlogic,meson6-timer.yaml#
$schema: http://devicetree.org/meta-schemas/core.yaml#

title: Amlogic Meson6 SoCs Timer Controller

maintainers:
  - Neil Armstrong <neil.armstrong@linaro.org>
  - Martin Blumenstingl <martin.blumenstingl@googlemail.com>

properties:
  compatible:
    const: amlogic,meson6-timer

  reg:
    maxItems: 1

  interrupts:
    maxItems: 4
    description: per-timer event interrupts

  clocks:
    maxItems: 2

  clock-names:
    items:
      - const: xtal
      - const: pclk

required:
  - compatible
  - reg
  - interrupts
  - clocks
  - clock-names

additionalProperties: false

examples:
  - |
    #include <dt-bindings/interrupt-controller/irq.h>
    #include <dt-bindings/interrupt-controller/arm-gic.h>
    timer@c1109940 {
        compatible = "amlogic,meson6-timer";
        reg = <0xc1109940 0x14>;
        interrupts = <GIC_SPI 10 IRQ_TYPE_EDGE_RISING>,
                     <GIC_SPI 11 IRQ_TYPE_EDGE_RISING>,
                     <GIC_SPI 6 IRQ_TYPE_EDGE_RISING>,
                     <GIC_SPI 29 IRQ_TYPE_EDGE_RISING>;
        clocks = <&xtal>, <&clk81>;
        clock-names = "xtal", "pclk";
    };
```

## Documentation/devicetree/bindings/timer/andestech,atcpit100-timer.txt
```
Andestech ATCPIT100 timer
------------------------------------------------------------------
ATCPIT100 is a generic IP block from Andes Technology, embedded in
Andestech AE3XX platforms and other designs.

This timer is a set of compact multi-function timers, which can be
used as pulse width modulators (PWM) as well as simple timers.

It supports up to 4 PIT channels. Each PIT channel is a
multi-function timer and provide the following usage scenarios:
One 32-bit timer
Two 16-bit timers
Four 8-bit timers
One 16-bit PWM
One 16-bit timer and one 8-bit PWM
Two 8-bit timer and one 8-bit PWM

Required properties:
- compatible	: Should be "andestech,atcpit100"
- reg		: Address and length of the register set
- interrupts	: Reference to the timer interrupt
- clocks 	: a clock to provide the tick rate for "andestech,atcpit100"
- clock-names 	: should be "PCLK" for the peripheral clock source.

Examples:

timer0: timer@f0400000 {
	compatible = "andestech,atcpit100";
	reg = <0xf0400000 0x1000>;
	interrupts = <2>;
	clocks = <&apb>;
	clock-names = "PCLK";
};
```

## Documentation/devicetree/bindings/timer/andestech,plmt0.yaml
```yaml
# SPDX-License-Identifier: (GPL-2.0-only OR BSD-2-Clause)
%YAML 1.2
---
$id: http://devicetree.org/schemas/timer/andestech,plmt0.yaml#
$schema: http://devicetree.org/meta-schemas/core.yaml#

title: Andes machine-level timer

description:
  The Andes machine-level timer device (PLMT0) provides machine-level timer
  functionality for a set of HARTs on a RISC-V platform. It has a single
  fixed-frequency monotonic time counter (MTIME) register and a time compare
  register (MTIMECMP) for each HART connected to the PLMT0. A timer interrupt is
  generated if MTIME >= MTIMECMP.

maintainers:
  - Ben Zong-You Xie <ben717@andestech.com>

properties:
  compatible:
    items:
      - enum:
          - andestech,qilai-plmt
      - const: andestech,plmt0

  reg:
    maxItems: 1

  interrupts-extended:
    minItems: 1
    maxItems: 32
    description:
      Specifies which harts are connected to the PLMT0. Each item must points
      to a riscv,cpu-intc node, which has a riscv cpu node as parent. The
      PLMT0 supports 1 hart up to 32 harts.

additionalProperties: false

required:
  - compatible
  - reg
  - interrupts-extended

examples:
  - |
    interrupt-controller@100000 {
      compatible = "andestech,qilai-plmt", "andestech,plmt0";
      reg = <0x100000 0x100000>;
      interrupts-extended = <&cpu0intc 7>,
                            <&cpu1intc 7>,
                            <&cpu2intc 7>,
                            <&cpu3intc 7>;
    };
```

## Documentation/devicetree/bindings/timer/arm,arch_timer.yaml
```yaml
# SPDX-License-Identifier: GPL-2.0
%YAML 1.2
---
$id: http://devicetree.org/schemas/timer/arm,arch_timer.yaml#
$schema: http://devicetree.org/meta-schemas/core.yaml#

title: ARM architected timer

maintainers:
  - Marc Zyngier <marc.zyngier@arm.com>
  - Mark Rutland <mark.rutland@arm.com>
description: |+
  ARM cores may have a per-core architected timer, which provides per-cpu timers,
  or a memory mapped architected timer, which provides up to 8 frames with a
  physical and optional virtual timer per frame.

  The per-core architected timer is attached to a GIC to deliver its
  per-processor interrupts via PPIs. The memory mapped timer is attached to a GIC
  to deliver its interrupts via SPIs.

properties:
  compatible:
    oneOf:
      - items:
          - enum:
              - arm,cortex-a15-timer
          - enum:
              - arm,armv7-timer
      - items:
          - enum:
              - arm,armv7-timer
      - items:
          - enum:
              - arm,armv8-timer

  interrupts:
    minItems: 1
    maxItems: 5
    items:
      - description: secure timer irq
      - description: non-secure timer irq
      - description: virtual timer irq
      - description: hypervisor timer irq
      - description: hypervisor virtual timer irq

  interrupt-names:
    oneOf:
      - minItems: 2
        items:
          - const: phys
          - const: virt
          - const: hyp-phys
          - const: hyp-virt
      - minItems: 3
        items:
          - const: sec-phys
          - const: phys
          - const: virt
          - const: hyp-phys
          - const: hyp-virt

  clock-frequency:
    description: The frequency of the main counter, in Hz. Should be present
      only where necessary to work around broken firmware which does not configure
      CNTFRQ on all CPUs to a uniform correct value. Use of this property is
      strongly discouraged; fix your firmware unless absolutely impossible.

  always-on:
    type: boolean
    description: If present, the timer is powered through an always-on power
      domain, therefore it never loses context.

  allwinner,erratum-unknown1:
    type: boolean
    description: Indicates the presence of an erratum found in Allwinner SoCs,
      where reading certain values from the counter is unreliable. This also
      affects writes to the tval register, due to the implicit counter read.

  fsl,erratum-a008585:
    type: boolean
    description: Indicates the presence of QorIQ erratum A-008585, which says
      that reading the counter is unreliable unless the same value is returned
      by back-to-back reads. This also affects writes to the tval register, due
      to the implicit counter read.

  hisilicon,erratum-161010101:
    type: boolean
    description: Indicates the presence of Hisilicon erratum 161010101, which
      says that reading the counters is unreliable in some cases, and reads may
      return a value 32 beyond the correct value. This also affects writes to
      the tval registers, due to the implicit counter read.

  arm,cpu-registers-not-fw-configured:
    type: boolean
    description: Firmware does not initialize any of the generic timer CPU
      registers, which contain their architecturally-defined reset values. Only
      supported for 32-bit systems which follow the ARMv7 architected reset
      values.

  arm,no-tick-in-suspend:
    type: boolean
    description: The main counter does not tick when the system is in
      low-power system suspend on some SoCs. This behavior does not match the
      Architecture Reference Manual's specification that the system counter "must
      be implemented in an always-on power domain."

required:
  - compatible

additionalProperties: false

oneOf:
  - required:
      - interrupts
  - required:
      - interrupts-extended

examples:
  - |
    timer {
      compatible = "arm,cortex-a15-timer",
             "arm,armv7-timer";
      interrupts = <1 13 0xf08>,
             <1 14 0xf08>,
             <1 11 0xf08>,
             <1 10 0xf08>;
      clock-frequency = <100000000>;
    };

...
```

## Documentation/devicetree/bindings/timer/arm,arch_timer_mmio.yaml
```yaml
# SPDX-License-Identifier: GPL-2.0
%YAML 1.2
---
$id: http://devicetree.org/schemas/timer/arm,arch_timer_mmio.yaml#
$schema: http://devicetree.org/meta-schemas/core.yaml#

title: ARM memory mapped architected timer

maintainers:
  - Marc Zyngier <marc.zyngier@arm.com>
  - Mark Rutland <mark.rutland@arm.com>

description: |+
  ARM cores may have a memory mapped architected timer, which provides up to 8
  frames with a physical and optional virtual timer per frame.

  The memory mapped timer is attached to a GIC to deliver its interrupts via SPIs.

properties:
  compatible:
    items:
      - enum:
        - arm,armv7-timer-mem

  reg:
    maxItems: 1
    description: The control frame base address

  '#address-cells':
    enum: [1, 2]

  '#size-cells':
    const: 1

  clock-frequency:
    description: The frequency of the main counter, in Hz. Should be present
      only where necessary to work around broken firmware which does not configure
      CNTFRQ on all CPUs to a uniform correct value. Use of this property is
      strongly discouraged; fix your firmware unless absolutely impossible.

  always-on:
    type: boolean
    description: If present, the timer is powered through an always-on power
      domain, therefore it never loses context.

  arm,cpu-registers-not-fw-configured:
    type: boolean
    description: Firmware does not initialize any of the generic timer CPU
      registers, which contain their architecturally-defined reset values. Only
      supported for 32-bit systems which follow the ARMv7 architected reset
      values.

  arm,no-tick-in-suspend:
    type: boolean
    description: The main counter does not tick when the system is in
      low-power system suspend on some SoCs. This behavior does not match the
      Architecture Reference Manual's specification that the system counter "must
      be implemented in an always-on power domain."

patternProperties:
  '^frame@[0-9a-z]*$':
    type: object
    description: A timer node has up to 8 frame sub-nodes, each with the following properties.
    properties:
      frame-number:
        allOf:
          - $ref: "/schemas/types.yaml#/definitions/uint32"
          - minimum: 0
            maximum: 7

      interrupts:
        minItems: 1
        maxItems: 2
        items:
          - description: physical timer irq
          - description: virtual timer irq

      reg :
        minItems: 1
        maxItems: 2
        items:
          - description: 1st view base address
          - description: 2nd optional view base address

    required:
      - frame-number
      - interrupts
      - reg

required:
  - compatible
  - reg
  - '#address-cells'
  - '#size-cells'

examples:
  - |
    timer@f0000000 {
      compatible = "arm,armv7-timer-mem";
      #address-cells = <1>;
      #size-cells = <1>;
      ranges = <0 0xf0001000 0x1000>;
      reg = <0xf0000000 0x1000>;
      clock-frequency = <50000000>;

      frame@0 {
        frame-number = <0>;
        interrupts = <0 13 0x8>,
               <0 14 0x8>;
        reg = <0x0000 0x1000>,
              <0x1000 0x1000>;
      };

      frame@2000 {
        frame-number = <1>;
        interrupts = <0 15 0x8>;
        reg = <0x2000 0x1000>;
      };
    };

...
```

## Documentation/devicetree/bindings/timer/arm,armv7m-systick.yaml
```yaml
# SPDX-License-Identifier: (GPL-2.0-only OR BSD-2-Clause)
%YAML 1.2
---
$id: http://devicetree.org/schemas/timer/arm,armv7m-systick.yaml#
$schema: http://devicetree.org/meta-schemas/core.yaml#

title: ARMv7M System Timer

maintainers:
  - Alexandre Torgue <alexandre.torgue@foss.st.com>
  - Fabrice Gasnier <fabrice.gasnier@foss.st.com>

description: ARMv7-M includes a system timer, known as SysTick.

properties:
  compatible:
    const: arm,armv7m-systick

  reg:
    maxItems: 1

  clocks:
    maxItems: 1

  clock-frequency: true

oneOf:
  - required:
      - clocks
  - required:
      - clock-frequency

required:
  - compatible
  - reg

additionalProperties: false

examples:
  - |
    timer@e000e010 {
        compatible = "arm,armv7m-systick";
        reg = <0xe000e010 0x10>;
        clocks = <&clk_systick>;
    };

  - |
    timer@e000e010 {
        compatible = "arm,armv7m-systick";
        reg = <0xe000e010 0x10>;
        clock-frequency = <90000000>;
    };

...
```

## Documentation/devicetree/bindings/timer/arm,global_timer.txt
```
* ARM Global Timer
	Cortex-A9 are often associated with a per-core Global timer.

** Timer node required properties:

- compatible : should contain
	     * "arm,cortex-a5-global-timer" for Cortex-A5 global timers.
	     * "arm,cortex-a9-global-timer" for Cortex-A9 global
	         timers or any compatible implementation. Note: driver
	         supports versions r2p0 and above.

- interrupts : One interrupt to each core

- reg : Specify the base address and the size of the GT timer
	register window.

- clocks : Should be phandle to a clock.

Example:

	timer@2c000600 {
		compatible = "arm,cortex-a9-global-timer";
		reg = <0x2c000600 0x20>;
		interrupts = <1 13 0xf01>;
		clocks = <&arm_periph_clk>;
	};
```

## Documentation/devicetree/bindings/timer/arm,global_timer.yaml
```yaml
# SPDX-License-Identifier: GPL-2.0
%YAML 1.2
---
$id: http://devicetree.org/schemas/timer/arm,global_timer.yaml#
$schema: http://devicetree.org/meta-schemas/core.yaml#

title: ARM Global Timer

maintainers:
  - Stuart Menefy <stuart.menefy@st.com>

description:
  Cortex-A9 are often associated with a per-core Global timer.

properties:
  compatible:
    items:
      - enum:
          - arm,cortex-a5-global-timer
          - arm,cortex-a9-global-timer

    description: driver supports versions r2p0 and above.

  reg:
    maxItems: 1

  interrupts:
    maxItems: 1

  clocks:
    maxItems: 1

required:
  - compatible
  - reg
  - clocks

examples:
  - |
    timer@2c000600 {
      compatible = "arm,cortex-a9-global-timer";
      reg = <0x2c000600 0x20>;
      interrupts = <1 13 0xf01>;
      clocks = <&arm_periph_clk>;
    };
...
```

## Documentation/devicetree/bindings/timer/arm,mps2-timer.txt
```
ARM MPS2 timer

The MPS2 platform has simple general-purpose 32 bits timers.

Required properties:
- compatible	: Should be "arm,mps2-timer"
- reg		: Address and length of the register set
- interrupts	: Reference to the timer interrupt

Required clocking property, have to be one of:
- clocks	  : The input clock of the timer
- clock-frequency : The rate in HZ in input of the ARM MPS2 timer

Examples:

timer1: mps2-timer@40000000 {
	compatible = "arm,mps2-timer";
	reg = <0x40000000 0x1000>;
	interrupts = <8>;
	clocks = <&sysclk>;
};

timer2: mps2-timer@40001000 {
	compatible = "arm,mps2-timer";
	reg = <0x40001000 0x1000>;
	interrupts = <9>;
	clock-frequency = <25000000>;
};
```
