## Documentation/devicetree/bindings/timer/renesas,tmu.yaml
```yaml
# SPDX-License-Identifier: (GPL-2.0-only OR BSD-2-Clause)
%YAML 1.2
---
$id: http://devicetree.org/schemas/timer/renesas,tmu.yaml#
$schema: http://devicetree.org/meta-schemas/core.yaml#

title: Renesas R-Mobile/R-Car Timer Unit (TMU)

maintainers:
  - Geert Uytterhoeven <geert+renesas@glider.be>
  - Laurent Pinchart <laurent.pinchart+renesas@ideasonboard.com>

description:
  The TMU is a 32-bit timer/counter with configurable clock inputs and
  programmable compare match.

  Channels share hardware resources but their counter and compare match value
  are independent. The TMU hardware supports up to three channels.

properties:
  compatible:
    items:
      - enum:
          - renesas,tmu-r8a73a4  # R-Mobile APE6
          - renesas,tmu-r8a7740  # R-Mobile A1
          - renesas,tmu-r8a7742  # RZ/G1H
          - renesas,tmu-r8a7743  # RZ/G1M
          - renesas,tmu-r8a7744  # RZ/G1N
          - renesas,tmu-r8a7745  # RZ/G1E
          - renesas,tmu-r8a77470 # RZ/G1C
          - renesas,tmu-r8a774a1 # RZ/G2M
          - renesas,tmu-r8a774b1 # RZ/G2N
          - renesas,tmu-r8a774c0 # RZ/G2E
          - renesas,tmu-r8a774e1 # RZ/G2H
          - renesas,tmu-r8a7778  # R-Car M1A
          - renesas,tmu-r8a7779  # R-Car H1
          - renesas,tmu-r8a7790  # R-Car H2
          - renesas,tmu-r8a7791  # R-Car M2-W
          - renesas,tmu-r8a7792  # R-Car V2H
          - renesas,tmu-r8a7793  # R-Car M2-N
          - renesas,tmu-r8a7794  # R-Car E2
          - renesas,tmu-r8a7795  # R-Car H3
          - renesas,tmu-r8a7796  # R-Car M3-W
          - renesas,tmu-r8a77961 # R-Car M3-W+
          - renesas,tmu-r8a77965 # R-Car M3-N
          - renesas,tmu-r8a77970 # R-Car V3M
          - renesas,tmu-r8a77980 # R-Car V3H
          - renesas,tmu-r8a77990 # R-Car E3
          - renesas,tmu-r8a77995 # R-Car D3
          - renesas,tmu-r8a779a0 # R-Car V3U
          - renesas,tmu-r8a779f0 # R-Car S4-8
          - renesas,tmu-r8a779g0 # R-Car V4H
          - renesas,tmu-r8a779h0 # R-Car V4M
      - const: renesas,tmu

  reg:
    maxItems: 1

  interrupts:
    minItems: 2
    items:
      - description: Underflow interrupt, channel 0
      - description: Underflow interrupt, channel 1
      - description: Underflow interrupt, channel 2
      - description: Input capture interrupt, channel 2

  interrupt-names:
    minItems: 2
    items:
      - const: tuni0
      - const: tuni1
      - const: tuni2
      - const: ticpi2

  clocks:
    maxItems: 1

  clock-names:
    const: fck

  power-domains:
    maxItems: 1

  resets:
    maxItems: 1

  '#renesas,channels':
    description:
      Number of channels implemented by the timer.
    $ref: /schemas/types.yaml#/definitions/uint32
    enum: [ 2, 3 ]
    default: 3

required:
  - compatible
  - reg
  - interrupts
  - interrupt-names
  - clocks
  - clock-names
  - power-domains

if:
  not:
    properties:
      compatible:
        contains:
          enum:
            - renesas,tmu-r8a73a4
            - renesas,tmu-r8a7740
            - renesas,tmu-r8a7778
            - renesas,tmu-r8a7779
then:
  required:
    - resets

additionalProperties: false

examples:
  - |
    #include <dt-bindings/clock/r8a7779-clock.h>
    #include <dt-bindings/interrupt-controller/arm-gic.h>
    #include <dt-bindings/power/r8a7779-sysc.h>
    tmu0: timer@ffd80000 {
            compatible = "renesas,tmu-r8a7779", "renesas,tmu";
            reg = <0xffd80000 0x30>;
            interrupts = <GIC_SPI 32 IRQ_TYPE_LEVEL_HIGH>,
                         <GIC_SPI 33 IRQ_TYPE_LEVEL_HIGH>,
                         <GIC_SPI 34 IRQ_TYPE_LEVEL_HIGH>,
                         <GIC_SPI 35 IRQ_TYPE_LEVEL_HIGH>;
            interrupt-names = "tuni0", "tuni1", "tuni2", "ticpi2";
            clocks = <&mstp0_clks R8A7779_CLK_TMU0>;
            clock-names = "fck";
            power-domains = <&sysc R8A7779_PD_ALWAYS_ON>;
            #renesas,channels = <3>;
    };
```

## Documentation/devicetree/bindings/timer/renesas,tpu.txt
```
* Renesas H8/300 Timer Pluse Unit

The TPU is a 16bit timer/counter with configurable clock inputs and
programmable compare match.
This implementation support only cascade mode.

Required Properties:

  - compatible: must contain "renesas,tpu"
  - reg: base address and length of the registers block in 2 channel.
  - clocks: a list of phandle, one for each entry in clock-names.
  - clock-names: must contain "peripheral_clk" for the functional clock.


Example:
	tpu: tpu@ffffe0 {
		compatible = "renesas,tpu";
		reg = <0xffffe0 16>, <0xfffff0 12>;
		clocks = <&pclk>;
		clock-names = "peripheral_clk";
	};
```

## Documentation/devicetree/bindings/timer/renesas,tpu.yaml
```yaml
# SPDX-License-Identifier: (GPL-2.0-only OR BSD-2-Clause)
%YAML 1.2
---
$id: http://devicetree.org/schemas/timer/renesas,tpu.yaml#
$schema: http://devicetree.org/meta-schemas/core.yaml#

title: Renesas H8/300 Timer Pulse Unit

maintainers:
  - Yoshinori Sato <ysato@users.sourceforge.jp>

description:
  The TPU is a 16bit timer/counter with configurable clock inputs and
  programmable compare match.
  This implementation supports only cascade mode.

select:
  properties:
    compatible:
      contains:
        const: renesas,tpu
    '#pwm-cells': false
  required:
    - compatible

properties:
  compatible:
    const: renesas,tpu

  reg:
    items:
      - description: First channel
      - description: Second channel

  clocks:
    maxItems: 1

  clock-names:
    const: fck

required:
  - compatible
  - reg
  - clocks
  - clock-names

additionalProperties: false

examples:
  - |
    tpu: tpu@ffffe0 {
            compatible = "renesas,tpu";
            reg = <0xffffe0 16>, <0xfffff0 12>;
            clocks = <&pclk>;
            clock-names = "fck";
    };
```

## Documentation/devicetree/bindings/timer/riscv,timer.yaml
```yaml
# SPDX-License-Identifier: (GPL-2.0-only OR BSD-2-Clause)
%YAML 1.2
---
$id: http://devicetree.org/schemas/timer/riscv,timer.yaml#
$schema: http://devicetree.org/meta-schemas/core.yaml#

title: RISC-V timer

maintainers:
  - Anup Patel <anup@brainfault.org>

description: |+
  RISC-V platforms always have a RISC-V timer device for the supervisor-mode
  based on the time CSR defined by the RISC-V privileged specification. The
  timer interrupts of this device are configured using the RISC-V SBI Time
  extension or the RISC-V Sstc extension.

  The clock frequency of RISC-V timer device is specified via the
  "timebase-frequency" DT property of "/cpus" DT node which is described
  in Documentation/devicetree/bindings/riscv/cpus.yaml

properties:
  compatible:
    enum:
      - riscv,timer

  interrupts-extended:
    minItems: 1
    maxItems: 4096   # Should be enough?

  riscv,timer-cannot-wake-cpu:
    type: boolean
    description:
      If present, the timer interrupt cannot wake up the CPU from one or
      more suspend/idle states.

additionalProperties: false

required:
  - compatible
  - interrupts-extended

examples:
  - |
    timer {
      compatible = "riscv,timer";
      interrupts-extended = <&cpu1intc 5>,
                            <&cpu2intc 5>,
                            <&cpu3intc 5>,
                            <&cpu4intc 5>;
    };
...
```

## Documentation/devicetree/bindings/timer/rockchip,rk-timer.txt
```
Rockchip rk timer

Required properties:
- compatible: should be:
  "rockchip,rv1108-timer", "rockchip,rk3288-timer": for Rockchip RV1108
  "rockchip,rk3036-timer", "rockchip,rk3288-timer": for Rockchip RK3036
  "rockchip,rk3066-timer", "rockchip,rk3288-timer": for Rockchip RK3066
  "rockchip,rk3188-timer", "rockchip,rk3288-timer": for Rockchip RK3188
  "rockchip,rk3228-timer", "rockchip,rk3288-timer": for Rockchip RK3228
  "rockchip,rk3229-timer", "rockchip,rk3288-timer": for Rockchip RK3229
  "rockchip,rk3288-timer": for Rockchip RK3288
  "rockchip,rk3368-timer", "rockchip,rk3288-timer": for Rockchip RK3368
  "rockchip,rk3399-timer": for Rockchip RK3399
- reg: base address of the timer register starting with TIMERS CONTROL register
- interrupts: should contain the interrupts for Timer0
- clocks : must contain an entry for each entry in clock-names
- clock-names : must include the following entries:
  "timer", "pclk"

Example:
	timer: timer@ff810000 {
		compatible = "rockchip,rk3288-timer";
		reg = <0xff810000 0x20>;
		interrupts = <GIC_SPI 72 IRQ_TYPE_LEVEL_HIGH>;
		clocks = <&xin24m>, <&cru PCLK_TIMER>;
		clock-names = "timer", "pclk";
	};
```

## Documentation/devicetree/bindings/timer/rockchip,rk-timer.yaml
```yaml
# SPDX-License-Identifier: GPL-2.0
%YAML 1.2
---
$id: http://devicetree.org/schemas/timer/rockchip,rk-timer.yaml#
$schema: http://devicetree.org/meta-schemas/core.yaml#

title: Rockchip Timer Device Tree Bindings

maintainers:
  - Daniel Lezcano <daniel.lezcano@linaro.org>

properties:
  compatible:
    oneOf:
      - const: rockchip,rk3288-timer
      - const: rockchip,rk3399-timer
      - items:
          - enum:
              - rockchip,rv1108-timer
              - rockchip,rk3036-timer
              - rockchip,rk3188-timer
              - rockchip,rk3228-timer
              - rockchip,rk3229-timer
              - rockchip,rk3288-timer
              - rockchip,rk3368-timer
              - rockchip,px30-timer
          - const: rockchip,rk3288-timer
  reg:
    maxItems: 1

  interrupts:
    maxItems: 1

  clocks:
    minItems: 2
    maxItems: 2

  clock-names:
    items:
      - const: pclk
      - const: timer

required:
  - compatible
  - reg
  - interrupts
  - clocks
  - clock-names

additionalProperties: false

examples:
  - |
    #include <dt-bindings/interrupt-controller/arm-gic.h>
    #include <dt-bindings/clock/rk3288-cru.h>

    timer: timer@ff810000 {
        compatible = "rockchip,rk3288-timer";
        reg = <0xff810000 0x20>;
        interrupts = <GIC_SPI 72 IRQ_TYPE_LEVEL_HIGH>;
        clocks = <&cru PCLK_TIMER>, <&xin24m>;
        clock-names = "pclk", "timer";
    };
```

## Documentation/devicetree/bindings/timer/rockchip,rk3288-timer.txt
```
Rockchip rk3288 timer

Required properties:
- compatible: shall be "rockchip,rk3288-timer"
- reg: base address of the timer register starting with TIMERS CONTROL register
- interrupts: should contain the interrupts for Timer0
- clocks : must contain an entry for each entry in clock-names
- clock-names : must include the following entries:
  "timer", "pclk"

Example:
	timer: timer@ff810000 {
		compatible = "rockchip,rk3288-timer";
		reg = <0xff810000 0x20>;
		interrupts = <GIC_SPI 72 IRQ_TYPE_LEVEL_HIGH>;
		clocks = <&xin24m>, <&cru PCLK_TIMER>;
		clock-names = "timer", "pclk";
	};
```

## Documentation/devicetree/bindings/timer/samsung,exynos4210-mct.txt
```
Samsung's Multi Core Timer (MCT)

The Samsung's Multi Core Timer (MCT) module includes two main blocks, the
global timer and CPU local timers. The global timer is a 64-bit free running
up-counter and can generate 4 interrupts when the counter reaches one of the
four preset counter values. The CPU local timers are 32-bit free running
down-counters and generate an interrupt when the counter expires. There is
one CPU local timer instantiated in MCT for every CPU in the system.

Required properties:

- compatible: should be "samsung,exynos4210-mct".
  (a) "samsung,exynos4210-mct", for mct compatible with Exynos4210 mct.
  (b) "samsung,exynos4412-mct", for mct compatible with Exynos4412 mct.

- reg: base address of the mct controller and length of the address space
  it occupies.

- interrupts: the list of interrupts generated by the controller. The following
  should be the order of the interrupts specified. The local timer interrupts
  should be specified after the four global timer interrupts have been
  specified.

	0: Global Timer Interrupt 0
	1: Global Timer Interrupt 1
	2: Global Timer Interrupt 2
	3: Global Timer Interrupt 3
	4: Local Timer Interrupt 0
	5: Local Timer Interrupt 1
	6: ..
	7: ..
	i: Local Timer Interrupt n

  For MCT block that uses a per-processor interrupt for local timers, such
  as ones compatible with "samsung,exynos4412-mct", only one local timer
  interrupt might be specified, meaning that all local timers use the same
  per processor interrupt.

Example 1: In this example, the IP contains two local timers, using separate
	   interrupts, so two local timer interrupts have been specified,
	   in addition to four global timer interrupts.

	mct@10050000 {
		compatible = "samsung,exynos4210-mct";
		reg = <0x10050000 0x800>;
		interrupts = <0 57 0>, <0 69 0>, <0 70 0>, <0 71 0>,
			     <0 42 0>, <0 48 0>;
	};

Example 2: In this example, the timer interrupts are connected to two separate
	   interrupt controllers. Hence, an interrupt-map is created to map
	   the interrupts to the respective interrupt controllers.

	mct@101c0000 {
		compatible = "samsung,exynos4210-mct";
		reg = <0x101C0000 0x800>;
		interrupt-parent = <&mct_map>;
		interrupts = <0>, <1>, <2>, <3>, <4>, <5>;

		mct_map: mct-map {
			#interrupt-cells = <1>;
			#address-cells = <0>;
			#size-cells = <0>;
			interrupt-map = <0 &gic 0 57 0>,
					<1 &gic 0 69 0>,
					<2 &combiner 12 6>,
					<3 &combiner 12 7>,
					<4 &gic 0 42 0>,
					<5 &gic 0 48 0>;
		};
	};

Example 3: In this example, the IP contains four local timers, but using
	   a per-processor interrupt to handle them. Either all the local
	   timer interrupts can be specified, with the same interrupt specifier
	   value or just the first one.

	mct@10050000 {
		compatible = "samsung,exynos4412-mct";
		reg = <0x10050000 0x800>;

		/* Both ways are possible in this case. Either: */
		interrupts = <0 57 0>, <0 69 0>, <0 70 0>, <0 71 0>,
			     <0 42 0>;
		/* or: */
		interrupts = <0 57 0>, <0 69 0>, <0 70 0>, <0 71 0>,
			     <0 42 0>, <0 42 0>, <0 42 0>, <0 42 0>;
	};
```
