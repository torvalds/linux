## Documentation/devicetree/bindings/timer/samsung,exynos4210-mct.yaml
```yaml
# SPDX-License-Identifier: GPL-2.0
%YAML 1.2
---
$id: http://devicetree.org/schemas/timer/samsung,exynos4210-mct.yaml#
$schema: http://devicetree.org/meta-schemas/core.yaml#

title: Samsung Exynos SoC Multi Core Timer (MCT)

maintainers:
  - Krzysztof Kozlowski <krzk@kernel.org>

description: |+
  The Samsung's Multi Core Timer (MCT) module includes two main blocks, the
  global timer and CPU local timers. The global timer is a 64-bit free running
  up-counter and can generate 4 interrupts when the counter reaches one of the
  four preset counter values. The CPU local timers are 32-bit free running
  down-counters and generate an interrupt when the counter expires. There is
  one CPU local timer instantiated in MCT for every CPU in the system.

properties:
  compatible:
    oneOf:
      - enum:
          - samsung,exynos4210-mct
          - samsung,exynos4412-mct
      - items:
          - enum:
              - samsung,exynos3250-mct
              - samsung,exynos5250-mct
              - samsung,exynos5260-mct
              - samsung,exynos5420-mct
              - samsung,exynos5433-mct
              - samsung,exynos850-mct
              - tesla,fsd-mct
          - const: samsung,exynos4210-mct

  clocks:
    maxItems: 2

  clock-names:
    items:
      - const: fin_pll
      - const: mct

  reg:
    maxItems: 1

  interrupts:
    description: |
      Interrupts should be put in specific order. This is, the local timer
      interrupts should be specified after the four global timer interrupts
      have been specified:
      0: Global Timer Interrupt 0
      1: Global Timer Interrupt 1
      2: Global Timer Interrupt 2
      3: Global Timer Interrupt 3
      4: Local Timer Interrupt 0
      5: Local Timer Interrupt 1
      6: ..
      7: ..
      i: Local Timer Interrupt n
      For MCT block that uses a per-processor interrupt for local timers, such
      as ones compatible with "samsung,exynos4412-mct", only one local timer
      interrupt might be specified, meaning that all local timers use the same
      per processor interrupt.
    minItems: 5               # 4 Global + 1 local
    maxItems: 20              # 4 Global + 16 local

required:
  - compatible
  - clock-names
  - clocks
  - interrupts
  - reg

allOf:
  - if:
      properties:
        compatible:
          contains:
            const: samsung,exynos3250-mct
    then:
      properties:
        interrupts:
          minItems: 8
          maxItems: 8

  - if:
      properties:
        compatible:
          contains:
            const: samsung,exynos5250-mct
    then:
      properties:
        interrupts:
          minItems: 6
          maxItems: 6

  - if:
      properties:
        compatible:
          contains:
            enum:
              - samsung,exynos5260-mct
              - samsung,exynos5420-mct
              - samsung,exynos5433-mct
              - samsung,exynos850-mct
    then:
      properties:
        interrupts:
          minItems: 12
          maxItems: 12

  - if:
      properties:
        compatible:
          contains:
            enum:
              - tesla,fsd-mct
    then:
      properties:
        interrupts:
          minItems: 16
          maxItems: 16

additionalProperties: false

examples:
  - |
    // In this example, the IP contains two local timers, using separate
    // interrupts, so two local timer interrupts have been specified,
    // in addition to four global timer interrupts.
    #include <dt-bindings/clock/exynos4.h>
    #include <dt-bindings/interrupt-controller/arm-gic.h>

    timer@10050000 {
        compatible = "samsung,exynos4210-mct";
        reg = <0x10050000 0x800>;
        clocks = <&clock CLK_FIN_PLL>, <&clock CLK_MCT>;
        clock-names = "fin_pll", "mct";

        interrupts = <GIC_SPI 57 IRQ_TYPE_LEVEL_HIGH>,
                     <GIC_SPI 69 IRQ_TYPE_LEVEL_HIGH>,
                     <GIC_SPI 70 IRQ_TYPE_LEVEL_HIGH>,
                     <GIC_SPI 71 IRQ_TYPE_LEVEL_HIGH>,
                     <GIC_SPI 42 IRQ_TYPE_LEVEL_HIGH>,
                     <GIC_SPI 48 IRQ_TYPE_LEVEL_HIGH>;
    };

  - |
    // In this example, the timer interrupts are connected to two separate
    // interrupt controllers. Hence, an interrupts-extended is needed.
    #include <dt-bindings/clock/exynos4.h>
    #include <dt-bindings/interrupt-controller/arm-gic.h>

    timer@101c0000 {
        compatible = "samsung,exynos4210-mct";
        reg = <0x101C0000 0x800>;
        clocks = <&clock CLK_FIN_PLL>, <&clock CLK_MCT>;
        clock-names = "fin_pll", "mct";

        interrupts-extended = <&gic GIC_SPI 57 IRQ_TYPE_LEVEL_HIGH>,
                              <&gic GIC_SPI 69 IRQ_TYPE_LEVEL_HIGH>,
                              <&combiner 12 6>,
                              <&combiner 12 7>,
                              <&gic GIC_SPI 42 IRQ_TYPE_LEVEL_HIGH>,
                              <&gic GIC_SPI 48 IRQ_TYPE_LEVEL_HIGH>;
    };

  - |
    // In this example, the IP contains four local timers, but using
    // a per-processor interrupt to handle them. Only one first local
    // interrupt is specified.
    #include <dt-bindings/clock/exynos4.h>
    #include <dt-bindings/interrupt-controller/arm-gic.h>

    timer@10050000 {
        compatible = "samsung,exynos4412-mct";
        reg = <0x10050000 0x800>;
        clocks = <&clock CLK_FIN_PLL>, <&clock CLK_MCT>;
        clock-names = "fin_pll", "mct";

        interrupts = <GIC_SPI 57 IRQ_TYPE_LEVEL_HIGH>,
                     <GIC_SPI 69 IRQ_TYPE_LEVEL_HIGH>,
                     <GIC_SPI 70 IRQ_TYPE_LEVEL_HIGH>,
                     <GIC_SPI 71 IRQ_TYPE_LEVEL_HIGH>,
                     <GIC_PPI 42 IRQ_TYPE_LEVEL_HIGH>;
    };

  - |
    // In this example, the IP contains four local timers, but using
    // a per-processor interrupt to handle them. All the local timer
    // interrupts are specified.
    #include <dt-bindings/clock/exynos4.h>
    #include <dt-bindings/interrupt-controller/arm-gic.h>

    timer@10050000 {
        compatible = "samsung,exynos4412-mct";
        reg = <0x10050000 0x800>;
        clocks = <&clock CLK_FIN_PLL>, <&clock CLK_MCT>;
        clock-names = "fin_pll", "mct";

        interrupts = <GIC_SPI 57 IRQ_TYPE_LEVEL_HIGH>,
                     <GIC_SPI 69 IRQ_TYPE_LEVEL_HIGH>,
                     <GIC_SPI 70 IRQ_TYPE_LEVEL_HIGH>,
                     <GIC_SPI 71 IRQ_TYPE_LEVEL_HIGH>,
                     <GIC_PPI 42 IRQ_TYPE_LEVEL_HIGH>,
                     <GIC_PPI 42 IRQ_TYPE_LEVEL_HIGH>,
                     <GIC_PPI 42 IRQ_TYPE_LEVEL_HIGH>,
                     <GIC_PPI 42 IRQ_TYPE_LEVEL_HIGH>;
    };
```

## Documentation/devicetree/bindings/timer/sifive,clint.yaml
```yaml
# SPDX-License-Identifier: (GPL-2.0-only OR BSD-2-Clause)
%YAML 1.2
---
$id: http://devicetree.org/schemas/timer/sifive,clint.yaml#
$schema: http://devicetree.org/meta-schemas/core.yaml#

title: SiFive Core Local Interruptor

maintainers:
  - Palmer Dabbelt <palmer@dabbelt.com>
  - Anup Patel <anup.patel@wdc.com>

description:
  SiFive (and other RISC-V) SOCs include an implementation of the SiFive
  Core Local Interruptor (CLINT) for M-mode timer and M-mode inter-processor
  interrupts. It directly connects to the timer and inter-processor interrupt
  lines of various HARTs (or CPUs) so RISC-V per-HART (or per-CPU) local
  interrupt controller is the parent interrupt controller for CLINT device.
  The clock frequency of CLINT is specified via "timebase-frequency" DT
  property of "/cpus" DT node. The "timebase-frequency" DT property is
  described in Documentation/devicetree/bindings/riscv/cpus.yaml

  T-Head C906/C910 CPU cores include an implementation of CLINT too, however
  their implementation lacks a memory-mapped MTIME register, thus not
  compatible with SiFive ones.

properties:
  compatible:
    oneOf:
      - items:
          - enum:
              - canaan,k210-clint       # Canaan Kendryte K210
              - sifive,fu540-c000-clint # SiFive FU540
              - spacemit,k1-clint       # SpacemiT K1
              - starfive,jh7100-clint   # StarFive JH7100
              - starfive,jh7110-clint   # StarFive JH7110
              - starfive,jh8100-clint   # StarFive JH8100
          - const: sifive,clint0        # SiFive CLINT v0 IP block
      - items:
          - enum:
              - allwinner,sun20i-d1-clint
              - sophgo,cv1800b-clint
              - sophgo,cv1812h-clint
              - sophgo,sg2002-clint
              - thead,th1520-clint
          - const: thead,c900-clint
      - items:
          - const: sifive,clint0
          - const: riscv,clint0
        deprecated: true
        description: For the QEMU virt machine only

    description:
      Should be "<vendor>,<chip>-clint", followed by "sifive,clint<version>"
      when compatible with a SiFive CLINT.  Please refer to
      sifive-blocks-ip-versioning.txt for details regarding the latter.

  reg:
    maxItems: 1

  interrupts-extended:
    minItems: 1
    maxItems: 4095

additionalProperties: false

required:
  - compatible
  - reg
  - interrupts-extended

examples:
  - |
    timer@2000000 {
      compatible = "sifive,fu540-c000-clint", "sifive,clint0";
      interrupts-extended = <&cpu1intc 3>, <&cpu1intc 7>,
                            <&cpu2intc 3>, <&cpu2intc 7>,
                            <&cpu3intc 3>, <&cpu3intc 7>,
                            <&cpu4intc 3>, <&cpu4intc 7>;
       reg = <0x2000000 0x10000>;
    };
...
```

## Documentation/devicetree/bindings/timer/snps,arc-timer.txt
```
Synopsys ARC Local Timer with Interrupt Capabilities
- Found on all ARC CPUs (ARC700/ARCHS)
- Can be optionally programmed to interrupt on Limit
- Two idential copies TIMER0 and TIMER1 exist in ARC cores and historically
  TIMER0 used as clockevent provider (true for all ARC cores)
  TIMER1 used for clocksource (mandatory for ARC700, optional for ARC HS)

Required properties:

- compatible : should be "snps,arc-timer"
- interrupts : single Interrupt going into parent intc
	       (16 for ARCHS cores, 3 for ARC700 cores)
- clocks     : phandle to the source clock

Example:

	timer0 {
		compatible = "snps,arc-timer";
		interrupts = <3>;
		interrupt-parent = <&core_intc>;
		clocks = <&core_clk>;
	};

	timer1 {
		compatible = "snps,arc-timer";
		clocks = <&core_clk>;
	};
```

## Documentation/devicetree/bindings/timer/snps,arc-timer.yaml
```yaml
# SPDX-License-Identifier: (GPL-2.0-only OR BSD-2-Clause)
%YAML 1.2
---
$id: http://devicetree.org/schemas/snps,arc-timer.yaml#
$schema: http://devicetree.org/meta-schemas/core.yaml#

title: Synopsys ARC Local Timer

maintainers:
  - Vineet Gupta <vgupta@synopsys.com>

description: >
  Synopsys ARC Local Timer with Interrupt Capabilities

    - Found on all ARC CPUs (ARC700/ARCHS)
    - Can be optionally programmed to interrupt on Limit
    - Two identical copies TIMER0 and TIMER1 exist in ARC cores and historically
      TIMER0 used as clockevent provider (true for all ARC cores)
      TIMER1 used for clocksource (mandatory for ARC700, optional for ARC HS)

properties:
  compatible:
    const: snps,arc-timer

  interrupts:
    maxItems: 1
    description: A single timer interrupt going into the parent interrupt controller.
      Use <16> for ARCHS cores, <3> for ARC700 cores.

  clocks:
    maxItems: 1

required:
  - compatible
  - clocks

additionalProperties: false

examples:
  - |
    timer0 {
        compatible = "snps,arc-timer";
        interrupts = <3>;
        clocks = <&core_clk>;
    };
```

## Documentation/devicetree/bindings/timer/snps,archs-gfrc.txt
```
Synopsys ARC Free Running 64-bit Global Timer for ARC HS CPUs
- clocksource provider for SMP SoC

Required properties:

- compatible : should be "snps,archs-gfrc"
- clocks     : phandle to the source clock

Example:

	gfrc {
		compatible = "snps,archs-gfrc";
		clocks = <&core_clk>;
	};
```

## Documentation/devicetree/bindings/timer/snps,archs-gfrc.yaml
```yaml
# SPDX-License-Identifier: (GPL-2.0-only OR BSD-2-Clause)
%YAML 1.2
---
$id: http://devicetree.org/schemas/snps,archs-gfrc.yaml#
$schema: http://devicetree.org/meta-schemas/core.yaml#

title: Synopsys ARC Free Running 64-bit Global Timer for ARC HS CPUs

maintainers:
  - Vineet Gupta <vgupta@synopsys.com>

properties:
  compatible:
    const: snps,archs-gfrc

  clocks:
    maxItems: 1

required:
  - compatible
  - clocks

additionalProperties: false

examples:
  - |
    timer {
        compatible = "snps,archs-gfrc";
        clocks = <&core_clk>;
    };
```

## Documentation/devicetree/bindings/timer/snps,archs-rtc.txt
```
Synopsys ARC Free Running 64-bit Local Timer for ARC HS CPUs
- clocksource provider for UP SoC

Required properties:

- compatible : should be "snps,archs-rtc"
- clocks     : phandle to the source clock

Example:

	rtc {
		compatible = "snps,arc-rtc";
		clocks = <&core_clk>;
	};
```

## Documentation/devicetree/bindings/timer/snps,archs-rtc.yaml
```yaml
# SPDX-License-Identifier: (GPL-2.0-only OR BSD-2-Clause)
%YAML 1.2
---
$id: http://devicetree.org/schemas/snps,archs-rtc.yaml#
$schema: http://devicetree.org/meta-schemas/core.yaml#

title: Synopsys ARC Free Running 64-bit Local Timer for ARC HS CPUs

maintainers:
  - Vineet Gupta <vgupta@synopsys.com>

properties:
  compatible:
    const: snps,archs-rtc

  clocks:
    maxItems: 1

required:
  - compatible
  - clocks

additionalProperties: false

examples:
  - |
    rtc {
      compatible = "snps,archs-rtc";
      clocks = <&core_clk>;
    };
```

## Documentation/devicetree/bindings/timer/snps,dw-apb-timer.yaml
```yaml
# SPDX-License-Identifier: GPL-2.0-only
%YAML 1.2
---
$id: http://devicetree.org/schemas/timer/snps,dw-apb-timer.yaml#
$schema: http://devicetree.org/meta-schemas/core.yaml#

title: Synopsys DesignWare APB Timer

maintainers:
  - Daniel Lezcano <daniel.lezcano@linaro.org>

properties:
  compatible:
    oneOf:
      - const: snps,dw-apb-timer
      - enum:
          - snps,dw-apb-timer-sp
          - snps,dw-apb-timer-osc
        deprecated: true

  reg:
    maxItems: 1

  interrupts:
    maxItems: 1

  clocks:
    minItems: 1
    items:
      - description: Timer ticks reference clock source
      - description: APB interface clock source

  clock-names:
    minItems: 1
    items:
      - const: timer
      - const: pclk

  clock-frequency: true

additionalProperties: false

required:
  - compatible
  - reg
  - interrupts

oneOf:
  - required:
      - clocks
      - clock-names
  - required:
      - clock-frequency
  - required:
      - clock-freq

examples:
  - |
    timer@ffe00000 {
      compatible = "snps,dw-apb-timer";
      interrupts = <0 170 4>;
      reg = <0xffe00000 0x1000>;
      clocks = <&timer_clk>, <&timer_pclk>;
      clock-names = "timer", "pclk";
    };
  - |
    timer@ffe00000 {
      compatible = "snps,dw-apb-timer";
      interrupts = <0 170 4>;
      reg = <0xffe00000 0x1000>;
      clocks = <&timer_clk>;
      clock-names = "timer";
    };
  - |
    timer@ffe00000 {
      compatible = "snps,dw-apb-timer";
      interrupts = <0 170 4>;
      reg = <0xffe00000 0x1000>;
      clock-frequency = <25000000>;
    };
...
```

## Documentation/devicetree/bindings/timer/socionext,milbeaut-timer.txt
```
Milbeaut SoCs Timer Controller

Required properties:

- compatible : should be "socionext,milbeaut-timer".
- reg : Specifies base physical address and size of the registers.
- interrupts : The interrupt of the first timer.
- clocks: phandle to the input clk.

Example:

timer {
	compatible = "socionext,milbeaut-timer";
	reg = <0x1e000050 0x20>
	interrupts = <0 91 4>;
	clocks = <&clk 4>;
};
```
