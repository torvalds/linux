## Documentation/devicetree/bindings/timer/socionext,milbeaut-timer.yaml
```yaml
# SPDX-License-Identifier: (GPL-2.0-only OR BSD-2-Clause)
%YAML 1.2
---
$id: http://devicetree.org/schemas/socionext,milbeaut-timer.yaml#
$schema: http://devicetree.org/meta-schemas/core.yaml#

title: Milbeaut SoCs Timer Controller

maintainers:
  - Sugaya Taichi <sugaya.taichi@socionext.com>

properties:
  compatible:
    const: socionext,milbeaut-timer

  reg:
    maxItems: 1

  interrupts:
    maxItems: 1

  clocks:
    maxItems: 1

required:
  - compatible
  - reg
  - interrupts
  - clocks

additionalProperties: false

examples:
  - |
    timer@1e000050 {
        compatible = "socionext,milbeaut-timer";
        reg = <0x1e000050 0x20>;
        interrupts = <0 91 4>;
        clocks = <&clk 4>;
    };
```

## Documentation/devicetree/bindings/timer/sprd,sc9860-timer.yaml
```yaml
# SPDX-License-Identifier: GPL-2.0-only OR BSD-2-Clause
%YAML 1.2
---
$id: http://devicetree.org/schemas/timer/sprd,sc9860-timer.yaml#
$schema: http://devicetree.org/meta-schemas/core.yaml#

title: Spreadtrum SC9860 timer

maintainers:
  - Orson Zhai <orsonzhai@gmail.com>
  - Baolin Wang <baolin.wang7@gmail.com>
  - Chunyan Zhang <zhang.lyra@gmail.com>

description:
  The Spreadtrum SC9860 platform provides 3 general-purpose timers.
  These timers can support 32bit or 64bit counter, as well as supporting
  period mode or one-shot mode, and they can be a wakeup source
  during deep sleep.

properties:
  compatible:
    enum:
      - sprd,sc9860-timer
      - sprd,sc9860-suspend-timer

  reg:
    maxItems: 1

  interrupts:
    maxItems: 1

  clocks:
    maxItems: 1

required:
  - compatible
  - reg
  - clocks

allOf:
  - if:
      properties:
        compatible:
          contains:
            const: sprd,sc9860-timer
    then:
      required:
        - interrupts

additionalProperties: false

examples:
  - |
    #include <dt-bindings/interrupt-controller/arm-gic.h>
    #include <dt-bindings/interrupt-controller/irq.h>

    soc {
      #address-cells = <2>;
      #size-cells = <2>;

      timer@40050000 {
        compatible = "sprd,sc9860-timer";
        reg = <0 0x40050000 0 0x20>;
        interrupts = <GIC_SPI 26 IRQ_TYPE_LEVEL_HIGH>;
        clocks = <&ext_32k>;
      };
    };
...
```

## Documentation/devicetree/bindings/timer/spreadtrum,sprd-timer.txt
```
Spreadtrum timers

The Spreadtrum SC9860 platform provides 3 general-purpose timers.
These timers can support 32bit or 64bit counter, as well as supporting
period mode or one-shot mode, and they are can be wakeup source
during deep sleep.

Required properties:
- compatible: should be "sprd,sc9860-timer" for SC9860 platform.
- reg: The register address of the timer device.
- interrupts: Should contain the interrupt for the timer device.
- clocks: The phandle to the source clock (usually a 32.768 KHz fixed clock).

Example:
	timer@40050000 {
		compatible = "sprd,sc9860-timer";
		reg = <0 0x40050000 0 0x20>;
		interrupts = <GIC_SPI 26 IRQ_TYPE_LEVEL_HIGH>;
		clocks = <&ext_32k>;
	};
```

## Documentation/devicetree/bindings/timer/st,nomadik-mtu.yaml
```yaml
# SPDX-License-Identifier: (GPL-2.0 OR BSD-2-Clause)
# Copyright 2022 Linaro Ltd.
%YAML 1.2
---
$id: "http://devicetree.org/schemas/timer/st,nomadik-mtu.yaml#"
$schema: "http://devicetree.org/meta-schemas/core.yaml#"

title: ST Microelectronics Nomadik Multi-Timer Unit MTU Timer

maintainers:
  - Linus Walleij <linus.walleij@linaro.org>

description: This timer is found in the ST Microelectronics Nomadik
  SoCs STn8800, STn8810 and STn8815 as well as in ST-Ericsson DB8500.

properties:
  compatible:
    items:
      - const: st,nomadik-mtu

  reg:
    maxItems: 1

  interrupts:
    maxItems: 1

  clocks:
    description: The first clock named TIMCLK clocks the actual timers and
      the second clock clocks the digital interface to the interconnect.
    maxItems: 2

  clock-names:
    items:
      - const: timclk
      - const: apb_pclk

required:
  - compatible
  - reg
  - interrupts
  - clocks
  - clock-names

additionalProperties: false

examples:
  - |
    #include <dt-bindings/interrupt-controller/irq.h>
    #include <dt-bindings/interrupt-controller/arm-gic.h>
    #include <dt-bindings/mfd/dbx500-prcmu.h>
    timer@a03c6000 {
      compatible = "st,nomadik-mtu";
      reg = <0xa03c6000 0x1000>;
      interrupts = <GIC_SPI 4 IRQ_TYPE_LEVEL_HIGH>;

      clocks = <&prcmu_clk PRCMU_TIMCLK>, <&prcc_pclk 6 6>;
      clock-names = "timclk", "apb_pclk";
    };
```

## Documentation/devicetree/bindings/timer/st,spear-timer.txt
```
* SPEAr ARM Timer

** Timer node required properties:

- compatible : Should be:
	"st,spear-timer"
- reg: Address range of the timer registers
- interrupt: Should contain the timer interrupt number

Example:

	timer@f0000000 {
		compatible = "st,spear-timer";
		reg = <0xf0000000 0x400>;
		interrupts = <2>;
	};
```

## Documentation/devicetree/bindings/timer/st,spear-timer.yaml
```yaml
# SPDX-License-Identifier: (GPL-2.0-only OR BSD-2-Clause)
%YAML 1.2
---
$id: http://devicetree.org/schemas/timer/st,spear-timer.yaml#
$schema: http://devicetree.org/meta-schemas/core.yaml#

title: SPEAr ARM Timer

maintainers:
  - Viresh Kumar <vireshk@kernel.org>
  - Shiraz Hashim <shiraz.linux.kernel@gmail.com>

properties:
  compatible:
    const: st,spear-timer

  reg:
    maxItems: 1

  interrupts:
    maxItems: 1

required:
  - compatible
  - reg
  - interrupts

additionalProperties: false

examples:
  - |
    timer@f0000000 {
        compatible = "st,spear-timer";
        reg = <0xf0000000 0x400>;
        interrupts = <2>;
    };
```

## Documentation/devicetree/bindings/timer/st,stm32-timer.txt
```
. STMicroelectronics STM32 timer

The STM32 MCUs family has several general-purpose 16 and 32 bits timers.

Required properties:
- compatible : Should be "st,stm32-timer"
- reg : Address and length of the register set
- clocks : Reference on the timer input clock
- interrupts : Reference to the timer interrupt

Optional properties:
- resets: Reference to a reset controller asserting the timer

Example:

timer5: timer@40000c00 {
	compatible = "st,stm32-timer";
	reg = <0x40000c00 0x400>;
	interrupts = <50>;
	resets = <&rrc 259>;
	clocks = <&clk_pmtr1>;
};
```
