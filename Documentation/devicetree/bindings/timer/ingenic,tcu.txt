## Documentation/devicetree/bindings/timer/marvell,armada-370-timer.yaml
```yaml
# SPDX-License-Identifier: (GPL-2.0-only OR BSD-2-Clause)
%YAML 1.2
---
$id: http://devicetree.org/schemas/timer/marvell,armada-370-timer.yaml#
$schema: http://devicetree.org/meta-schemas/core.yaml#

title: Marvell Armada 370, 375, 380 and XP Timers

maintainers:
  - Andrew Lunn <andrew@lunn.ch>
  - Gregory Clement <gregory.clement@bootlin.com>

properties:
  compatible:
    oneOf:
      - items:
          - const: marvell,armada-380-timer
          - const: marvell,armada-xp-timer
      - items:
          - const: marvell,armada-375-timer
          - const: marvell,armada-370-timer
      - enum:
          - marvell,armada-370-timer
          - marvell,armada-xp-timer

  reg:
    items:
      - description: Global timer registers
      - description: Local/private timer registers

  interrupts:
    items:
      - description: Global timer interrupt 0
      - description: Global timer interrupt 1
      - description: Global timer interrupt 2
      - description: Global timer interrupt 3
      - description: First private timer interrupt
      - description: Second private timer interrupt

  clocks:
    minItems: 1
    maxItems: 2

  clock-names:
    items:
      - const: nbclk
      - const: fixed

required:
  - compatible
  - reg
  - interrupts
  - clocks

additionalProperties: false

allOf:
  - if:
      properties:
        compatible:
          contains:
            enum:
              - marvell,armada-375-timer
              - marvell,armada-xp-timer
    then:
      properties:
        clocks:
          minItems: 2
        clock-names:
          minItems: 2
      required:
        - clock-names
    else:
      properties:
        clocks:
          maxItems: 1
        clock-names:
          maxItems: 1

examples:
  - |
    timer@20300 {
        compatible = "marvell,armada-xp-timer";
        reg = <0x20300 0x30>, <0x21040 0x30>;
        interrupts = <37>, <38>, <39>, <40>, <5>, <6>;
        clocks = <&coreclk 2>, <&refclk>;
        clock-names = "nbclk", "fixed";
    };
```

## Documentation/devicetree/bindings/timer/marvell,armada-370-xp-timer.txt
```
Marvell Armada 370 and Armada XP Timers
---------------------------------------

Required properties:
- compatible: Should be one of the following
              "marvell,armada-370-timer",
	      "marvell,armada-375-timer",
	      "marvell,armada-xp-timer".
- interrupts: Should contain the list of Global Timer interrupts and
  then local timer interrupts
- reg: Should contain location and length for timers register. First
  pair for the Global Timer registers, second pair for the
  local/private timers.

Clocks required for compatible = "marvell,armada-370-timer":
- clocks : Must contain a single entry describing the clock input

Clocks required for compatibles = "marvell,armada-xp-timer",
				  "marvell,armada-375-timer":
- clocks : Must contain an entry for each entry in clock-names.
- clock-names : Must include the following entries:
  "nbclk" (L2/coherency fabric clock),
  "fixed" (Reference 25 MHz fixed-clock).

Examples:

- Armada 370:

	timer {
		compatible = "marvell,armada-370-timer";
		reg = <0x20300 0x30>, <0x21040 0x30>;
		interrupts = <37>, <38>, <39>, <40>, <5>, <6>;
		clocks = <&coreclk 2>;
	};

- Armada XP:

	timer {
		compatible = "marvell,armada-xp-timer";
		reg = <0x20300 0x30>, <0x21040 0x30>;
		interrupts = <37>, <38>, <39>, <40>, <5>, <6>;
		clocks = <&coreclk 2>, <&refclk>;
		clock-names = "nbclk", "fixed";
	};
```

## Documentation/devicetree/bindings/timer/marvell,orion-timer.txt
```
Marvell Orion SoC timer

Required properties:
- compatible: shall be "marvell,orion-timer"
- reg: base address of the timer register starting with TIMERS CONTROL register
- interrupt-parent: phandle of the bridge interrupt controller
- interrupts: should contain the interrupts for Timer0 and Timer1
- clocks: phandle of timer reference clock (tclk)

Example:
	timer: timer {
		compatible = "marvell,orion-timer";
		reg = <0x20300 0x20>;
		interrupt-parent = <&bridge_intc>;
		interrupts = <1>, <2>;
		clocks = <&core_clk 0>;
	};
```

## Documentation/devicetree/bindings/timer/marvell,orion-timer.yaml
```yaml
# SPDX-License-Identifier: (GPL-2.0-only OR BSD-2-Clause)
%YAML 1.2
---
$id: http://devicetree.org/schemas/marvell,orion-timer.yaml#
$schema: http://devicetree.org/meta-schemas/core.yaml#

title: Marvell Orion SoC timer

maintainers:
  - Andrew Lunn <andrew@lunn.ch>
  - Gregory Clement <gregory.clement@bootlin.com>

properties:
  compatible:
    const: marvell,orion-timer

  reg:
    maxItems: 1

  clocks:
    maxItems: 1

  interrupts:
    items:
      - description: Timer0 interrupt
      - description: Timer1 interrupt

required:
  - compatible
  - reg
  - interrupts
  - clocks

additionalProperties: false

examples:
  - |
    timer@20300 {
        compatible = "marvell,orion-timer";
        reg = <0x20300 0x20>;
        interrupts = <1>, <2>;
        clocks = <&core_clk 0>;
    };
```

## Documentation/devicetree/bindings/timer/mediatek,mtk-timer.txt
```
MediaTek Timers
---------------

MediaTek SoCs have two different timers on different platforms,
- GPT (General Purpose Timer)
- SYST (System Timer)

The proper timer will be selected automatically by driver.

Required properties:
- compatible should contain:
	For those SoCs that use GPT
	* "mediatek,mt2701-timer" for MT2701 compatible timers (GPT)
	* "mediatek,mt6580-timer" for MT6580 compatible timers (GPT)
	* "mediatek,mt6589-timer" for MT6589 compatible timers (GPT)
	* "mediatek,mt7623-timer" for MT7623 compatible timers (GPT)
	* "mediatek,mt8127-timer" for MT8127 compatible timers (GPT)
	* "mediatek,mt8135-timer" for MT8135 compatible timers (GPT)
	* "mediatek,mt8173-timer" for MT8173 compatible timers (GPT)
	* "mediatek,mt8516-timer" for MT8516 compatible timers (GPT)
	* "mediatek,mt6577-timer" for MT6577 and all above compatible timers (GPT)

	For those SoCs that use SYST
	* "mediatek,mt8183-timer" for MT8183 compatible timers (SYST)
	* "mediatek,mt8192-timer" for MT8192 compatible timers (SYST)
	* "mediatek,mt7629-timer" for MT7629 compatible timers (SYST)
	* "mediatek,mt6765-timer" for MT6765 and all above compatible timers (SYST)

- reg: Should contain location and length for timer register.
- clocks: Should contain system clock.

Examples:

	timer@10008000 {
		compatible = "mediatek,mt6577-timer";
		reg = <0x10008000 0x80>;
		interrupts = <GIC_SPI 113 IRQ_TYPE_LEVEL_LOW>;
		clocks = <&system_clk>;
	};
```

## Documentation/devicetree/bindings/timer/mediatek,timer.yaml
```yaml
# SPDX-License-Identifier: (GPL-2.0 OR BSD-2-Clause)
%YAML 1.2
---
$id: http://devicetree.org/schemas/timer/mediatek,timer.yaml#
$schema: http://devicetree.org/meta-schemas/core.yaml#

title: MediaTek SoC timers

maintainers:
  - Matthias Brugger <matthias.bgg@gmail.com>

description:
  MediaTek SoCs have different timers on different platforms,
  CPUX (ARM/ARM64 System Timer), GPT (General Purpose Timer)
  and SYST (System Timer).

properties:
  compatible:
    oneOf:
      - items:
          - enum:
              - mediatek,mt6577-timer
              - mediatek,mt6765-timer
              - mediatek,mt6795-systimer
      # GPT Timers
      - items:
          - enum:
              - mediatek,mt2701-timer
              - mediatek,mt6580-timer
              - mediatek,mt6582-timer
              - mediatek,mt6589-timer
              - mediatek,mt7623-timer
              - mediatek,mt8127-timer
              - mediatek,mt8135-timer
              - mediatek,mt8173-timer
              - mediatek,mt8516-timer
          - const: mediatek,mt6577-timer
      # SYST Timers
      - items:
          - enum:
              - mediatek,mt7629-timer
              - mediatek,mt8183-timer
              - mediatek,mt8186-timer
              - mediatek,mt8188-timer
              - mediatek,mt8192-timer
              - mediatek,mt8195-timer
              - mediatek,mt8365-systimer
          - const: mediatek,mt6765-timer

  reg:
    maxItems: 1

  interrupts:
    maxItems: 1

  clocks:
    minItems: 1
    items:
      - description: Timer clock
      - description: RTC or bus clock

  clock-names:
    minItems: 1
    maxItems: 2

required:
  - compatible
  - reg
  - interrupts
  - clocks

additionalProperties: false

examples:
  - |
    #include <dt-bindings/interrupt-controller/irq.h>
    #include <dt-bindings/interrupt-controller/arm-gic.h>

    timer@10008000 {
      compatible = "mediatek,mt6577-timer";
      reg = <0x10008000 0x80>;
      interrupts = <GIC_SPI 113 IRQ_TYPE_LEVEL_LOW>;
      clocks = <&system_clk>;
    };
```

## Documentation/devicetree/bindings/timer/moxa,moxart-timer.txt
```
MOXA ART timer

Required properties:

- compatible : Must be one of:
 	- "moxa,moxart-timer"
 	- "aspeed,ast2400-timer"
- reg : Should contain registers location and length
- interrupts : Should contain the timer interrupt number
- clocks : Should contain phandle for the clock that drives the counter

Example:

	timer: timer@98400000 {
		compatible = "moxa,moxart-timer";
		reg = <0x98400000 0x42>;
		interrupts = <19 1>;
		clocks = <&coreclk>;
	};
```

## Documentation/devicetree/bindings/timer/mrvl,mmp-timer.txt
```
* Marvell MMP Timer controller

Required properties:
- compatible : Should be "mrvl,mmp-timer".
- reg : Address and length of the register set of timer controller.
- interrupts : Should be the interrupt number.

Example:
	timer0: timer@d4014000 {
		compatible = "mrvl,mmp-timer";
		reg = <0xd4014000 0x100>;
		interrupts = <13>;
	};
```

## Documentation/devicetree/bindings/timer/mrvl,mmp-timer.yaml
```yaml
# SPDX-License-Identifier: GPL-2.0-only
%YAML 1.2
---
$id: http://devicetree.org/schemas/timer/mrvl,mmp-timer.yaml#
$schema: http://devicetree.org/meta-schemas/core.yaml#

title: Marvell MMP Timer bindings

maintainers:
  - Daniel Lezcano <daniel.lezcano@linaro.org>
  - Thomas Gleixner <tglx@linutronix.de>
  - Rob Herring <robh+dt@kernel.org>

properties:
  $nodename:
    pattern: '^timer@[a-f0-9]+$'

  compatible:
    const: mrvl,mmp-timer

  reg:
    maxItems: 1

  interrupts:
    maxItems: 1

  clocks:
    maxItems: 1

required:
  - compatible
  - reg
  - interrupts

additionalProperties: false

examples:
  - |
    timer@d4014000 {
        compatible = "mrvl,mmp-timer";
        reg = <0xd4014000 0x100>;
        interrupts = <13>;
        clocks = <&coreclk 2>;
    };

...
```

## Documentation/devicetree/bindings/timer/mstar,msc313e-timer.yaml
```yaml
# SPDX-License-Identifier: (GPL-2.0-only OR BSD-2-Clause)
%YAML 1.2
---
$id: http://devicetree.org/schemas/timer/mstar,msc313e-timer.yaml#
$schema: http://devicetree.org/meta-schemas/core.yaml#

title: Mstar MSC313e Timer

maintainers:
  - Daniel Palmer <daniel@0x0f.com>
  - Romain Perier <romain.perier@gmail.com>

properties:
  compatible:
    enum:
      - mstar,msc313e-timer
      - sstar,ssd20xd-timer

  reg:
    maxItems: 1

  interrupts:
    maxItems: 1

  clocks:
    maxItems: 1

required:
  - compatible
  - reg
  - interrupts
  - clocks

additionalProperties: false

examples:
  - |
    #include <dt-bindings/interrupt-controller/arm-gic.h>

    timer@6040 {
        compatible = "mstar,msc313e-timer";
        reg = <0x6040 0x40>;
        clocks = <&xtal_div2>;
        interrupts-extended = <&intc_fiq GIC_SPI 0 IRQ_TYPE_LEVEL_HIGH>;
    };
...
```

## Documentation/devicetree/bindings/timer/nuvoton,npcm7xx-timer.txt
```
Nuvoton NPCM7xx timer

Nuvoton NPCM7xx have three timer modules, each timer module provides five 24-bit
timer counters.

Required properties:
- compatible      : "nuvoton,npcm750-timer" for Poleg NPCM750, or
                    "nuvoton,wpcm450-timer" for Hermon WPCM450.
- reg             : Offset and length of the register set for the device.
- interrupts      : Contain the timer interrupt of timer 0.
- clocks          : phandle of timer reference clock (usually a 25 MHz clock).

Example:

timer@f0008000 {
    compatible = "nuvoton,npcm750-timer";
    interrupts = <GIC_SPI 32 IRQ_TYPE_LEVEL_HIGH>;
    reg = <0xf0008000 0x50>;
    clocks = <&clk NPCM7XX_CLK_TIMER>;
};
```

## Documentation/devicetree/bindings/timer/nuvoton,npcm7xx-timer.yaml
```yaml
# SPDX-License-Identifier: (GPL-2.0-only OR BSD-2-Clause)
%YAML 1.2
---
$id: http://devicetree.org/schemas/timer/nuvoton,npcm7xx-timer.yaml#
$schema: http://devicetree.org/meta-schemas/core.yaml#

title: Nuvoton NPCM7xx timer

maintainers:
  - Jonathan Neuschäfer <j.neuschaefer@gmx.net>
  - Tomer Maimon <tmaimon77@gmail.com>

properties:
  compatible:
    enum:
      - nuvoton,wpcm450-timer  # for Hermon WPCM450
      - nuvoton,npcm750-timer  # for Poleg NPCM750
      - nuvoton,npcm845-timer  # for Arbel NPCM845

  reg:
    maxItems: 1

  interrupts:
    items:
      - description: The timer interrupt of timer 0

  clocks:
    maxItems: 1

required:
  - compatible
  - reg
  - interrupts
  - clocks

additionalProperties: false

examples:
  - |
    #include <dt-bindings/interrupt-controller/irq.h>
    #include <dt-bindings/interrupt-controller/arm-gic.h>
    #include <dt-bindings/clock/nuvoton,npcm7xx-clock.h>
    timer@f0008000 {
        compatible = "nuvoton,npcm750-timer";
        interrupts = <GIC_SPI 32 IRQ_TYPE_LEVEL_HIGH>;
        reg = <0xf0008000 0x50>;
        clocks = <&clk NPCM7XX_CLK_TIMER>;
    };
```
