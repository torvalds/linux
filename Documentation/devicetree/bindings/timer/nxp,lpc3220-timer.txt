## Documentation/devicetree/bindings/timer/renesas,tmu.txt
```
* Renesas R-Mobile/R-Car Timer Unit (TMU)

The TMU is a 32-bit timer/counter with configurable clock inputs and
programmable compare match.

Channels share hardware resources but their counter and compare match value
are independent. The TMU hardware supports up to three channels.

Required Properties:

  - compatible: must contain one or more of the following:
    - "renesas,tmu-r8a7740" for the r8a7740 TMU
    - "renesas,tmu-r8a774c0" for the r8a774C0 TMU
    - "renesas,tmu-r8a7778" for the r8a7778 TMU
    - "renesas,tmu-r8a7779" for the r8a7779 TMU
    - "renesas,tmu-r8a77970" for the r8a77970 TMU
    - "renesas,tmu-r8a77980" for the r8a77980 TMU
    - "renesas,tmu" for any TMU.
      This is a fallback for the above renesas,tmu-* entries

  - reg: base address and length of the registers block for the timer module.

  - interrupts: interrupt-specifier for the timer, one per channel.

  - clocks: a list of phandle + clock-specifier pairs, one for each entry
    in clock-names.
  - clock-names: must contain "fck" for the functional clock.

Optional Properties:

  - #renesas,channels: number of channels implemented by the timer, must be 2
    or 3 (if not specified the value defaults to 3).


Example: R8A7779 (R-Car H1) TMU0 node

	tmu0: timer@ffd80000 {
		compatible = "renesas,tmu-r8a7779", "renesas,tmu";
		reg = <0xffd80000 0x30>;
		interrupts = <0 32 IRQ_TYPE_LEVEL_HIGH>,
			     <0 33 IRQ_TYPE_LEVEL_HIGH>,
			     <0 34 IRQ_TYPE_LEVEL_HIGH>;
		clocks = <&mstp0_clks R8A7779_CLK_TMU0>;
		clock-names = "fck";

		#renesas,channels = <3>;
	};
```
