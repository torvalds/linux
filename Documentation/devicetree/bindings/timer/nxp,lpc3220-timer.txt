## Documentation/devicetree/bindings/timer/nxp,lpc3220-timer.txt
```
* NXP LPC3220 timer

The NXP LPC3220 timer is used on a wide range of NXP SoCs. This
includes LPC32xx, LPC178x, LPC18xx and LPC43xx parts.

Required properties:
- compatible:
	Should be "nxp,lpc3220-timer".
- reg:
	Address and length of the register set.
- interrupts:
	Reference to the timer interrupt
- clocks:
	Should contain a reference to timer clock.
- clock-names:
	Should contain "timerclk".

Example:

timer1: timer@40085000 {
	compatible = "nxp,lpc3220-timer";
	reg = <0x40085000 0x1000>;
	interrupts = <13>;
	clocks = <&ccu1 CLK_CPU_TIMER1>;
	clock-names = "timerclk";
};
```

## Documentation/devicetree/bindings/timer/nxp,lpc3220-timer.yaml
```yaml
# SPDX-License-Identifier: (GPL-2.0-only OR BSD-2-Clause)
%YAML 1.2
---
$id: http://devicetree.org/schemas/timer/nxp,lpc3220-timer.yaml#
$schema: http://devicetree.org/meta-schemas/core.yaml#

title: NXP LPC3220 timer

maintainers:
  - Animesh Agarwal <animeshagarwal28@gmail.com>

description: |
  The NXP LPC3220 timer is used on a wide range of NXP SoCs. This includes
  LPC32xx, LPC178x, LPC18xx and LPC43xx parts.

properties:
  compatible:
    const: nxp,lpc3220-timer

  reg:
    maxItems: 1

  interrupts:
    maxItems: 1

  clocks:
    maxItems: 1

  clock-names:
    const: timerclk

  resets:
    maxItems: 1

required:
  - compatible
  - reg
  - interrupts
  - clocks
  - clock-names

additionalProperties: false

examples:
  - |
    #include <dt-bindings/clock/lpc32xx-clock.h>
    #include <dt-bindings/interrupt-controller/irq.h>

    timer@4004c000 {
        compatible = "nxp,lpc3220-timer";
        reg = <0x4004c000 0x1000>;
        interrupts = <17 IRQ_TYPE_LEVEL_LOW>;
        clocks = <&clk LPC32XX_CLK_TIMER1>;
        clock-names = "timerclk";
    };
```

## Documentation/devicetree/bindings/timer/nxp,s32g2-stm.yaml
```yaml
# SPDX-License-Identifier: (GPL-2.0-only OR BSD-2-Clause)
%YAML 1.2
---
$id: http://devicetree.org/schemas/timer/nxp,s32g2-stm.yaml#
$schema: http://devicetree.org/meta-schemas/core.yaml#

title: NXP System Timer Module (STM)

maintainers:
  - Daniel Lezcano <daniel.lezcano@kernel.org>

description:
  The System Timer Module supports commonly required system and application
  software timing functions. STM includes a 32-bit count-up timer and four
  32-bit compare channels with a separate interrupt source for each channel.
  The timer is driven by the STM module clock divided by an 8-bit prescale
  value.

properties:
  compatible:
    oneOf:
      - const: nxp,s32g2-stm
      - items:
          - const: nxp,s32g3-stm
          - const: nxp,s32g2-stm

  reg:
    maxItems: 1

  interrupts:
    maxItems: 1

  clocks:
    items:
      - description: Counter clock
      - description: Module clock
      - description: Register clock

  clock-names:
    items:
      - const: counter
      - const: module
      - const: register

required:
  - compatible
  - reg
  - interrupts
  - clocks
  - clock-names

additionalProperties: false

examples:
  - |
    #include <dt-bindings/interrupt-controller/arm-gic.h>

    timer@4011c000 {
        compatible = "nxp,s32g2-stm";
        reg = <0x4011c000 0x3000>;
        interrupts = <GIC_SPI 24 IRQ_TYPE_LEVEL_HIGH>;
        clocks = <&clks 0x3b>, <&clks 0x3c>, <&clks 0x3c>;
        clock-names = "counter", "module", "register";
    };
```

## Documentation/devicetree/bindings/timer/nxp,sysctr-timer.txt
```
NXP System Counter Module(sys_ctr)

The system counter(sys_ctr) is a programmable system counter which provides
a shared time base to Cortex A15, A7, A53, A73, etc. it is intended for use in
applications where the counter is always powered and support multiple,
unrelated clocks. The compare frame inside can be used for timer purpose.

Required properties:

- compatible :      should be "nxp,sysctr-timer"
- reg :             Specifies the base physical address and size of the comapre
                    frame and the counter control, read & compare.
- interrupts :      should be the first compare frames' interrupt
- clocks : 	    Specifies the counter clock.
- clock-names: 	    Specifies the clock's name of this module

Example:

	system_counter: timer@306a0000 {
		compatible = "nxp,sysctr-timer";
		reg = <0x306a0000 0x20000>;/* system-counter-rd & compare */
		clocks = <&clk_8m>;
		clock-names = "per";
		interrupts = <GIC_SPI 47 IRQ_TYPE_LEVEL_HIGH>;
	};
```

## Documentation/devicetree/bindings/timer/nxp,sysctr-timer.yaml
```yaml
# SPDX-License-Identifier: (GPL-2.0-only OR BSD-2-Clause)
%YAML 1.2
---
$id: http://devicetree.org/schemas/timer/nxp,sysctr-timer.yaml#
$schema: http://devicetree.org/meta-schemas/core.yaml#

title: NXP System Counter Module(sys_ctr)

maintainers:
  - Bai Ping <ping.bai@nxp.com>

description: |
  The system counter(sys_ctr) is a programmable system counter
  which provides a shared time base to Cortex A15, A7, A53, A73,
  etc. it is intended for use in applications where the counter
  is always powered and support multiple, unrelated clocks. The
  compare frame inside can be used for timer purpose.

properties:
  compatible:
    const: nxp,sysctr-timer

  reg:
    maxItems: 1

  interrupts:
    maxItems: 1

  clocks:
    maxItems: 1

  clock-names:
    const: per

  nxp,no-divider:
    description: if present, means there is no internal base clk divider.
    type: boolean

required:
  - compatible
  - reg
  - interrupts
  - clocks
  - clock-names

additionalProperties: false

examples:
  - |
    #include <dt-bindings/interrupt-controller/arm-gic.h>

    timer@306a0000 {
        compatible = "nxp,sysctr-timer";
        reg = <0x306a0000 0x20000>;
        clocks = <&clk_8m>;
        clock-names = "per";
        interrupts = <GIC_SPI 47 IRQ_TYPE_LEVEL_HIGH>;
     };
```

## Documentation/devicetree/bindings/timer/nxp,tpm-timer.txt
```
NXP Low Power Timer/Pulse Width Modulation Module (TPM)

The Timer/PWM Module (TPM) supports input capture, output compare,
and the generation of PWM signals to control electric motor and power
management applications. The counter, compare and capture registers
are clocked by an asynchronous clock that can remain enabled in low
power modes. TPM can support global counter bus where one TPM drives
the counter bus for the others, provided bit width is the same.

Required properties:

- compatible :	should be "fsl,imx7ulp-tpm"
- reg :		Specifies base physical address and size of the register sets
		for the clock event device and clock source device.
- interrupts :	Should be the clock event device interrupt.
- clocks :	The clocks provided by the SoC to drive the timer, must contain
		an entry for each entry in clock-names.
- clock-names : Must include the following entries: "igp" and "per".

Example:
tpm5: tpm@40260000 {
	compatible = "fsl,imx7ulp-tpm";
	reg = <0x40260000 0x1000>;
	interrupts = <GIC_SPI 22 IRQ_TYPE_LEVEL_HIGH>;
	clocks = <&clks IMX7ULP_CLK_NIC1_BUS_DIV>,
		 <&clks IMX7ULP_CLK_LPTPM5>;
	clock-names = "ipg", "per";
};
```

## Documentation/devicetree/bindings/timer/nxp,tpm-timer.yaml
```yaml
# SPDX-License-Identifier: (GPL-2.0-only OR BSD-2-Clause)
%YAML 1.2
---
$id: http://devicetree.org/schemas/timer/nxp,tpm-timer.yaml#
$schema: http://devicetree.org/meta-schemas/core.yaml#

title: NXP Low Power Timer/Pulse Width Modulation Module (TPM)

maintainers:
  - Dong Aisheng <aisheng.dong@nxp.com>

description: |
  The Timer/PWM Module (TPM) supports input capture, output compare,
  and the generation of PWM signals to control electric motor and power
  management applications. The counter, compare and capture registers
  are clocked by an asynchronous clock that can remain enabled in low
  power modes. TPM can support global counter bus where one TPM drives
  the counter bus for the others, provided bit width is the same.

properties:
  compatible:
    oneOf:
      - const: fsl,imx7ulp-tpm
      - items:
          - const: fsl,imx8ulp-tpm
          - const: fsl,imx7ulp-tpm

  reg:
    maxItems: 1

  interrupts:
    maxItems: 1

  clocks:
    items:
      - description: SoC TPM ipg clock
      - description: SoC TPM per clock

  clock-names:
    items:
      - const: ipg
      - const: per

required:
  - compatible
  - reg
  - interrupts
  - clocks
  - clock-names

additionalProperties: false

examples:
  - |
    #include <dt-bindings/clock/imx7ulp-clock.h>
    #include <dt-bindings/interrupt-controller/arm-gic.h>

    timer@40260000 {
        compatible = "fsl,imx7ulp-tpm";
        reg = <0x40260000 0x1000>;
        interrupts = <GIC_SPI 22 IRQ_TYPE_LEVEL_HIGH>;
        clocks = <&scg1 IMX7ULP_CLK_NIC1_BUS_DIV>,
                 <&pcc2 IMX7ULP_CLK_LPTPM5>;
        clock-names = "ipg", "per";
    };
```

## Documentation/devicetree/bindings/timer/oxsemi,rps-timer.txt
```
Oxford Semiconductor OXNAS SoCs Family RPS Timer
================================================

Required properties:
- compatible: Should be "oxsemi,ox810se-rps-timer" or "oxsemi,ox820-rps-timer"
- reg : Specifies base physical address and size of the registers.
- interrupts : The interrupts of the two timers
- clocks : The phandle of the timer clock source

example:

timer0: timer@200 {
	compatible = "oxsemi,ox810se-rps-timer";
	reg = <0x200 0x40>;
	clocks = <&rpsclk>;
	interrupts = <4 5>;
};
```

## Documentation/devicetree/bindings/timer/ralink,cevt-systick.yaml
```yaml
# SPDX-License-Identifier: (GPL-2.0-only OR BSD-2-Clause)
%YAML 1.2
---
$id: http://devicetree.org/schemas/timer/ralink,cevt-systick.yaml#
$schema: http://devicetree.org/meta-schemas/core.yaml#

title: System tick counter present in Ralink family SoCs

maintainers:
  - Sergio Paracuellos <sergio.paracuellos@gmail.com>

properties:
  compatible:
    const: ralink,cevt-systick

  reg:
    maxItems: 1

  interrupts:
    maxItems: 1

required:
  - compatible
  - reg
  - interrupts

additionalProperties: false

examples:
  - |
    systick@d00 {
        compatible = "ralink,cevt-systick";
        reg = <0xd00 0x10>;

        interrupt-parent = <&cpuintc>;
        interrupts = <7>;
    };
...
```

## Documentation/devicetree/bindings/timer/ralink,rt2880-timer.yaml
```yaml
# SPDX-License-Identifier: (GPL-2.0-only OR BSD-2-Clause)
%YAML 1.2
---
$id: http://devicetree.org/schemas/timer/ralink,rt2880-timer.yaml#
$schema: http://devicetree.org/meta-schemas/core.yaml#

title: Timer present in Ralink family SoCs

maintainers:
  - Sergio Paracuellos <sergio.paracuellos@gmail.com>

properties:
  compatible:
    const: ralink,rt2880-timer

  reg:
    maxItems: 1

  clocks:
    maxItems: 1

  interrupts:
    maxItems: 1

required:
  - compatible
  - reg
  - clocks
  - interrupts

additionalProperties: false

examples:
  - |
    timer@100 {
        compatible = "ralink,rt2880-timer";
        reg = <0x100 0x20>;

        clocks = <&sysc 3>;

        interrupt-parent = <&intc>;
        interrupts = <1>;
    };
...
```

## Documentation/devicetree/bindings/timer/rda,8810pl-timer.txt
```
RDA Micro RDA8810PL Timer

Required properties:
- compatible      :  "rda,8810pl-timer"
- reg             :  Offset and length of the register set for the device.
- interrupts      :  Should contain two interrupts.
- interrupt-names :  Should be "hwtimer", "ostimer".

Example:

		apb@20900000 {
			compatible = "simple-bus";
			...
			timer@10000 {
				compatible = "rda,8810pl-timer";
				reg = <0x10000 0x1000>;
				interrupts = <16 IRQ_TYPE_LEVEL_HIGH>,
					     <17 IRQ_TYPE_LEVEL_HIGH>;
				interrupt-names = "hwtimer", "ostimer";
			};
```

## Documentation/devicetree/bindings/timer/rda,8810pl-timer.yaml
```yaml
# SPDX-License-Identifier: (GPL-2.0-only OR BSD-2-Clause)
%YAML 1.2
---
$id: http://devicetree.org/schemas/timer/rda,8810pl-timer.yaml#
$schema: http://devicetree.org/meta-schemas/core.yaml#

title: RDA Micro RDA8810PL Timer

maintainers:
  - Manivannan Sadhasivam <manivannan.sadhasivam@linaro.org>

properties:
  compatible:
    const: rda,8810pl-timer

  reg:
    maxItems: 1

  interrupts:
    minItems: 2
    maxItems: 2

  interrupt-names:
    items:
      - const: hwtimer
      - const: ostimer

required:
  - compatible
  - reg
  - interrupts
  - interrupt-names

additionalProperties: false

examples:
  - |
    #include <dt-bindings/interrupt-controller/irq.h>

    timer@20910000 {
      compatible = "rda,8810pl-timer";
      reg = <0x20910000 0x1000>;
      interrupts = <16 IRQ_TYPE_LEVEL_HIGH>,
                   <17 IRQ_TYPE_LEVEL_HIGH>;
      interrupt-names = "hwtimer", "ostimer";
    };
...
```

## Documentation/devicetree/bindings/timer/realtek,otto-timer.yaml
```yaml
# SPDX-License-Identifier: (GPL-2.0-only OR BSD-2-Clause)
%YAML 1.2
---
$id: http://devicetree.org/schemas/timer/realtek,otto-timer.yaml#
$schema: http://devicetree.org/meta-schemas/core.yaml#

title: Realtek Otto SoCs Timer/Counter

description:
  Realtek SoCs support a number of timers/counters. These are used
  as a per CPU clock event generator and an overall CPU clocksource.

maintainers:
  - Chris Packham <chris.packham@alliedtelesis.co.nz>

properties:
  $nodename:
    pattern: "^timer@[0-9a-f]+$"

  compatible:
    items:
      - enum:
          - realtek,rtl9302-timer
      - const: realtek,otto-timer

  reg:
    items:
      - description: timer0 registers
      - description: timer1 registers
      - description: timer2 registers
      - description: timer3 registers
      - description: timer4 registers

  clocks:
    maxItems: 1

  interrupts:
    items:
      - description: timer0 interrupt
      - description: timer1 interrupt
      - description: timer2 interrupt
      - description: timer3 interrupt
      - description: timer4 interrupt

required:
  - compatible
  - reg
  - clocks
  - interrupts

additionalProperties: false

examples:
  - |
    timer@3200 {
      compatible = "realtek,rtl9302-timer", "realtek,otto-timer";
      reg = <0x3200 0x10>, <0x3210 0x10>, <0x3220 0x10>,
            <0x3230 0x10>, <0x3240 0x10>;

      interrupt-parent = <&intc>;
      interrupts = <7>, <8>, <9>, <10>, <11>;
      clocks = <&lx_clk>;
    };
```

## Documentation/devicetree/bindings/timer/realtek,rtd1625-systimer.yaml
```yaml
# SPDX-License-Identifier: (GPL-2.0-only OR BSD-2-Clause)
%YAML 1.2
---
$id: http://devicetree.org/schemas/timer/realtek,rtd1625-systimer.yaml#
$schema: http://devicetree.org/meta-schemas/core.yaml#

title: Realtek System Timer

maintainers:
  - Hao-Wen Ting <haowen.ting@realtek.com>

description:
  The Realtek SYSTIMER (System Timer) is a 64-bit global hardware counter operating
  at a fixed 1MHz frequency. Thanks to its compare match interrupt capability,
  the timer natively supports oneshot mode for tick broadcast functionality.

properties:
  compatible:
    oneOf:
      - const: realtek,rtd1625-systimer
      - items:
          - const: realtek,rtd1635-systimer
          - const: realtek,rtd1625-systimer

  reg:
    maxItems: 1

  interrupts:
    maxItems: 1

required:
  - compatible
  - reg
  - interrupts

additionalProperties: false

examples:
  - |
    #include <dt-bindings/interrupt-controller/arm-gic.h>

    timer@89420 {
        compatible = "realtek,rtd1635-systimer",
                     "realtek,rtd1625-systimer";
        reg = <0x89420 0x18>;
        interrupts = <GIC_SPI 112 IRQ_TYPE_LEVEL_HIGH>;
    };
```
