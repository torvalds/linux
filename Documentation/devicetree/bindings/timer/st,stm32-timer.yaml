## Documentation/devicetree/bindings/timer/via,vt8500-timer.yaml
```yaml
# SPDX-License-Identifier: (GPL-2.0-only OR BSD-2-Clause)
%YAML 1.2
---
$id: http://devicetree.org/schemas/timer/via,vt8500-timer.yaml#
$schema: http://devicetree.org/meta-schemas/core.yaml#

title: VIA/Wondermedia VT8500 Timer

description:
  This is the timer block that is a standalone part of the system power
  management controller on VIA/WonderMedia SoCs (VIA VT8500 and alike).
  The hardware has a single 32-bit counter running at 3 MHz and four match
  registers, each of which is associated with a dedicated match interrupt,
  and the first of which can also serve as the system watchdog (if the
  watchdog function is enabled, it will reset the system upon match instead
  of triggering its respective interrupt)

maintainers:
  - Alexey Charkov <alchark@gmail.com>

properties:
  compatible:
    const: via,vt8500-timer

  reg:
    maxItems: 1

  interrupts:
    minItems: 1
    items:
      - description: Channel 0 match. Note that if the watchdog function
          is enabled, this interrupt will not fire and the system will
          reboot instead once the counter reaches match register 0 value
      - description: Channel 1 match
      - description: Channel 2 match
      - description: Channel 3 match

required:
  - compatible
  - reg
  - interrupts

additionalProperties: false

examples:
  - |
    timer@d8130100 {
        compatible = "via,vt8500-timer";
        reg = <0xd8130100 0x28>;
        interrupts = <36>;
    };
```

## Documentation/devicetree/bindings/timer/xlnx,xps-timer.yaml
```yaml
# SPDX-License-Identifier: GPL-2.0 OR BSD-2-Clause
%YAML 1.2
---
$id: http://devicetree.org/schemas/timer/xlnx,xps-timer.yaml#
$schema: http://devicetree.org/meta-schemas/core.yaml#

title: Xilinx LogiCORE IP AXI Timer

maintainers:
  - Sean Anderson <sean.anderson@seco.com>

properties:
  compatible:
    contains:
      const: xlnx,xps-timer-1.00.a

  clocks:
    maxItems: 1

  clock-names:
    const: s_axi_aclk

  interrupts:
    maxItems: 1

  reg:
    maxItems: 1

  '#pwm-cells': true

  xlnx,count-width:
    $ref: /schemas/types.yaml#/definitions/uint32
    enum: [8, 16, 32]
    default: 32
    description:
      The width of the counter(s), in bits.

  xlnx,one-timer-only:
    $ref: /schemas/types.yaml#/definitions/uint32
    enum: [ 0, 1 ]
    description:
      Whether only one timer is present in this block.

required:
  - compatible
  - reg
  - xlnx,one-timer-only

allOf:
  - if:
      required:
        - '#pwm-cells'
    then:
      allOf:
        - required:
            - clocks
        - properties:
            xlnx,one-timer-only:
              const: 0
    else:
      required:
        - interrupts
  - if:
      required:
        - clocks
    then:
      required:
        - clock-names

additionalProperties: false

examples:
  - |
    timer@800e0000 {
        clock-names = "s_axi_aclk";
        clocks = <&zynqmp_clk 71>;
        compatible = "xlnx,xps-timer-1.00.a";
        reg = <0x800e0000 0x10000>;
        interrupts = <0 39 2>;
        xlnx,count-width = <16>;
        xlnx,one-timer-only = <0x0>;
    };

    timer@800f0000 {
        #pwm-cells = <0>;
        clock-names = "s_axi_aclk";
        clocks = <&zynqmp_clk 71>;
        compatible = "xlnx,xps-timer-1.00.a";
        reg = <0x800e0000 0x10000>;
        xlnx,count-width = <32>;
        xlnx,one-timer-only = <0x0>;
    };
```

## Documentation/devicetree/bindings/timestamp/hardware-timestamps-common.yaml
```yaml
# SPDX-License-Identifier: (GPL-2.0-only OR BSD-2-Clause)
%YAML 1.2
---
$id: http://devicetree.org/schemas/timestamp/hardware-timestamps-common.yaml#
$schema: http://devicetree.org/meta-schemas/core.yaml#

title: Hardware timestamp providers

maintainers:
  - Dipen Patel <dipenp@nvidia.com>

description:
  Some devices/SoCs have hardware timestamp engines (HTE) which can use
  hardware means to timestamp entity in realtime. The entity could be anything
  from GPIOs, IRQs, Bus and so on. The hardware timestamp engine present
  itself as a provider with the bindings described in this document.

properties:
  $nodename:
    pattern: "^timestamp(@.*|-([0-9]|[1-9][0-9]+))?$"

  "#timestamp-cells":
    description:
      Number of cells in a HTE specifier.

required:
  - "#timestamp-cells"

additionalProperties: true
```

## Documentation/devicetree/bindings/timestamp/hte-consumer.yaml
```yaml
# SPDX-License-Identifier: (GPL-2.0-only OR BSD-2-Clause)
%YAML 1.2
---
$id: http://devicetree.org/schemas/timestamp/hte-consumer.yaml#
$schema: http://devicetree.org/meta-schemas/core.yaml#

title: HTE Consumer

maintainers:
  - Dipen Patel <dipenp@nvidia.com>

select: true

properties:
  timestamps:
    $ref: /schemas/types.yaml#/definitions/phandle-array
    description:
      The list of HTE provider phandle. The first cell must represent the
      provider phandle followed by the line identifiers. The meaning of the
      line identifier and exact number of arguments must be specified in the
      HTE provider device tree binding document.

  timestamp-names:
    $ref: /schemas/types.yaml#/definitions/string-array
    description:
      An optional string property to label each line specifier present in the
      timestamp property.

dependencies:
  timestamp-names: [ timestamps ]

additionalProperties: true

examples:
  - |
    hte_tegra_consumer {
              timestamps = <&tegra_hte_aon 0x9>, <&tegra_hte_lic 0x19>;
              timestamp-names = "hte-gpio", "hte-i2c";
    };
```

## Documentation/devicetree/bindings/timestamp/nvidia,tegra194-hte.yaml
```yaml
# SPDX-License-Identifier: (GPL-2.0-only OR BSD-2-Clause)
%YAML 1.2
---
$id: http://devicetree.org/schemas/timestamp/nvidia,tegra194-hte.yaml#
$schema: http://devicetree.org/meta-schemas/core.yaml#

title: Tegra194 on chip generic hardware timestamping engine (HTE)

maintainers:
  - Dipen Patel <dipenp@nvidia.com>

description:
  Tegra SoC has two instances of generic hardware timestamping engines (GTE)
  known as GTE GPIO and GTE IRQ, which can monitor subset of GPIO and on chip
  IRQ lines for the state change respectively, upon detection it will record
  timestamp (taken from system counter) in its internal hardware FIFO. It has
  a bitmap array arranged in 32bit slices where each bit represent signal/line
  to enable or disable for the hardware timestamping. The GTE GPIO monitors
  GPIO lines from the AON (always on) GPIO controller.

properties:
  compatible:
    enum:
      - nvidia,tegra194-gte-aon
      - nvidia,tegra194-gte-lic

  reg:
    maxItems: 1

  interrupts:
    maxItems: 1

  nvidia,int-threshold:
    $ref: /schemas/types.yaml#/definitions/uint32
    description:
      HTE device generates its interrupt based on this u32 FIFO threshold
      value. The recommended value is 1.
    minimum: 1
    maximum: 256

  nvidia,slices:
    $ref: /schemas/types.yaml#/definitions/uint32
    description:
      HTE lines are arranged in 32 bit slice where each bit represents different
      line/signal that it can enable/configure for the timestamp. It is u32
      property and depends on the HTE instance in the chip. The value 3 is for
      GPIO GTE and 11 for IRQ GTE.
    enum: [3, 11]

  '#timestamp-cells':
    description:
      This represents number of line id arguments as specified by the
      consumers. For the GTE IRQ, this is IRQ number as mentioned in the
      SoC technical reference manual. For the GTE GPIO, its value is same as
      mentioned in the nvidia GPIO device tree binding document.
    const: 1

required:
  - compatible
  - reg
  - interrupts
  - nvidia,slices
  - "#timestamp-cells"

additionalProperties: false

examples:
  - |
    tegra_hte_aon: timestamp@c1e0000 {
              compatible = "nvidia,tegra194-gte-aon";
              reg = <0xc1e0000 0x10000>;
              interrupts = <0 13 0x4>;
              nvidia,int-threshold = <1>;
              nvidia,slices = <3>;
              #timestamp-cells = <1>;
    };

  - |
    tegra_hte_lic: timestamp@3aa0000 {
              compatible = "nvidia,tegra194-gte-lic";
              reg = <0x3aa0000 0x10000>;
              interrupts = <0 11 0x4>;
              nvidia,int-threshold = <1>;
              nvidia,slices = <11>;
              #timestamp-cells = <1>;
    };

...
```

## Documentation/devicetree/bindings/tpm/google,cr50.yaml
```yaml
# SPDX-License-Identifier: (GPL-2.0-only OR BSD-2-Clause)
%YAML 1.2
---
$id: http://devicetree.org/schemas/tpm/google,cr50.yaml#
$schema: http://devicetree.org/meta-schemas/core.yaml#

title: Google Security Chip H1 (running Cr50 firmware)

maintainers:
  - Andrey Pronin <apronin@chromium.org>

description: |
  Google has designed a family of security chips called "Titan".
  One member is the H1 built into Chromebooks and running Cr50 firmware:
  https://www.osfc.io/2018/talks/google-secure-microcontroller-and-ccd-closed-case-debugging/

  The chip provides several functions, including TPM 2.0 like functionality.
  It communicates over SPI or I²C using the FIFO protocol described in the
  TCG PC Client Platform TPM Profile Specification for TPM 2.0 (PTP), sec 6:
  https://trustedcomputinggroup.org/resource/pc-client-platform-tpm-profile-ptp-specification/

properties:
  compatible:
    const: google,cr50

allOf:
  - $ref: tpm-common.yaml#

anyOf:
  - $ref: /schemas/spi/spi-peripheral-props.yaml#
  - $ref: tcg,tpm-tis-i2c.yaml#/properties/reg

required:
  - compatible
  - reg

unevaluatedProperties: false

examples:
  - |
    spi {
        #address-cells = <1>;
        #size-cells = <0>;

        tpm@0 {
            reg = <0>;
            compatible = "google,cr50";
            spi-max-frequency = <800000>;
        };
    };

  - |
    #include <dt-bindings/interrupt-controller/irq.h>
    i2c {
        #address-cells = <1>;
        #size-cells = <0>;

        tpm@50 {
            compatible = "google,cr50";
            reg = <0x50>;
            interrupts-extended = <&pio 88 IRQ_TYPE_EDGE_FALLING>;
            pinctrl-names = "default";
            pinctrl-0 = <&cr50_int>;
        };
    };
```

## Documentation/devicetree/bindings/tpm/ibm,vtpm.yaml
```yaml
# SPDX-License-Identifier: (GPL-2.0-only OR BSD-2-Clause)
%YAML 1.2
---
$id: http://devicetree.org/schemas/tpm/ibm,vtpm.yaml#
$schema: http://devicetree.org/meta-schemas/core.yaml#

title: IBM Virtual Trusted Platform Module (vTPM)

maintainers:
  - Nayna Jain <nayna@linux.ibm.com>

description: |
  Virtual TPM is used on IBM POWER7+ and POWER8 systems running POWERVM.
  It is supported through the adjunct partition with firmware release 740
  or higher.  With vTPM support, each lpar is able to have its own vTPM
  without the physical TPM hardware.  The TPM functionality is provided by
  communicating with the vTPM adjunct partition through Hypervisor calls
  (Hcalls) and Command/Response Queue (CRQ) commands.

properties:
  compatible:
    enum:
      - IBM,vtpm
      - IBM,vtpm20

  device_type:
    description:
      type of virtual device
    enum:
      - IBM,vtpm
      - IBM,vtpm20

  reg:
    maxItems: 1

  ibm,#dma-address-cells:
    description:
      number of cells that are used to encode the physical address field of
      dma-window properties
    $ref: /schemas/types.yaml#/definitions/uint32-array

  ibm,#dma-size-cells:
    description:
      number of cells that are used to encode the size field of
      dma-window properties
    $ref: /schemas/types.yaml#/definitions/uint32-array

  ibm,my-dma-window:
    description:
      DMA window associated with this virtual I/O Adapter
    $ref: /schemas/types.yaml#/definitions/uint32-array
    minItems: 5
    maxItems: 5

  ibm,my-drc-index:
    description:
      integer index for the connector between the device and its parent;
      present only if Dynamic Reconfiguration (DR) Connector is enabled
    $ref: /schemas/types.yaml#/definitions/uint32

  ibm,loc-code:
    description:
      unique and persistent location code associated with this virtual
      I/O Adapter
    $ref: /schemas/types.yaml#/definitions/string

required:
  - compatible
  - device_type
  - reg
  - interrupts
  - ibm,#dma-address-cells
  - ibm,#dma-size-cells
  - ibm,my-dma-window
  - ibm,my-drc-index
  - ibm,loc-code
  - linux,sml-base
  - linux,sml-size

allOf:
  - $ref: tpm-common.yaml#

unevaluatedProperties: false

examples:
  - |
    soc {
        #address-cells = <1>;
        #size-cells = <0>;

        tpm@30000003 {
            compatible = "IBM,vtpm";
            device_type = "IBM,vtpm";
            reg = <0x30000003>;
            interrupts = <0xa0003 0x0>;
            ibm,#dma-address-cells = <0x2>;
            ibm,#dma-size-cells = <0x2>;
            ibm,my-dma-window = <0x10000003 0x0 0x0 0x0 0x10000000>;
            ibm,my-drc-index = <0x30000003>;
            ibm,loc-code = "U8286.41A.10082DV-V3-C3";
            linux,sml-base = <0xc60e 0x0>;
            linux,sml-size = <0xbce10200>;
        };
    };
```

## Documentation/devicetree/bindings/tpm/microsoft,ftpm.yaml
```yaml
# SPDX-License-Identifier: (GPL-2.0-only OR BSD-2-Clause)
%YAML 1.2
---
$id: http://devicetree.org/schemas/tpm/microsoft,ftpm.yaml#
$schema: http://devicetree.org/meta-schemas/core.yaml#

title: Microsoft firmware-based Trusted Platform Module (fTPM)

maintainers:
  - Thirupathaiah Annapureddy <thiruan@microsoft.com>
  - Sasha Levin <sashal@kernel.org>

description: |
  Commodity CPU architectures, such as ARM and Intel CPUs, have started to
  offer trusted computing features in their CPUs aimed at displacing dedicated
  trusted hardware.  Unfortunately, these CPU architectures raise serious
  challenges to building trusted systems because they omit providing secure
  resources outside the CPU perimeter.

  Microsoft's firmware-based TPM 2.0 (fTPM) leverages ARM TrustZone to overcome
  these challenges and provide software with security guarantees similar to
  those of dedicated trusted hardware.

  https://www.microsoft.com/en-us/research/publication/ftpm-software-implementation-tpm-chip/
  https://github.com/Microsoft/ms-tpm-20-ref/tree/main/Samples/ARM32-FirmwareTPM

properties:
  compatible:
    const: microsoft,ftpm

required:
  - compatible
  - linux,sml-base
  - linux,sml-size

allOf:
  - $ref: tpm-common.yaml#

unevaluatedProperties: false

examples:
  - |
    tpm {
        compatible = "microsoft,ftpm";
        linux,sml-base = <0x0 0xc0000000>;
        linux,sml-size = <0x10000>;
    };
```
