## Documentation/devicetree/bindings/tpm/tcg,tpm-tis-i2c.yaml
```yaml
# SPDX-License-Identifier: (GPL-2.0-only OR BSD-2-Clause)
%YAML 1.2
---
$id: http://devicetree.org/schemas/tpm/tcg,tpm-tis-i2c.yaml#
$schema: http://devicetree.org/meta-schemas/core.yaml#

title: I²C-attached Trusted Platform Module conforming to TCG TIS specification

maintainers:
  - Lukas Wunner <lukas@wunner.de>

description: |
  The Trusted Computing Group (TCG) has defined a multi-vendor standard
  for accessing a TPM chip.  It can be transported over various buses,
  one of them being I²C.  The standard is named:
  TCG PC Client Specific TPM Interface Specification (TIS)
  https://trustedcomputinggroup.org/resource/pc-client-work-group-pc-client-specific-tpm-interface-specification-tis/

  The I²C interface was not originally part of the standard, but added
  in 2017 with a separate document:
  TCG PC Client Platform TPM Profile Specification for TPM 2.0 (PTP)
  https://trustedcomputinggroup.org/resource/pc-client-platform-tpm-profile-ptp-specification/

  Recent TPM 2.0 chips conform to this generic interface, others use a
  vendor-specific I²C interface.

properties:
  compatible:
    oneOf:
      - description: Generic TPM 2.0 chips conforming to TCG PTP interface
        items:
          - enum:
              - infineon,slb9673
              - nuvoton,npct75x
              - st,st33ktpm2xi2c
          - const: tcg,tpm-tis-i2c

      - description: TPM 1.2 and 2.0 chips with vendor-specific I²C interface
        items:
          - enum:
              - atmel,at97sc3204t # TPM 1.2
              - infineon,slb9635tt # TPM 1.2 (maximum 100 kHz)
              - infineon,slb9645tt # TPM 1.2 (maximum 400 kHz)
              - infineon,tpm_i2c_infineon # TPM 1.2
              - nuvoton,npct501 # TPM 1.2
              - nuvoton,npct601 # TPM 2.0
              - st,st33zp24-i2c # TPM 2.0
              - winbond,wpct301 # TPM 1.2

  reg:
    description: address of TPM on the I²C bus

allOf:
  - $ref: tpm-common.yaml#

required:
  - compatible
  - reg

unevaluatedProperties: false

examples:
  - |
    i2c {
        #address-cells = <1>;
        #size-cells = <0>;

        tpm@57 {
            label = "tpm";
            compatible = "nuvoton,npct601";
            reg = <0x57>;
            linux,sml-base = <0x7f 0xfd450000>;
            linux,sml-size = <0x10000>;
        };
    };

  - |
    #include <dt-bindings/gpio/gpio.h>
    #include <dt-bindings/interrupt-controller/irq.h>
    i2c {
        #address-cells = <1>;
        #size-cells = <0>;

        tpm@13 {
            reg = <0x13>;
            compatible = "st,st33zp24-i2c";
            interrupt-parent = <&gpio5>;
            interrupts = <7 IRQ_TYPE_LEVEL_HIGH>;
            lpcpd-gpios = <&gpio5 15 GPIO_ACTIVE_HIGH>;
        };
    };
```

## Documentation/devicetree/bindings/tpm/tcg,tpm-tis-mmio.yaml
```yaml
# SPDX-License-Identifier: (GPL-2.0-only OR BSD-2-Clause)
%YAML 1.2
---
$id: http://devicetree.org/schemas/tpm/tcg,tpm-tis-mmio.yaml#
$schema: http://devicetree.org/meta-schemas/core.yaml#

title: MMIO-accessed Trusted Platform Module conforming to TCG TIS specification

maintainers:
  - Lukas Wunner <lukas@wunner.de>

description: |
  The Trusted Computing Group (TCG) has defined a multi-vendor standard
  for accessing a TPM chip.  It can be transported over various buses,
  one of them being LPC (via MMIO).  The standard is named:
  TCG PC Client Specific TPM Interface Specification (TIS)
  https://trustedcomputinggroup.org/resource/pc-client-work-group-pc-client-specific-tpm-interface-specification-tis/

properties:
  compatible:
    items:
      - enum:
          - at97sc3201
          - atmel,at97sc3204
          - socionext,synquacer-tpm-mmio
      - const: tcg,tpm-tis-mmio

  reg:
    description:
      location and length of the MMIO registers, length should be
      at least 0x5000 bytes

allOf:
  - $ref: tpm-common.yaml#

required:
  - compatible
  - reg

unevaluatedProperties: false

examples:
  - |
    tpm@90000 {
        compatible = "atmel,at97sc3204", "tcg,tpm-tis-mmio";
        reg = <0x90000 0x5000>;
        interrupt-parent = <&EIC0>;
        interrupts = <1 2>;
    };
```

## Documentation/devicetree/bindings/tpm/tcg,tpm_tis-spi.yaml
```yaml
# SPDX-License-Identifier: (GPL-2.0-only OR BSD-2-Clause)
%YAML 1.2
---
$id: http://devicetree.org/schemas/tpm/tcg,tpm_tis-spi.yaml#
$schema: http://devicetree.org/meta-schemas/core.yaml#

title: SPI-attached Trusted Platform Module conforming to TCG TIS specification

maintainers:
  - Lukas Wunner <lukas@wunner.de>

description: |
  The Trusted Computing Group (TCG) has defined a multi-vendor standard
  for accessing a TPM chip.  It can be transported over various buses,
  one of them being SPI.  The standard is named:
  TCG PC Client Specific TPM Interface Specification (TIS)
  https://trustedcomputinggroup.org/resource/pc-client-work-group-pc-client-specific-tpm-interface-specification-tis/

properties:
  compatible:
    items:
      - enum:
          - infineon,slb9670
          - st,st33htpm-spi
          - st,st33zp24-spi
      - const: tcg,tpm_tis-spi

allOf:
  - $ref: tpm-common.yaml#
  - $ref: /schemas/spi/spi-peripheral-props.yaml#
  - if:
      properties:
        compatible:
          contains:
            const: st,st33zp24-spi
    then:
      properties:
        spi-max-frequency:
          maximum: 10000000

required:
  - compatible
  - reg

unevaluatedProperties: false

examples:
  - |
    spi {
        #address-cells = <1>;
        #size-cells = <0>;

        tpm@0 {
            reg = <0>;
            compatible = "infineon,slb9670", "tcg,tpm_tis-spi";
            spi-max-frequency = <10000000>;
        };
    };

  - |
    #include <dt-bindings/gpio/gpio.h>
    #include <dt-bindings/interrupt-controller/irq.h>
    spi {
        #address-cells = <1>;
        #size-cells = <0>;

        tpm@0 {
            reg = <0>;
            compatible = "st,st33zp24-spi", "tcg,tpm_tis-spi";
            spi-max-frequency = <10000000>;
            interrupt-parent = <&gpio5>;
            interrupts = <7 IRQ_TYPE_LEVEL_HIGH>;
            lpcpd-gpios = <&gpio5 15 GPIO_ACTIVE_HIGH>;
        };
    };
```

## Documentation/devicetree/bindings/tpm/tpm-common.yaml
```yaml
# SPDX-License-Identifier: (GPL-2.0-only OR BSD-2-Clause)
%YAML 1.2
---
$id: http://devicetree.org/schemas/tpm/tpm-common.yaml#
$schema: http://devicetree.org/meta-schemas/core.yaml#

title: Trusted Platform Module common properties

maintainers:
  - Lukas Wunner <lukas@wunner.de>

properties:
  $nodename:
    pattern: '^tpm(@[0-9a-f]+)?$'

  interrupts:
    description: indicates command completion
    maxItems: 1

  label:
    description: human readable string describing the device, e.g. "tpm"

  linux,sml-base:
    description:
      base address of reserved memory allocated for firmware event log
    $ref: /schemas/types.yaml#/definitions/uint64

  linux,sml-size:
    description:
      size of reserved memory allocated for firmware event log
    $ref: /schemas/types.yaml#/definitions/uint32

  memory-region:
    description: reserved memory allocated for firmware event log
    maxItems: 1

  powered-while-suspended:
    description:
      present when the TPM is left powered on between suspend and resume
      (makes the suspend/resume callbacks do nothing)
    type: boolean

  resets:
    description: Reset controller to reset the TPM
    maxItems: 1

  reset-gpios:
    description: Output GPIO pin to reset the TPM
    maxItems: 1

# must always have both linux,sml-base and linux,sml-size
dependentRequired:
  linux,sml-base: ['linux,sml-size']
  linux,sml-size: ['linux,sml-base']

# must only have either memory-region or linux,sml-base
# as well as either resets or reset-gpios
dependentSchemas:
  memory-region:
    properties:
      linux,sml-base: false
  linux,sml-base:
    properties:
      memory-region: false
  resets:
    properties:
      reset-gpios: false
  reset-gpios:
    properties:
      resets: false

allOf:
  - if:
      properties:
        compatible:
          contains:
            pattern: '^st,st33zp24'
    then:
      properties:
        lpcpd-gpios:
          description:
            Output GPIO pin used for ST33ZP24 power management of D1/D2 state.
            If set, power must be present when the platform is going into
            sleep/hibernate mode.
          maxItems: 1

additionalProperties: true
```

## Documentation/devicetree/bindings/trigger-source/adi,util-sigma-delta-spi.yaml
```yaml
# SPDX-License-Identifier: (GPL-2.0-only OR BSD-2-Clause)
# Copyright (c) 2025 Analog Devices, Inc.
# Copyright (c) 2025 BayLibre, SAS

%YAML 1.2
---
$id: http://devicetree.org/schemas/trigger-source/adi,util-sigma-delta-spi.yaml#
$schema: http://devicetree.org/meta-schemas/core.yaml#

title: Analog Devices Util Sigma-Delta SPI IP Core

maintainers:
  - David Lechner <dlechner@baylibre.com>

description:
  The Util Sigma-Delta SPI is an FPGA IP core from Analog Devices that provides
  a SPI offload trigger from the RDY signal of the combined DOUT/RDY pin of
  the sigma-delta family of ADCs.
  https://analogdevicesinc.github.io/hdl/library/util_sigma_delta_spi/index.html

properties:
  compatible:
    const: adi,util-sigma-delta-spi

  reg:
    maxItems: 1

  clocks:
    maxItems: 1

  '#trigger-source-cells':
    const: 0

required:
  - compatible
  - reg
  - clocks
  - '#trigger-source-cells'

additionalProperties: false

examples:
  - |
    trigger@40000 {
        reg = <0x40000 0x1000>;
        compatible = "adi,util-sigma-delta-spi";
        clocks = <&clk 0>;
        #trigger-source-cells = <0>;
    };
```

## Documentation/devicetree/bindings/trigger-source/gpio-trigger.yaml
```yaml
# SPDX-License-Identifier: (GPL-2.0-only OR BSD-2-Clause)
%YAML 1.2
---
$id: http://devicetree.org/schemas/trigger-source/gpio-trigger.yaml#
$schema: http://devicetree.org/meta-schemas/core.yaml#

title: Generic trigger source using GPIO

description: A GPIO used as a trigger source.

maintainers:
  - Jonathan Santos <Jonathan.Santos@analog.com>

properties:
  compatible:
    const: gpio-trigger

  '#trigger-source-cells':
    const: 0

  gpios:
    maxItems: 1
    description: GPIO to be used as a trigger source.

required:
  - compatible
  - '#trigger-source-cells'
  - gpios

additionalProperties: false

examples:
  - |
    #include <dt-bindings/gpio/gpio.h>

    trigger {
        compatible = "gpio-trigger";
        #trigger-source-cells = <0>;
        gpios = <&gpio1 15 GPIO_ACTIVE_HIGH>;
    };
```
