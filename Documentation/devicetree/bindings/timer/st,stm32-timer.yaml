## Documentation/devicetree/bindings/timer/st,stm32-timer.yaml
```yaml
# SPDX-License-Identifier: (GPL-2.0-only OR BSD-2-Clause)
%YAML 1.2
---
$id: http://devicetree.org/schemas/timer/st,stm32-timer.yaml#
$schema: http://devicetree.org/meta-schemas/core.yaml#

title: STMicroelectronics STM32 general-purpose 16 and 32 bits timers bindings

maintainers:
  - Benjamin Gaignard <benjamin.gaignard@st.com>

properties:
  compatible:
    const: st,stm32-timer

  reg:
    maxItems: 1

  interrupts:
    maxItems: 1

  clocks:
    maxItems: 1

  resets:
    maxItems: 1

required:
  - compatible
  - reg
  - interrupts
  - clocks

additionalProperties: false

examples:
  - |
    #include <dt-bindings/interrupt-controller/arm-gic.h>
    #include <dt-bindings/clock/stm32mp1-clks.h>
    timer: timer@40000c00 {
        compatible = "st,stm32-timer";
        reg = <0x40000c00 0x400>;
        interrupts = <50>;
        clocks = <&clk_pmtr1>;
    };

...
```

## Documentation/devicetree/bindings/timer/starfive,jh7110-timers.yaml
```yaml
# SPDX-License-Identifier: (GPL-2.0-only OR BSD-2-Clause)
%YAML 1.2
---
$id: http://devicetree.org/schemas/timer/starfive,jh7110-timers.yaml#
$schema: http://devicetree.org/meta-schemas/core.yaml#

title: StarFive timers bindings

maintainers:
  - samin.guo <samin.guo@starfivetech.com>
  - xingyu.wu <xingyu.wu@starfivetech.com>

properties:
  compatible:
    const: starfive,jh7110-timers

  reg:
    maxItems: 1

  interrupts:
    items:
      - description: timer channel 0 interrupt
      - description: timer channel 1 interrupt
      - description: timer channel 2 interrupt
      - description: timer channel 3 interrupt
      
  interrupt-names:
    items:
      - const: timer0
      - const: timer1
      - const: timer2
      - const: timer3

  clocks:
    items:
      - description: timer channel 0 clock
      - description: timer channel 1 clock
      - description: timer channel 2 clock
      - description: timer channel 3 clock
      - description: APB clock

  clock-names:
    items:
      - const: timer0
      - const: timer1
      - const: timer2
      - const: timer3
      - const: apb_clk

  resets:
    items:
      - description: timer channel 0 reset
      - description: timer channel 1 reset
      - description: timer channel 2 reset
      - description: timer channel 3 reset
      - description: APB reset

  reset-names:
    items:
      - const: timer0
      - const: timer1
      - const: timer2
      - const: timer3
      - const: apb_rst

required:
  - compatible
  - reg
  - interrupts
  - interrupt-names
  - clocks
  - clock-names
  - resets
  - reset-names

additionalProperties: false

examples:
  - |
    #include <dt-bindings/clock/starfive-jh7110-clkgen.h>
    #include <dt-bindings/reset/starfive-jh7110.h>

    timer0: timer@15200000 {
            compatible = "starfive,jh7110-timers";
            reg = <0x15200000 0x10000>;
            interrupts = <85>, <86>, <87> ,<88>;
            interrupt-names = "timer0", "timer1", "timer2", "timer3";
            clocks = <&clkgen JH7110_TIMER_CLK_TIMER0>,
                     <&clkgen JH7110_TIMER_CLK_TIMER1>,
                     <&clkgen JH7110_TIMER_CLK_TIMER2>,
                     <&clkgen JH7110_TIMER_CLK_TIMER3>,
                     <&clkgen JH7110_TIMER_CLK_APB>;
            clock-names = "timer0", "timer1",
                          "timer2", "timer3", "apb_clk";
            resets = <&rstgen RSTN_U0_TIMER_TIMER0>,
                     <&rstgen RSTN_U0_TIMER_TIMER1>,
                     <&rstgen RSTN_U0_TIMER_TIMER2>,
                     <&rstgen RSTN_U0_TIMER_TIMER3>,
                     <&rstgen RSTN_U0_TIMER_APB>;
            reset-names = "timer0", "timer1",
                          "timer2", "timer3", "apb_rst";
    };
```

## Documentation/devicetree/bindings/timer/stericsson-u300-apptimer.txt
```
ST-Ericsson U300 apptimer

Required properties:

- compatible : should be "stericsson,u300-apptimer"
- reg : Specifies base physical address and size of the registers.
- interrupts : A list of 4 interrupts; one for each subtimer. These
  are, in order: OS (operating system), DD (device driver) both
  adopted for EPOC/Symbian with two specific IRQs for these tasks,
  then GP1 and GP2, which are general-purpose timers.

Example:

timer {
	compatible = "stericsson,u300-apptimer";
	reg = <0xc0014000 0x1000>;
	interrupts = <24 25 26 27>;
};
```

## Documentation/devicetree/bindings/timer/thead,c900-aclint-mtimer.yaml
```yaml
# SPDX-License-Identifier: (GPL-2.0-only OR BSD-2-Clause)
%YAML 1.2
---
$id: http://devicetree.org/schemas/timer/thead,c900-aclint-mtimer.yaml#
$schema: http://devicetree.org/meta-schemas/core.yaml#

title: Sophgo CLINT Timer

maintainers:
  - Inochi Amaoto <inochiama@outlook.com>

properties:
  compatible:
    items:
      - enum:
          - sophgo,sg2042-aclint-mtimer
      - const: thead,c900-aclint-mtimer

  reg:
    items:
      - description: MTIMECMP Registers

  reg-names:
    items:
      - const: mtimecmp

  interrupts-extended:
    minItems: 1
    maxItems: 4095

additionalProperties: false

required:
  - compatible
  - reg
  - reg-names
  - interrupts-extended

examples:
  - |
    timer@ac000000 {
      compatible = "sophgo,sg2042-aclint-mtimer", "thead,c900-aclint-mtimer";
      interrupts-extended = <&cpu1intc 7>,
                            <&cpu2intc 7>,
                            <&cpu3intc 7>,
                            <&cpu4intc 7>;
      reg = <0xac000000 0x00010000>;
      reg-names = "mtimecmp";
    };
...
```

## Documentation/devicetree/bindings/timer/ti,c64x+timer64.txt
```
Timer64
-------

The timer64 node describes C6X event timers.

Required properties:

- compatible: must be "ti,c64x+timer64"
- reg: base address and size of register region
- interrupts: interrupt id

Optional properties:

- ti,dscr-dev-enable: Device ID used to enable timer IP through DSCR interface.

- ti,core-mask: on multi-core SoCs, bitmask of cores allowed to use this timer.

Example:
	timer0: timer@25e0000 {
		compatible = "ti,c64x+timer64";
		ti,core-mask = < 0x01 >;
		reg = <0x25e0000 0x40>;
		interrupt-parent = <&megamod_pic>;
		interrupts = < 16 >;
	};
```

## Documentation/devicetree/bindings/timer/ti,da830-timer.yaml
```yaml
# SPDX-License-Identifier: (GPL-2.0-only OR BSD-2-Clause)
%YAML 1.2
---
$id: http://devicetree.org/schemas/timer/ti,da830-timer.yaml#
$schema: http://devicetree.org/meta-schemas/core.yaml#

title: TI DaVinci Timer

maintainers:
  - Kousik Sanagavarapu <five231003@gmail.com>

description: |
  This is a 64-bit timer found on TI's DaVinci architecture devices. The timer
  can be configured as a general-purpose 64-bit timer, dual general-purpose
  32-bit timers. When configured as dual 32-bit timers, each half can operate
  in conjunction (chain mode) or independently (unchained mode) of each other.

  The timer is a free running up-counter and can generate interrupts when the
  counter reaches preset counter values.

properties:
  compatible:
    const: ti,da830-timer

  reg:
    maxItems: 1

  interrupts:
    minItems: 2
    maxItems: 10

  interrupt-names:
    minItems: 2
    items:
      - const: tint12
      - const: tint34
      - const: cmpint0
      - const: cmpint1
      - const: cmpint2
      - const: cmpint3
      - const: cmpint4
      - const: cmpint5
      - const: cmpint6
      - const: cmpint7

  clocks:
    maxItems: 1

required:
  - compatible
  - reg
  - interrupts
  - interrupt-names
  - clocks

additionalProperties: false

examples:
  - |
    timer@20000 {
        compatible = "ti,da830-timer";
        reg = <0x20000 0x1000>;
        interrupts = <21>, <22>;
        interrupt-names = "tint12", "tint34";
        clocks = <&pll0_auxclk>;
    };

...
```

## Documentation/devicetree/bindings/timer/ti,davinci-timer.txt
```
* Device tree bindings for Texas Instruments DaVinci timer

This document provides bindings for the 64-bit timer in the DaVinci
architecture devices. The timer can be configured as a general-purpose 64-bit
timer, dual general-purpose 32-bit timers. When configured as dual 32-bit
timers, each half can operate in conjunction (chain mode) or independently
(unchained mode) of each other.

The timer is a free running up-counter and can generate interrupts when the
counter reaches preset counter values.

Also see ../watchdog/davinci-wdt.txt for timers that are configurable as
watchdog timers.

Required properties:

- compatible : should be "ti,da830-timer".
- reg : specifies base physical address and count of the registers.
- interrupts : interrupts generated by the timer.
- interrupt-names: should be "tint12", "tint34", "cmpint0", "cmpint1",
		   "cmpint2", "cmpint3", "cmpint4", "cmpint5", "cmpint6",
		   "cmpint7" ("cmpintX" may be omitted if not present in the
		   hardware).
- clocks : the clock feeding the timer clock.

Example:

	clocksource: timer@20000 {
		compatible = "ti,da830-timer";
		reg = <0x20000 0x1000>;
		interrupts = <21>, <22>, <74>, <75>, <76>, <77>, <78>, <79>,
			     <80>, <81>;
		interrupt-names = "tint12", "tint34", "cmpint0", "cmpint1",
				  "cmpint2", "cmpint3", "cmpint4", "cmpint5",
				  "cmpint6", "cmpint7";
		clocks = <&pll0_auxclk>;
	};
```

## Documentation/devicetree/bindings/timer/ti,keystone-timer.txt
```
* Device tree bindings for Texas instruments Keystone timer

This document provides bindings for the 64-bit timer in the KeyStone
architecture devices. The timer can be configured as a general-purpose 64-bit
timer, dual general-purpose 32-bit timers. When configured as dual 32-bit
timers, each half can operate in conjunction (chain mode) or independently
(unchained mode) of each other.

It is global timer is a free running up-counter and can generate interrupt
when the counter reaches preset counter values.

Documentation:
https://www.ti.com/lit/ug/sprugv5a/sprugv5a.pdf

Required properties:

- compatible : should be "ti,keystone-timer".
- reg : specifies base physical address and count of the registers.
- interrupts : interrupt generated by the timer.
- clocks : the clock feeding the timer clock.

Example:

timer@22f0000 {
	compatible = "ti,keystone-timer";
	reg = <0x022f0000 0x80>;
	interrupts = <GIC_SPI 110 IRQ_TYPE_EDGE_RISING>;
	clocks = <&clktimer15>;
};
```

## Documentation/devicetree/bindings/timer/ti,keystone-timer.yaml
```yaml
# SPDX-License-Identifier: (GPL-2.0-only OR BSD-2-Clause)
%YAML 1.2
---
$id: http://devicetree.org/schemas/ti,keystone-timer.yaml#
$schema: http://devicetree.org/meta-schemas/core.yaml#

title: TI Keystone timer

maintainers:
  - Alexander A. Klimov <grandmaster@al2klimov.de>
  - Ivan Khoronzhuk <ivan.khoronzhuk@ti.com>

description: >
  A 64-bit timer in the KeyStone architecture devices. The timer can be
  configured as a general-purpose 64-bit timer, dual general-purpose 32-bit
  timers. When configured as dual 32-bit timers, each half can operate in
  conjunction (chain mode) or independently (unchained mode) of each other.

  It is global timer is a free running up-counter and can generate interrupt
  when the counter reaches preset counter values.

  Documentation:
  https://www.ti.com/lit/ug/sprugv5a/sprugv5a.pdf

properties:
  compatible:
    const: ti,keystone-timer

  reg:
    maxItems: 1

  interrupts:
    maxItems: 1

  interrupt-names:
    items:
      - const: irq

  clocks:
    maxItems: 1

  clock-names:
    items:
      - const: timer

required:
  - compatible
  - reg
  - interrupts
  - clocks

additionalProperties: false

examples:
  - |
    #include <dt-bindings/interrupt-controller/irq.h>

    timer@22f0000 {
        compatible = "ti,keystone-timer";
        reg = <0x022f0000 0x80>;
        interrupts = <110 IRQ_TYPE_EDGE_RISING>;
        clocks = <&clktimer15>;
    };
```

## Documentation/devicetree/bindings/timer/ti,timer-dm.yaml
```yaml
# SPDX-License-Identifier: (GPL-2.0-only OR BSD-2-Clause)
%YAML 1.2
---
$id: http://devicetree.org/schemas/timer/ti,timer-dm.yaml#
$schema: http://devicetree.org/meta-schemas/core.yaml#

title: TI dual-mode timer

maintainers:
  - Tony Lindgren <tony@atomide.com>

description: |
  The TI dual-mode timer is a general purpose timer with PWM capabilities.

properties:
  compatible:
    oneOf:
      - items:
          - enum:
              - ti,am335x-timer
              - ti,am335x-timer-1ms
              - ti,am654-timer
              - ti,dm814-timer
              - ti,dm816-timer
              - ti,omap2420-timer
              - ti,omap3430-timer
              - ti,omap4430-timer
              - ti,omap5430-timer
      - items:
          - const: ti,am4372-timer
          - const: ti,am335x-timer
      - items:
          - const: ti,am4372-timer-1ms
          - const: ti,am335x-timer-1ms

  reg:
    items:
      - description: IO address
      - description: L3 to L4 mapping for omap4/5 L4 ABE
    minItems: 1

  clocks:
    items:
      - description: Functional clock
      - description: System clock for omap4/5 and dra7
    minItems: 1

  clock-names:
    items:
      - const: fck
      - const: timer_sys_ck
    minItems: 1

  interrupts:
    description:
      Interrupt if available. The timer PWM features may be usable
      in a limited way even without interrupts.
    maxItems: 1

  ti,timer-alwon:
    description:
      Timer is always enabled when the SoC is powered. Note that some SoCs like
      am335x can suspend to PM coprocessor RTC only mode and in that case the
      SoC power is cut including timers.
    type: boolean

  ti,timer-dsp:
    description:
      Timer is routable to the DSP in addition to the operating system.
    type: boolean

  ti,timer-pwm:
    description:
      Timer has been wired for PWM capability.
    type: boolean

  ti,timer-secure:
    description:
      Timer access has been limited to secure mode only.
    type: boolean

  ti,hwmods:
    description:
      Name of the HWMOD associated with timer. This is for legacy
      omap2/3 platforms only.
    $ref: /schemas/types.yaml#/definitions/string
    deprecated: true

required:
  - compatible
  - reg

additionalProperties: false

allOf:
  - if:
      not:
        properties:
          compatible:
            contains:
              const: ti,am654-timer
    then:
      required:
        - interrupts

  - if:
      not:
        properties:
          compatible:
            contains:
              enum:
                - ti,omap3430-timer
                - ti,omap4430-timer
                - ti,omap5430-timer
    then:
      properties:
        reg:
          maxItems: 1
        clocks:
          maxItems: 1
        clock-names:
          maxItems: 1

  - if:
      properties:
        compatible:
          contains:
            enum:
              - ti,dm814-timer
              - ti,dm816-timer
              - ti,omap2420-timer
              - ti,omap3430-timer
    then:
      properties:
        ti,hwmods:
          items:
            - pattern: "^timer([1-9]|1[0-2])$"
    else:
      properties:
        ti,hwmods: false

examples:
  - |
    timer1: timer@0 {
      compatible = "ti,am335x-timer-1ms";
      reg = <0x0 0x400>;
      interrupts = <67>;
      ti,timer-alwon;
      clocks = <&timer1_fck>;
      clock-names = "fck";
    };
...
```

## Documentation/devicetree/bindings/timer/via,vt8500-timer.txt
```
VIA/Wondermedia VT8500 Timer
-----------------------------------------------------

Required properties:
- compatible : "via,vt8500-timer"
- reg : Should contain 1 register ranges(address and length)
- interrupts : interrupt for the timer

Example:

	timer@d8130100 {
		compatible = "via,vt8500-timer";
		reg = <0xd8130100 0x28>;
		interrupts = <36>;
	};
```
