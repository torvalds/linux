## Documentation/devicetree/bindings/timer/cortina,gemini-timer.txt
```
Cortina Systems Gemini timer

This timer is embedded in the Cortina Systems Gemini SoCs.

Required properties:

- compatible : Must be "cortina,gemini-timer"
- reg : Should contain registers location and length
- interrupts : Should contain the three timer interrupts with
  flags for rising edge
- syscon : a phandle to the global Gemini system controller

Example:

timer@43000000 {
	compatible = "cortina,gemini-timer";
	reg = <0x43000000 0x1000>;
	interrupts = <14 IRQ_TYPE_EDGE_RISING>, /* Timer 1 */
		   <15 IRQ_TYPE_EDGE_RISING>, /* Timer 2 */
		   <16 IRQ_TYPE_EDGE_RISING>; /* Timer 3 */
	syscon = <&syscon>;
};
```

## Documentation/devicetree/bindings/timer/csky,gx6605s-timer.txt
```
=================
gx6605s SOC Timer
=================

The timer is used in gx6605s soc as system timer and the driver
contain clk event and clk source.

==============================
timer node bindings definition
==============================

	Description: Describes gx6605s SOC timer

	PROPERTIES

	- compatible
		Usage: required
		Value type: <string>
		Definition: must be "csky,gx6605s-timer"
	- reg
		Usage: required
		Value type: <u32 u32>
		Definition: <phyaddr size> in soc from cpu view
	- clocks
		Usage: required
		Value type: phandle + clock specifier cells
		Definition: must be input clk node
	- interrupt
		Usage: required
		Value type: <u32>
		Definition: must be timer irq num defined by soc

Examples:
---------

	timer0: timer@20a000 {
		compatible = "csky,gx6605s-timer";
		reg = <0x0020a000 0x400>;
		clocks = <&dummy_apb_clk>;
		interrupts = <10>;
		interrupt-parent = <&intc>;
	};
```

## Documentation/devicetree/bindings/timer/csky,gx6605s-timer.yaml
```yaml
# SPDX-License-Identifier: (GPL-2.0-only OR BSD-2-Clause)
%YAML 1.2
---
$id: http://devicetree.org/schemas/timer/csky,gx6605s-timer.yaml#
$schema: http://devicetree.org/meta-schemas/core.yaml#

title: gx6605s SOC Timer

maintainers:
  - Guo Ren <guoren@kernel.org>

properties:
  compatible:
    const: csky,gx6605s-timer

  reg:
    maxItems: 1

  clocks:
    maxItems: 1

  interrupts:
    maxItems: 1

required:
  - compatible
  - reg
  - clocks
  - interrupts

additionalProperties: false

examples:
  - |
    timer@20a000 {
        compatible = "csky,gx6605s-timer";
        reg = <0x0020a000 0x400>;
        clocks = <&dummy_apb_clk>;
        interrupts = <10>;
    };
```

## Documentation/devicetree/bindings/timer/csky,mptimer.txt
```
============================
C-SKY Multi-processors Timer
============================

C-SKY multi-processors timer is designed for C-SKY SMP system and the
regs is accessed by cpu co-processor 4 registers with mtcr/mfcr.

 - PTIM_CTLR "cr<0, 14>" Control reg to start reset timer.
 - PTIM_TSR  "cr<1, 14>" Interrupt cleanup status reg.
 - PTIM_CCVR "cr<3, 14>" Current counter value reg.
 - PTIM_LVR  "cr<6, 14>" Window value reg to trigger next event.

==============================
timer analde bindings definition
==============================

	Description: Describes SMP timer

	PROPERTIES

	- compatible
		Usage: required
		Value type: <string>
		Definition: must be "csky,mptimer"
	- clocks
		Usage: required
		Value type: <analde>
		Definition: must be input clk analde
	- interrupts
		Usage: required
		Value type: <u32>
		Definition: must be timer irq num defined by soc

Examples:
---------

	timer: timer {
		compatible = "csky,mptimer";
		clocks = <&dummy_apb_clk>;
		interrupts = <16>;
		interrupt-parent = <&intc>;
	};
```

## Documentation/devicetree/bindings/timer/csky,mptimer.yaml
```yaml
# SPDX-License-Identifier: (GPL-2.0-only OR BSD-2-Clause)
%YAML 1.2
---
$id: http://devicetree.org/schemas/timer/csky,mptimer.yaml#
$schema: http://devicetree.org/meta-schemas/core.yaml#

title: C-SKY Multi-processors Timer

maintainers:
  - Flavio Suligoi <f.suligoi@asem.it>
  - Guo Ren <guoren@kernel.org>

description: |
  C-SKY multi-processors timer is designed for C-SKY SMP system and the regs are
  accessed by cpu co-processor 4 registers with mtcr/mfcr.

   - PTIM_CTLR "cr<0, 14>" Control reg to start reset timer.
   - PTIM_TSR  "cr<1, 14>" Interrupt cleanup status reg.
   - PTIM_CCVR "cr<3, 14>" Current counter value reg.
   - PTIM_LVR  "cr<6, 14>" Window value reg to trigger next event.

properties:
  compatible:
    items:
      - const: csky,mptimer

  clocks:
    maxItems: 1

  interrupts:
    maxItems: 1

required:
  - compatible
  - clocks
  - interrupts

additionalProperties: false

examples:
  - |
    timer {
        compatible = "csky,mptimer";
        clocks = <&dummy_apb_clk>;
        interrupts = <16>;
    };
```

## Documentation/devicetree/bindings/timer/digicolor-timer.txt
```
Conexant Digicolor SoCs Timer Controller

Required properties:

- compatible : should be "cnxt,cx92755-timer"
- reg : Specifies base physical address and size of the "Agent Communication"
  timer registers
- interrupts : Contains 8 interrupts, one for each timer
- clocks: phandle to the main clock

Example:

	timer@f0000fc0 {
		compatible = "cnxt,cx92755-timer";
		reg = <0xf0000fc0 0x40>;
		interrupts = <19>, <31>, <34>, <35>, <52>, <53>, <54>, <55>;
		clocks = <&main_clk>;
	};
```

## Documentation/devicetree/bindings/timer/econet,en751221-timer.yaml
```yaml
# SPDX-License-Identifier: (GPL-2.0 OR BSD-2-Clause)
%YAML 1.2
---
$id: http://devicetree.org/schemas/timer/econet,en751221-timer.yaml#
$schema: http://devicetree.org/meta-schemas/core.yaml#

title: EcoNet EN751221 High Precision Timer (HPT)

maintainers:
  - Caleb James DeLisle <cjd@cjdns.fr>

description:
  The EcoNet High Precision Timer (HPT) is a timer peripheral found in various
  EcoNet SoCs, including the EN751221 and EN751627 families. It provides per-VPE
  count/compare registers and a per-CPU control register, with a single interrupt
  line using a percpu-devid interrupt mechanism.

properties:
  compatible:
    oneOf:
      - const: econet,en751221-timer
      - items:
          - const: econet,en751627-timer
          - const: econet,en751221-timer

  reg:
    minItems: 1
    maxItems: 2

  interrupts:
    maxItems: 1
    description: A percpu-devid timer interrupt shared across CPUs.

  clocks:
    maxItems: 1

required:
  - compatible
  - reg
  - interrupts
  - clocks

allOf:
  - if:
      properties:
        compatible:
          contains:
            const: econet,en751627-timer
    then:
      properties:
        reg:
          items:
            - description: VPE timers 0 and 1
            - description: VPE timers 2 and 3
    else:
      properties:
        reg:
          items:
            - description: VPE timers 0 and 1

additionalProperties: false

examples:
  - |
    timer@1fbf0400 {
        compatible = "econet,en751627-timer", "econet,en751221-timer";
        reg = <0x1fbf0400 0x100>, <0x1fbe0000 0x100>;
        interrupt-parent = <&intc>;
        interrupts = <30>;
        clocks = <&hpt_clock>;
    };
  - |
    timer@1fbf0400 {
        compatible = "econet,en751221-timer";
        reg = <0x1fbe0400 0x100>;
        interrupt-parent = <&intc>;
        interrupts = <30>;
        clocks = <&hpt_clock>;
    };
...
```

## Documentation/devicetree/bindings/timer/energymicro,efm32-timer.txt
```
* EFM32 timer hardware

The efm32 Giant Gecko SoCs come with four 16 bit timers. Two counters can be
connected to form a 32 bit counter. Each timer has three Compare/Capture
channels and can be used as PWM or Quadrature Decoder. Available clock sources
are the cpu's HFPERCLK (with a 10-bit prescaler) or an external pin.

Required properties:
- compatible : Should be "energymicro,efm32-timer"
- reg : Address and length of the register set
- clocks : Should contain a reference to the HFPERCLK

Optional properties:
- interrupts : Reference to the timer interrupt

Example:

timer@40010c00 {
	compatible = "energymicro,efm32-timer";
	reg = <0x40010c00 0x400>;
	interrupts = <14>;
	clocks = <&cmu clk_HFPERCLKTIMER3>;
};
```

## Documentation/devicetree/bindings/timer/ezchip,nps400-timer.txt
```
NPS Network Processor

Required properties:

- compatible :	should be "ezchip,nps400-timer"

Clocks required for compatible = "ezchip,nps400-timer":
- clocks : Must contain a single entry describing the clock input

Example:

timer {
	compatible = "ezchip,nps400-timer";
	clocks = <&sysclk>;
};
```

## Documentation/devicetree/bindings/timer/ezchip,nps400-timer.yaml
```yaml
# SPDX-License-Identifier: (GPL-2.0-only OR BSD-2-Clause)
%YAML 1.2
---
$id: http://devicetree.org/schemas/ezchip,nps400-timer.yaml#
$schema: http://devicetree.org/meta-schemas/core.yaml#

title: EZChip NPS400 Timers

maintainers:
  - Noam Camus <noamca@mellanox.com>

properties:
  compatible:
    enum:
      - ezchip,nps400-timer0
      - ezchip,nps400-timer1

  interrupts:
    maxItems: 1

  clocks:
    maxItems: 1

required:
  - compatible
  - clocks

additionalProperties: false

allOf:
  - if:
      properties:
        compatible:
          contains:
            const: ezchip,nps400-timer0
    then:
      required: [ interrupts ]

examples:
  - |
    timer {
        compatible = "ezchip,nps400-timer0";
        interrupts = <3>;
        clocks = <&sysclk>;
    };
```

## Documentation/devicetree/bindings/timer/ezchip,nps400-timer0.txt
```
NPS Network Processor

Required properties:

- compatible :	should be "ezchip,nps400-timer0"

Clocks required for compatible = "ezchip,nps400-timer0":
- interrupts : The interrupt of the first timer
- clocks : Must contain a single entry describing the clock input

Example:

timer {
	compatible = "ezchip,nps400-timer0";
	interrupts = <3>;
	clocks = <&sysclk>;
};
```

## Documentation/devicetree/bindings/timer/ezchip,nps400-timer1.txt
```
NPS Network Processor

Required properties:

- compatible :	should be "ezchip,nps400-timer1"

Clocks required for compatible = "ezchip,nps400-timer1":
- clocks : Must contain a single entry describing the clock input

Example:

timer {
	compatible = "ezchip,nps400-timer1";
	clocks = <&sysclk>;
};
```

## Documentation/devicetree/bindings/timer/faraday,fttmr010.txt
```
Faraday Technology timer

This timer is a generic IP block from Faraday Technology, embedded in the
Cortina Systems Gemini SoCs and other designs.

Required properties:

- compatible : Must be one of
  "faraday,fttmr010"
  "cortina,gemini-timer", "faraday,fttmr010"
  "moxa,moxart-timer", "faraday,fttmr010"
  "aspeed,ast2400-timer"
  "aspeed,ast2500-timer"

- reg : Should contain registers location and length
- interrupts : Should contain the three timer interrupts usually with
  flags for falling edge

Optionally required properties:

- clocks : a clock to provide the tick rate for "faraday,fttmr010"
- clock-names : should be "EXTCLK" and "PCLK" for the external tick timer
  and peripheral clock respectively, for "faraday,fttmr010"
- syscon : a phandle to the global Gemini system controller if the compatible
  type is "cortina,gemini-timer"

Example:

timer@43000000 {
	compatible = "faraday,fttmr010";
	reg = <0x43000000 0x1000>;
	interrupts = <14 IRQ_TYPE_EDGE_FALLING>, /* Timer 1 */
		   <15 IRQ_TYPE_EDGE_FALLING>, /* Timer 2 */
		   <16 IRQ_TYPE_EDGE_FALLING>; /* Timer 3 */
	clocks = <&extclk>, <&pclk>;
	clock-names = "EXTCLK", "PCLK";
};
```

## Documentation/devicetree/bindings/timer/faraday,fttmr010.yaml
```yaml
# SPDX-License-Identifier: (GPL-2.0-only OR BSD-2-Clause)
%YAML 1.2
---
$id: http://devicetree.org/schemas/timer/faraday,fttmr010.yaml#
$schema: http://devicetree.org/meta-schemas/core.yaml#

title: Faraday FTTMR010 timer

maintainers:
  - Joel Stanley <joel@jms.id.au>
  - Linus Walleij <linus.walleij@linaro.org>

description:
  This timer is a generic IP block from Faraday Technology, embedded in the
  Cortina Systems Gemini SoCs and other designs.

properties:
  compatible:
    oneOf:
      - items:
          - const: moxa,moxart-timer
          - const: faraday,fttmr010
      - enum:
          - aspeed,ast2400-timer
          - aspeed,ast2500-timer
          - aspeed,ast2600-timer
          - cortina,gemini-timer
          - faraday,fttmr010

  reg:
    maxItems: 1

  interrupts:
    minItems: 1
    maxItems: 8
    description: One interrupt per timer

  clocks:
    minItems: 1
    items:
      - description: Peripheral clock
      - description: External tick clock

  clock-names:
    minItems: 1
    items:
      - const: PCLK
      - const: EXTCLK

  resets:
    maxItems: 1

  syscon:
    description: System controller phandle for Gemini systems
    $ref: /schemas/types.yaml#/definitions/phandle

required:
  - compatible
  - reg
  - interrupts

allOf:
  - if:
      properties:
        compatible:
          contains:
            const: cortina,gemini-timer
    then:
      required:
        - syscon
    else:
      properties:
        syscon: false

additionalProperties: false

examples:
  - |
    #include <dt-bindings/interrupt-controller/irq.h>

    timer@43000000 {
        compatible = "faraday,fttmr010";
        reg = <0x43000000 0x1000>;
        interrupts = <14 IRQ_TYPE_EDGE_FALLING>, /* Timer 1 */
                    <15 IRQ_TYPE_EDGE_FALLING>, /* Timer 2 */
                    <16 IRQ_TYPE_EDGE_FALLING>; /* Timer 3 */
        clocks = <&pclk>, <&extclk>;
        clock-names = "PCLK", "EXTCLK";
    };
```

## Documentation/devicetree/bindings/timer/fsl,ftm-timer.txt
```
Freescale FlexTimer Module (FTM) Timer

Required properties:

- compatible : should be "fsl,ftm-timer"
- reg : Specifies base physical address and size of the register sets for the
  clock event device and clock source device.
- interrupts : Should be the clock event device interrupt.
- clocks : The clocks provided by the SoC to drive the timer, must contain an
  entry for each entry in clock-names.
- clock-names : Must include the following entries:
  o "ftm-evt"
  o "ftm-src"
  o "ftm-evt-counter-en"
  o "ftm-src-counter-en"
- big-endian: One boolean property, the big endian mode will be in use if it is
  present, or the little endian mode will be in use for all the device registers.

Example:
ftm: ftm@400b8000 {
	compatible = "fsl,ftm-timer";
	reg = <0x400b8000 0x1000 0x400b9000 0x1000>;
	interrupts = <0 44 IRQ_TYPE_LEVEL_HIGH>;
	clock-names = "ftm-evt", "ftm-src",
		"ftm-evt-counter-en", "ftm-src-counter-en";
	clocks = <&clks VF610_CLK_FTM2>,
		<&clks VF610_CLK_FTM3>,
		<&clks VF610_CLK_FTM2_EXT_FIX_EN>,
		<&clks VF610_CLK_FTM3_EXT_FIX_EN>;
	big-endian;
};
```

## Documentation/devicetree/bindings/timer/fsl,ftm-timer.yaml
```yaml
# SPDX-License-Identifier: (GPL-2.0-only OR BSD-2-Clause)
%YAML 1.2
---
$id: http://devicetree.org/schemas/timer/fsl,ftm-timer.yaml#
$schema: http://devicetree.org/meta-schemas/core.yaml#

title: Freescale FlexTimer Module (FTM) Timer

maintainers:
  - Animesh Agarwal <animeshagarwal28@gmail.com>

properties:
  compatible:
    const: fsl,ftm-timer

  reg:
    maxItems: 1

  interrupts:
    maxItems: 1

  clocks:
    description: The clocks provided by the SoC to drive the timer, must
      contain an entry for each entry in clock-names.
    minItems: 4
    maxItems: 4

  clock-names:
    items:
      - const: ftm-evt
      - const: ftm-src
      - const: ftm-evt-counter-en
      - const: ftm-src-counter-en

  big-endian: true

required:
  - compatible
  - reg
  - interrupts
  - clocks
  - clock-names

additionalProperties: false

examples:
  - |
    #include <dt-bindings/clock/vf610-clock.h>
    #include <dt-bindings/interrupt-controller/irq.h>

    ftm@400b8000 {
        compatible = "fsl,ftm-timer";
        reg = <0x400b8000 0x1000>;
        interrupts = <0 44 IRQ_TYPE_LEVEL_HIGH>;
        clock-names = "ftm-evt", "ftm-src", "ftm-evt-counter-en", "ftm-src-counter-en";
        clocks = <&clks VF610_CLK_FTM2>, <&clks VF610_CLK_FTM3>,
            <&clks VF610_CLK_FTM2_EXT_FIX_EN>, <&clks VF610_CLK_FTM3_EXT_FIX_EN>;
        big-endian;
    };
```
