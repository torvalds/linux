## Documentation/devicetree/bindings/timer/fsl,gtm.yaml
```yaml
# SPDX-License-Identifier: (GPL-2.0-only OR BSD-2-Clause)
%YAML 1.2
---
$id: http://devicetree.org/schemas/timer/fsl,gtm.yaml#
$schema: http://devicetree.org/meta-schemas/core.yaml#

title: Freescale General-purpose Timers Module

maintainers:
  - J. Neuschäfer <j.ne@posteo.net>

properties:
  compatible:
    oneOf:
      # for SoC GTMs
      - items:
          - enum:
              - fsl,mpc8308-gtm
              - fsl,mpc8313-gtm
              - fsl,mpc8315-gtm
              - fsl,mpc8360-gtm
          - const: fsl,gtm

      # for QE GTMs
      - items:
          - enum:
              - fsl,mpc8360-qe-gtm
              - fsl,mpc8569-qe-gtm
          - const: fsl,qe-gtm
          - const: fsl,gtm

      # for CPM2 GTMs (no known examples)
      - items:
          # - enum:
          #     - fsl,<chip>-cpm2-gtm
          - const: fsl,cpm2-gtm
          - const: fsl,gtm

  reg:
    maxItems: 1

  interrupts:
    items:
      - description: Interrupt for timer 1 (e.g. GTM1 or GTM5)
      - description: Interrupt for timer 2 (e.g. GTM2 or GTM6)
      - description: Interrupt for timer 3 (e.g. GTM3 or GTM7)
      - description: Interrupt for timer 4 (e.g. GTM4 or GTM8)

  clock-frequency: true

required:
  - compatible
  - reg
  - interrupts
  - clock-frequency

additionalProperties: false

examples:
  - |
    #include <dt-bindings/interrupt-controller/irq.h>

    timer@500 {
        compatible = "fsl,mpc8360-gtm", "fsl,gtm";
        reg = <0x500 0x40>;
        interrupts = <90 IRQ_TYPE_LEVEL_LOW>,
                     <78 IRQ_TYPE_LEVEL_LOW>,
                     <84 IRQ_TYPE_LEVEL_LOW>,
                     <72 IRQ_TYPE_LEVEL_LOW>;
        /* filled by u-boot */
        clock-frequency = <0>;
    };

  - |
    timer@440 {
        compatible = "fsl,mpc8360-qe-gtm", "fsl,qe-gtm", "fsl,gtm";
        reg = <0x440 0x40>;
        interrupts = <12>, <13>, <14>, <15>;
        /* filled by u-boot */
        clock-frequency = <0>;
    };

...
```

## Documentation/devicetree/bindings/timer/fsl,imxgpt.txt
```
Freescale i.MX General Purpose Timer (GPT)

Required properties:

- compatible : should be one of following:
  for i.MX1:
  - "fsl,imx1-gpt";
  for i.MX21:
  - "fsl,imx21-gpt";
  for i.MX27:
  - "fsl,imx27-gpt", "fsl,imx21-gpt";
  for i.MX31:
  - "fsl,imx31-gpt";
  for i.MX25:
  - "fsl,imx25-gpt", "fsl,imx31-gpt";
  for i.MX50:
  - "fsl,imx50-gpt", "fsl,imx31-gpt";
  for i.MX51:
  - "fsl,imx51-gpt", "fsl,imx31-gpt";
  for i.MX53:
  - "fsl,imx53-gpt", "fsl,imx31-gpt";
  for i.MX6Q:
  - "fsl,imx6q-gpt", "fsl,imx31-gpt";
  for i.MX6DL:
  - "fsl,imx6dl-gpt";
  for i.MX6SL:
  - "fsl,imx6sl-gpt", "fsl,imx6dl-gpt";
  for i.MX6SX:
  - "fsl,imx6sx-gpt", "fsl,imx6dl-gpt";
- reg : specifies base physical address and size of the registers.
- interrupts : should be the gpt interrupt.
- clocks : the clocks provided by the SoC to drive the timer, must contain
           an entry for each entry in clock-names.
- clock-names : must include "ipg" entry first, then "per" entry.

Example:

gpt1: timer@10003000 {
	compatible = "fsl,imx27-gpt", "fsl,imx21-gpt";
	reg = <0x10003000 0x1000>;
	interrupts = <26>;
	clocks = <&clks IMX27_CLK_GPT1_IPG_GATE>,
		 <&clks IMX27_CLK_PER1_GATE>;
	clock-names = "ipg", "per";
};
```

## Documentation/devicetree/bindings/timer/fsl,imxgpt.yaml
```yaml
# SPDX-License-Identifier: (GPL-2.0-only OR BSD-2-Clause)
%YAML 1.2
---
$id: http://devicetree.org/schemas/timer/fsl,imxgpt.yaml#
$schema: http://devicetree.org/meta-schemas/core.yaml#

title: Freescale i.MX General Purpose Timer (GPT)

maintainers:
  - Sascha Hauer <s.hauer@pengutronix.de>

properties:
  compatible:
    oneOf:
      - const: fsl,imx1-gpt
      - const: fsl,imx21-gpt
      - items:
          - const: fsl,imx27-gpt
          - const: fsl,imx21-gpt
      - const: fsl,imx31-gpt
      - items:
          - enum:
            - fsl,imx25-gpt
            - fsl,imx50-gpt
            - fsl,imx51-gpt
            - fsl,imx53-gpt
            - fsl,imx6q-gpt
          - const: fsl,imx31-gpt
      - const: fsl,imx6dl-gpt
      - items:
          - enum:
            - fsl,imx6sl-gpt
            - fsl,imx6sx-gpt
          - const: fsl,imx6dl-gpt

  reg:
    maxItems: 1

  interrupts:
    maxItems: 1

  clocks:
    items:
      - description: SoC GPT ipg clock
      - description: SoC GPT per clock

  clock-names:
    items:
      - const: ipg
      - const: per

required:
  - compatible
  - reg
  - interrupts
  - clocks
  - clock-names

additionalProperties: false

examples:
  - |
    #include <dt-bindings/clock/imx27-clock.h>

    timer@10003000 {
        compatible = "fsl,imx27-gpt", "fsl,imx21-gpt";
        reg = <0x10003000 0x1000>;
        interrupts = <26>;
        clocks = <&clks IMX27_CLK_GPT1_IPG_GATE>,
                 <&clks IMX27_CLK_PER1_GATE>;
        clock-names = "ipg", "per";
    };
```

## Documentation/devicetree/bindings/timer/fsl,timrot.yaml
```yaml
# SPDX-License-Identifier: (GPL-2.0-only OR BSD-2-Clause)
%YAML 1.2
---
$id: http://devicetree.org/schemas/timer/fsl,timrot.yaml#
$schema: http://devicetree.org/meta-schemas/core.yaml#

title: Freescale MXS Timer

maintainers:
  - Frank Li <Frank.Li@nxp.com>

properties:
  compatible:
    items:
      - enum:
          - fsl,imx23-timrot
          - fsl,imx28-timrot
      - const: fsl,timrot

  reg:
    maxItems: 1

  interrupts:
    items:
      - description: irq for timer0
      - description: irq for timer1
      - description: irq for timer2
      - description: irq for timer3

  clocks:
    maxItems: 1

required:
  - compatible
  - reg
  - interrupts
  - clocks

additionalProperties: false

examples:
  - |
    timer: timer@80068000 {
        compatible = "fsl,imx28-timrot", "fsl,timrot";
        reg = <0x80068000 0x2000>;
        interrupts = <48>, <49>, <50>, <51>;
        clocks = <&clks 26>;
    };
```

## Documentation/devicetree/bindings/timer/fsl,vf610-pit.yaml
```yaml
# SPDX-License-Identifier: (GPL-2.0-only OR BSD-2-Clause)
%YAML 1.2
---
$id: http://devicetree.org/schemas/timer/fsl,vf610-pit.yaml#
$schema: http://devicetree.org/meta-schemas/core.yaml#

title: Freescale Periodic Interrupt Timer (PIT)

maintainers:
  - Frank Li <Frank.Li@nxp.com>

description:
  The PIT module is an array of timers that can be used to raise interrupts
  and trigger DMA channels.

properties:
  compatible:
    oneOf:
      - enum:
          - fsl,vf610-pit
          - nxp,s32g2-pit
      - items:
          - const: nxp,s32g3-pit
          - const: nxp,s32g2-pit

  reg:
    maxItems: 1

  interrupts:
    maxItems: 1

  clocks:
    maxItems: 1

  clock-names:
    items:
      - const: pit

required:
  - compatible
  - reg
  - interrupts
  - clocks
  - clock-names

additionalProperties: false

examples:
  - |
    #include <dt-bindings/clock/vf610-clock.h>
    #include <dt-bindings/interrupt-controller/irq.h>

    timer@40037000 {
        compatible = "fsl,vf610-pit";
        reg = <0x40037000 0x1000>;
        interrupts = <39 IRQ_TYPE_LEVEL_HIGH>;
        clocks = <&clks VF610_CLK_PIT>;
        clock-names = "pit";
    };
```

## Documentation/devicetree/bindings/timer/hpe,gxp-timer.yaml
```yaml
# SPDX-License-Identifier: (GPL-2.0-only OR BSD-2-Clause)
%YAML 1.2
---
$id: http://devicetree.org/schemas/timer/hpe,gxp-timer.yaml#
$schema: http://devicetree.org/meta-schemas/core.yaml#

title: HPE GXP Timer

maintainers:
  - Nick Hawkins <nick.hawkins@hpe.com>
  - Jean-Marie Verdun <verdun@hpe.com>

properties:
  compatible:
    const: hpe,gxp-timer

  reg:
    maxItems: 1

  interrupts:
    maxItems: 1

  clocks:
    maxItems: 1

  clock-names:
    const: iop

required:
  - compatible
  - reg
  - interrupts
  - clocks
  - clock-names

additionalProperties: false

examples:
  - |
    timer@c0000000 {
        compatible = "hpe,gxp-timer";
        reg = <0x80 0x16>;
        interrupts = <0>;
        interrupt-parent = <&vic0>;
        clocks = <&iopclk>;
        clock-names = "iop";
    };
```

## Documentation/devicetree/bindings/timer/img,pistachio-gptimer.txt
```
* Pistachio general-purpose timer based clocksource

Required properties:
 - compatible: "img,pistachio-gptimer".
 - reg: Address range of the timer registers.
 - interrupts: An interrupt for each of the four timers
 - clocks: Should contain a clock specifier for each entry in clock-names
 - clock-names: Should contain the following entries:
                "sys", interface clock
                "slow", slow counter clock
                "fast", fast counter clock
 - img,cr-periph: Must contain a phandle to the peripheral control
		  syscon node.

Example:
	timer: timer@18102000 {
		compatible = "img,pistachio-gptimer";
		reg = <0x18102000 0x100>;
		interrupts = <GIC_SHARED 60 IRQ_TYPE_LEVEL_HIGH>,
			     <GIC_SHARED 61 IRQ_TYPE_LEVEL_HIGH>,
			     <GIC_SHARED 62 IRQ_TYPE_LEVEL_HIGH>,
			     <GIC_SHARED 63 IRQ_TYPE_LEVEL_HIGH>;
		clocks = <&clk_periph PERIPH_CLK_COUNTER_FAST>,
		         <&clk_periph PERIPH_CLK_COUNTER_SLOW>,
			 <&cr_periph SYS_CLK_TIMER>;
		clock-names = "fast", "slow", "sys";
		img,cr-periph = <&cr_periph>;
	};
```

## Documentation/devicetree/bindings/timer/img,pistachio-gptimer.yaml
```yaml
# SPDX-License-Identifier: (GPL-2.0-only OR BSD-2-Clause)
%YAML 1.2
---
$id: http://devicetree.org/schemas/img,pistachio-gptimer.yaml#
$schema: http://devicetree.org/meta-schemas/core.yaml#

title: Pistachio general-purpose timer

maintainers:
  - Ezequiel Garcia <ezequiel.garcia@imgtec.com>

properties:
  compatible:
    const: img,pistachio-gptimer

  reg:
    maxItems: 1

  interrupts:
    items:
      - description: Timer0 interrupt
      - description: Timer1 interrupt
      - description: Timer2 interrupt
      - description: Timer3 interrupt

  clocks:
    items:
      - description: Fast counter clock
      - description: Slow counter clock
      - description: Interface clock

  clock-names:
    items:
      - const: fast
      - const: slow
      - const: sys

  img,cr-periph:
    description: Peripheral control syscon phandle
    $ref: /schemas/types.yaml#/definitions/phandle

required:
  - compatible
  - reg
  - interrupts
  - clocks
  - clock-names
  - img,cr-periph

additionalProperties: false

examples:
  - |
    #include <dt-bindings/interrupt-controller/mips-gic.h>
    #include <dt-bindings/clock/pistachio-clk.h>

    timer@18102000 {
        compatible = "img,pistachio-gptimer";
        reg = <0x18102000 0x100>;
        interrupts = <GIC_SHARED 60 IRQ_TYPE_LEVEL_HIGH>,
                     <GIC_SHARED 61 IRQ_TYPE_LEVEL_HIGH>,
                     <GIC_SHARED 62 IRQ_TYPE_LEVEL_HIGH>,
                     <GIC_SHARED 63 IRQ_TYPE_LEVEL_HIGH>;
        clocks = <&clk_periph PERIPH_CLK_COUNTER_FAST>,
                 <&clk_periph PERIPH_CLK_COUNTER_SLOW>,
                 <&cr_periph SYS_CLK_TIMER>;
        clock-names = "fast", "slow", "sys";
        img,cr-periph = <&cr_periph>;
    };
```

## Documentation/devicetree/bindings/timer/ingenic,sysost.yaml
```yaml
# SPDX-License-Identifier: (GPL-2.0-only OR BSD-2-Clause)
%YAML 1.2
---
$id: http://devicetree.org/schemas/timer/ingenic,sysost.yaml#
$schema: http://devicetree.org/meta-schemas/core.yaml#

title: Bindings for SYSOST in Ingenic XBurst family SoCs

maintainers:
  - 周琰杰 (Zhou Yanjie) <zhouyanjie@wanyeetech.com>

description:
  The SYSOST in an Ingenic SoC provides one 64bit timer for clocksource
  and one or more 32bit timers for clockevent.

properties:
  "#clock-cells":
    const: 1

  compatible:
    enum:
      - ingenic,x1000-ost
      - ingenic,x2000-ost

  reg:
    maxItems: 1

  clocks:
    maxItems: 1

  clock-names:
    const: ost

  interrupts:
    maxItems: 1

required:
  - "#clock-cells"
  - compatible
  - reg
  - clocks
  - clock-names
  - interrupts

additionalProperties: false

examples:
  - |
    #include <dt-bindings/clock/ingenic,x1000-cgu.h>

    ost: timer@12000000 {
        compatible = "ingenic,x1000-ost";
        reg = <0x12000000 0x3c>;

        #clock-cells = <1>;

        clocks = <&cgu X1000_CLK_OST>;
        clock-names = "ost";

        interrupt-parent = <&cpuintc>;
        interrupts = <3>;
    };
...
```
