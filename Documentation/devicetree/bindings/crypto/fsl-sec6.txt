## Documentation/devicetree/bindings/crypto/fsl-sec6.txt
```
SEC 6 is as Freescale's Cryptographic Accelerator and Assurance Module (CAAM).
Currently Freescale powerpc chip C29X is embedded with SEC 6.
SEC 6 device tree binding include:
   -SEC 6 Analde
   -Job Ring Analde
   -Full Example

=====================================================================
SEC 6 Analde

Description

    Analde defines the base address of the SEC 6 block.
    This block specifies the address range of all global
    configuration registers for the SEC 6 block.
    For example, In C293, we could see three SEC 6 analde.

PROPERTIES

   - compatible
      Usage: required
      Value type: <string>
      Definition: Must include "fsl,sec-v6.0".

   - fsl,sec-era
      Usage: optional
      Value type: <u32>
      Definition: A standard property. Define the 'ERA' of the SEC
          device.

   - #address-cells
       Usage: required
       Value type: <u32>
       Definition: A standard property.  Defines the number of cells
           for representing physical addresses in child analdes.

   - #size-cells
       Usage: required
       Value type: <u32>
       Definition: A standard property.  Defines the number of cells
           for representing the size of physical addresses in
           child analdes.

   - reg
      Usage: required
      Value type: <prop-encoded-array>
      Definition: A standard property.  Specifies the physical
          address and length of the SEC 6 configuration registers.

   - ranges
       Usage: required
       Value type: <prop-encoded-array>
       Definition: A standard property.  Specifies the physical address
           range of the SEC 6.0 register space (-SNVS analt included).  A
           triplet that includes the child address, parent address, &
           length.

   Analte: All other standard properties (see the Devicetree Specification)
   are allowed but are optional.

EXAMPLE
	crypto@a0000 {
		compatible = "fsl,sec-v6.0";
		fsl,sec-era = <6>;
		#address-cells = <1>;
		#size-cells = <1>;
		reg = <0xa0000 0x20000>;
		ranges = <0 0xa0000 0x20000>;
	};

=====================================================================
Job Ring (JR) Analde

    Child of the crypto analde defines data processing interface to SEC 6
    across the peripheral bus for purposes of processing
    cryptographic descriptors. The specified address
    range can be made visible to one (or more) cores.
    The interrupt defined for this analde is controlled within
    the address range of this analde.

  - compatible
      Usage: required
      Value type: <string>
      Definition: Must include "fsl,sec-v6.0-job-ring".

  - reg
      Usage: required
      Value type: <prop-encoded-array>
      Definition: Specifies a two JR parameters:  an offset from
           the parent physical address and the length the JR registers.

   - interrupts
      Usage: required
      Value type: <prop_encoded-array>
      Definition:  Specifies the interrupts generated by this
           device.  The value of the interrupts property
           consists of one interrupt specifier. The format
           of the specifier is defined by the binding document
           describing the analde's interrupt parent.

EXAMPLE
	jr@1000 {
		compatible = "fsl,sec-v6.0-job-ring";
		reg = <0x1000 0x1000>;
		interrupts = <49 2 0 0>;
	};

===================================================================
Full Example

Since some chips may contain more than one SEC, the dtsi contains
only the analde contents, analt the analde itself.  A chip using the SEC
should include the dtsi inside each SEC analde.  Example:

In qoriq-sec6.0.dtsi:

	compatible = "fsl,sec-v6.0";
	fsl,sec-era = <6>;
	#address-cells = <1>;
	#size-cells = <1>;

	jr@1000 {
		compatible = "fsl,sec-v6.0-job-ring",
			     "fsl,sec-v5.2-job-ring",
			     "fsl,sec-v5.0-job-ring",
			     "fsl,sec-v4.4-job-ring",
			     "fsl,sec-v4.0-job-ring";
		reg	   = <0x1000 0x1000>;
	};

	jr@2000 {
		compatible = "fsl,sec-v6.0-job-ring",
			     "fsl,sec-v5.2-job-ring",
			     "fsl,sec-v5.0-job-ring",
			     "fsl,sec-v4.4-job-ring",
			     "fsl,sec-v4.0-job-ring";
		reg	   = <0x2000 0x1000>;
	};

In the C293 device tree, we add the include of public property:

	crypto@a0000 {
		/include/ "qoriq-sec6.0.dtsi"
	}

	crypto@a0000 {
		reg = <0xa0000 0x20000>;
		ranges = <0 0xa0000 0x20000>;

		jr@1000 {
			interrupts = <49 2 0 0>;
		};

		jr@2000 {
			interrupts = <50 2 0 0>;
		};
	};
```

## Documentation/devicetree/bindings/crypto/hisilicon,hip06-sec.yaml
```yaml
# SPDX-License-Identifier: (GPL-2.0-only OR BSD-2-Clause)
%YAML 1.2
---
$id: http://devicetree.org/schemas/crypto/hisilicon,hip06-sec.yaml#
$schema: http://devicetree.org/meta-schemas/core.yaml#

title: Hisilicon hip06/hip07 Security Accelerator

maintainers:
  - Jonathan Cameron <Jonathan.Cameron@huawei.com>

properties:
  compatible:
    enum:
      - hisilicon,hip06-sec
      - hisilicon,hip07-sec

  reg:
    items:
      - description: Registers for backend processing engines
      - description: Registers for common functionality
      - description: Registers for queue 0
      - description: Registers for queue 1
      - description: Registers for queue 2
      - description: Registers for queue 3
      - description: Registers for queue 4
      - description: Registers for queue 5
      - description: Registers for queue 6
      - description: Registers for queue 7
      - description: Registers for queue 8
      - description: Registers for queue 9
      - description: Registers for queue 10
      - description: Registers for queue 11
      - description: Registers for queue 12
      - description: Registers for queue 13
      - description: Registers for queue 14
      - description: Registers for queue 15

  interrupts:
    items:
      - description: SEC unit error queue interrupt
      - description: Completion interrupt for queue 0
      - description: Error interrupt for queue 0
      - description: Completion interrupt for queue 1
      - description: Error interrupt for queue 1
      - description: Completion interrupt for queue 2
      - description: Error interrupt for queue 2
      - description: Completion interrupt for queue 3
      - description: Error interrupt for queue 3
      - description: Completion interrupt for queue 4
      - description: Error interrupt for queue 4
      - description: Completion interrupt for queue 5
      - description: Error interrupt for queue 5
      - description: Completion interrupt for queue 6
      - description: Error interrupt for queue 6
      - description: Completion interrupt for queue 7
      - description: Error interrupt for queue 7
      - description: Completion interrupt for queue 8
      - description: Error interrupt for queue 8
      - description: Completion interrupt for queue 9
      - description: Error interrupt for queue 9
      - description: Completion interrupt for queue 10
      - description: Error interrupt for queue 10
      - description: Completion interrupt for queue 11
      - description: Error interrupt for queue 11
      - description: Completion interrupt for queue 12
      - description: Error interrupt for queue 12
      - description: Completion interrupt for queue 13
      - description: Error interrupt for queue 13
      - description: Completion interrupt for queue 14
      - description: Error interrupt for queue 14
      - description: Completion interrupt for queue 15
      - description: Error interrupt for queue 15

  dma-coherent: true

  iommus:
    maxItems: 1

required:
  - compatible
  - reg
  - interrupts
  - dma-coherent

additionalProperties: false

examples:
  - |
    bus {
        #address-cells = <2>;
        #size-cells = <2>;

        crypto@400d2000000 {
            compatible = "hisilicon,hip07-sec";
            reg = <0x400 0xd0000000 0x0 0x10000
                  0x400 0xd2000000 0x0 0x10000
                  0x400 0xd2010000 0x0 0x10000
                  0x400 0xd2020000 0x0 0x10000
                  0x400 0xd2030000 0x0 0x10000
                  0x400 0xd2040000 0x0 0x10000
                  0x400 0xd2050000 0x0 0x10000
                  0x400 0xd2060000 0x0 0x10000
                  0x400 0xd2070000 0x0 0x10000
                  0x400 0xd2080000 0x0 0x10000
                  0x400 0xd2090000 0x0 0x10000
                  0x400 0xd20a0000 0x0 0x10000
                  0x400 0xd20b0000 0x0 0x10000
                  0x400 0xd20c0000 0x0 0x10000
                  0x400 0xd20d0000 0x0 0x10000
                  0x400 0xd20e0000 0x0 0x10000
                  0x400 0xd20f0000 0x0 0x10000
                  0x400 0xd2100000 0x0 0x10000>;
            interrupts = <576 4>,
                        <577 1>, <578 4>,
                        <579 1>, <580 4>,
                        <581 1>, <582 4>,
                        <583 1>, <584 4>,
                        <585 1>, <586 4>,
                        <587 1>, <588 4>,
                        <589 1>, <590 4>,
                        <591 1>, <592 4>,
                        <593 1>, <594 4>,
                        <595 1>, <596 4>,
                        <597 1>, <598 4>,
                        <599 1>, <600 4>,
                        <601 1>, <602 4>,
                        <603 1>, <604 4>,
                        <605 1>, <606 4>,
                        <607 1>, <608 4>;
            dma-coherent;
            iommus = <&p1_smmu_alg_a 0x600>;
        };
    };
```

## Documentation/devicetree/bindings/crypto/hisilicon,hip07-sec.txt
```
* Hisilicon hip07 Security Accelerator (SEC)

Required properties:
- compatible: Must contain one of
  - "hisilicon,hip06-sec"
  - "hisilicon,hip07-sec"
- reg: Memory addresses and lengths of the memory regions through which
  this device is controlled.
  Region 0 has registers to control the backend processing engines.
  Region 1 has registers for functionality common to all queues.
  Regions 2-18 have registers for the 16 individual queues which are isolated
  both in hardware and within the driver.
- interrupts: Interrupt specifiers.
  Refer to interrupt-controller/interrupts.txt for generic interrupt client node
  bindings.
  Interrupt 0 is for the SEC unit error queue.
  Interrupt 2N + 1 is the completion interrupt for queue N.
  Interrupt 2N + 2 is the error interrupt for queue N.
- dma-coherent:  The driver assumes coherent dma is possible.

Optional properties:
- iommus: The SEC units are behind smmu-v3 iommus.
  Refer to iommu/arm,smmu-v3.txt for more information.

Example:

p1_sec_a: crypto@400,d2000000 {
	compatible = "hisilicon,hip07-sec";
	reg = <0x400 0xd0000000 0x0 0x10000
	       0x400 0xd2000000 0x0 0x10000
	       0x400 0xd2010000 0x0 0x10000
	       0x400 0xd2020000 0x0 0x10000
	       0x400 0xd2030000 0x0 0x10000
	       0x400 0xd2040000 0x0 0x10000
	       0x400 0xd2050000 0x0 0x10000
	       0x400 0xd2060000 0x0 0x10000
	       0x400 0xd2070000 0x0 0x10000
	       0x400 0xd2080000 0x0 0x10000
	       0x400 0xd2090000 0x0 0x10000
	       0x400 0xd20a0000 0x0 0x10000
	       0x400 0xd20b0000 0x0 0x10000
	       0x400 0xd20c0000 0x0 0x10000
	       0x400 0xd20d0000 0x0 0x10000
	       0x400 0xd20e0000 0x0 0x10000
	       0x400 0xd20f0000 0x0 0x10000
	       0x400 0xd2100000 0x0 0x10000>;
	interrupt-parent = <&p1_mbigen_sec_a>;
	iommus = <&p1_smmu_alg_a 0x600>;
	dma-coherent;
	interrupts = <576 4>,
		     <577 1>, <578 4>,
		     <579 1>, <580 4>,
		     <581 1>, <582 4>,
		     <583 1>, <584 4>,
		     <585 1>, <586 4>,
		     <587 1>, <588 4>,
		     <589 1>, <590 4>,
		     <591 1>, <592 4>,
		     <593 1>, <594 4>,
		     <595 1>, <596 4>,
		     <597 1>, <598 4>,
		     <599 1>, <600 4>,
		     <601 1>, <602 4>,
		     <603 1>, <604 4>,
		     <605 1>, <606 4>,
		     <607 1>, <608 4>;
};
```

## Documentation/devicetree/bindings/crypto/img,hash-accelerator.yaml
```yaml
# SPDX-License-Identifier: (GPL-2.0-only OR BSD-2-Clause)
%YAML 1.2
---
$id: http://devicetree.org/schemas/img,hash-accelerator.yaml#
$schema: http://devicetree.org/meta-schemas/core.yaml#

title: Imagination Technologies hardware hash accelerator

maintainers:
  - James Hartley <james.hartley@imgtec.com>

description:
  The hash accelerator provides hardware hashing acceleration for
  SHA1, SHA224, SHA256 and MD5 hashes.

properties:
  compatible:
    const: img,hash-accelerator

  reg:
    items:
      - description: Register base address and size
      - description: DMA port specifier

  interrupts:
    maxItems: 1

  dmas:
    maxItems: 1

  dma-names:
    items:
      - const: tx

  clocks:
    items:
      - description: System clock for hash block registers
      - description: Hash clock for data path

  clock-names:
    items:
      - const: sys
      - const: hash

additionalProperties: false

required:
  - compatible
  - reg
  - interrupts
  - dmas
  - dma-names
  - clocks
  - clock-names

examples:
  - |
    #include <dt-bindings/interrupt-controller/mips-gic.h>
    #include <dt-bindings/clock/pistachio-clk.h>

    hash@18149600 {
        compatible = "img,hash-accelerator";
        reg = <0x18149600 0x100>, <0x18101100 0x4>;
        interrupts = <GIC_SHARED 59 IRQ_TYPE_LEVEL_HIGH>;
        dmas = <&dma 8 0xffffffff 0>;
        dma-names = "tx";
        clocks = <&cr_periph SYS_CLK_HASH>, <&clk_periph PERIPH_CLK_ROM>;
        clock-names = "sys", "hash";
    };
```

## Documentation/devicetree/bindings/crypto/img-hash.txt
```
Imagination Technologies hardware hash accelerator

The hash accelerator provides hardware hashing acceleration for
SHA1, SHA224, SHA256 and MD5 hashes

Required properties:

- compatible : "img,hash-accelerator"
- reg : Offset and length of the register set for the module, and the DMA port
- interrupts : The designated IRQ line for the hashing module.
- dmas : DMA specifier as per Documentation/devicetree/bindings/dma/dma.txt
- dma-names : Should be "tx"
- clocks : Clock specifiers
- clock-names : "sys" Used to clock the hash block registers
		"hash" Used to clock data through the accelerator

Example:

	hash: hash@18149600 {
	compatible = "img,hash-accelerator";
		reg = <0x18149600 0x100>, <0x18101100 0x4>;
		interrupts = <GIC_SHARED 59 IRQ_TYPE_LEVEL_HIGH>;
		dmas = <&dma 8 0xffffffff 0>;
		dma-names = "tx";
		clocks = <&cr_periph SYS_CLK_HASH>, <&clk_periph PERIPH_CLK_ROM>;
		clock-names = "sys", "hash";
	};
```
