## Documentation/devicetree/bindings/crypto/marvell-cesa.txt
```
Marvell Cryptographic Engines And Security Accelerator

Required properties:
- compatible: should be one of the following string
	      "marvell,orion-crypto"
	      "marvell,kirkwood-crypto"
	      "marvell,dove-crypto"
	      "marvell,armada-370-crypto"
	      "marvell,armada-xp-crypto"
	      "marvell,armada-375-crypto"
	      "marvell,armada-38x-crypto"
- reg: base physical address of the engine and length of memory mapped
       region. Can also contain an entry for the SRAM attached to the CESA,
       but this representation is deprecated and marvell,crypto-srams should
       be used instead
- reg-names: "regs". Can contain an "sram" entry, but this representation
	     is deprecated and marvell,crypto-srams should be used instead
- interrupts: interrupt number
- clocks: reference to the crypto engines clocks. This property is not
	  required for orion and kirkwood platforms
- clock-names: "cesaX" and "cesazX", X should be replaced by the crypto engine
	       id.
	       This property is not required for the orion and kirkwoord
	       platforms.
	       "cesazX" clocks are not required on armada-370 platforms
- marvell,crypto-srams: phandle to crypto SRAM definitions

Optional properties:
- marvell,crypto-sram-size: SRAM size reserved for crypto operations, if not
			    specified the whole SRAM is used (2KB)


Examples:

	crypto@90000 {
		compatible = "marvell,armada-xp-crypto";
		reg = <0x90000 0x10000>;
		reg-names = "regs";
		interrupts = <48>, <49>;
		clocks = <&gateclk 23>, <&gateclk 23>;
		clock-names = "cesa0", "cesa1";
		marvell,crypto-srams = <&crypto_sram0>, <&crypto_sram1>;
		marvell,crypto-sram-size = <0x600>;
		status = "okay";
	};
```

## Documentation/devicetree/bindings/crypto/mediatek-crypto.txt
```
MediaTek cryptographic accelerators

Required properties:
- compatible: Should be "mediatek,eip97-crypto"
- reg: Address and length of the register set for the device
- interrupts: Should contain the five crypto engines interrupts in numeric
	order. These are global system and four descriptor rings.
- clocks: the clock used by the core
- clock-names: Must contain "cryp".
- power-domains: Must contain a reference to the PM domain.


Example:
	crypto: crypto@1b240000 {
		compatible = "mediatek,eip97-crypto";
		reg = <0 0x1b240000 0 0x20000>;
		interrupts = <GIC_SPI 82 IRQ_TYPE_LEVEL_LOW>,
			     <GIC_SPI 83 IRQ_TYPE_LEVEL_LOW>,
			     <GIC_SPI 84 IRQ_TYPE_LEVEL_LOW>,
			     <GIC_SPI 91 IRQ_TYPE_LEVEL_LOW>,
			     <GIC_SPI 97 IRQ_TYPE_LEVEL_LOW>;
		clocks = <&ethsys CLK_ETHSYS_CRYPTO>;
		clock-names = "cryp";
		power-domains = <&scpsys MT2701_POWER_DOMAIN_ETH>;
	};
```

## Documentation/devicetree/bindings/crypto/mv_cesa.txt
```
Marvell Cryptographic Engines And Security Accelerator

Required properties:
- compatible: should be one of the following string
	      "marvell,orion-crypto"
	      "marvell,kirkwood-crypto"
	      "marvell,dove-crypto"
- reg: base physical address of the engine and length of memory mapped
       region. Can also contain an entry for the SRAM attached to the CESA,
       but this representation is deprecated and marvell,crypto-srams should
       be used instead
- reg-names: "regs". Can contain an "sram" entry, but this representation
	     is deprecated and marvell,crypto-srams should be used instead
- interrupts: interrupt number
- clocks: reference to the crypto engines clocks. This property is only
	  required for Dove platforms
- marvell,crypto-srams: phandle to crypto SRAM definitions

Optional properties:
- marvell,crypto-sram-size: SRAM size reserved for crypto operations, if not
			    specified the whole SRAM is used (2KB)

Examples:

	crypto@30000 {
		compatible = "marvell,orion-crypto";
		reg = <0x30000 0x10000>;
		reg-names = "regs";
		interrupts = <22>;
		marvell,crypto-srams = <&crypto_sram>;
		marvell,crypto-sram-size = <0x600>;
	};
```

## Documentation/devicetree/bindings/crypto/nvidia,tegra234-se-aes.yaml
```yaml
# SPDX-License-Identifier: (GPL-2.0-only OR BSD-2-Clause)
%YAML 1.2
---
$id: http://devicetree.org/schemas/crypto/nvidia,tegra234-se-aes.yaml#
$schema: http://devicetree.org/meta-schemas/core.yaml#

title: NVIDIA Tegra Security Engine for AES algorithms

description:
  The Tegra Security Engine accelerates the following AES encryption/decryption
  algorithms - AES-ECB, AES-CBC, AES-OFB, AES-XTS, AES-CTR, AES-GCM, AES-CCM,
  AES-CMAC

maintainers:
  - Akhil R <akhilrajeev@nvidia.com>

properties:
  compatible:
    const: nvidia,tegra234-se-aes

  reg:
    maxItems: 1

  clocks:
    maxItems: 1

  iommus:
    maxItems: 1

  dma-coherent: true

required:
  - compatible
  - reg
  - clocks
  - iommus

additionalProperties: false

examples:
  - |
    #include <dt-bindings/memory/tegra234-mc.h>
    #include <dt-bindings/clock/tegra234-clock.h>

    crypto@15820000 {
        compatible = "nvidia,tegra234-se-aes";
        reg = <0x15820000 0x10000>;
        clocks = <&bpmp TEGRA234_CLK_SE>;
        iommus = <&smmu TEGRA234_SID_SES_SE1>;
        dma-coherent;
    };
...
```

## Documentation/devicetree/bindings/crypto/nvidia,tegra234-se-hash.yaml
```yaml
# SPDX-License-Identifier: (GPL-2.0-only OR BSD-2-Clause)
%YAML 1.2
---
$id: http://devicetree.org/schemas/crypto/nvidia,tegra234-se-hash.yaml#
$schema: http://devicetree.org/meta-schemas/core.yaml#

title: NVIDIA Tegra Security Engine for HASH algorithms

description:
  The Tegra Security HASH Engine accelerates the following HASH functions -
  SHA1, SHA224, SHA256, SHA384, SHA512, SHA3-224, SHA3-256, SHA3-384, SHA3-512
  HMAC(SHA224), HMAC(SHA256), HMAC(SHA384), HMAC(SHA512)

maintainers:
  - Akhil R <akhilrajeev@nvidia.com>

properties:
  compatible:
    const: nvidia,tegra234-se-hash

  reg:
    maxItems: 1

  clocks:
    maxItems: 1

  iommus:
    maxItems: 1

  dma-coherent: true

required:
  - compatible
  - reg
  - clocks
  - iommus

additionalProperties: false

examples:
  - |
    #include <dt-bindings/memory/tegra234-mc.h>
    #include <dt-bindings/clock/tegra234-clock.h>

    crypto@15840000 {
        compatible = "nvidia,tegra234-se-hash";
        reg = <0x15840000 0x10000>;
        clocks = <&bpmp TEGRA234_CLK_SE>;
        iommus = <&smmu TEGRA234_SID_SES_SE2>;
        dma-coherent;
    };
...
```

## Documentation/devicetree/bindings/crypto/omap-aes.txt
```
OMAP SoC AES crypto Module

Required properties:

- compatible : Should contain entries for this and backward compatible
  AES versions:
  - "ti,omap2-aes" for OMAP2.
  - "ti,omap3-aes" for OMAP3.
  - "ti,omap4-aes" for OMAP4 and AM33XX.
  Note that the OMAP2 and 3 versions are compatible (OMAP3 supports
  more algorithms) but they are incompatible with OMAP4.
- ti,hwmods: Name of the hwmod associated with the AES module
- reg : Offset and length of the register set for the module
- interrupts : the interrupt-specifier for the AES module.

Optional properties:
- dmas: DMA specifiers for tx and rx dma. See the DMA client binding,
	Documentation/devicetree/bindings/dma/dma.txt
- dma-names: DMA request names should include "tx" and "rx" if present.

Example:
	/* AM335x */
	aes: aes@53500000 {
		compatible = "ti,omap4-aes";
		ti,hwmods = "aes";
		reg = <0x53500000 0xa0>;
		interrupts = <102>;
		dmas = <&edma 6>,
		       <&edma 5>;
		dma-names = "tx", "rx";
	};
```

## Documentation/devicetree/bindings/crypto/omap-des.txt
```
OMAP SoC DES crypto Module

Required properties:

- compatible : Should contain "ti,omap4-des"
- ti,hwmods: Name of the hwmod associated with the DES module
- reg : Offset and length of the register set for the module
- interrupts : the interrupt-specifier for the DES module
- clocks : A phandle to the functional clock node of the DES module
           corresponding to each entry in clock-names
- clock-names : Name of the functional clock, should be "fck"

Optional properties:
- dmas: DMA specifiers for tx and rx dma. See the DMA client binding,
	Documentation/devicetree/bindings/dma/dma.txt
	Each entry corresponds to an entry in dma-names
- dma-names: DMA request names should include "tx" and "rx" if present

Example:
	/* DRA7xx SoC */
	des: des@480a5000 {
		compatible = "ti,omap4-des";
		ti,hwmods = "des";
		reg = <0x480a5000 0xa0>;
		interrupts = <GIC_SPI 82 IRQ_TYPE_LEVEL_HIGH>;
		dmas = <&sdma 117>, <&sdma 116>;
		dma-names = "tx", "rx";
		clocks = <&l3_iclk_div>;
		clock-names = "fck";
	};
```

## Documentation/devicetree/bindings/crypto/omap-sham.txt
```
OMAP SoC SHA crypto Module

Required properties:

- compatible : Should contain entries for this and backward compatible
  SHAM versions:
  - "ti,omap2-sham" for OMAP2 & OMAP3.
  - "ti,omap4-sham" for OMAP4 and AM33XX.
  Note that these two versions are incompatible.
- ti,hwmods: Name of the hwmod associated with the SHAM module
- reg : Offset and length of the register set for the module
- interrupts : the interrupt-specifier for the SHAM module.

Optional properties:
- dmas: DMA specifiers for the rx dma. See the DMA client binding,
	Documentation/devicetree/bindings/dma/dma.txt
- dma-names: DMA request name. Should be "rx" if a dma is present.

Example:
	/* AM335x */
	sham: sham@53100000 {
		compatible = "ti,omap4-sham";
		ti,hwmods = "sham";
		reg = <0x53100000 0x200>;
		interrupts = <109>;
		dmas = <&edma 36>;
		dma-names = "rx";
	};
```

## Documentation/devicetree/bindings/crypto/picochip-spacc.txt
```
Picochip picoXcell SPAcc (Security Protocol Accelerator) bindings

Picochip picoXcell devices contain crypto offload engines that may be used for
IPSEC and femtocell layer 2 ciphering.

Required properties:
  - compatible : "picochip,spacc-ipsec" for the IPSEC offload engine
    "picochip,spacc-l2" for the femtocell layer 2 ciphering engine.
  - reg : Offset and length of the register set for this device
  - interrupt-parent : The interrupt controller that controls the SPAcc
    interrupt.
  - interrupts : The interrupt line from the SPAcc.
  - ref-clock : The input clock that drives the SPAcc.

Example SPAcc node:

spacc@10000 {
	compatible = "picochip,spacc-ipsec";
	reg = <0x100000 0x10000>;
	interrupt-parent = <&vic0>;
	interrupts = <24>;
	ref-clock = <&ipsec_clk>, "ref";
};
```

## Documentation/devicetree/bindings/crypto/qcom,inline-crypto-engine.yaml
```yaml
# SPDX-License-Identifier: (GPL-2.0-only OR BSD-2-Clause)
%YAML 1.2
---
$id: http://devicetree.org/schemas/crypto/qcom,inline-crypto-engine.yaml#
$schema: http://devicetree.org/meta-schemas/core.yaml#

title: Qualcomm Technologies, Inc. (QTI) Inline Crypto Engine

maintainers:
  - Bjorn Andersson <andersson@kernel.org>

properties:
  compatible:
    items:
      - enum:
          - qcom,eliza-inline-crypto-engine
          - qcom,kaanapali-inline-crypto-engine
          - qcom,milos-inline-crypto-engine
          - qcom,qcs8300-inline-crypto-engine
          - qcom,sa8775p-inline-crypto-engine
          - qcom,sc7180-inline-crypto-engine
          - qcom,sc7280-inline-crypto-engine
          - qcom,sm8450-inline-crypto-engine
          - qcom,sm8550-inline-crypto-engine
          - qcom,sm8650-inline-crypto-engine
          - qcom,sm8750-inline-crypto-engine
      - const: qcom,inline-crypto-engine

  reg:
    maxItems: 1

  clocks:
    maxItems: 1

  operating-points-v2: true

  opp-table:
    type: object

required:
  - compatible
  - reg
  - clocks

additionalProperties: false

examples:
  - |
    #include <dt-bindings/clock/qcom,sm8550-gcc.h>

    crypto@1d88000 {
      compatible = "qcom,sm8550-inline-crypto-engine",
                   "qcom,inline-crypto-engine";
      reg = <0x01d88000 0x8000>;
      clocks = <&gcc GCC_UFS_PHY_ICE_CORE_CLK>;

      operating-points-v2 = <&ice_opp_table>;

      ice_opp_table: opp-table {
        compatible = "operating-points-v2";

        opp-100000000 {
          opp-hz = /bits/ 64 <100000000>;
          required-opps = <&rpmhpd_opp_low_svs>;
        };

        opp-201500000 {
          opp-hz = /bits/ 64 <201500000>;
          required-opps = <&rpmhpd_opp_svs_l1>;
        };

        opp-403000000 {
          opp-hz = /bits/ 64 <403000000>;
          required-opps = <&rpmhpd_opp_nom>;
        };
      };
    };
...
```

## Documentation/devicetree/bindings/crypto/qcom,prng.yaml
```yaml
# SPDX-License-Identifier: GPL-2.0-only
%YAML 1.2
---
$id: http://devicetree.org/schemas/crypto/qcom,prng.yaml#
$schema: http://devicetree.org/meta-schemas/core.yaml#

title: Qualcomm Pseudo Random Number Generator

maintainers:
  - Vinod Koul <vkoul@kernel.org>

properties:
  compatible:
    enum:
      - qcom,prng  # 8916 etc.
      - qcom,prng-ee  # 8996 and later using EE

  reg:
    maxItems: 1

  clocks:
    maxItems: 1

  clock-names:
    items:
      - const: core

required:
  - compatible
  - reg
  - clocks
  - clock-names

additionalProperties: false

examples:
  - |
    rng@f9bff000 {
        compatible = "qcom,prng";
        reg = <0xf9bff000 0x200>;
        clocks = <&clk 125>;
        clock-names = "core";
    };
```

## Documentation/devicetree/bindings/crypto/qcom-qce.txt
```
Qualcomm crypto engine driver

Required properties:

- compatible  : should be "qcom,crypto-v5.1"
- reg         : specifies base physical address and size of the registers map
- clocks      : phandle to clock-controller plus clock-specifier pair
- clock-names : "iface" clocks register interface
                "bus" clocks data transfer interface
                "core" clocks rest of the crypto block
- dmas        : DMA specifiers for tx and rx dma channels. For more see
                Documentation/devicetree/bindings/dma/dma.txt
- dma-names   : DMA request names should be "rx" and "tx"

Example:
	crypto@fd45a000 {
		compatible = "qcom,crypto-v5.1";
		reg = <0xfd45a000 0x6000>;
		clocks = <&gcc GCC_CE2_AHB_CLK>,
			 <&gcc GCC_CE2_AXI_CLK>,
			 <&gcc GCC_CE2_CLK>;
		clock-names = "iface", "bus", "core";
		dmas = <&cryptobam 2>, <&cryptobam 3>;
		dma-names = "rx", "tx";
	};
```
