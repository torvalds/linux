## Documentation/devicetree/bindings/crypto/inside-secure,safexcel-eip93.yaml
```yaml
# SPDX-License-Identifier: (GPL-2.0-only OR BSD-2-Clause)
%YAML 1.2
---
$id: http://devicetree.org/schemas/crypto/inside-secure,safexcel-eip93.yaml#
$schema: http://devicetree.org/meta-schemas/core.yaml#

title: Inside Secure SafeXcel EIP-93 cryptographic engine

maintainers:
  - Christian Marangi <ansuelsmth@gmail.com>

description: |
  The Inside Secure SafeXcel EIP-93 is a cryptographic engine IP block
  integrated in varios devices with very different and generic name from
  PKTE to simply vendor+EIP93. The real IP under the hood is actually
  developed by Inside Secure and given to license to vendors.

  The IP block is sold with different model based on what feature are
  needed and are identified with the final letter. Each letter correspond
  to a specific set of feature and multiple letter reflect the sum of the
  feature set.

  EIP-93 models:
    - EIP-93i: (basic) DES/Triple DES, AES, PRNG, IPsec ESP, SRTP, SHA1
    - EIP-93ie: i + SHA224/256, AES-192/256
    - EIP-93is: i + SSL/DTLS/DTLS, MD5, ARC4
    - EIP-93ies: i + e + s
    - EIP-93iw: i + AES-XCB-MAC, AES-CCM

properties:
  compatible:
    oneOf:
      - items:
          - const: airoha,en7581-eip93
          - const: inside-secure,safexcel-eip93ies
      - items:
          - not: {}
            description: Need a SoC specific compatible
          - enum:
              - inside-secure,safexcel-eip93i
              - inside-secure,safexcel-eip93ie
              - inside-secure,safexcel-eip93is
              - inside-secure,safexcel-eip93iw

  reg:
    maxItems: 1

  interrupts:
    maxItems: 1

required:
  - compatible
  - reg
  - interrupts

additionalProperties: false

examples:
  - |
    #include <dt-bindings/interrupt-controller/arm-gic.h>

    crypto@1e004000 {
      compatible = "airoha,en7581-eip93", "inside-secure,safexcel-eip93ies";
      reg = <0x1fb70000 0x1000>;

      interrupts = <GIC_SPI 44 IRQ_TYPE_LEVEL_HIGH>;
    };
```

## Documentation/devicetree/bindings/crypto/inside-secure,safexcel.yaml
```yaml
# SPDX-License-Identifier: GPL-2.0-only OR BSD-2-Clause
%YAML 1.2
---
$id: http://devicetree.org/schemas/crypto/inside-secure,safexcel.yaml#
$schema: http://devicetree.org/meta-schemas/core.yaml#

title: Inside Secure SafeXcel cryptographic engine

maintainers:
  - Antoine Tenart <atenart@kernel.org>

properties:
  compatible:
    oneOf:
      - items:
          - const: marvell,armada-cp110-crypto
          - const: inside-secure,safexcel-eip197b
      - items:
          - enum:
              - marvell,armada-3700-crypto
              - mediatek,mt7986-crypto
          - const: inside-secure,safexcel-eip97ies
      - const: inside-secure,safexcel-eip197b
      - const: inside-secure,safexcel-eip197d
      - const: inside-secure,safexcel-eip97ies
      - const: inside-secure,safexcel-eip197
        description: Equivalent of inside-secure,safexcel-eip197b
        deprecated: true
      - const: inside-secure,safexcel-eip97
        description: Equivalent of inside-secure,safexcel-eip97ies
        deprecated: true

  reg:
    maxItems: 1

  interrupts:
    minItems: 4
    maxItems: 6

  interrupt-names:
    minItems: 4
    items:
      - const: ring0
      - const: ring1
      - const: ring2
      - const: ring3
      - const: eip
      - const: mem

  clocks:
    minItems: 1
    maxItems: 2

  clock-names:
    minItems: 1
    items:
      - const: core
      - const: reg

  dma-coherent: true

required:
  - reg
  - interrupts
  - interrupt-names

allOf:
  - if:
      properties:
        clocks:
          minItems: 2
    then:
      properties:
        clock-names:
          minItems: 2
      required:
        - clock-names
  - if:
      properties:
        compatible:
          not:
            contains:
              const: mediatek,mt7986-crypto
    then:
      properties:
        interrupts:
          minItems: 6
        interrupt-names:
          minItems: 6

additionalProperties: false

examples:
  - |
    #include <dt-bindings/interrupt-controller/arm-gic.h>
    #include <dt-bindings/interrupt-controller/irq.h>

    crypto@800000 {
        compatible = "inside-secure,safexcel-eip197b";
        reg = <0x800000 0x200000>;
        interrupts = <GIC_SPI 54 IRQ_TYPE_LEVEL_HIGH>,
                     <GIC_SPI 55 IRQ_TYPE_LEVEL_HIGH>,
                     <GIC_SPI 56 IRQ_TYPE_LEVEL_HIGH>,
                     <GIC_SPI 57 IRQ_TYPE_LEVEL_HIGH>,
                     <GIC_SPI 58 IRQ_TYPE_LEVEL_HIGH>,
                     <GIC_SPI 34 IRQ_TYPE_LEVEL_HIGH>;
        interrupt-names = "ring0", "ring1", "ring2", "ring3", "eip", "mem";
        clocks = <&cpm_syscon0 1 26>;
        clock-names = "core";
    };
```

## Documentation/devicetree/bindings/crypto/inside-secure-safexcel.txt
```
Inside Secure SafeXcel cryptographic engine

Required properties:
- compatible: Should be "inside-secure,safexcel-eip197b",
	      "inside-secure,safexcel-eip197d" or
              "inside-secure,safexcel-eip97ies".
- reg: Base physical address of the engine and length of memory mapped region.
- interrupts: Interrupt numbers for the rings and engine.
- interrupt-names: Should be "ring0", "ring1", "ring2", "ring3", "eip", "mem".

Optional properties:
- clocks: Reference to the crypto engine clocks, the second clock is
          needed for the Armada 7K/8K SoCs.
- clock-names: mandatory if there is a second clock, in this case the
               name must be "core" for the first clock and "reg" for
               the second one.

Backward compatibility:
Two compatibles are kept for backward compatibility, but shouldn't be used for
new submissions:
- "inside-secure,safexcel-eip197" is equivalent to
  "inside-secure,safexcel-eip197b".
- "inside-secure,safexcel-eip97" is equivalent to
  "inside-secure,safexcel-eip97ies".

Example:

	crypto: crypto@800000 {
		compatible = "inside-secure,safexcel-eip197b";
		reg = <0x800000 0x200000>;
		interrupts = <GIC_SPI 34 IRQ_TYPE_LEVEL_HIGH>,
			     <GIC_SPI 54 IRQ_TYPE_LEVEL_HIGH>,
			     <GIC_SPI 55 IRQ_TYPE_LEVEL_HIGH>,
			     <GIC_SPI 56 IRQ_TYPE_LEVEL_HIGH>,
			     <GIC_SPI 57 IRQ_TYPE_LEVEL_HIGH>,
			     <GIC_SPI 58 IRQ_TYPE_LEVEL_HIGH>;
		interrupt-names = "mem", "ring0", "ring1", "ring2", "ring3",
				  "eip";
		clocks = <&cpm_syscon0 1 26>;
	};
```

## Documentation/devicetree/bindings/crypto/intel,ixp4xx-crypto.yaml
```yaml
# SPDX-License-Identifier: (GPL-2.0 OR BSD-2-Clause)
# Copyright 2018 Linaro Ltd.
%YAML 1.2
---
$id: http://devicetree.org/schemas/crypto/intel,ixp4xx-crypto.yaml#
$schema: http://devicetree.org/meta-schemas/core.yaml#

title: Intel IXP4xx cryptographic engine

maintainers:
  - Linus Walleij <linus.walleij@linaro.org>

description: |
  The Intel IXP4xx cryptographic engine makes use of the IXP4xx NPE
  (Network Processing Engine). Since it is not a device on its own
  it is defined as a subnode of the NPE, if crypto support is
  available on the platform.

properties:
  compatible:
    const: intel,ixp4xx-crypto

  intel,npe-handle:
    $ref: /schemas/types.yaml#/definitions/phandle-array
    items:
      - items:
          - description: phandle to the NPE this crypto engine
          - description: the NPE instance number
    description: phandle to the NPE this crypto engine is using, the cell
      describing the NPE instance to be used.

  queue-rx:
    $ref: /schemas/types.yaml#/definitions/phandle-array
    items:
      - items:
          - description: phandle to the RX queue on the NPE
          - description: the queue instance number
    description: phandle to the RX queue on the NPE, the cell describing
      the queue instance to be used.

  queue-txready:
    $ref: /schemas/types.yaml#/definitions/phandle-array
    items:
      - items:
          - description: phandle to the TX READY queue on the NPE
          - description: the queue instance number
    description: phandle to the TX READY queue on the NPE, the cell describing
      the queue instance to be used.

required:
  - compatible
  - intel,npe-handle
  - queue-rx
  - queue-txready

additionalProperties: false
```

## Documentation/devicetree/bindings/crypto/intel,keembay-ocs-aes.yaml
```yaml
# SPDX-License-Identifier: (GPL-2.0-only OR BSD-2-Clause)
%YAML 1.2
---
$id: http://devicetree.org/schemas/crypto/intel,keembay-ocs-aes.yaml#
$schema: http://devicetree.org/meta-schemas/core.yaml#

title: Intel Keem Bay OCS AES

maintainers:
  - Daniele Alessandrelli <daniele.alessandrelli@intel.com>

description:
  The Intel Keem Bay Offload and Crypto Subsystem (OCS) AES engine provides
  hardware-accelerated AES/SM4 encryption/decryption.

properties:
  compatible:
    const: intel,keembay-ocs-aes

  reg:
    maxItems: 1

  interrupts:
    maxItems: 1

  clocks:
    maxItems: 1

required:
  - compatible
  - reg
  - interrupts
  - clocks

additionalProperties: false

examples:
  - |
    #include <dt-bindings/interrupt-controller/arm-gic.h>
    crypto@30008000 {
      compatible = "intel,keembay-ocs-aes";
      reg = <0x30008000 0x1000>;
      interrupts = <GIC_SPI 114 IRQ_TYPE_LEVEL_HIGH>;
      clocks = <&scmi_clk 95>;
    };
```

## Documentation/devicetree/bindings/crypto/intel,keembay-ocs-ecc.yaml
```yaml
# SPDX-License-Identifier: (GPL-2.0-only OR BSD-2-Clause)
%YAML 1.2
---
$id: http://devicetree.org/schemas/crypto/intel,keembay-ocs-ecc.yaml#
$schema: http://devicetree.org/meta-schemas/core.yaml#

title: Intel Keem Bay OCS ECC Device Tree Bindings

maintainers:
  - Daniele Alessandrelli <daniele.alessandrelli@intel.com>
  - Prabhjot Khurana <prabhjot.khurana@intel.com>

description:
  The Intel Keem Bay Offload and Crypto Subsystem (OCS) Elliptic Curve
  Cryptography (ECC) device provides hardware acceleration for elliptic curve
  cryptography using the NIST P-256 and NIST P-384 elliptic curves.

properties:
  compatible:
    const: intel,keembay-ocs-ecc

  reg:
    maxItems: 1

  interrupts:
    maxItems: 1

  clocks:
    maxItems: 1

required:
  - compatible
  - reg
  - interrupts
  - clocks

additionalProperties: false

examples:
  - |
    #include <dt-bindings/interrupt-controller/arm-gic.h>
    crypto@30001000 {
      compatible = "intel,keembay-ocs-ecc";
      reg = <0x30001000 0x1000>;
      interrupts = <GIC_SPI 120 IRQ_TYPE_LEVEL_HIGH>;
      clocks = <&scmi_clk 95>;
    };
```

## Documentation/devicetree/bindings/crypto/intel,keembay-ocs-hcu.yaml
```yaml
# SPDX-License-Identifier: (GPL-2.0-only OR BSD-2-Clause)
%YAML 1.2
---
$id: http://devicetree.org/schemas/crypto/intel,keembay-ocs-hcu.yaml#
$schema: http://devicetree.org/meta-schemas/core.yaml#

title: Intel Keem Bay OCS HCU

maintainers:
  - Declan Murphy <declan.murphy@intel.com>
  - Daniele Alessandrelli <daniele.alessandrelli@intel.com>

description:
  The Intel Keem Bay Offload and Crypto Subsystem (OCS) Hash Control Unit (HCU)
  provides hardware-accelerated hashing and HMAC.

properties:
  compatible:
    const: intel,keembay-ocs-hcu

  reg:
    maxItems: 1

  interrupts:
    maxItems: 1

  clocks:
    maxItems: 1

required:
  - compatible
  - reg
  - interrupts
  - clocks

additionalProperties: false

examples:
  - |
    #include <dt-bindings/interrupt-controller/arm-gic.h>
    crypto@3000b000 {
      compatible = "intel,keembay-ocs-hcu";
      reg = <0x3000b000 0x1000>;
      interrupts = <GIC_SPI 121 IRQ_TYPE_LEVEL_HIGH>;
      clocks = <&scmi_clk 94>;
    };
```

## Documentation/devicetree/bindings/crypto/marvell,orion-crypto.yaml
```yaml
# SPDX-License-Identifier: (GPL-2.0-only OR BSD-2-Clause)
%YAML 1.2
---
$id: http://devicetree.org/schemas/crypto/marvell,orion-crypto.yaml#
$schema: http://devicetree.org/meta-schemas/core.yaml#

title: Marvell Cryptographic Engines And Security Accelerator

maintainers:
  - Andrew Lunn <andrew@lunn.ch>
  - Boris Brezillon <bbrezillon@kernel.org>

description: |
  Marvell Cryptographic Engines And Security Accelerator

properties:
  compatible:
    enum:
      - marvell,armada-370-crypto
      - marvell,armada-xp-crypto
      - marvell,armada-375-crypto
      - marvell,armada-38x-crypto
      - marvell,dove-crypto
      - marvell,kirkwood-crypto
      - marvell,orion-crypto

  reg:
    minItems: 1
    items:
      - description: Registers region
      - description: SRAM region
        deprecated: true

  reg-names:
    minItems: 1
    items:
      - const: regs
      - const: sram
        deprecated: true

  interrupts:
    description: One interrupt for each CESA engine
    minItems: 1
    maxItems: 2

  clocks:
    description: One or two clocks for each CESA engine
    minItems: 1
    maxItems: 4

  clock-names:
    minItems: 1
    items:
      - const: cesa0
      - const: cesa1
      - const: cesaz0
      - const: cesaz1

  marvell,crypto-srams:
    description: Phandle(s) to crypto SRAM.
    $ref: /schemas/types.yaml#/definitions/phandle-array
    minItems: 1
    maxItems: 2
    items:
      maxItems: 1

  marvell,crypto-sram-size:
    description: SRAM size reserved for crypto operations.
    $ref: /schemas/types.yaml#/definitions/uint32
    default: 0x800

required:
  - compatible
  - reg
  - reg-names
  - interrupts
  - marvell,crypto-srams

allOf:
  - if:
      not:
        properties:
          compatible:
            enum:
              - marvell,kirkwood-crypto
              - marvell,orion-crypto
    then:
      required:
        - clocks
  - if:
      properties:
        compatible:
          contains:
            enum:
              - marvell,armada-370-crypto
              - marvell,armada-375-crypto
              - marvell,armada-38x-crypto
              - marvell,armada-xp-crypto
    then:
      required:
        - clock-names
  - if:
      properties:
        compatible:
          contains:
            enum:
              - marvell,armada-375-crypto
              - marvell,armada-38x-crypto
    then:
      properties:
        clocks:
          minItems: 4
        clock-names:
          minItems: 4
    else:
      properties:
        clocks:
          maxItems: 2
        clock-names:
          maxItems: 2

additionalProperties: false

examples:
  - |
    crypto@30000 {
        compatible = "marvell,orion-crypto";
        reg = <0x30000 0x10000>;
        reg-names = "regs";
        interrupts = <22>;
        marvell,crypto-srams = <&crypto_sram>;
        marvell,crypto-sram-size = <0x600>;
    };
```
