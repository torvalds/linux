## Documentation/devicetree/bindings/crypto/amd-ccp.txt
```
* AMD Cryptographic Coprocessor driver (ccp)

Required properties:
- compatible: Should be "amd,ccp-seattle-v1a"
- reg: Address and length of the register set for the device
- interrupt-parent: Should be the phandle for the interrupt controller
  that services interrupts for this device
- interrupts: Should contain the CCP interrupt

Example:
	ccp@e0100000 {
		compatible = "amd,ccp-seattle-v1a";
		reg = <0 0xe0100000 0 0x10000>;
		interrupt-parent = <&gic>;
		interrupts = <0 3 4>;
	};
```

## Documentation/devicetree/bindings/crypto/amlogic,gxl-crypto.yaml
```yaml
# SPDX-License-Identifier: GPL-2.0
%YAML 1.2
---
$id: http://devicetree.org/schemas/crypto/amlogic,gxl-crypto.yaml#
$schema: http://devicetree.org/meta-schemas/core.yaml#

title: Amlogic GXL Cryptographic Offloader

maintainers:
  - Corentin Labbe <clabbe@baylibre.com>

properties:
  compatible:
    items:
    - const: amlogic,gxl-crypto

  reg:
    maxItems: 1

  interrupts:
    items:
      - description: "Interrupt for flow 0"
      - description: "Interrupt for flow 1"

  clocks:
    maxItems: 1

  clock-names:
    const: blkmv

required:
  - compatible
  - reg
  - interrupts
  - clocks
  - clock-names

additionalProperties: false

examples:
  - |
    #include <dt-bindings/interrupt-controller/irq.h>
    #include <dt-bindings/interrupt-controller/arm-gic.h>
    #include <dt-bindings/clock/gxbb-clkc.h>

    crypto: crypto-engine@c883e000 {
        compatible = "amlogic,gxl-crypto";
        reg = <0x0 0xc883e000 0x0 0x36>;
        interrupts = <GIC_SPI 188 IRQ_TYPE_EDGE_RISING>, <GIC_SPI 189 IRQ_TYPE_EDGE_RISING>;
        clocks = <&clkc CLKID_BLKMV>;
        clock-names = "blkmv";
    };
```

## Documentation/devicetree/bindings/crypto/arm,cryptocell.yaml
```yaml
# SPDX-License-Identifier: (GPL-2.0-only OR BSD-2-Clause)
%YAML 1.2
---
$id: http://devicetree.org/schemas/crypto/arm,cryptocell.yaml#
$schema: http://devicetree.org/meta-schemas/core.yaml#

title: Arm TrustZone CryptoCell cryptographic engine

maintainers:
  - Gilad Ben-Yossef <gilad@benyossef.com>

properties:
  compatible:
    enum:
      - arm,cryptocell-713-ree
      - arm,cryptocell-703-ree
      - arm,cryptocell-712-ree
      - arm,cryptocell-710-ree
      - arm,cryptocell-630p-ree

  reg:
    maxItems: 1

  interrupts:
    maxItems: 1

  clocks:
    maxItems: 1

  power-domains:
    maxItems: 1

  resets:
    maxItems: 1

  dma-coherent: true

required:
  - compatible
  - reg
  - interrupts

additionalProperties: false

examples:
  - |
    #include <dt-bindings/interrupt-controller/arm-gic.h>

    arm_cc712: crypto@80000000 {
            compatible = "arm,cryptocell-712-ree";
            reg = <0x80000000 0x10000>;
            interrupts = <GIC_SPI 30 IRQ_TYPE_LEVEL_HIGH>;
    };
```

## Documentation/devicetree/bindings/crypto/arm-cryptocell.txt
```
Arm TrustZone CryptoCell cryptographic engine

Required properties:
- compatible: Should be one of -
   "arm,cryptocell-713-ree"
   "arm,cryptocell-712-ree"
   "arm,cryptocell-710-ree"
   "arm,cryptocell-630p-ree"
- reg: Base physical address of the engine and length of memory mapped region.
- interrupts: Interrupt number for the device.

Optional properties:
- clocks: Reference to the crypto engine clock.
- dma-coherent: Present if dma operations are coherent.

Examples:

       arm_cc712: crypto@80000000 {
               compatible = "arm,cryptocell-712-ree";
               interrupt-parent = <&intc>;
               interrupts = < 0 30 4 >;
               reg = < 0x80000000 0x10000 >;

       };
```

## Documentation/devicetree/bindings/crypto/artpec6-crypto.txt
```
Axis crypto engine with PDMA interface.

Required properties:
- compatible : Should be one of the following strings:
	"axis,artpec6-crypto" for the version in the Axis ARTPEC-6 SoC
	"axis,artpec7-crypto" for the version in the Axis ARTPEC-7 SoC.
- reg: Base address and size for the PDMA register area.
- interrupts: Interrupt handle for the PDMA interrupt line.

Example:

crypto@f4264000 {
	compatible = "axis,artpec6-crypto";
	reg = <0xf4264000 0x1000>;
	interrupts = <GIC_SPI 19 IRQ_TYPE_LEVEL_HIGH>;
};
```

## Documentation/devicetree/bindings/crypto/aspeed,ast2500-hace.yaml
```yaml
# SPDX-License-Identifier: (GPL-2.0-only OR BSD-2-Clause)
%YAML 1.2
---
$id: http://devicetree.org/schemas/crypto/aspeed,ast2500-hace.yaml#
$schema: http://devicetree.org/meta-schemas/core.yaml#

title: ASPEED HACE hash and crypto Hardware Accelerator Engines

maintainers:
  - Neal Liu <neal_liu@aspeedtech.com>

description: |
  The Hash and Crypto Engine (HACE) is designed to accelerate the throughput
  of hash data digest, encryption, and decryption. Basically, HACE can be
  divided into two independently engines - Hash Engine and Crypto Engine.

properties:
  compatible:
    enum:
      - aspeed,ast2500-hace
      - aspeed,ast2600-hace

  reg:
    maxItems: 1

  clocks:
    maxItems: 1

  interrupts:
    maxItems: 1

  resets:
    maxItems: 1

required:
  - compatible
  - reg
  - clocks
  - interrupts
  - resets

additionalProperties: false

examples:
  - |
    #include <dt-bindings/clock/ast2600-clock.h>
    hace: crypto@1e6d0000 {
        compatible = "aspeed,ast2600-hace";
        reg = <0x1e6d0000 0x200>;
        interrupts = <4>;
        clocks = <&syscon ASPEED_CLK_GATE_YCLK>;
        resets = <&syscon ASPEED_RESET_HACE>;
    };
```

## Documentation/devicetree/bindings/crypto/aspeed,ast2600-acry.yaml
```yaml
# SPDX-License-Identifier: (GPL-2.0-only OR BSD-2-Clause)
%YAML 1.2
---
$id: http://devicetree.org/schemas/crypto/aspeed,ast2600-acry.yaml#
$schema: http://devicetree.org/meta-schemas/core.yaml#

title: ASPEED ACRY ECDSA/RSA Hardware Accelerator Engines

maintainers:
  - Neal Liu <neal_liu@aspeedtech.com>

description:
  The ACRY ECDSA/RSA engines is designed to accelerate the throughput
  of ECDSA/RSA signature and verification. Basically, ACRY can be
  divided into two independent engines - ECC Engine and RSA Engine.

properties:
  compatible:
    enum:
      - aspeed,ast2600-acry

  reg:
    items:
      - description: acry base address & size
      - description: acry sram base address & size

  clocks:
    maxItems: 1

  interrupts:
    maxItems: 1

required:
  - compatible
  - reg
  - clocks
  - interrupts

additionalProperties: false

examples:
  - |
    #include <dt-bindings/clock/ast2600-clock.h>
    acry: crypto@1e6fa000 {
        compatible = "aspeed,ast2600-acry";
        reg = <0x1e6fa000 0x400>, <0x1e710000 0x1800>;
        interrupts = <160>;
        clocks = <&syscon ASPEED_CLK_GATE_RSACLK>;
    };
```

## Documentation/devicetree/bindings/crypto/atmel,at91sam9g46-aes.yaml
```yaml
# SPDX-License-Identifier: (GPL-2.0-only OR BSD-2-Clause)
# Copyright (C) 2022 Microchip Technology, Inc. and its subsidiaries
%YAML 1.2
---
$id: http://devicetree.org/schemas/crypto/atmel,at91sam9g46-aes.yaml#
$schema: http://devicetree.org/meta-schemas/core.yaml#

title: Atmel Advanced Encryption Standard (AES) HW cryptographic accelerator

maintainers:
  - Tudor Ambarus <tudor.ambarus@linaro.org>

properties:
  compatible:
    oneOf:
      - const: atmel,at91sam9g46-aes
      - items:
          - enum:
              - microchip,sam9x7-aes
              - microchip,sama7d65-aes
          - const: atmel,at91sam9g46-aes

  reg:
    maxItems: 1

  interrupts:
    maxItems: 1

  clocks:
    maxItems: 1

  clock-names:
    const: aes_clk

  dmas:
    items:
      - description: TX DMA Channel
      - description: RX DMA Channel

  dma-names:
    items:
      - const: tx
      - const: rx

required:
  - compatible
  - reg
  - interrupts
  - clocks
  - clock-names
  - dmas
  - dma-names

additionalProperties: false

examples:
  - |
    #include <dt-bindings/interrupt-controller/irq.h>
    #include <dt-bindings/interrupt-controller/arm-gic.h>
    #include <dt-bindings/clock/at91.h>
    #include <dt-bindings/dma/at91.h>

    aes: crypto@e1810000 {
      compatible = "atmel,at91sam9g46-aes";
      reg = <0xe1810000 0x100>;
      interrupts = <GIC_SPI 27 IRQ_TYPE_LEVEL_HIGH>;
      clocks = <&pmc PMC_TYPE_PERIPHERAL 27>;
      clock-names = "aes_clk";
      dmas = <&dma0 AT91_XDMAC_DT_PERID(1)>,
             <&dma0 AT91_XDMAC_DT_PERID(2)>;
      dma-names = "tx", "rx";
    };
```

## Documentation/devicetree/bindings/crypto/atmel,at91sam9g46-sha.yaml
```yaml
# SPDX-License-Identifier: (GPL-2.0-only OR BSD-2-Clause)
# Copyright (C) 2022 Microchip Technology, Inc. and its subsidiaries
%YAML 1.2
---
$id: http://devicetree.org/schemas/crypto/atmel,at91sam9g46-sha.yaml#
$schema: http://devicetree.org/meta-schemas/core.yaml#

title: Atmel Secure Hash Algorithm (SHA) HW cryptographic accelerator

maintainers:
  - Tudor Ambarus <tudor.ambarus@linaro.org>

properties:
  compatible:
    oneOf:
      - const: atmel,at91sam9g46-sha
      - items:
          - enum:
              - microchip,sam9x7-sha
              - microchip,sama7d65-sha
          - const: atmel,at91sam9g46-sha

  reg:
    maxItems: 1

  interrupts:
    maxItems: 1

  clocks:
    maxItems: 1

  clock-names:
    const: sha_clk

  dmas:
    maxItems: 1
    description: TX DMA Channel

  dma-names:
    const: tx

required:
  - compatible
  - reg
  - interrupts
  - clocks
  - clock-names

additionalProperties: false

examples:
  - |
    #include <dt-bindings/interrupt-controller/irq.h>
    #include <dt-bindings/interrupt-controller/arm-gic.h>
    #include <dt-bindings/clock/at91.h>
    #include <dt-bindings/dma/at91.h>

    sha: crypto@e1814000 {
      compatible = "atmel,at91sam9g46-sha";
      reg = <0xe1814000 0x100>;
      interrupts = <GIC_SPI 83 IRQ_TYPE_LEVEL_HIGH>;
      clocks = <&pmc PMC_TYPE_PERIPHERAL 83>;
      clock-names = "sha_clk";
      dmas = <&dma0 AT91_XDMAC_DT_PERID(48)>;
      dma-names = "tx";
    };
```

## Documentation/devicetree/bindings/crypto/atmel,at91sam9g46-tdes.yaml
```yaml
# SPDX-License-Identifier: (GPL-2.0-only OR BSD-2-Clause)
# Copyright (C) 2022 Microchip Technology, Inc. and its subsidiaries
%YAML 1.2
---
$id: http://devicetree.org/schemas/crypto/atmel,at91sam9g46-tdes.yaml#
$schema: http://devicetree.org/meta-schemas/core.yaml#

title: Atmel Triple Data Encryption Standard (TDES) HW cryptographic accelerator

maintainers:
  - Tudor Ambarus <tudor.ambarus@microchip.com>

properties:
  compatible:
    const: atmel,at91sam9g46-tdes

  reg:
    maxItems: 1

  interrupts:
    maxItems: 1

  clocks:
    maxItems: 1

  clock-names:
    const: tdes_clk

  dmas:
    items:
      - description: TX DMA Channel
      - description: RX DMA Channel

  dma-names:
    items:
      - const: tx
      - const: rx

required:
  - compatible
  - reg
  - interrupts
  - clocks
  - clock-names

additionalProperties: false

examples:
  - |
    #include <dt-bindings/interrupt-controller/irq.h>
    #include <dt-bindings/interrupt-controller/arm-gic.h>
    #include <dt-bindings/clock/at91.h>
    #include <dt-bindings/dma/at91.h>

    tdes: crypto@e2014000 {
      compatible = "atmel,at91sam9g46-tdes";
      reg = <0xe2014000 0x100>;
      interrupts = <GIC_SPI 96 IRQ_TYPE_LEVEL_HIGH>;
      clocks = <&pmc PMC_TYPE_PERIPHERAL 96>;
      clock-names = "tdes_clk";
      dmas = <&dma0 AT91_XDMAC_DT_PERID(54)>,
             <&dma0 AT91_XDMAC_DT_PERID(53)>;
      dma-names = "tx", "rx";
    };
```

## Documentation/devicetree/bindings/crypto/atmel-crypto.txt
```
* Atmel HW cryptographic accelerators

These are the HW cryptographic accelerators found on some Atmel products.

* Secure Hash Algorithm (SHA)

Required properties:
- compatible : Should be "atmel,at91sam9g46-sha".
- reg: Should contain SHA registers location and length.
- interrupts: Should contain the IRQ line for the SHA.

Optional properties:
- dmas: One DMA specifiers as described in
        atmel-dma.txt and dma.txt files.
- dma-names: Contains one identifier string for each DMA specifier
             in the dmas property. Only one "tx" string needed.

Example:
sha@f8034000 {
	compatible = "atmel,at91sam9g46-sha";
	reg = <0xf8034000 0x100>;
	interrupts = <42 4 0>;
	dmas = <&dma1 2 17>;
	dma-names = "tx";
};
```

## Documentation/devicetree/bindings/crypto/axis,artpec6-crypto.yaml
```yaml
# SPDX-License-Identifier: (GPL-2.0-only OR BSD-2-Clause)
%YAML 1.2
---
$id: http://devicetree.org/schemas/crypto/axis,artpec6-crypto.yaml#
$schema: http://devicetree.org/meta-schemas/core.yaml#

title: Axis ARTPEC6 crypto engine with PDMA interface

maintainers:
  - Lars Persson <lars.persson@axis.com>

properties:
  compatible:
    enum:
      - axis,artpec6-crypto
      - axis,artpec7-crypto

  reg:
    maxItems: 1

  interrupts:
    maxItems: 1

required:
  - compatible
  - reg
  - interrupts

additionalProperties: false

examples:
  - |
    #include <dt-bindings/interrupt-controller/arm-gic.h>

    crypto@f4264000 {
        compatible = "axis,artpec6-crypto";
        reg = <0xf4264000 0x1000>;
        interrupts = <GIC_SPI 19 IRQ_TYPE_LEVEL_HIGH>;
    };
```

## Documentation/devicetree/bindings/crypto/brcm,spu-crypto.txt
```
The Broadcom Secure Processing Unit (SPU) hardware supports symmetric
cryptographic offload for Broadcom SoCs. A SoC may have multiple SPU hardware
blocks.

Required properties:
- compatible: Should be one of the following:
  brcm,spum-crypto - for devices with SPU-M hardware
  brcm,spu2-crypto - for devices with SPU2 hardware
  brcm,spu2-v2-crypto - for devices with enhanced SPU2 hardware features like SHA3
  and Rabin Fingerprint support
  brcm,spum-nsp-crypto - for the Northstar Plus variant of the SPU-M hardware

- reg: Should contain SPU registers location and length.
- mboxes: The mailbox channel to be used to communicate with the SPU.
  Mailbox channels correspond to DMA rings on the device.

Example:
	crypto@612d0000 {
		compatible = "brcm,spum-crypto";
		reg = <0 0x612d0000 0 0x900>;
		mboxes = <&pdc0 0>;
	};
```

## Documentation/devicetree/bindings/crypto/brcm,spum-crypto.yaml
```yaml
# SPDX-License-Identifier: (GPL-2.0-only OR BSD-2-Clause)
%YAML 1.2
---
$id: http://devicetree.org/schemas/brcm,spum-crypto.yaml#
$schema: http://devicetree.org/meta-schemas/core.yaml#

title: Broadcom SPU Crypto Offload

maintainers:
  - Rob Rice <rob.rice@broadcom.com>

description:
  The Broadcom Secure Processing Unit (SPU) hardware supports symmetric
  cryptographic offload for Broadcom SoCs. A SoC may have multiple SPU hardware
  blocks.

properties:
  compatible:
    enum:
      - brcm,spum-crypto
      - brcm,spu2-crypto
      - brcm,spu2-v2-crypto     # enhanced SPU2 hardware features like SHA3 and Rabin Fingerprint support
      - brcm,spum-nsp-crypto    # Northstar Plus variant of the SPU-M hardware

  reg:
    maxItems: 1

  mboxes:
    maxItems: 1

required:
  - compatible
  - reg
  - mboxes

additionalProperties: false

examples:
  - |
    crypto@612d0000 {
        compatible = "brcm,spum-crypto";
        reg = <0x612d0000 0x900>;
        mboxes = <&pdc0 0>;
    };
```
