## Documentation/devicetree/bindings/crypto/xlnx,versal-trng.yaml
```yaml
# SPDX-License-Identifier: (GPL-2.0-only OR BSD-2-Clause)
%YAML 1.2
---
$id: http://devicetree.org/schemas/crypto/xlnx,versal-trng.yaml#
$schema: http://devicetree.org/meta-schemas/core.yaml#

title: Xilinx Versal True Random Number Generator Hardware Accelerator

maintainers:
  - Harsh Jain <h.jain@amd.com>
  - Mounika Botcha <mounika.botcha@amd.com>

description:
  The Versal True Random Number Generator consists of Ring Oscillators as
  entropy source and a deterministic CTR_DRBG random bit generator (DRBG).

properties:
  compatible:
    const: xlnx,versal-trng

  reg:
    maxItems: 1

required:
  - reg

additionalProperties: false

examples:
  - |
    rng@f1230000 {
        compatible = "xlnx,versal-trng";
        reg = <0xf1230000 0x1000>;
    };
...
```

## Documentation/devicetree/bindings/crypto/xlnx,zynqmp-aes.yaml
```yaml
# SPDX-License-Identifier: (GPL-2.0-only OR BSD-2-Clause)
%YAML 1.2
---
$id: http://devicetree.org/schemas/crypto/xlnx,zynqmp-aes.yaml#
$schema: http://devicetree.org/meta-schemas/core.yaml#

title: Xilinx ZynqMP AES-GCM Hardware Accelerator

maintainers:
  - Kalyani Akula <kalyani.akula@amd.com>
  - Michal Simek <michal.simek@amd.com>

description: |
  The ZynqMP AES-GCM hardened cryptographic accelerator is used to
  encrypt or decrypt the data with provided key and initialization vector.

properties:
  compatible:
    const: xlnx,zynqmp-aes

required:
  - compatible

additionalProperties: false

examples:
  - |
    firmware {
      zynqmp_firmware: zynqmp-firmware {
        compatible = "xlnx,zynqmp-firmware";
        method = "smc";
        xlnx_aes: zynqmp-aes {
          compatible = "xlnx,zynqmp-aes";
        };
      };
    };
...
```

## Documentation/devicetree/bindings/csky/cpus.txt
```
==================
C-SKY CPU Bindings
==================

The device tree allows to describe the layout of CPUs in a system through
the "cpus" node, which in turn contains a number of subnodes (ie "cpu")
defining properties for every cpu.

Only SMP system need to care about the cpus node and single processor
needn't define cpus node at all.

=====================================
cpus and cpu node bindings definition
=====================================

- cpus node

	Description: Container of cpu nodes

	The node name must be "cpus".

	A cpus node must define the following properties:

	- #address-cells
		Usage: required
		Value type: <u32>
		Definition: must be set to 1
	- #size-cells
		Usage: required
		Value type: <u32>
		Definition: must be set to 0

- cpu node

	Description: Describes one of SMP cores

	PROPERTIES

	- device_type
		Usage: required
		Value type: <string>
		Definition: must be "cpu"
	- reg
		Usage: required
		Value type: <u32>
		Definition: CPU index
	- compatible:
		Usage: required
		Value type: <string>
		Definition: must contain "csky", eg:
			"csky,610"
			"csky,807"
			"csky,810"
			"csky,860"

Example:
--------

	cpus {
		#address-cells = <1>;
		#size-cells = <0>;
		cpu@0 {
			device_type = "cpu";
			reg = <0>;
			status = "ok";
		};

		cpu@1 {
			device_type = "cpu";
			reg = <1>;
			status = "ok";
		};
	};
```
