## Documentation/devicetree/bindings/crypto/st,stm32-cryp.yaml
```yaml
# SPDX-License-Identifier: (GPL-2.0-only OR BSD-2-Clause)
%YAML 1.2
---
$id: http://devicetree.org/schemas/crypto/st,stm32-cryp.yaml#
$schema: http://devicetree.org/meta-schemas/core.yaml#

title: STMicroelectronics STM32 CRYP

description: The STM32 CRYP block is built on the CRYP block found in
  the STn8820 SoC introduced in 2007, and subsequently used in the U8500
  SoC in 2010.

maintainers:
  - Lionel Debieve <lionel.debieve@foss.st.com>

properties:
  compatible:
    enum:
      - st,stn8820-cryp
      - stericsson,ux500-cryp
      - st,stm32f756-cryp
      - st,stm32mp1-cryp

  reg:
    maxItems: 1

  clocks:
    maxItems: 1

  interrupts:
    maxItems: 1

  resets:
    maxItems: 1

  dmas:
    items:
      - description: mem2cryp DMA channel
      - description: cryp2mem DMA channel

  dma-names:
    items:
      - const: mem2cryp
      - const: cryp2mem

  power-domains:
    maxItems: 1

  access-controllers:
    minItems: 1
    maxItems: 2

required:
  - compatible
  - reg
  - clocks
  - interrupts

additionalProperties: false

examples:
  - |
    #include <dt-bindings/interrupt-controller/arm-gic.h>
    #include <dt-bindings/clock/stm32mp1-clks.h>
    #include <dt-bindings/reset/stm32mp1-resets.h>
    cryp@54001000 {
      compatible = "st,stm32mp1-cryp";
      reg = <0x54001000 0x400>;
      interrupts = <GIC_SPI 79 IRQ_TYPE_LEVEL_HIGH>;
      clocks = <&rcc CRYP1>;
      resets = <&rcc CRYP1_R>;
    };

...
```

## Documentation/devicetree/bindings/crypto/st,stm32-hash.txt
```
* STMicroelectronics STM32 HASH

Required properties:
- compatible: Should contain entries for this and backward compatible
  HASH versions:
  - "st,stm32f456-hash" for stm32 F456.
  - "st,stm32f756-hash" for stm32 F756.
- reg: The address and length of the peripheral registers space
- interrupts: the interrupt specifier for the HASH
- clocks: The input clock of the HASH instance

Optional properties:
- resets: The input reset of the HASH instance
- dmas: DMA specifiers for the HASH. See the DMA client binding,
	 Documentation/devicetree/bindings/dma/dma.txt
- dma-names: DMA request name. Should be "in" if a dma is present.
- dma-maxburst: Set number of maximum dma burst supported

Example:

hash1: hash@50060400 {
	compatible = "st,stm32f756-hash";
	reg = <0x50060400 0x400>;
	interrupts = <80>;
	clocks = <&rcc 0 STM32F7_AHB2_CLOCK(HASH)>;
	resets = <&rcc STM32F7_AHB2_RESET(HASH)>;
	dmas = <&dma2 7 2 0x400 0x0>;
	dma-names = "in";
	dma-maxburst = <0>;
};
```

## Documentation/devicetree/bindings/crypto/st,stm32-hash.yaml
```yaml
# SPDX-License-Identifier: (GPL-2.0-only OR BSD-2-Clause)
%YAML 1.2
---
$id: http://devicetree.org/schemas/crypto/st,stm32-hash.yaml#
$schema: http://devicetree.org/meta-schemas/core.yaml#

title: STMicroelectronics STM32 HASH

description: The STM32 HASH block is built on the HASH block found in
  the STn8820 SoC introduced in 2007, and subsequently used in the U8500
  SoC in 2010.

maintainers:
  - Lionel Debieve <lionel.debieve@foss.st.com>

properties:
  compatible:
    enum:
      - st,stn8820-hash
      - stericsson,ux500-hash
      - st,stm32f456-hash
      - st,stm32f756-hash
      - st,stm32mp13-hash

  reg:
    maxItems: 1

  clocks:
    maxItems: 1

  interrupts:
    maxItems: 1

  resets:
    maxItems: 1

  dmas:
    maxItems: 1

  dma-names:
    items:
      - const: in

  dma-maxburst:
    description: Set number of maximum dma burst supported
    $ref: /schemas/types.yaml#/definitions/uint32
    minimum: 0
    maximum: 2
    default: 0

  power-domains:
    maxItems: 1

required:
  - compatible
  - reg
  - clocks

allOf:
  - if:
      properties:
        compatible:
          items:
            const: stericsson,ux500-hash
    then:
      properties:
        interrupts: false
    else:
      required:
        - interrupts

additionalProperties: false

examples:
  - |
    #include <dt-bindings/interrupt-controller/arm-gic.h>
    #include <dt-bindings/clock/stm32mp1-clks.h>
    #include <dt-bindings/reset/stm32mp1-resets.h>
    hash@54002000 {
      compatible = "st,stm32f756-hash";
      reg = <0x54002000 0x400>;
      interrupts = <GIC_SPI 80 IRQ_TYPE_LEVEL_HIGH>;
      clocks = <&rcc HASH1>;
      resets = <&rcc HASH1_R>;
      dmas = <&mdma1 31 0x10 0x1000A02 0x0 0x0>;
      dma-names = "in";
      dma-maxburst = <2>;
    };

...
```

## Documentation/devicetree/bindings/crypto/starfive,jh7110-crypto.yaml
```yaml
# SPDX-License-Identifier: (GPL-2.0-only OR BSD-2-Clause)
%YAML 1.2
---
$id: http://devicetree.org/schemas/crypto/starfive,jh7110-crypto.yaml#
$schema: http://devicetree.org/meta-schemas/core.yaml#

title: StarFive Cryptographic Module

maintainers:
  - Jia Jie Ho <jiajie.ho@starfivetech.com>
  - William Qiu <william.qiu@starfivetech.com>

properties:
  compatible:
    enum:
      - starfive,jh7110-crypto
      - starfive,jh8100-crypto

  reg:
    maxItems: 1

  clocks:
    items:
      - description: Hardware reference clock
      - description: AHB reference clock

  clock-names:
    items:
      - const: hclk
      - const: ahb

  interrupts:
    minItems: 1
    items:
      - description: SHA2 module irq
      - description: SM3 module irq

  resets:
    maxItems: 1

  dmas:
    items:
      - description: TX DMA channel
      - description: RX DMA channel

  dma-names:
    items:
      - const: tx
      - const: rx

required:
  - compatible
  - reg
  - clocks
  - clock-names
  - resets
  - dmas
  - dma-names

additionalProperties: false

allOf:
  - if:
      properties:
        compatible:
          const: starfive,jh7110-crypto

    then:
      properties:
        interrupts:
          maxItems: 1

  - if:
      properties:
        compatible:
          const: starfive,jh8100-crypto

    then:
      properties:
        interrupts:
          minItems: 2

examples:
  - |
    crypto: crypto@16000000 {
        compatible = "starfive,jh7110-crypto";
        reg = <0x16000000 0x4000>;
        clocks = <&clk 15>, <&clk 16>;
        clock-names = "hclk", "ahb";
        interrupts = <28>;
        resets = <&reset 3>;
        dmas = <&dma 1 2>,
               <&dma 0 2>;
        dma-names = "tx", "rx";
    };
...
```

## Documentation/devicetree/bindings/crypto/starfive-sec.yaml
```yaml
# SPDX-License-Identifier: (GPL-2.0-only OR BSD-2-Clause)
%YAML 1.2
---
$id: http://devicetree.org/schemas/crypto/starfive-sec.yaml#
$schema: http://devicetree.org/meta-schemas/core.yaml#

title: Starfive SEC controller Device Tree Bindings

properties:
    compatible:
        const:starfive,jh7110-sec

    reg:
        minItem: 1

    reg-names:
        minItem: 1
        items:
            -const:secreg
            -const:secdma

    interrupts:
        minItem: 1

    interrupt-names:
        minItem: 1
        items:
            -const:secirq
            -const:secdma

    clocks:
        minItem: 1
        items:
            -description:sec_hclk clock
            -description:sec_ahb clock

    clock-names:
        minItem: 1
        items:
            -const:sec_hclk
            -const:sec_ahb

    resets:
        minItem: 1
        items:
            -description:sec_hre reset

    reset-names:
        minItem: 1
        items:
            -const:sec_hre

required:
    - compatible
    - reg
    - reg-names
    - interrupts
    - interrupt-names
    - clocks
    - clock-names
    - resets
    - reset-names

additionalProperties:false

examples:
    - |
        crypto: crypto@16000000 {
        compatible = "starfive,jh7110-sec";
        reg = <0x0 0x16000000 0x0 0x4000>,
              <0x0 0x16008000 0x0 0x4000>;
        reg-names = "secreg","secdma";
        interrupts = <28>, <29>;
        interrupt-names = "secirq",
                "dmairq";
        clocks = <&clkgen JH7110_SEC_HCLK>,
                 <&clkgen JH7110_SEC_MISCAHB_CLK>;
        clock-names = "sec_hclk","sec_ahb";
        resets = <&rstgen RSTN_U0_SEC_TOP_HRESETN>;
        reset-names = "sec_hre";
        };
```

## Documentation/devicetree/bindings/crypto/sun4i-ss.txt
```
* Allwinner Security System found on A20 SoC

Required properties:
- compatible : Should be "allwinner,sun4i-a10-crypto".
- reg: Should contain the Security System register location and length.
- interrupts: Should contain the IRQ line for the Security System.
- clocks : List of clock specifiers, corresponding to ahb and ss.
- clock-names : Name of the functional clock, should be
	* "ahb" : AHB gating clock
	* "mod" : SS controller clock

Optional properties:
 - resets : phandle + reset specifier pair
 - reset-names : must contain "ahb"

Example:
	crypto: crypto-engine@1c15000 {
		compatible = "allwinner,sun4i-a10-crypto";
		reg = <0x01c15000 0x1000>;
		interrupts = <GIC_SPI 86 IRQ_TYPE_LEVEL_HIGH>;
		clocks = <&ahb_gates 5>, <&ss_clk>;
		clock-names = "ahb", "mod";
	};
```

## Documentation/devicetree/bindings/crypto/ti,am62l-dthev2.yaml
```yaml
# SPDX-License-Identifier: (GPL-2.0-only OR BSD-2-Clause)
%YAML 1.2
---
$id: http://devicetree.org/schemas/crypto/ti,am62l-dthev2.yaml#
$schema: http://devicetree.org/meta-schemas/core.yaml#

title: K3 SoC DTHE V2 crypto module

maintainers:
  - T Pratham <t-pratham@ti.com>

properties:
  compatible:
    enum:
      - ti,am62l-dthev2

  reg:
    maxItems: 1

  dmas:
    items:
      - description: AES Engine RX DMA Channel
      - description: AES Engine TX DMA Channel
      - description: SHA Engine TX DMA Channel

  dma-names:
    items:
      - const: rx
      - const: tx1
      - const: tx2

required:
  - compatible
  - reg
  - dmas
  - dma-names

additionalProperties: false

examples:
  - |
    crypto@40800000 {
        compatible = "ti,am62l-dthev2";
        reg = <0x40800000 0x10000>;

        dmas = <&main_bcdma 0 0 0x4700 0>,
               <&main_bcdma 0 0 0xc701 0>,
               <&main_bcdma 0 0 0xc700 0>;
        dma-names = "rx", "tx1", "tx2";
    };
```

## Documentation/devicetree/bindings/crypto/ti,omap-sham.yaml
```yaml
# SPDX-License-Identifier: (GPL-2.0-only OR BSD-2-Clause)
%YAML 1.2
---
$id: http://devicetree.org/schemas/crypto/ti,omap-sham.yaml#
$schema: http://devicetree.org/meta-schemas/core.yaml#

title: OMAP SoC SHA crypto Module

maintainers:
  - Animesh Agarwal <animeshagarwal28@gmail.com>

properties:
  compatible:
    enum:
      - ti,omap2-sham
      - ti,omap4-sham
      - ti,omap5-sham

  reg:
    maxItems: 1

  interrupts:
    maxItems: 1

  dmas:
    maxItems: 1

  dma-names:
    const: rx

  ti,hwmods:
    description: Name of the hwmod associated with the SHAM module
    $ref: /schemas/types.yaml#/definitions/string
    enum: [sham]

dependencies:
  dmas: [dma-names]

additionalProperties: false

required:
  - compatible
  - ti,hwmods
  - reg
  - interrupts

examples:
  - |
    sham@53100000 {
        compatible = "ti,omap4-sham";
        ti,hwmods = "sham";
        reg = <0x53100000 0x200>;
        interrupts = <109>;
        dmas = <&edma 36>;
        dma-names = "rx";
    };
```

## Documentation/devicetree/bindings/crypto/ti,omap2-aes.yaml
```yaml
# SPDX-License-Identifier: (GPL-2.0-only OR BSD-2-Clause)
%YAML 1.2
---
$id: http://devicetree.org/schemas/ti,omap2-aes.yaml#
$schema: http://devicetree.org/meta-schemas/core.yaml#

title: OMAP SoC AES crypto Module

maintainers:
  - Aaro Koskinen <aaro.koskinen@iki.fi>
  - Andreas Kemnade <andreas@kemnade.info>
  - Kevin Hilman <khilman@baylibre.com>
  - Roger Quadros <rogerq@kernel.org>
  - Tony Lindgren <tony@atomide.com>

properties:
  compatible:
    enum:
      - ti,omap2-aes
      - ti,omap3-aes
      - ti,omap4-aes

  reg:
    maxItems: 1

  interrupts:
    maxItems: 1

  dmas:
    maxItems: 2

  dma-names:
    items:
      - const: tx
      - const: rx

  ti,hwmods:
    description: Name of the hwmod associated with the AES module
    const: aes
    deprecated: true

required:
  - compatible
  - reg
  - interrupts

additionalProperties: false

examples:
  - |
    aes@53500000 {
        compatible = "ti,omap4-aes";
        reg = <0x53500000 0xa0>;
        interrupts = <102>;
        dmas = <&edma 6>,
               <&edma 5>;
        dma-names = "tx", "rx";
    };
```

## Documentation/devicetree/bindings/crypto/ti,omap4-des.yaml
```yaml
# SPDX-License-Identifier: (GPL-2.0-only OR BSD-2-Clause)
%YAML 1.2
---
$id: http://devicetree.org/schemas/ti,omap4-des.yaml#
$schema: http://devicetree.org/meta-schemas/core.yaml#

title: OMAP4 DES crypto Module

maintainers:
  - Aaro Koskinen <aaro.koskinen@iki.fi>
  - Andreas Kemnade <andreas@kemnade.info>
  - Kevin Hilman <khilman@baylibre.com>
  - Roger Quadros <rogerq@kernel.org>
  - Tony Lindgren <tony@atomide.com>

properties:
  compatible:
    const: ti,omap4-des

  reg:
    maxItems: 1

  interrupts:
    maxItems: 1

  dmas:
    maxItems: 2

  dma-names:
    items:
      - const: tx
      - const: rx

  clocks:
    maxItems: 1

  clock-names:
    items:
      - const: fck

dependencies:
  dmas: [ dma-names ]

required:
  - compatible
  - reg
  - interrupts
  - clocks
  - clock-names

additionalProperties: false

examples:
  - |
    #include <dt-bindings/interrupt-controller/arm-gic.h>

    des@480a5000 {
        compatible = "ti,omap4-des";
        reg = <0x480a5000 0xa0>;
        interrupts = <GIC_SPI 82 IRQ_TYPE_LEVEL_HIGH>;
        clocks = <&l3_iclk_div>;
        clock-names = "fck";
        dmas = <&sdma 117>, <&sdma 116>;
        dma-names = "tx", "rx";
    };
```

## Documentation/devicetree/bindings/crypto/ti,sa2ul.yaml
```yaml
# SPDX-License-Identifier: (GPL-2.0-only or BSD-2-Clause)
%YAML 1.2
---
$id: http://devicetree.org/schemas/crypto/ti,sa2ul.yaml#
$schema: http://devicetree.org/meta-schemas/core.yaml#

title: K3 SoC SA2UL crypto module

maintainers:
  - Tero Kristo <t-kristo@ti.com>

properties:
  compatible:
    enum:
      - ti,j721e-sa2ul
      - ti,am654-sa2ul
      - ti,am64-sa2ul
      - ti,am62-sa3ul

  reg:
    maxItems: 1

  power-domains:
    maxItems: 1

  dmas:
    items:
      - description: TX DMA Channel
      - description: RX DMA Channel #1
      - description: RX DMA Channel #2

  dma-names:
    items:
      - const: tx
      - const: rx1
      - const: rx2

  dma-coherent: true

  "#address-cells":
    const: 2

  "#size-cells":
    const: 2

  ranges:
    description:
      Address translation for the possible RNG child node for SA2UL

  clocks:
    items:
      - description: Clock used by PKA
      - description: Main Input Clock
      - description: Clock used by rng

  clock-names:
    items:
      - const: pka_in_clk
      - const: x1_clk
      - const: x2_clk

patternProperties:
  "^rng@[a-f0-9]+$":
    type: object
    description:
      Child RNG node for SA2UL

required:
  - compatible
  - reg
  - power-domains
  - dmas
  - dma-names

if:
  properties:
    compatible:
      enum:
        - ti,j721e-sa2ul
        - ti,am654-sa2ul
then:
  required:
    - dma-coherent

additionalProperties: false

examples:
  - |
    #include <dt-bindings/soc/ti,sci_pm_domain.h>

    main_crypto: crypto@4e00000 {
        compatible = "ti,j721e-sa2ul";
        reg = <0x4e00000 0x1200>;
        power-domains = <&k3_pds 264 TI_SCI_PD_EXCLUSIVE>;
        dmas = <&main_udmap 0xc000>, <&main_udmap 0x4000>,
               <&main_udmap 0x4001>;
        dma-names = "tx", "rx1", "rx2";
        dma-coherent;
    };
```
