## Documentation/devicetree/bindings/crypto/qcom-qce.yaml
```yaml
# SPDX-License-Identifier: (GPL-2.0-only OR BSD-2-Clause)
%YAML 1.2
---
$id: http://devicetree.org/schemas/crypto/qcom-qce.yaml#
$schema: http://devicetree.org/meta-schemas/core.yaml#

title: Qualcomm crypto engine driver

maintainers:
  - Bjorn Andersson <andersson@kernel.org>
  - Konrad Dybcio <konradybcio@kernel.org>

description:
  This document defines the binding for the QCE crypto
  controller found on Qualcomm parts.

properties:
  compatible:
    oneOf:
      - const: qcom,crypto-v5.1
        deprecated: true
        description: Kept only for ABI backward compatibility

      - const: qcom,crypto-v5.4
        deprecated: true
        description: Kept only for ABI backward compatibility

      - items:
          - enum:
              - qcom,ipq4019-qce
              - qcom,sm8150-qce
          - const: qcom,qce

      - items:
          - enum:
              - qcom,ipq6018-qce
              - qcom,ipq8074-qce
              - qcom,ipq9574-qce
              - qcom,msm8996-qce
              - qcom,qcm2290-qce
              - qcom,sdm845-qce
              - qcom,sm6115-qce
          - const: qcom,ipq4019-qce
          - const: qcom,qce

      - items:
          - enum:
              - qcom,qcs615-qce
              - qcom,qcs8300-qce
              - qcom,sa8775p-qce
              - qcom,sc7280-qce
              - qcom,sm6350-qce
              - qcom,sm8250-qce
              - qcom,sm8350-qce
              - qcom,sm8450-qce
              - qcom,sm8550-qce
              - qcom,sm8650-qce
              - qcom,sm8750-qce
              - qcom,x1e80100-qce
          - const: qcom,sm8150-qce
          - const: qcom,qce

  reg:
    maxItems: 1

  clocks:
    minItems: 1
    maxItems: 3

  clock-names:
    minItems: 1
    maxItems: 3

  iommus:
    minItems: 1
    maxItems: 8
    description:
      phandle to apps_smmu node with sid mask.

  interconnects:
    maxItems: 1
    description:
      Interconnect path between qce crypto and main memory.

  interconnect-names:
    const: memory

  dmas:
    items:
      - description: DMA specifiers for rx dma channel.
      - description: DMA specifiers for tx dma channel.

  dma-names:
    items:
      - const: rx
      - const: tx

allOf:
  - if:
      properties:
        compatible:
          contains:
            enum:
              - qcom,crypto-v5.1
              - qcom,crypto-v5.4
              - qcom,ipq6018-qce
              - qcom,ipq8074-qce
              - qcom,ipq9574-qce
              - qcom,msm8996-qce
              - qcom,sdm845-qce
    then:
      properties:
        clocks:
          maxItems: 3
        clock-names:
          items:
            - const: iface
            - const: bus
            - const: core
      required:
        - clocks
        - clock-names

  - if:
      properties:
        compatible:
          contains:
            enum:
              - qcom,qcm2290-qce
              - qcom,sm6115-qce
    then:
      properties:
        clocks:
          maxItems: 1
        clock-names:
          items:
            - const: core
      required:
        - clocks
        - clock-names

  - if:
      properties:
        compatible:
          contains:
            enum:
              - qcom,sm8150-qce
    then:
      properties:
        clocks: false
        clock-names: false

required:
  - compatible
  - reg
  - dmas
  - dma-names

additionalProperties: false

examples:
  - |
    #include <dt-bindings/clock/qcom,gcc-apq8084.h>
    crypto-engine@fd45a000 {
        compatible = "qcom,ipq6018-qce", "qcom,ipq4019-qce", "qcom,qce";
        reg = <0xfd45a000 0x6000>;
        clocks = <&gcc GCC_CE2_AHB_CLK>,
                 <&gcc GCC_CE2_AXI_CLK>,
                 <&gcc GCC_CE2_CLK>;
        clock-names = "iface", "bus", "core";
        dmas = <&cryptobam 2>, <&cryptobam 3>;
        dma-names = "rx", "tx";
        iommus = <&apps_smmu 0x584 0x0011>,
                 <&apps_smmu 0x586 0x0011>,
                 <&apps_smmu 0x594 0x0011>,
                 <&apps_smmu 0x596 0x0011>;
    };
```

## Documentation/devicetree/bindings/crypto/rockchip,rk3288-crypto.yaml
```yaml
# SPDX-License-Identifier: (GPL-2.0-only OR BSD-2-Clause)
%YAML 1.2
---
$id: http://devicetree.org/schemas/crypto/rockchip,rk3288-crypto.yaml#
$schema: http://devicetree.org/meta-schemas/core.yaml#

title: Rockchip Electronics Security Accelerator

maintainers:
  - Heiko Stuebner <heiko@sntech.de>

properties:
  compatible:
    enum:
      - rockchip,rk3288-crypto
      - rockchip,rk3328-crypto
      - rockchip,rk3399-crypto

  reg:
    maxItems: 1

  interrupts:
    maxItems: 1

  clocks:
    minItems: 3
    maxItems: 4

  clock-names:
    minItems: 3
    maxItems: 4

  resets:
    minItems: 1
    maxItems: 3

  reset-names:
    minItems: 1
    maxItems: 3

allOf:
  - if:
      properties:
        compatible:
          contains:
            const: rockchip,rk3288-crypto
    then:
      properties:
        clocks:
          minItems: 4
        clock-names:
          items:
            - const: aclk
            - const: hclk
            - const: sclk
            - const: apb_pclk
        resets:
          maxItems: 1
        reset-names:
          items:
            - const: crypto-rst
  - if:
      properties:
        compatible:
          contains:
            const: rockchip,rk3328-crypto
    then:
      properties:
        clocks:
          maxItems: 3
        clock-names:
          items:
            - const: hclk_master
            - const: hclk_slave
            - const: sclk
        resets:
          maxItems: 1
        reset-names:
          items:
            - const: crypto-rst
  - if:
      properties:
        compatible:
          contains:
            const: rockchip,rk3399-crypto
    then:
      properties:
        clocks:
          maxItems: 3
        clock-names:
          items:
            - const: hclk_master
            - const: hclk_slave
            - const: sclk
        resets:
          minItems: 3
        reset-names:
          items:
            - const: master
            - const: slave
            - const: crypto-rst

required:
  - compatible
  - reg
  - interrupts
  - clocks
  - clock-names
  - resets
  - reset-names

additionalProperties: false

examples:
  - |
    #include <dt-bindings/interrupt-controller/arm-gic.h>
    #include <dt-bindings/clock/rk3288-cru.h>
    crypto@ff8a0000 {
      compatible = "rockchip,rk3288-crypto";
      reg = <0xff8a0000 0x4000>;
      interrupts = <GIC_SPI 48 IRQ_TYPE_LEVEL_HIGH>;
      clocks = <&cru ACLK_CRYPTO>, <&cru HCLK_CRYPTO>,
               <&cru SCLK_CRYPTO>, <&cru ACLK_DMAC1>;
      clock-names = "aclk", "hclk", "sclk", "apb_pclk";
      resets = <&cru SRST_CRYPTO>;
      reset-names = "crypto-rst";
    };
```

## Documentation/devicetree/bindings/crypto/rockchip-crypto.txt
```
Rockchip Electronics And Security Accelerator

Required properties:
- compatible: should be one of the following:
	- "rockchip,rk3288-crypto": for rk3288
	- "rockchip,px30-crypto": for px30
- reg: Base physical address of the engine and length of memory mapped
       region
- interrupts: Interrupt number
- clocks: Reference to the clocks about crypto
- clock-names: "aclk" used to clock data
	       "hclk" used to clock data
	       "sclk" used to clock crypto accelerator
	       "apb_pclk" used to clock dma
- resets: Must contain an entry for each entry in reset-names.
	  See ../reset/reset.txt for details.
- reset-names: Must include the name "crypto-rst".

Examples:

	crypto: cypto-controller@ff8a0000 {
		compatible = "rockchip,rk3288-crypto";
		reg = <0xff8a0000 0x4000>;
		interrupts = <GIC_SPI 48 IRQ_TYPE_LEVEL_HIGH>;
		clocks = <&cru ACLK_CRYPTO>, <&cru HCLK_CRYPTO>,
			 <&cru SCLK_CRYPTO>, <&cru ACLK_DMAC1>;
		clock-names = "aclk", "hclk", "sclk", "apb_pclk";
		resets = <&cru SRST_CRYPTO>;
		reset-names = "crypto-rst";
	};
```

## Documentation/devicetree/bindings/crypto/samsung,exynos-rng4.txt
```
Exynos Pseudo Random Number Generator

Required properties:

- compatible  : Should be "samsung,exynos4-rng".
- reg         : Specifies base physical address and size of the registers map.
- clocks      : Phandle to clock-controller plus clock-specifier pair.
- clock-names : "secss" as a clock name.

Example:

	rng@10830400 {
		compatible = "samsung,exynos4-rng";
		reg = <0x10830400 0x200>;
		clocks = <&clock CLK_SSS>;
		clock-names = "secss";
	};
```

## Documentation/devicetree/bindings/crypto/samsung-slimsss.txt
```
Samsung SoC SlimSSS (Slim Security SubSystem) module

The SlimSSS module in Exynos5433 SoC supports the following:
-- Feeder (FeedCtrl)
-- Advanced Encryption Standard (AES) with ECB,CBC,CTR,XTS and (CBC/XTS)/CTS
-- SHA-1/SHA-256 and (SHA-1/SHA-256)/HMAC

Required properties:

- compatible : Should contain entry for slimSSS version:
  - "samsung,exynos5433-slim-sss" for Exynos5433 SoC.
- reg : Offset and length of the register set for the module
- interrupts : interrupt specifiers of SlimSSS module interrupts (one feed
		control interrupt).

- clocks : list of clock phandle and specifier pairs for all clocks listed in
		clock-names property.
- clock-names : list of device clock input names; should contain "pclk" and
		"aclk" for slim-sss in Exynos5433.
```

## Documentation/devicetree/bindings/crypto/samsung-slimsss.yaml
```yaml
# SPDX-License-Identifier: GPL-2.0
%YAML 1.2
---
$id: http://devicetree.org/schemas/crypto/samsung-slimsss.yaml#
$schema: http://devicetree.org/meta-schemas/core.yaml#

title: Samsung Exynos SoC SlimSSS (Slim Security SubSystem) module

maintainers:
  - Krzysztof Kozlowski <krzk@kernel.org>

description: |+
  The SlimSSS module in Exynos5433 SoC supports the following:
  -- Feeder (FeedCtrl)
  -- Advanced Encryption Standard (AES) with ECB,CBC,CTR,XTS and (CBC/XTS)/CTS
  -- SHA-1/SHA-256 and (SHA-1/SHA-256)/HMAC

properties:
  compatible:
    items:
      - const: samsung,exynos5433-slim-sss

  reg:
    maxItems: 1

  clocks:
    maxItems: 2

  clock-names:
    items:
      - const: pclk
      - const: aclk

  interrupts:
    description: One feed control interrupt.
    maxItems: 1

required:
  - compatible
  - reg
  - clock-names
  - clocks
  - interrupts

additionalProperties: false
```

## Documentation/devicetree/bindings/crypto/samsung-sss.txt
```
Samsung SoC SSS (Security SubSystem) module

The SSS module in S5PV210 SoC supports the following:
-- Feeder (FeedCtrl)
-- Advanced Encryption Standard (AES)
-- Data Encryption Standard (DES)/3DES
-- Public Key Accelerator (PKA)
-- SHA-1/SHA-256/MD5/HMAC (SHA-1/SHA-256/MD5)/PRNG
-- PRNG: Pseudo Random Number Generator

The SSS module in Exynos4 (Exynos4210) and
Exynos5 (Exynos5420 and Exynos5250) SoCs
supports the following also:
-- ARCFOUR (ARC4)
-- True Random Number Generator (TRNG)
-- Secure Key Manager

Required properties:

- compatible : Should contain entries for this and backward compatible
  SSS versions:
  - "samsung,s5pv210-secss" for S5PV210 SoC.
  - "samsung,exynos4210-secss" for Exynos4210, Exynos4212, Exynos4412, Exynos5250,
		Exynos5260 and Exynos5420 SoCs.
- reg : Offset and length of the register set for the module
- interrupts : interrupt specifiers of SSS module interrupts (one feed
		control interrupt).

- clocks : list of clock phandle and specifier pairs for all clocks  listed in
		clock-names property.
- clock-names : list of device clock input names; should contain one entry
		"secss".
```

## Documentation/devicetree/bindings/crypto/samsung-sss.yaml
```yaml
# SPDX-License-Identifier: GPL-2.0
%YAML 1.2
---
$id: http://devicetree.org/schemas/crypto/samsung-sss.yaml#
$schema: http://devicetree.org/meta-schemas/core.yaml#

title: Samsung Exyanals SoC SSS (Security SubSystem) module

maintainers:
  - Krzysztof Kozlowski <krzk@kernel.org>

description: |+
  The SSS module in S5PV210 SoC supports the following:
  -- Feeder (FeedCtrl)
  -- Advanced Encryption Standard (AES)
  -- Data Encryption Standard (DES)/3DES
  -- Public Key Accelerator (PKA)
  -- SHA-1/SHA-256/MD5/HMAC (SHA-1/SHA-256/MD5)/PRNG
  -- PRNG: Pseudo Random Number Generator

  The SSS module in Exyanals4 (Exyanals4210) and Exyanals5 (Exyanals5420 and Exyanals5250)
  SoCs supports the following also:
  -- ARCFOUR (ARC4)
  -- True Random Number Generator (TRNG)
  -- Secure Key Manager

properties:
  compatible:
    items:
      - enum:
          - samsung,s5pv210-secss           # for S5PV210
          - samsung,exyanals4210-secss        # for Exyanals4210, Exyanals4212,
                                            # Exyanals4412, Exyanals5250,
                                            # Exyanals5260 and Exyanals5420

  reg:
    maxItems: 1

  clocks:
    maxItems: 1

  clock-names:
    items:
      - const: secss

  interrupts:
    description: One feed control interrupt.
    maxItems: 1

required:
  - compatible
  - reg
  - clock-names
  - clocks
  - interrupts

additionalProperties: false
```

## Documentation/devicetree/bindings/crypto/st,stm32-crc.txt
```
* STMicroelectronics STM32 CRC

Required properties:
- compatible: Should be "st,stm32f7-crc".
- reg: The address and length of the peripheral registers space
- clocks: The input clock of the CRC instance

Optional properties: none

Example:

crc: crc@40023000 {
	compatible = "st,stm32f7-crc";
	reg = <0x40023000 0x400>;
	clocks = <&rcc 0 12>;
};
```

## Documentation/devicetree/bindings/crypto/st,stm32-crc.yaml
```yaml
# SPDX-License-Identifier: (GPL-2.0-only OR BSD-2-Clause)
%YAML 1.2
---
$id: http://devicetree.org/schemas/crypto/st,stm32-crc.yaml#
$schema: http://devicetree.org/meta-schemas/core.yaml#

title: STMicroelectronics STM32 CRC bindings

maintainers:
  - Lionel Debieve <lionel.debieve@foss.st.com>

properties:
  compatible:
    const: st,stm32f7-crc

  reg:
    maxItems: 1

  clocks:
    maxItems: 1

required:
  - compatible
  - reg
  - clocks

additionalProperties: false

examples:
  - |
    #include <dt-bindings/clock/stm32mp1-clks.h>
    crc@40023000 {
      compatible = "st,stm32f7-crc";
      reg = <0x40023000 0x400>;
      clocks = <&rcc 0 12>;
    };

...
```

## Documentation/devicetree/bindings/crypto/st,stm32-cryp.txt
```
* STMicroelectronics STM32 CRYP

Required properties:
- compatible: Should be "st,stm32f756-cryp".
- reg: The address and length of the peripheral registers space
- clocks: The input clock of the CRYP instance
- interrupts: The CRYP interrupt

Optional properties:
- resets: The input reset of the CRYP instance

Example:
crypto@50060000 {
	compatible = "st,stm32f756-cryp";
	reg = <0x50060000 0x400>;
	interrupts = <79>;
	clocks = <&rcc 0 STM32F7_AHB2_CLOCK(CRYP)>;
	resets = <&rcc STM32F7_AHB2_RESET(CRYP)>;
};
```
