## Documentation/devicetree/bindings/fuse/nvidia,tegra20-fuse.txt
```
NVIDIA Tegra20/Tegra30/Tegr114/Tegra124 fuse block.

Required properties:
- compatible : For Tegra20, must contain "nvidia,tegra20-efuse".  For Tegra30,
  must contain "nvidia,tegra30-efuse".  For Tegra114, must contain
  "nvidia,tegra114-efuse".  For Tegra124, must contain "nvidia,tegra124-efuse".
  For Tegra132 must contain "nvidia,tegra132-efuse", "nvidia,tegra124-efuse".
  For Tegra210 must contain "nvidia,tegra210-efuse". For Tegra186 must contain
  "nvidia,tegra186-efuse". For Tegra194 must contain "nvidia,tegra194-efuse".
  Details:
  nvidia,tegra20-efuse: Tegra20 requires using APB DMA to read the fuse data
	due to a hardware bug. Tegra20 also lacks certain information which is
	available in later generations such as fab code, lot code, wafer id,..
  nvidia,tegra30-efuse, nvidia,tegra114-efuse and nvidia,tegra124-efuse:
	The differences between these SoCs are the size of the efuse array,
	the location of the spare (OEM programmable) bits and the location of
	the speedo data.
- reg: Should contain 1 entry: the entry gives the physical address and length
       of the fuse registers.
- clocks: Must contain an entry for each entry in clock-names.
  See ../clocks/clock-bindings.txt for details.
- clock-names: Must include the following entries:
  - fuse
- resets: Must contain an entry for each entry in reset-names.
  See ../reset/reset.txt for details.
- reset-names: Must include the following entries:
 - fuse

Example:

	fuse@7000f800 {
		compatible = "nvidia,tegra20-efuse";
		reg = <0x7000f800 0x400>,
		      <0x70000000 0x400>;
		clocks = <&tegra_car TEGRA20_CLK_FUSE>;
		clock-names = "fuse";
		resets = <&tegra_car 39>;
		reset-names = "fuse";
	};
```

## Documentation/devicetree/bindings/fuse/nvidia,tegra20-fuse.yaml
```yaml
# SPDX-License-Identifier: (GPL-2.0-only OR BSD-2-Clause)
%YAML 1.2
---
$id: http://devicetree.org/schemas/fuse/nvidia,tegra20-fuse.yaml#
$schema: http://devicetree.org/meta-schemas/core.yaml#

title: NVIDIA Tegra FUSE block

maintainers:
  - Thierry Reding <thierry.reding@gmail.com>
  - Jon Hunter <jonathanh@nvidia.com>

properties:
  compatible:
    oneOf:
      - enum:
          - nvidia,tegra20-efuse
          - nvidia,tegra30-efuse
          - nvidia,tegra114-efuse
          - nvidia,tegra124-efuse
          - nvidia,tegra210-efuse
          - nvidia,tegra186-efuse
          - nvidia,tegra194-efuse
          - nvidia,tegra234-efuse

      - items:
          - const: nvidia,tegra132-efuse
          - const: nvidia,tegra124-efuse

  reg:
    maxItems: 1

  clocks:
    maxItems: 1

  clock-names:
    items:
      - const: fuse

  resets:
    maxItems: 1

  reset-names:
    items:
      - const: fuse

  operating-points-v2:
    $ref: "/schemas/types.yaml#/definitions/phandle"

  power-domains:
    items:
      - description: phandle to the core power domain

additionalProperties: false

required:
  - compatible
  - reg
  - clocks
  - clock-names

if:
  properties:
    compatible:
      contains:
        enum:
          - nvidia,tegra20-efuse
          - nvidia,tegra30-efuse
          - nvidia,tegra114-efuse
          - nvidia,tegra124-efuse
          - nvidia,tegra132-efuse
          - nvidia,tegra210-efuse
then:
  required:
    - resets
    - reset-names

examples:
  - |
    #include <dt-bindings/clock/tegra20-car.h>

    fuse@7000f800 {
        compatible = "nvidia,tegra20-efuse";
        reg = <0x7000f800 0x400>;
        clocks = <&tegra_car TEGRA20_CLK_FUSE>;
        clock-names = "fuse";
        resets = <&tegra_car 39>;
        reset-names = "fuse";
    };
```

## Documentation/devicetree/bindings/fuse/renesas,rcar-efuse.yaml
```yaml
# SPDX-License-Identifier: (GPL-2.0-only OR BSD-2-Clause)
%YAML 1.2
---
$id: http://devicetree.org/schemas/fuse/renesas,rcar-efuse.yaml#
$schema: http://devicetree.org/meta-schemas/core.yaml#

title: R-Car E-FUSE connected to PFC

maintainers:
  - Geert Uytterhoeven <geert+renesas@glider.be>

description:
  The E-FUSE is a type of non-volatile memory, which is accessible through the
  Pin Function Controller (PFC) on some R-Car Gen4 SoCs.

properties:
  compatible:
    enum:
      - renesas,r8a779a0-efuse # R-Car V3U
      - renesas,r8a779f0-efuse # R-Car S4-8

  reg:
    maxItems: 1
    description: PFC System Group Fuse Control and Monitor register block

  clocks:
    maxItems: 1

  power-domains:
    maxItems: 1

  resets:
    maxItems: 1

required:
  - compatible
  - reg
  - clocks
  - power-domains
  - resets

additionalProperties: false

examples:
  - |
    #include <dt-bindings/clock/r8a779a0-cpg-mssr.h>
    #include <dt-bindings/power/r8a779a0-sysc.h>

    fuse: fuse@e6078800 {
            compatible = "renesas,r8a779a0-efuse";
            reg = <0xe6078800 0x100>;
            clocks = <&cpg CPG_MOD 916>;
            power-domains = <&sysc R8A779A0_PD_ALWAYS_ON>;
            resets = <&cpg 916>;
    };
```

## Documentation/devicetree/bindings/fuse/renesas,rcar-otp.yaml
```yaml
# SPDX-License-Identifier: (GPL-2.0-only OR BSD-2-Clause)
%YAML 1.2
---
$id: http://devicetree.org/schemas/fuse/renesas,rcar-otp.yaml#
$schema: http://devicetree.org/meta-schemas/core.yaml#

title: R-Car E-FUSE connected to OTP_MEM

maintainers:
  - Geert Uytterhoeven <geert+renesas@glider.be>

description:
  The E-FUSE is a type of non-volatile memory, which is accessible through the
  One-Time Programmable Memory (OTP_MEM) module on some R-Car Gen4 SoCs.

properties:
  compatible:
    enum:
      - renesas,r8a779g0-otp # R-CarV4H
      - renesas,r8a779h0-otp # R-CarV4M

  reg:
    items:
      - description: OTP_MEM_0
      - description: OTP_MEM_1

required:
  - compatible
  - reg

additionalProperties: false

examples:
  - |
    otp: otp@e61be000 {
            compatible = "renesas,r8a779g0-otp";
            reg = <0xe61be000 0x1000>, <0xe61bf000 0x1000>;
    };
```

## Documentation/devicetree/bindings/gnss/brcm,bcm4751.yaml
```yaml
# SPDX-License-Identifier: (GPL-2.0-only OR BSD-2-Clause)
%YAML 1.2
---
$id: http://devicetree.org/schemas/gnss/brcm,bcm4751.yaml#
$schema: http://devicetree.org/meta-schemas/core.yaml#

title: Broadcom BCM4751 family GNSS Receiver

maintainers:
  - Johan Hovold <johan@kernel.org>
  - Linus Walleij <linus.walleij@linaro.org>

description:
  Broadcom GPS chips can be used over the UART or I2C bus. The UART
  bus requires CTS/RTS support. The number of the capsule is more
  elaborate than the compatibles BCM4751 may be printed
  BCM4751IFBG for example.

allOf:
  - $ref: gnss-common.yaml#

properties:
  compatible:
    enum:
      - brcm,bcm4751
      - brcm,bcm4752
      - brcm,bcm4753

  reg:
    description:
      The I2C Address, not required on UART buses.

  vdd-auxin-supply:
    description:
      Main voltage supply, pin name VDD_AUXIN, typically connected
      directly to a battery such as LiIon 3.8V battery or a 2.6V supply.

  vddio-supply:
    description:
      IO voltage supply, pin name VDDIO, typically 1.8V

  reset-gpios:
    maxItems: 1
    description: An optional active low reset line, should be flagged with
      GPIO_ACTIVE_LOW.

  enable-gpios:
    description: Enable GPIO line, connected to pins named REGPU or NSTANDBY.
      If the line is active low such as NSTANDBY, it should be tagged
      GPIO_ACTIVE_LOW.

required:
  - compatible
  - enable-gpios

unevaluatedProperties: false

examples:
  - |
    #include <dt-bindings/gpio/gpio.h>
    serial {
        gnss {
            compatible = "brcm,bcm4751";
            vdd-auxin-supply = <&vbat>;
            reset-gpios = <&gpio0 15 GPIO_ACTIVE_LOW>;
            enable-gpios = <&gpio0 16 GPIO_ACTIVE_HIGH>;
            current-speed = <38400>;
        };
    };
```

## Documentation/devicetree/bindings/gnss/gnss-common.yaml
```yaml
# SPDX-License-Identifier: (GPL-2.0-only OR BSD-2-Clause)
%YAML 1.2
---
$id: http://devicetree.org/schemas/gnss/gnss-common.yaml#
$schema: http://devicetree.org/meta-schemas/core.yaml#

title: Common Properties for Global Navigation Satellite Systems (GNSS)
  receiver devices

maintainers:
  - Johan Hovold <johan@kernel.org>

description: |
  This document defines device tree properties common to Global Navigation
  Satellite System receivers.

properties:
  $nodename:
    pattern: "^gnss(@.*)?$"

  lna-supply:
    description: A separate regulator supplying power for the Low Noise
      Amplifier (LNA). This is an amplifier connected between the GNSS
      device and the receiver antenna.

  enable-gpios:
    description: A GPIO line that will enable the GNSS receiver when
      asserted. If this line is active low, the GPIO phandle should
      consequently be tagged with the GPIO_ACTIVE_LOW flag so the operating
      system can rely on asserting the line to enable the GNSS device.
    maxItems: 1

  timepulse-gpios:
    description: When a timepulse is provided to the GNSS device using a
      GPIO line, this is used.
    maxItems: 1

  current-speed:
    description: The baudrate in bits per second of the device as it comes
      online, current active speed.
    $ref: /schemas/types.yaml#/definitions/uint32

additionalProperties: true

examples:
  - |
    #include <dt-bindings/gpio/gpio.h>
    serial {
      gnss {
        compatible = "u-blox,neo-8";
        vcc-supply = <&gnss_reg>;
        timepulse-gpios = <&gpio0 16 GPIO_ACTIVE_HIGH>;
        current-speed = <4800>;
      };
    };
```

## Documentation/devicetree/bindings/gnss/gnss.txt
```
GNSS Receiver DT binding

This documents the binding structure and common properties for GNSS receiver
devices.

A GNSS receiver node is a node named "gnss" and typically resides on a serial
bus (e.g. UART, I2C or SPI).

Please refer to the following documents for generic properties:

	Documentation/devicetree/bindings/serial/slave-device.txt
	Documentation/devicetree/bindings/spi/spi-bus.txt

Required properties:

- compatible	: A string reflecting the vendor and specific device the node
		  represents

Optional properties:
- lna-supply	: Separate supply for an LNA
- enable-gpios	: GPIO used to enable the device
- timepulse-gpios	: Time pulse GPIO

Example:

serial@1234 {
	compatible = "ns16550a";

	gnss {
		compatible = "u-blox,neo-8";

		vcc-supply = <&gnss_reg>;
		timepulse-gpios = <&gpio0 16 GPIO_ACTIVE_HIGH>;

		current-speed = <4800>;
	};
};
```

## Documentation/devicetree/bindings/gnss/mediatek.txt
```
Mediatek-based GNSS Receiver DT binding

Mediatek chipsets are used in GNSS-receiver modules produced by several
vendors and can use a UART interface.

Please see Documentation/devicetree/bindings/gnss/gnss.txt for generic
properties.

Required properties:

- compatible	: Must be

			"globaltop,pa6h"

- vcc-supply	: Main voltage regulator (pin name: VCC)

Optional properties:

- current-speed		: Default UART baud rate
- gnss-fix-gpios	: GPIO used to determine device position fix state
			  (pin name: FIX, 3D_FIX)
- reset-gpios		: GPIO used to reset the device (pin name: RESET, NRESET)
- timepulse-gpios	: Time pulse GPIO (pin name: PPS1, 1PPS)
- vbackup-supply	: Backup voltage regulator (pin name: VBAT, VBACKUP)

Example:

serial@1234 {
	compatible = "ns16550a";

	gnss {
		compatible = "globaltop,pa6h";
		vcc-supply = <&vcc_3v3>;
	};
};
```

## Documentation/devicetree/bindings/gnss/mediatek.yaml
```yaml
# SPDX-License-Identifier: GPL-2.0
%YAML 1.2
---
$id: http://devicetree.org/schemas/gnss/mediatek.yaml#
$schema: http://devicetree.org/meta-schemas/core.yaml#

title: Mediatek GNSS Receiver Device Tree Bindings

maintainers:
  - Johan Hovold <johan@kernel.org>

description:
  Mediatek chipsets are used in GNSS-receiver modules produced by several
  vendors and can use a UART interface.

allOf:
  - $ref: gnss-common.yaml#

properties:
  compatible:
    const: globaltop,pa6h

  vcc-supply:
    description:
      Main voltage regulator, pin name VCC.

  reset-gpios:
    maxItems: 1
    description: An optional reset line, with names such as RESET or NRESET.
      If the line is active low it should be flagged with GPIO_ACTIVE_LOW.

  timepulse-gpios:
    description: Comes with pin names such as PPS1 or 1PPS.

  gnss-fix-gpios:
    maxItems: 1
    description: GPIO used to determine device position fix state, pin names
      FIX or 3D_FIX.

  vbackup-supply:
    description:
      Regulator providing backup voltage, pin names such as VBAT or VBACKUP.

required:
  - compatible
  - vcc-supply

unevaluatedProperties: false

examples:
  - |
    #include <dt-bindings/gpio/gpio.h>
    serial {
        gnss {
            compatible = "globaltop,pa6h";
            vcc-supply = <&vcc_3v3>;
            reset-gpios = <&gpio 1 GPIO_ACTIVE_LOW>;
        };
    };
```

## Documentation/devicetree/bindings/gnss/sirfstar.txt
```
SiRFstar-based GNSS Receiver DT binding

SiRFstar chipsets are used in GNSS-receiver modules produced by several
vendors and can use UART, SPI or I2C interfaces.

Please see Documentation/devicetree/bindings/gnss/gnss.txt for generic
properties.

Required properties:

- compatible	: Must be one of

			"fastrax,uc430"
			"linx,r4"
			"wi2wi,w2sg0004"
			"wi2wi,w2sg0008i"
			"wi2wi,w2sg0084i"

- vcc-supply	: Main voltage regulator (pin name: 3V3_IN, VCC, VDD)

Required properties (I2C):
- reg		: I2C slave address

Required properties (SPI):
- reg		: SPI chip select address

Optional properties:

- sirf,onoff-gpios	: GPIO used to power on and off device (pin name: ON_OFF)
- sirf,wakeup-gpios	: GPIO used to determine device power state
			  (pin name: RFPWRUP, WAKEUP)
- timepulse-gpios	: Time pulse GPIO (pin name: 1PPS, TM)

Example:

serial@1234 {
	compatible = "ns16550a";

	gnss {
		compatible = "wi2wi,w2sg0084i";

		vcc-supply = <&gnss_reg>;
		sirf,onoff-gpios = <&gpio0 16 GPIO_ACTIVE_HIGH>;
		sirf,wakeup-gpios = <&gpio0 17 GPIO_ACTIVE_HIGH>;
	};
};
```

## Documentation/devicetree/bindings/gnss/sirfstar.yaml
```yaml
# SPDX-License-Identifier: GPL-2.0
%YAML 1.2
---
$id: http://devicetree.org/schemas/gnss/sirfstar.yaml#
$schema: http://devicetree.org/meta-schemas/core.yaml#

title: SiRFstar GNSS Receiver Device Tree Bindings

maintainers:
  - Johan Hovold <johan@kernel.org>

description:
  The SiRFstar GNSS receivers have incarnated over the years in different
  chips, starting from the SiRFstarIII which was a chip that was introduced in
  2004 and used in a lot of dedicated GPS devices. In 2009 SiRF was acquired
  by CSR (Cambridge Silicon Radio) and in 2012 the CSR GPS business was
  acquired by Samsung, while some products remained with CSR. In 2014 CSR
  was acquired by Qualcomm who still sell some of the SiRF products.

  SiRF chips can be used over UART, I2C or SPI buses.

allOf:
  - $ref: gnss-common.yaml#

properties:
  compatible:
    enum:
      - csr,gsd4t
      - csr,csrg05ta03-icje-r
      - fastrax,uc430
      - linx,r4
      - wi2wi,w2sg0004
      - wi2wi,w2sg0008i
      - wi2wi,w2sg0084i

  reg:
    description:
      The I2C Address, SPI chip select address. Not required on UART buses.

  vcc-supply:
    description:
      Main voltage regulator, pin names such as 3V3_IN, VCC, VDD.

  reset-gpios:
    maxItems: 1
    description: An optional active low reset line, should be flagged with
      GPIO_ACTIVE_LOW.

  sirf,onoff-gpios:
    maxItems: 1
    description: GPIO used to power on and off device, pin name ON_OFF.

  sirf,wakeup-gpios:
    maxItems: 1
    description: GPIO used to determine device power state, pin names such
      as RFPWRUP, WAKEUP.

required:
  - compatible
  - vcc-supply

unevaluatedProperties: false

examples:
  - |
    #include <dt-bindings/gpio/gpio.h>
    serial {
        gnss {
            compatible = "wi2wi,w2sg0084i";
            vcc-supply = <&gnss_vcc_reg>;
            reset-gpios = <&gpio0 15 GPIO_ACTIVE_LOW>;
            sirf,onoff-gpios = <&gpio0 16 GPIO_ACTIVE_HIGH>;
            sirf,wakeup-gpios = <&gpio0 17 GPIO_ACTIVE_HIGH>;
            current-speed = <38400>;
        };
    };
```
