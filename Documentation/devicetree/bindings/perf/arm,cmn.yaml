## Documentation/devicetree/bindings/perf/arm,cmn.yaml
```yaml
# SPDX-License-Identifier: (GPL-2.0-only OR BSD-2-Clause)
# Copyright 2020 Arm Ltd.
%YAML 1.2
---
$id: http://devicetree.org/schemas/perf/arm,cmn.yaml#
$schema: http://devicetree.org/meta-schemas/core.yaml#

title: Arm CMN (Coherent Mesh Network) Performance Monitors

maintainers:
  - Robin Murphy <robin.murphy@arm.com>

properties:
  compatible:
    const: arm,cmn-600

  reg:
    items:
      - description: Physical address of the base (PERIPHBASE) and
          size (up to 64MB) of the configuration address space.

  interrupts:
    minItems: 1
    maxItems: 4
    items:
      - description: Overflow interrupt for DTC0
      - description: Overflow interrupt for DTC1
      - description: Overflow interrupt for DTC2
      - description: Overflow interrupt for DTC3
    description: One interrupt for each DTC domain implemented must
      be specified, in order. DTC0 is always present.

  arm,root-node:
    $ref: /schemas/types.yaml#/definitions/uint32
    description: Offset from PERIPHBASE of the configuration
      discovery node (see TRM definition of ROOTNODEBASE).

required:
  - compatible
  - reg
  - interrupts
  - arm,root-node

additionalProperties: false

examples:
  - |
    #include <dt-bindings/interrupt-controller/arm-gic.h>
    #include <dt-bindings/interrupt-controller/irq.h>
    pmu@50000000 {
        compatible = "arm,cmn-600";
        reg = <0x50000000 0x4000000>;
        /* 4x2 mesh with one DTC, and CFG node at 0,1,1,0 */
        interrupts = <GIC_SPI 46 IRQ_TYPE_LEVEL_HIGH>;
        arm,root-node = <0x104000>;
    };
...
```

## Documentation/devicetree/bindings/perf/arm,coresight-pmu.yaml
```yaml
# SPDX-License-Identifier: GPL-2.0-only OR BSD-2-Clause
%YAML 1.2
---
$id: http://devicetree.org/schemas/perf/arm,coresight-pmu.yaml#
$schema: http://devicetree.org/meta-schemas/core.yaml#

title: Arm Coresight Performance Monitoring Unit Architecture

maintainers:
  - Robin Murphy <robin.murphy@arm.com>

properties:
  compatible:
    const: arm,coresight-pmu

  reg:
    items:
      - description: Register page 0
      - description: Register page 1, if the PMU implements the dual-page extension
    minItems: 1

  interrupts:
    items:
      - description: Overflow interrupt

  cpus:
    description: If the PMU is associated with a particular CPU or subset of CPUs,
      array of phandles to the appropriate CPU node(s)

  reg-io-width:
    description: Granularity at which PMU register accesses are single-copy atomic
    default: 4
    enum: [4, 8]

required:
  - compatible
  - reg

additionalProperties: false
```

## Documentation/devicetree/bindings/perf/arm,dsu-pmu.yaml
```yaml
# SPDX-License-Identifier: (GPL-2.0-only OR BSD-2-Clause)
# Copyright 2021 Arm Ltd.
%YAML 1.2
---
$id: http://devicetree.org/schemas/perf/arm,dsu-pmu.yaml#
$schema: http://devicetree.org/meta-schemas/core.yaml#

title: ARM DynamIQ Shared Unit (DSU) Performance Monitor Unit (PMU)

maintainers:
  - Suzuki K Poulose <suzuki.poulose@arm.com>
  - Robin Murphy <robin.murphy@arm.com>

description:
  ARM DynamIQ Shared Unit (DSU) integrates one or more CPU cores with a shared
  L3 memory system, control logic and external interfaces to form a multicore
  cluster. The PMU enables gathering various statistics on the operation of the
  DSU. The PMU provides independent 32-bit counters that can count any of the
  supported events, along with a 64-bit cycle counter. The PMU is accessed via
  CPU system registers and has no MMIO component.

properties:
  compatible:
    oneOf:
      - const: arm,dsu-pmu
      - items:
          - const: arm,dsu-110-pmu
          - const: arm,dsu-pmu

  interrupts:
    items:
      - description: nCLUSTERPMUIRQ interrupt

  cpus:
    $ref: /schemas/types.yaml#/definitions/phandle-array
    minItems: 1
    maxItems: 12
    items:
      maxItems: 1
    description: List of phandles for the CPUs connected to this DSU instance.

required:
  - compatible
  - interrupts
  - cpus

additionalProperties: false
```

## Documentation/devicetree/bindings/perf/arm,ni.yaml
```yaml
# SPDX-License-Identifier: GPL-2.0-only OR BSD-2-Clause
%YAML 1.2
---
$id: http://devicetree.org/schemas/perf/arm,ni.yaml#
$schema: http://devicetree.org/meta-schemas/core.yaml#

title: Arm NI (Network-on-Chip Interconnect) Performance Monitors

maintainers:
  - Robin Murphy <robin.murphy@arm.com>

properties:
  compatible:
    const: arm,ni-700

  reg:
    items:
      - description: Complete configuration register space

  interrupts:
    minItems: 1
    maxItems: 32
    description: Overflow interrupts, one per clock domain, in order of domain ID

required:
  - compatible
  - reg
  - interrupts

additionalProperties: false
```

## Documentation/devicetree/bindings/perf/arm,smmu-v3-pmcg.yaml
```yaml
# SPDX-License-Identifier: (GPL-2.0-only OR BSD-2-Clause)
%YAML 1.2
---
$id: http://devicetree.org/schemas/perf/arm,smmu-v3-pmcg.yaml#
$schema: http://devicetree.org/meta-schemas/core.yaml#

title: Arm SMMUv3 Performance Monitor Counter Group

maintainers:
  - Will Deacon <will@kernel.org>
  - Robin Murphy <robin.murphy@arm.com>

description: |
  An SMMUv3 may have several Performance Monitor Counter Group (PMCG).
  They are standalone performance monitoring units that support both
  architected and IMPLEMENTATION DEFINED event counters.

properties:
  $nodename:
    pattern: "^pmu@[0-9a-f]*"
  compatible:
    oneOf:
      - items:
          - const: arm,mmu-600-pmcg
          - const: arm,smmu-v3-pmcg
      - const: arm,smmu-v3-pmcg

  reg:
    items:
      - description: Register page 0
      - description: Register page 1, if SMMU_PMCG_CFGR.RELOC_CTRS = 1
    minItems: 1

  interrupts:
    maxItems: 1

  msi-parent: true

required:
  - compatible
  - reg

anyOf:
  - required:
      - interrupts
  - required:
      - msi-parent

additionalProperties: false

examples:
  - |
    #include <dt-bindings/interrupt-controller/arm-gic.h>
    #include <dt-bindings/interrupt-controller/irq.h>

    pmu@2b420000 {
            compatible = "arm,smmu-v3-pmcg";
            reg = <0x2b420000 0x1000>,
                  <0x2b430000 0x1000>;
            interrupts = <GIC_SPI 80 IRQ_TYPE_EDGE_RISING>;
            msi-parent = <&its 0xff0000>;
    };

    pmu@2b440000 {
            compatible = "arm,smmu-v3-pmcg";
            reg = <0x2b440000 0x1000>,
                  <0x2b450000 0x1000>;
            interrupts = <GIC_SPI 81 IRQ_TYPE_EDGE_RISING>;
            msi-parent = <&its 0xff0000>;
    };
```

## Documentation/devicetree/bindings/perf/fsl-imx-ddr.txt
```
* Freescale(NXP) IMX8 DDR performance monitor

Required properties:

- compatible: should be one of:
	"fsl,imx8-ddr-pmu"
	"fsl,imx8m-ddr-pmu"

- reg: physical address and size

- interrupts: single interrupt
	generated by the control block

Example:

	ddr-pmu@5c020000 {
		compatible = "fsl,imx8-ddr-pmu";
		reg = <0x5c020000 0x10000>;
		interrupt-parent = <&gic>;
		interrupts = <GIC_SPI 131 IRQ_TYPE_LEVEL_HIGH>;
	};
```

## Documentation/devicetree/bindings/perf/fsl-imx-ddr.yaml
```yaml
# SPDX-License-Identifier: (GPL-2.0-only OR BSD-2-Clause)
%YAML 1.2
---
$id: http://devicetree.org/schemas/perf/fsl-imx-ddr.yaml#
$schema: http://devicetree.org/meta-schemas/core.yaml#

title: Freescale(NXP) IMX8 DDR performance monitor

maintainers:
  - Frank Li <frank.li@nxp.com>

properties:
  compatible:
    oneOf:
      - enum:
          - fsl,imx8-ddr-pmu
          - fsl,imx8m-ddr-pmu
          - fsl,imx8mp-ddr-pmu
      - items:
          - enum:
              - fsl,imx8mm-ddr-pmu
              - fsl,imx8mn-ddr-pmu
              - fsl,imx8mq-ddr-pmu
              - fsl,imx8mp-ddr-pmu
          - const: fsl,imx8m-ddr-pmu

  reg:
    maxItems: 1

  interrupts:
    maxItems: 1

required:
  - compatible
  - reg
  - interrupts

additionalProperties: false

examples:
  - |
    #include <dt-bindings/interrupt-controller/arm-gic.h>

    ddr-pmu@5c020000 {
        compatible = "fsl,imx8-ddr-pmu";
        reg = <0x5c020000 0x10000>;
        interrupt-parent = <&gic>;
        interrupts = <GIC_SPI 131 IRQ_TYPE_LEVEL_HIGH>;
    };
```

## Documentation/devicetree/bindings/perf/marvell-cn10k-ddr.yaml
```yaml
# SPDX-License-Identifier: (GPL-2.0-only OR BSD-2-Clause)
%YAML 1.2
---
$id: http://devicetree.org/schemas/perf/marvell-cn10k-ddr.yaml#
$schema: http://devicetree.org/meta-schemas/core.yaml#

title: Marvell CN10K DDR performance monitor

maintainers:
  - Bharat Bhushan <bbhushan2@marvell.com>

properties:
  compatible:
    items:
      - enum:
          - marvell,cn10k-ddr-pmu

  reg:
    maxItems: 1

required:
  - compatible
  - reg

additionalProperties: false

examples:
  - |
    bus {
        #address-cells = <2>;
        #size-cells = <2>;

        pmu@87e1c0000000 {
            compatible = "marvell,cn10k-ddr-pmu";
            reg = <0x87e1 0xc0000000 0x0 0x10000>;
        };
    };
```

## Documentation/devicetree/bindings/perf/marvell-cn10k-tad.yaml
```yaml
# SPDX-License-Identifier: (GPL-2.0-only OR BSD-2-Clause)
%YAML 1.2
---
$id: http://devicetree.org/schemas/perf/marvell-cn10k-tad.yaml#
$schema: http://devicetree.org/meta-schemas/core.yaml#

title: Marvell CN10K LLC-TAD performance monitor

maintainers:
  - Bhaskara Budiredla <bbudiredla@marvell.com>

description: |
  The Tag-and-Data units (TADs) maintain coherence and contain CN10K
  shared on-chip last level cache (LLC). The tad pmu measures the
  performance of last-level cache. Each tad pmu supports up to eight
  counters.

  The DT setup comprises of number of tad blocks, the sizes of pmu
  regions, tad blocks and overall base address of the HW.

properties:
  compatible:
    const: marvell,cn10k-tad-pmu

  reg:
    maxItems: 1

  marvell,tad-cnt:
    description: specifies the number of tads on the soc
    $ref: /schemas/types.yaml#/definitions/uint32

  marvell,tad-page-size:
    description: specifies the size of each tad page
    $ref: /schemas/types.yaml#/definitions/uint32

  marvell,tad-pmu-page-size:
    description: specifies the size of page that the pmu uses
    $ref: /schemas/types.yaml#/definitions/uint32

required:
  - compatible
  - reg
  - marvell,tad-cnt
  - marvell,tad-page-size
  - marvell,tad-pmu-page-size

additionalProperties: false

examples:
  - |

    tad {
        #address-cells = <2>;
        #size-cells = <2>;

        tad_pmu@80000000 {
            compatible = "marvell,cn10k-tad-pmu";
            reg = <0x87e2 0x80000000 0x0 0x1000>;
            marvell,tad-cnt = <1>;
            marvell,tad-page-size = <0x1000>;
            marvell,tad-pmu-page-size = <0x1000>;
        };
    };
```

## Documentation/devicetree/bindings/perf/nds32v3-pmu.txt
```
* NDS32 Performance Monitor Units

NDS32 core have a PMU for counting cpu and cache events like cache misses.
The NDS32 PMU representation in the device tree should be done as under:

Required properties:

- compatible :
	"andestech,nds32v3-pmu"

- interrupts : The interrupt number for NDS32 PMU is 13.

Example:
pmu{
	compatible = "andestech,nds32v3-pmu";
	interrupts = <13>;
}
```
