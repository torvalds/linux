## Documentation/devicetree/bindings/perf/riscv,pmu.yaml
```yaml
# SPDX-License-Identifier: BSD-2-Clause
%YAML 1.2
---
$id: http://devicetree.org/schemas/perf/riscv,pmu.yaml#
$schema: http://devicetree.org/meta-schemas/core.yaml#

title: RISC-V SBI PMU events

maintainers:
  - Atish Patra <atishp@rivosinc.com>

description: |
  The SBI PMU extension allows supervisor software to configure, start and
  stop any performance counter at anytime. Thus, a user can leverage all
  capabilities of performance analysis tools, such as perf, if the SBI PMU
  extension is enabled. The following constraints apply:

    The platform must provide information about PMU event to counter mappings
    either via device tree or another way, specific to the platform.
    Without the event to counter mappings, the SBI PMU extension cannot be used.

    Platforms should provide information about the PMU event selector values
    that should be encoded in the expected value of MHPMEVENTx while configuring
    MHPMCOUNTERx for that specific event. The can either be done via device tree
    or another way, specific to the platform.
    The exact value to be written to MHPMEVENTx is completely dependent on the
    platform.

    For information on the SBI specification see the section "Performance
    Monitoring Unit Extension" of:
      https://github.com/riscv-non-isa/riscv-sbi-doc/blob/master/riscv-sbi.adoc

properties:
  compatible:
    const: riscv,pmu

  riscv,event-to-mhpmevent:
    $ref: /schemas/types.yaml#/definitions/uint32-matrix
    description:
      Represents an ONE-to-ONE mapping between a PMU event and the event
      selector value that the platform expects to be written to the MHPMEVENTx
      CSR for that event.
      The mapping is encoded in an matrix format where each element represents
      an event.
      This property shouldn't encode any raw hardware event.
    items:
      items:
        - description: event_idx, a 20-bit wide encoding of the event type and
            code. Refer to the SBI specification for a complete description of
            the event types and codes.
        - description: upper 32 bits of the event selector value for MHPMEVENTx
        - description: lower 32 bits of the event selector value for MHPMEVENTx

  riscv,event-to-mhpmcounters:
    $ref: /schemas/types.yaml#/definitions/uint32-matrix
    description:
      Represents a MANY-to-MANY mapping between a range of events and all the
      MHPMCOUNTERx in a bitmap format that can be used to monitor these range
      of events. The information is encoded in an matrix format where each
      element represents a certain range of events and corresponding counters.
      This property shouldn't encode any raw event.
    items:
      items:
        - description: first event_idx of the range of events
        - description: last event_idx of the range of events
        - description: bitmap of MHPMCOUNTERx for this event

  riscv,raw-event-to-mhpmcounters:
    $ref: /schemas/types.yaml#/definitions/uint32-matrix
    description:
      Represents an ONE-to-MANY or MANY-to-MANY mapping between the rawevent(s)
      and all the MHPMCOUNTERx in a bitmap format that can be used to monitor
      that raw event.
      The encoding of the raw events are platform specific. The information is
      encoded in a matrix format where each element represents the specific raw
      event(s).
      If a platform directly encodes each raw PMU event as a unique ID, the
      value of variant must be 0xffffffff_ffffffff.
    items:
      items:
        - description:
            upper 32 invariant bits for the range of events
        - description:
            lower 32 invariant bits for the range of events
        - description:
            upper 32 bits of the variant bit mask for the range of events
        - description:
            lower 32 bits of the variant bit mask for the range of events
        - description:
            bitmap of all MHPMCOUNTERx that can monitor the range of events

dependencies:
  "riscv,event-to-mhpmevent": [ "riscv,event-to-mhpmcounters" ]
  "riscv,event-to-mhpmcounters": [ "riscv,event-to-mhpmevent" ]

required:
  - compatible

additionalProperties: false

examples:
  - |
    pmu {
        compatible = "riscv,pmu";
        riscv,event-to-mhpmevent = <0x0000B 0x0000 0x0001>;
        riscv,event-to-mhpmcounters = <0x00001 0x00001 0x00000001>,
                                      <0x00002 0x00002 0x00000004>,
                                      <0x00003 0x0000A 0x00000ff8>,
                                      <0x10000 0x10033 0x000ff000>;
        riscv,raw-event-to-mhpmcounters =
            /* For event ID 0x0002 */
            <0x0000 0x0002 0xffffffff 0xffffffff 0x00000f8>,
            /* For event ID 0-4 */
            <0x0 0x0 0xffffffff 0xfffffff0 0x00000ff0>,
            /* For event ID 0xffffffff0000000f - 0xffffffff000000ff */
            <0xffffffff 0x0 0xffffffff 0xffffff0f 0x00000ff0>;
    };

  - |
    /*
     * For HiFive Unmatched board the encodings can be found here
     * https://sifive.cdn.prismic.io/sifive/1a82e600-1f93-4f41-b2d8-86ed8b16acba_fu740-c000-manual-v1p6.pdf
     *
     * This example also binds standard SBI PMU hardware IDs to U74 PMU event
     * codes, U74 uses a bitfield for events encoding, so several U74 events
     * can be bound to a single perf ID.
     * See SBI PMU hardware IDs in arch/riscv/include/asm/sbi.h
     */
    pmu {
          compatible = "riscv,pmu";
          riscv,event-to-mhpmevent =
              /* SBI_PMU_HW_CACHE_REFERENCES -> Instruction or Data cache/ITIM busy */
              <0x00003 0x00000000 0x1801>,
              /* SBI_PMU_HW_CACHE_MISSES -> Instruction or Data cache miss or MMIO access */
              <0x00004 0x00000000 0x0302>,
              /* SBI_PMU_HW_BRANCH_INSTRUCTIONS -> Conditional branch retired */
              <0x00005 0x00000000 0x4000>,
              /* SBI_PMU_HW_BRANCH_MISSES -> Branch or jump misprediction */
              <0x00006 0x00000000 0x6001>,
              /* L1D_READ_MISS -> Data cache miss or MMIO access */
              <0x10001 0x00000000 0x0202>,
              /* L1D_WRITE_ACCESS -> Data cache write-back */
              <0x10002 0x00000000 0x0402>,
              /* L1I_READ_ACCESS -> Instruction cache miss */
              <0x10009 0x00000000 0x0102>,
              /* LL_READ_MISS -> UTLB miss */
              <0x10011 0x00000000 0x2002>,
              /* DTLB_READ_MISS -> Data TLB miss */
              <0x10019 0x00000000 0x1002>,
              /* ITLB_READ_MISS-> Instruction TLB miss */
              <0x10021 0x00000000 0x0802>;
          riscv,event-to-mhpmcounters = <0x00003 0x00006 0x18>,
                                        <0x10001 0x10002 0x18>,
                                        <0x10009 0x10009 0x18>,
                                        <0x10011 0x10011 0x18>,
                                        <0x10019 0x10019 0x18>,
                                        <0x10021 0x10021 0x18>;
          riscv,raw-event-to-mhpmcounters = <0x0 0x0 0xffffffff 0xfc0000ff 0x18>,
                                            <0x0 0x1 0xffffffff 0xfff800ff 0x18>,
                                            <0x0 0x2 0xffffffff 0xffffe0ff 0x18>;
    };
```

## Documentation/devicetree/bindings/perf/spe-pmu.yaml
```yaml
# SPDX-License-Identifier: (GPL-2.0-only OR BSD-2-Clause)
%YAML 1.2
---
$id: http://devicetree.org/schemas/perf/spe-pmu.yaml#
$schema: http://devicetree.org/meta-schemas/core.yaml#

title: ARMv8.2 Statistical Profiling Extension (SPE) Performance Monitor Units (PMU)

maintainers:
  - Will Deacon <will@kernel.org>

description:
  ARMv8.2 introduces the optional Statistical Profiling Extension for collecting
  performance sample data using an in-memory trace buffer.

properties:
  compatible:
    const: arm,statistical-profiling-extension-v1

  interrupts:
    maxItems: 1
    description: |
      The PPI to signal SPE events. For heterogeneous systems where SPE is only
      supported on a subset of the CPUs, please consult the arm,gic-v3 binding
      for details on describing a PPI partition.

additionalProperties: false

required:
  - compatible
  - interrupts

examples:
  - |
    #include <dt-bindings/interrupt-controller/arm-gic.h>

    spe-pmu {
        compatible = "arm,statistical-profiling-extension-v1";
        interrupts = <GIC_PPI 5 IRQ_TYPE_LEVEL_HIGH>;
    };
```

## Documentation/devicetree/bindings/perf/starfive,jh8100-starlink-pmu.yaml
```yaml
# SPDX-License-Identifier: GPL-2.0-only OR BSD-2-Clause
%YAML 1.2
---
$id: http://devicetree.org/schemas/perf/starfive,jh8100-starlink-pmu.yaml#
$schema: http://devicetree.org/meta-schemas/core.yaml#

title: StarFive JH8100 StarLink PMU

maintainers:
  - Ji Sheng Teoh <jisheng.teoh@starfivetech.com>

description:
  StarFive's JH8100 StarLink PMU integrates one or more CPU cores with a
  shared L3 memory system. The PMU support overflow interrupt, up to
  16 programmable 64bit event counters, and an independent 64bit cycle
  counter. StarFive's JH8100 StarLink PMU is accessed via MMIO.

properties:
  compatible:
    const: starfive,jh8100-starlink-pmu

  reg:
    maxItems: 1

  interrupts:
    maxItems: 1

required:
  - compatible
  - reg
  - interrupts

additionalProperties: false

examples:
  - |
    soc {
        #address-cells = <2>;
        #size-cells = <2>;

        pmu@12900000 {
            compatible = "starfive,jh8100-starlink-pmu";
            reg = <0x0 0x12900000 0x0 0x10000>;
            interrupts = <34>;
        };
    };
```

## Documentation/devicetree/bindings/phy/airoha,en7581-pcie-phy.yaml
```yaml
# SPDX-License-Identifier: (GPL-2.0 OR BSD-2-Clause)
%YAML 1.2
---
$id: http://devicetree.org/schemas/phy/airoha,en7581-pcie-phy.yaml#
$schema: http://devicetree.org/meta-schemas/core.yaml#

title: Airoha EN7581 PCI-Express PHY

maintainers:
  - Lorenzo Bianconi <lorenzo@kernel.org>

description:
  The PCIe PHY supports physical layer functionality for PCIe Gen2/Gen3 port.

properties:
  compatible:
    const: airoha,en7581-pcie-phy

  reg:
    items:
      - description: PCIE analog base address
      - description: PCIE lane0 base address
      - description: PCIE lane1 base address
      - description: PCIE lane0 detection time base address
      - description: PCIE lane1 detection time base address
      - description: PCIE Rx AEQ base address

  reg-names:
    items:
      - const: csr-2l
      - const: pma0
      - const: pma1
      - const: p0-xr-dtime
      - const: p1-xr-dtime
      - const: rx-aeq

  "#phy-cells":
    const: 0

required:
  - compatible
  - reg
  - reg-names
  - "#phy-cells"

additionalProperties: false

examples:
  - |
    #include <dt-bindings/phy/phy.h>

    soc {
        #address-cells = <2>;
        #size-cells = <2>;

        phy@11e80000 {
            compatible = "airoha,en7581-pcie-phy";
            #phy-cells = <0>;
            reg = <0x0 0x1fa5a000 0x0 0xfff>,
                  <0x0 0x1fa5b000 0x0 0xfff>,
                  <0x0 0x1fa5c000 0x0 0xfff>,
                  <0x0 0x1fc10044 0x0 0x4>,
                  <0x0 0x1fc30044 0x0 0x4>,
                  <0x0 0x1fc15030 0x0 0x104>;
            reg-names = "csr-2l", "pma0", "pma1",
                        "p0-xr-dtime", "p1-xr-dtime",
                        "rx-aeq";
        };
    };
```

## Documentation/devicetree/bindings/phy/allwinner,sun50i-a64-usb-phy.yaml
```yaml
# SPDX-License-Identifier: GPL-2.0
%YAML 1.2
---
$id: http://devicetree.org/schemas/phy/allwinner,sun50i-a64-usb-phy.yaml#
$schema: http://devicetree.org/meta-schemas/core.yaml#

title: Allwinner A64 USB PHY

maintainers:
  - Chen-Yu Tsai <wens@csie.org>
  - Maxime Ripard <mripard@kernel.org>

properties:
  "#phy-cells":
    const: 1

  compatible:
    oneOf:
      - enum:
          - allwinner,sun20i-d1-usb-phy
          - allwinner,sun50i-a64-usb-phy
      - items:
          - enum:
              - allwinner,sun50i-a100-usb-phy
              - allwinner,sun55i-a523-usb-phy
          - const: allwinner,sun20i-d1-usb-phy

  reg:
    items:
      - description: PHY Control registers
      - description: PHY PMU0 registers
      - description: PHY PMU1 registers

  reg-names:
    items:
      - const: phy_ctrl
      - const: pmu0
      - const: pmu1

  clocks:
    items:
      - description: USB OTG PHY bus clock
      - description: USB Host 0 PHY bus clock

  clock-names:
    items:
      - const: usb0_phy
      - const: usb1_phy

  resets:
    items:
      - description: USB OTG reset
      - description: USB Host 1 Controller reset

  reset-names:
    items:
      - const: usb0_reset
      - const: usb1_reset

  usb0_id_det-gpios:
    maxItems: 1
    description: GPIO to the USB OTG ID pin

  usb0_vbus_det-gpios:
    maxItems: 1
    description: GPIO to the USB OTG VBUS detect pin

  usb0_vbus_power-supply:
    description: Power supply to detect the USB OTG VBUS

  usb0_vbus-supply:
    description: Regulator controlling USB OTG VBUS

  usb1_vbus-supply:
    description: Regulator controlling USB1 Host controller

required:
  - "#phy-cells"
  - compatible
  - clocks
  - clock-names
  - reg
  - reg-names
  - resets
  - reset-names

additionalProperties: false

examples:
  - |
    #include <dt-bindings/gpio/gpio.h>
    #include <dt-bindings/clock/sun50i-a64-ccu.h>
    #include <dt-bindings/reset/sun50i-a64-ccu.h>

    phy@1c19400 {
        #phy-cells = <1>;
        compatible = "allwinner,sun50i-a64-usb-phy";
        reg = <0x01c19400 0x14>,
              <0x01c1a800 0x4>,
              <0x01c1b800 0x4>;
        reg-names = "phy_ctrl",
                    "pmu0",
                    "pmu1";
        clocks = <&ccu CLK_USB_PHY0>,
                 <&ccu CLK_USB_PHY1>;
        clock-names = "usb0_phy",
                      "usb1_phy";
        resets = <&ccu RST_USB_PHY0>,
                 <&ccu RST_USB_PHY1>;
        reset-names = "usb0_reset",
                      "usb1_reset";
        usb0_id_det-gpios = <&pio 7 9 GPIO_ACTIVE_HIGH>; /* PH9 */
        usb0_vbus_power-supply = <&usb_power_supply>;
        usb0_vbus-supply = <&reg_drivevbus>;
        usb1_vbus-supply = <&reg_usb1_vbus>;
    };
```
