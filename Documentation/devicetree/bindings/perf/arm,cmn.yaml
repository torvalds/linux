## Documentation/devicetree/bindings/phy/allwinner,sun50i-h6-usb-phy.yaml
```yaml
# SPDX-License-Identifier: GPL-2.0
%YAML 1.2
---
$id: http://devicetree.org/schemas/phy/allwinner,sun50i-h6-usb-phy.yaml#
$schema: http://devicetree.org/meta-schemas/core.yaml#

title: Allwinner H6 USB PHY Device Tree Bindings

maintainers:
  - Chen-Yu Tsai <wens@csie.org>
  - Maxime Ripard <mripard@kernel.org>

properties:
  "#phy-cells":
    const: 1

  compatible:
    const: allwinner,sun50i-h6-usb-phy

  reg:
    items:
      - description: PHY Control registers
      - description: PHY PMU0 registers
      - description: PHY PMU3 registers

  reg-names:
    items:
      - const: phy_ctrl
      - const: pmu0
      - const: pmu3

  clocks:
    items:
      - description: USB OTG PHY bus clock
      - description: USB Host PHY bus clock

  clock-names:
    items:
      - const: usb0_phy
      - const: usb3_phy

  resets:
    items:
      - description: USB OTG reset
      - description: USB Host Controller reset

  reset-names:
    items:
      - const: usb0_reset
      - const: usb3_reset

  usb0_id_det-gpios:
    description: GPIO to the USB OTG ID pin

  usb0_vbus_det-gpios:
    description: GPIO to the USB OTG VBUS detect pin

  usb0_vbus_power-supply:
    description: Power supply to detect the USB OTG VBUS

  usb0_vbus-supply:
    description: Regulator controlling USB OTG VBUS

  usb3_vbus-supply:
    description: Regulator controlling USB3 Host controller

required:
  - "#phy-cells"
  - compatible
  - clocks
  - clock-names
  - reg
  - reg-names
  - resets
  - reset-names

additionalProperties: false

examples:
  - |
    #include <dt-bindings/gpio/gpio.h>
    #include <dt-bindings/clock/sun50i-h6-ccu.h>
    #include <dt-bindings/reset/sun50i-h6-ccu.h>

    phy@5100400 {
        #phy-cells = <1>;
        compatible = "allwinner,sun50i-h6-usb-phy";
        reg = <0x05100400 0x24>,
              <0x05101800 0x4>,
              <0x05311800 0x4>;
        reg-names = "phy_ctrl",
                    "pmu0",
                    "pmu3";
        clocks = <&ccu CLK_USB_PHY0>,
                 <&ccu CLK_USB_PHY3>;
        clock-names = "usb0_phy",
                      "usb3_phy";
        resets = <&ccu RST_USB_PHY0>,
                 <&ccu RST_USB_PHY3>;
        reset-names = "usb0_reset",
                      "usb3_reset";
        usb0_id_det-gpios = <&pio 2 6 GPIO_ACTIVE_HIGH>; /* PC6 */
        usb0_vbus-supply = <&reg_vcc5v>;
        usb3_vbus-supply = <&reg_vcc5v>;
    };
```

## Documentation/devicetree/bindings/phy/allwinner,sun50i-h6-usb3-phy.yaml
```yaml
# SPDX-License-Identifier: (GPL-2.0 OR BSD-2-Clause)
# Copyright 2019 Ondrej Jirman <megous@megous.com>
%YAML 1.2
---
$id: "http://devicetree.org/schemas/phy/allwinner,sun50i-h6-usb3-phy.yaml#"
$schema: "http://devicetree.org/meta-schemas/core.yaml#"

title: Allwinner H6 USB3 PHY

maintainers:
  - Ondrej Jirman <megous@megous.com>

properties:
  compatible:
    enum:
      - allwinner,sun50i-h6-usb3-phy

  reg:
    maxItems: 1

  clocks:
    maxItems: 1

  resets:
    maxItems: 1

  "#phy-cells":
    const: 0

required:
  - compatible
  - reg
  - clocks
  - resets
  - "#phy-cells"

examples:
  - |
    #include <dt-bindings/clock/sun50i-h6-ccu.h>
    #include <dt-bindings/reset/sun50i-h6-ccu.h>
    phy@5210000 {
          compatible = "allwinner,sun50i-h6-usb3-phy";
          reg = <0x5210000 0x10000>;
          clocks = <&ccu CLK_USB_PHY1>;
          resets = <&ccu RST_USB_PHY1>;
          #phy-cells = <0>;
    };
```

## Documentation/devicetree/bindings/phy/allwinner,sun5i-a13-usb-phy.yaml
```yaml
# SPDX-License-Identifier: GPL-2.0
%YAML 1.2
---
$id: http://devicetree.org/schemas/phy/allwinner,sun5i-a13-usb-phy.yaml#
$schema: http://devicetree.org/meta-schemas/core.yaml#

title: Allwinner A13 USB PHY Device Tree Bindings

maintainers:
  - Chen-Yu Tsai <wens@csie.org>
  - Maxime Ripard <mripard@kernel.org>

properties:
  "#phy-cells":
    const: 1

  compatible:
    const: allwinner,sun5i-a13-usb-phy

  reg:
    items:
      - description: PHY Control registers
      - description: PHY PMU1 registers

  reg-names:
    items:
      - const: phy_ctrl
      - const: pmu1

  clocks:
    maxItems: 1
    description: USB OTG PHY bus clock

  clock-names:
    const: usb_phy

  resets:
    items:
      - description: USB OTG reset
      - description: USB Host 1 Controller reset

  reset-names:
    items:
      - const: usb0_reset
      - const: usb1_reset

  usb0_id_det-gpios:
    maxItems: 1
    description: GPIO to the USB OTG ID pin

  usb0_vbus_det-gpios:
    maxItems: 1
    description: GPIO to the USB OTG VBUS detect pin

  usb0_vbus_power-supply:
    description: Power supply to detect the USB OTG VBUS

  usb0_vbus-supply:
    description: Regulator controlling USB OTG VBUS

  usb1_vbus-supply:
    description: Regulator controlling USB1 Host controller

required:
  - "#phy-cells"
  - compatible
  - clocks
  - clock-names
  - reg
  - reg-names
  - resets
  - reset-names

additionalProperties: false

examples:
  - |
    #include <dt-bindings/gpio/gpio.h>
    #include <dt-bindings/clock/sun5i-ccu.h>
    #include <dt-bindings/reset/sun5i-ccu.h>

    phy@1c13400 {
        #phy-cells = <1>;
        compatible = "allwinner,sun5i-a13-usb-phy";
        reg = <0x01c13400 0x10>, <0x01c14800 0x4>;
        reg-names = "phy_ctrl", "pmu1";
        clocks = <&ccu CLK_USB_PHY0>;
        clock-names = "usb_phy";
        resets = <&ccu RST_USB_PHY0>, <&ccu RST_USB_PHY1>;
        reset-names = "usb0_reset", "usb1_reset";
        usb0_id_det-gpios = <&pio 6 2 (GPIO_ACTIVE_HIGH | GPIO_PULL_UP)>; /* PG2 */
        usb0_vbus_det-gpios = <&pio 6 1 (GPIO_ACTIVE_HIGH | GPIO_PULL_DOWN)>; /* PG1 */
        usb0_vbus-supply = <&reg_usb0_vbus>;
        usb1_vbus-supply = <&reg_usb1_vbus>;
    };
```

## Documentation/devicetree/bindings/phy/allwinner,sun6i-a31-mipi-dphy.yaml
```yaml
# SPDX-License-Identifier: GPL-2.0
%YAML 1.2
---
$id: http://devicetree.org/schemas/phy/allwinner,sun6i-a31-mipi-dphy.yaml#
$schema: http://devicetree.org/meta-schemas/core.yaml#

title: Allwinner A31 MIPI D-PHY Controller

maintainers:
  - Chen-Yu Tsai <wens@csie.org>
  - Maxime Ripard <mripard@kernel.org>

properties:
  "#phy-cells":
    const: 0

  compatible:
    oneOf:
      - const: allwinner,sun6i-a31-mipi-dphy
      - const: allwinner,sun50i-a100-mipi-dphy
      - items:
          - const: allwinner,sun50i-a64-mipi-dphy
          - const: allwinner,sun6i-a31-mipi-dphy
      - items:
          - const: allwinner,sun20i-d1-mipi-dphy
          - const: allwinner,sun50i-a100-mipi-dphy

  reg:
    maxItems: 1

  interrupts:
    maxItems: 1

  clocks:
    items:
      - description: Bus Clock
      - description: Module Clock

  clock-names:
    items:
      - const: bus
      - const: mod

  resets:
    maxItems: 1

  allwinner,direction:
    $ref: /schemas/types.yaml#/definitions/string
    description: |
      Direction of the D-PHY:
      - "rx" for receiving (e.g. when used with MIPI CSI-2);
      - "tx" for transmitting (e.g. when used with MIPI DSI).

    enum:
      - tx
      - rx
    default: tx

required:
  - "#phy-cells"
  - compatible
  - reg
  - interrupts
  - clocks
  - clock-names
  - resets

additionalProperties: false

examples:
  - |
    #include <dt-bindings/interrupt-controller/arm-gic.h>

    dphy0: d-phy@1ca1000 {
        compatible = "allwinner,sun6i-a31-mipi-dphy";
        reg = <0x01ca1000 0x1000>;
        interrupts = <GIC_SPI 89 IRQ_TYPE_LEVEL_HIGH>;
        clocks = <&ccu 23>, <&ccu 97>;
        clock-names = "bus", "mod";
        resets = <&ccu 4>;
        #phy-cells = <0>;
    };

...
```

## Documentation/devicetree/bindings/phy/allwinner,sun6i-a31-usb-phy.yaml
```yaml
# SPDX-License-Identifier: GPL-2.0
%YAML 1.2
---
$id: http://devicetree.org/schemas/phy/allwinner,sun6i-a31-usb-phy.yaml#
$schema: http://devicetree.org/meta-schemas/core.yaml#

title: Allwinner A31 USB PHY Device Tree Bindings

maintainers:
  - Chen-Yu Tsai <wens@csie.org>
  - Maxime Ripard <mripard@kernel.org>

properties:
  "#phy-cells":
    const: 1

  compatible:
    const: allwinner,sun6i-a31-usb-phy

  reg:
    items:
      - description: PHY Control registers
      - description: PHY PMU1 registers
      - description: PHY PMU2 registers

  reg-names:
    items:
      - const: phy_ctrl
      - const: pmu1
      - const: pmu2

  clocks:
    items:
      - description: USB OTG PHY bus clock
      - description: USB Host 0 PHY bus clock
      - description: USB Host 1 PHY bus clock

  clock-names:
    items:
      - const: usb0_phy
      - const: usb1_phy
      - const: usb2_phy

  resets:
    items:
      - description: USB OTG reset
      - description: USB Host 1 Controller reset
      - description: USB Host 2 Controller reset

  reset-names:
    items:
      - const: usb0_reset
      - const: usb1_reset
      - const: usb2_reset

  usb0_id_det-gpios:
    maxItems: 1
    description: GPIO to the USB OTG ID pin

  usb0_vbus_det-gpios:
    maxItems: 1
    description: GPIO to the USB OTG VBUS detect pin

  usb0_vbus_power-supply:
    description: Power supply to detect the USB OTG VBUS

  usb0_vbus-supply:
    description: Regulator controlling USB OTG VBUS

  usb1_vbus-supply:
    description: Regulator controlling USB1 Host controller

  usb2_vbus-supply:
    description: Regulator controlling USB2 Host controller

required:
  - "#phy-cells"
  - compatible
  - clocks
  - clock-names
  - reg
  - reg-names
  - resets
  - reset-names

additionalProperties: false

examples:
  - |
    #include <dt-bindings/gpio/gpio.h>
    #include <dt-bindings/clock/sun6i-a31-ccu.h>
    #include <dt-bindings/reset/sun6i-a31-ccu.h>

    phy@1c19400 {
        #phy-cells = <1>;
        compatible = "allwinner,sun6i-a31-usb-phy";
        reg = <0x01c19400 0x10>,
              <0x01c1a800 0x4>,
              <0x01c1b800 0x4>;
        reg-names = "phy_ctrl",
                    "pmu1",
                    "pmu2";
        clocks = <&ccu CLK_USB_PHY0>,
                 <&ccu CLK_USB_PHY1>,
                 <&ccu CLK_USB_PHY2>;
        clock-names = "usb0_phy",
                      "usb1_phy",
                      "usb2_phy";
        resets = <&ccu RST_USB_PHY0>,
                 <&ccu RST_USB_PHY1>,
                 <&ccu RST_USB_PHY2>;
        reset-names = "usb0_reset",
                      "usb1_reset",
                      "usb2_reset";
        usb0_id_det-gpios = <&pio 0 15 GPIO_ACTIVE_HIGH>; /* PA15 */
        usb0_vbus_det-gpios = <&pio 0 16 GPIO_ACTIVE_HIGH>; /* PA16 */
        usb0_vbus_power-supply = <&usb_power_supply>;
        usb0_vbus-supply = <&reg_drivevbus>;
        usb1_vbus-supply = <&reg_usb1_vbus>;
        usb2_vbus-supply = <&reg_usb2_vbus>;
    };
```

## Documentation/devicetree/bindings/phy/allwinner,sun8i-a23-usb-phy.yaml
```yaml
# SPDX-License-Identifier: GPL-2.0
%YAML 1.2
---
$id: http://devicetree.org/schemas/phy/allwinner,sun8i-a23-usb-phy.yaml#
$schema: http://devicetree.org/meta-schemas/core.yaml#

title: Allwinner A23 USB PHY

maintainers:
  - Chen-Yu Tsai <wens@csie.org>
  - Maxime Ripard <mripard@kernel.org>

properties:
  "#phy-cells":
    const: 1

  compatible:
    enum:
      - allwinner,sun8i-a23-usb-phy
      - allwinner,sun8i-a33-usb-phy

  reg:
    items:
      - description: PHY Control registers
      - description: PHY PMU1 registers

  reg-names:
    items:
      - const: phy_ctrl
      - const: pmu1

  clocks:
    items:
      - description: USB OTG PHY bus clock
      - description: USB Host 0 PHY bus clock

  clock-names:
    items:
      - const: usb0_phy
      - const: usb1_phy

  resets:
    items:
      - description: USB OTG reset
      - description: USB Host 1 Controller reset

  reset-names:
    items:
      - const: usb0_reset
      - const: usb1_reset

  usb0_id_det-gpios:
    maxItems: 1
    description: GPIO to the USB OTG ID pin

  usb0_vbus_det-gpios:
    maxItems: 1
    description: GPIO to the USB OTG VBUS detect pin

  usb0_vbus_power-supply:
    description: Power supply to detect the USB OTG VBUS

  usb0_vbus-supply:
    description: Regulator controlling USB OTG VBUS

  usb1_vbus-supply:
    description: Regulator controlling USB1 Host controller

required:
  - "#phy-cells"
  - compatible
  - clocks
  - clock-names
  - reg
  - reg-names
  - resets
  - reset-names

additionalProperties: false

examples:
  - |
    #include <dt-bindings/gpio/gpio.h>
    #include <dt-bindings/clock/sun8i-a23-a33-ccu.h>
    #include <dt-bindings/reset/sun8i-a23-a33-ccu.h>

    phy@1c19400 {
        #phy-cells = <1>;
        compatible = "allwinner,sun8i-a23-usb-phy";
        reg = <0x01c19400 0x10>, <0x01c1a800 0x4>;
        reg-names = "phy_ctrl", "pmu1";
        clocks = <&ccu CLK_USB_PHY0>,
                 <&ccu CLK_USB_PHY1>;
        clock-names = "usb0_phy",
                      "usb1_phy";
        resets = <&ccu RST_USB_PHY0>,
                 <&ccu RST_USB_PHY1>;
        reset-names = "usb0_reset",
                      "usb1_reset";
        usb0_id_det-gpios = <&pio 1 3 GPIO_ACTIVE_HIGH>; /* PB3 */
        usb0_vbus_power-supply = <&usb_power_supply>;
        usb0_vbus-supply = <&reg_drivevbus>;
        usb1_vbus-supply = <&reg_usb1_vbus>;
    };
```
