## Documentation/devicetree/bindings/input/microchip,cap11xx.yaml
```yaml
# SPDX-License-Identifier: (GPL-2.0 OR BSD-2-Clause)
%YAML 1.2
---
$id: http://devicetree.org/schemas/input/microchip,cap11xx.yaml#
$schema: http://devicetree.org/meta-schemas/core.yaml#

title: Microchip CAP11xx based capacitive touch sensors

description: |
  The Microchip CAP1xxx Family of RightTouchTM multiple-channel capacitive
  touch controllers and LED drivers. The device communication via I2C only.

maintainers:
  - Rob Herring <robh@kernel.org>

properties:
  compatible:
    enum:
      - microchip,cap1106
      - microchip,cap1126
      - microchip,cap1188
      - microchip,cap1203
      - microchip,cap1206
      - microchip,cap1293
      - microchip,cap1298

  reg:
    maxItems: 1

  '#address-cells':
    const: 1

  '#size-cells':
    const: 0

  interrupts:
    maxItems: 1
    description: |
      Property describing the interrupt line the
      device's ALERT#/CM_IRQ# pin is connected to.
      The device only has one interrupt source.

  autorepeat:
    description: |
      Enables the Linux input system's autorepeat feature on the input device.

  linux,keycodes:
    minItems: 3
    maxItems: 8
    description: |
      Specifies an array of numeric keycode values to
      be used for the channels. If this property is
      omitted, KEY_A, KEY_B, etc are used as defaults.
      The number of entries must correspond to the number of channels.

  microchip,sensor-gain:
    $ref: /schemas/types.yaml#/definitions/uint32
    default: 1
    enum: [1, 2, 4, 8]
    description: |
      Defines the gain of the sensor circuitry. This
      effectively controls the sensitivity, as a
      smaller delta capacitance is required to
      generate the same delta count values.

  microchip,irq-active-high:
    type: boolean
    description: |
      By default the interrupt pin is active low
      open drain. This property allows using the active
      high push-pull output.

  microchip,sensitivity-delta-sense:
    $ref: /schemas/types.yaml#/definitions/uint32
    default: 32
    enum: [1, 2, 4, 8, 16, 32, 64, 128]
    description:
      Controls the sensitivity multiplier of a touch detection.
      Higher value means more sensitive settings.
      At the more sensitive settings, touches are detected for a smaller delta
      capacitance corresponding to a "lighter" touch.

  microchip,signal-guard:
    $ref: /schemas/types.yaml#/definitions/uint32-array
    minItems: 3
    maxItems: 8
    items:
      enum: [0, 1]
    description: |
      0 - off
      1 - on
      The signal guard isolates the signal from virtual grounds.
      If enabled then the behavior of the channel is changed to signal guard.
      The number of entries must correspond to the number of channels.

  microchip,input-threshold:
    $ref: /schemas/types.yaml#/definitions/uint32-array
    minItems: 3
    maxItems: 8
    items:
      minimum: 0
      maximum: 127
    description:
      Specifies the delta threshold that is used to determine if a touch has
      been detected. A higher value means a larger difference in capacitance
      is required for a touch to be registered, making the touch sensor less
      sensitive.
      The number of entries must correspond to the number of channels.

  microchip,calib-sensitivity:
    $ref: /schemas/types.yaml#/definitions/uint32-array
    minItems: 3
    maxItems: 8
    items:
      enum: [1, 2, 4]
    description: |
      Specifies an array of numeric values that controls the gain
      used by the calibration routine to enable sensor inputs
      to be more sensitive for proximity detection.
      Gain is based on touch pad capacitance range
      1 - 5-50pF
      2 - 0-25pF
      4 - 0-12.5pF
      The number of entries must correspond to the number of channels.

patternProperties:
  "^led@[0-7]$":
    type: object
    description: CAP11xx LEDs
    $ref: /schemas/leds/common.yaml#

    properties:
      reg:
        enum: [0, 1, 2, 3, 4, 5, 6, 7]

      label: true

      linux,default-trigger: true

      default-state: true

    required:
      - reg

    additionalProperties: false

allOf:
  - $ref: input.yaml
  - if:
      properties:
        compatible:
          contains:
            enum:
              - microchip,cap1106
              - microchip,cap1203
              - microchip,cap1206
              - microchip,cap1293
              - microchip,cap1298
    then:
      patternProperties:
        "^led@[0-7]$": false

  - if:
      properties:
        compatible:
          contains:
            enum:
              - microchip,cap1106
              - microchip,cap1126
              - microchip,cap1188
              - microchip,cap1203
              - microchip,cap1206
    then:
      properties:
        microchip,signal-guard: false
        microchip,calib-sensitivity: false

required:
  - compatible
  - interrupts

additionalProperties: false

examples:
  - |
    i2c {
      #address-cells = <1>;
      #size-cells = <0>;

      touch@28 {
        compatible = "microchip,cap1188";
        interrupt-parent = <&gpio1>;
        interrupts = <0 0>;
        reg = <0x28>;
        autorepeat;
        microchip,sensor-gain = <2>;
        microchip,sensitivity-delta-sense = <16>;
        microchip,input-threshold = <21>, <18>, <46>, <46>, <46>, <21>;

        linux,keycodes = <103>,	/* KEY_UP */
                         <106>,	/* KEY_RIGHT */
                         <108>,	/* KEY_DOWN */
                         <105>,	/* KEY_LEFT */
                         <109>,	/* KEY_PAGEDOWN */
                         <104>;	/* KEY_PAGEUP */

        #address-cells = <1>;
        #size-cells = <0>;

        led@0 {
                label = "cap11xx:green:usr0";
                reg = <0>;
        };

        led@1 {
                label = "cap11xx:green:usr1";
                reg = <1>;
        };

        led@2 {
                label = "cap11xx:green:alive";
                reg = <2>;
                linux,default-trigger = "heartbeat";
        };
      };
    };
```

## Documentation/devicetree/bindings/input/microchip,qt1050.txt
```
Microchip AT42QT1050 Five-channel Touch Sensor IC

The AT42QT1050 (QT1050) is a QTouchADC sensor device. The device can sense from
one to five keys, dependent on mode. The QT1050 includes all signal processing
functions necessary to provide stable sensing under a wide variety of changing
conditions, and the outputs are fully debounced.

The touchkey device node should be placed inside an I2C bus node.

Required properties:
- compatible: Must be "microchip,qt1050"
- reg: The I2C address of the device
- interrupts: The sink for the touchpad's IRQ output,
  see ../interrupt-controller/interrupts.txt

Optional properties:
- wakeup-source: touch keys can be used as a wakeup source

Each button (key) is represented as a sub-node:

Each not specified key or key with linux,code set to KEY_RESERVED gets disabled
in HW.

Subnode properties:
- linux,code: Keycode to emit.
- reg: The key number. Valid values: 0, 1, 2, 3, 4.

Optional subnode-properties:

If a optional property is missing or has a invalid value the default value is
taken.

- microchip,pre-charge-time-ns:
  Each touchpad need some time to precharge. The value depends on the mechanical
  layout.
  Valid value range: 0 - 637500; values must be a multiple of 2500;
  default is 0.
- microchip,average-samples:
  Number of data samples which are averaged for each read.
  Valid values: 1, 4, 16, 64, 256, 1024, 4096, 16384; default is 1.
- microchip,average-scaling:
  The scaling factor which is used to scale the average-samples.
  Valid values: 1, 2, 4, 8, 16, 32, 64, 128; default is 1.
- microchip,threshold:
  Number of counts to register a touch detection.
  Valid value range: 0 - 255; default is 20.

Example:
QT1050 with 3 non continuous keys, key2 and key4 are disabled.

touchkeys@41 {
	compatible = "microchip,qt1050";
	reg = <0x41>;
	interrupt-parent = <&gpio0>;
	interrupts = <17 IRQ_TYPE_EDGE_FALLING>;

	up@0 {
		reg = <0>;
		linux,code = <KEY_UP>;
		microchip,average-samples = <64>;
		microchip,average-scaling = <16>;
		microchip,pre-charge-time-ns = <10000>;
	};

	right@1 {
		reg = <1>;
		linux,code = <KEY_RIGHT>;
		microchip,average-samples = <64>;
		microchip,average-scaling = <8>;
	};

	down@3 {
		reg = <3>;
		linux,code = <KEY_DOWN>;
		microchip,average-samples = <256>;
		microchip,average-scaling = <16>;
	};
};
```

## Documentation/devicetree/bindings/input/mpr121-touchkey.txt
```
* Freescale MPR121 Controllor

Required Properties:
- compatible:		Should be "fsl,mpr121-touchkey"
- reg:			The I2C slave address of the device.
- interrupts:		The interrupt number to the cpu.
- vdd-supply:		Phandle to the Vdd power supply.
- linux,keycodes:	Specifies an array of numeric keycode values to
			be used for reporting button presses. The array can
			contain up to 12 entries.

Optional Properties:
- wakeup-source:	Use any event on keypad as wakeup event.
- autorepeat:		Enable autorepeat feature.

Example:

#include "dt-bindings/input/input.h"

	touchkey: mpr121@5a {
		compatible = "fsl,mpr121-touchkey";
		reg = <0x5a>;
		interrupt-parent = <&gpio1>;
		interrupts = <28 2>;
		autorepeat;
		vdd-supply = <&ldo4_reg>;
		linux,keycodes = <KEY_0>, <KEY_1>, <KEY_2>, <KEY_3>,
				<KEY_4> <KEY_5>, <KEY_6>, <KEY_7>,
				<KEY_8>, <KEY_9>, <KEY_A>, <KEY_B>;
	};
```

## Documentation/devicetree/bindings/input/msm-vibrator.txt
```
* Device tree bindings for the Qualcomm MSM vibrator

Required properties:

  - compatible: Should be one of
		"qcom,msm8226-vibrator"
		"qcom,msm8974-vibrator"
  - reg: the base address and length of the IO memory for the registers.
  - pinctrl-names: set to default.
  - pinctrl-0: phandles pointing to pin configuration nodes. See
               Documentation/devicetree/bindings/pinctrl/pinctrl-bindings.txt
  - clock-names: set to pwm
  - clocks: phandle of the clock. See
            Documentation/devicetree/bindings/clock/clock-bindings.txt
  - enable-gpios: GPIO that enables the vibrator.

Optional properties:

  - vcc-supply: phandle to the regulator that provides power to the sensor.

Example from a LG Nexus 5 (hammerhead) phone:

vibrator@fd8c3450 {
	reg = <0xfd8c3450 0x400>;
	compatible = "qcom,msm8974-vibrator";

	vcc-supply = <&pm8941_l19>;

	clocks = <&mmcc CAMSS_GP1_CLK>;
	clock-names = "pwm";

	enable-gpios = <&msmgpio 60 GPIO_ACTIVE_HIGH>;

	pinctrl-names = "default";
	pinctrl-0 = <&vibrator_pin>;
};
```

## Documentation/devicetree/bindings/input/mtk-pmic-keys.txt
```
MediaTek MT6397/MT6323 PMIC Keys Device Driver

There are two key functions provided by MT6397/MT6323 PMIC, pwrkey
and homekey. The key functions are defined as the subnode of the function
node provided by MT6397/MT6323 PMIC that is being defined as one kind
of Muti-Function Device (MFD)

For MT6397/MT6323 MFD bindings see:
Documentation/devicetree/bindings/mfd/mt6397.txt

Required properties:
- compatible: "mediatek,mt6397-keys" or "mediatek,mt6323-keys"
- linux,keycodes: See Documentation/devicetree/bindings/input/input.yaml

Optional Properties:
- wakeup-source: See Documentation/devicetree/bindings/power/wakeup-source.txt
- mediatek,long-press-mode: Long press key shutdown setting, 1 for
	pwrkey only, 2 for pwrkey/homekey together, others for disabled.
- power-off-time-sec: See Documentation/devicetree/bindings/input/input.yaml

Example:

	pmic: mt6397 {
		compatible = "mediatek,mt6397";

		...

		mt6397keys: mt6397keys {
			compatible = "mediatek,mt6397-keys";
			mediatek,long-press-mode = <1>;
			power-off-time-sec = <0>;

			power {
				linux,keycodes = <116>;
				wakeup-source;
			};

			home {
				linux,keycodes = <114>;
			};
		};

	};
```
