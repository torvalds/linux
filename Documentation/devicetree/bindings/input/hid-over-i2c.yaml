## Documentation/devicetree/bindings/input/iqs62x-keys.yaml
```yaml
# SPDX-License-Identifier: (GPL-2.0 OR BSD-2-Clause)
%YAML 1.2
---
$id: http://devicetree.org/schemas/input/iqs62x-keys.yaml#
$schema: http://devicetree.org/meta-schemas/core.yaml#

title: Azoteq IQS620A/621/622/624/625 Keys and Switches

maintainers:
  - Jeff LaBundy <jeff@labundy.com>

allOf:
  - $ref: input.yaml#

description: |
  The Azoteq IQS620A, IQS621, IQS622, IQS624 and IQS625 multi-function sensors
  feature a variety of self-capacitive, mutual-inductive and Hall-effect sens-
  ing capabilities that can facilitate a variety of contactless key and switch
  applications.

  These functions are collectively represented by a "keys" child node from the
  parent MFD driver. See Documentation/devicetree/bindings/mfd/iqs62x.yaml for
  further details and examples. Sensor hardware configuration (self-capacitive
  vs. mutual-inductive, etc.) is selected based on the device's firmware.

properties:
  compatible:
    enum:
      - azoteq,iqs620a-keys
      - azoteq,iqs621-keys
      - azoteq,iqs622-keys
      - azoteq,iqs624-keys
      - azoteq,iqs625-keys

  linux,keycodes:
    minItems: 1
    maxItems: 16
    description: |
      Specifies the numeric keycodes associated with each available touch or
      proximity event according to the following table. An 'x' indicates the
      event is supported for a given device. Specify 0 for unused events.

      -------------------------------------------------------------------------
      | #  | Event              | IQS620A | IQS621 | IQS622 | IQS624 | IQS625 |
      -------------------------------------------------------------------------
      | 0  | CH0 Touch          |    x    |    x   |    x   |    x   |    x   |
      |    | Antenna 1 Touch*   |    x    |        |        |        |        |
      -------------------------------------------------------------------------
      | 1  | CH0 Proximity      |    x    |    x   |    x   |    x   |    x   |
      |    | Antenna 1 Prox.*   |    x    |        |        |        |        |
      -------------------------------------------------------------------------
      | 2  | CH1 Touch          |    x    |    x   |    x   |    x   |    x   |
      |    | Ant. 1 Deep Touch* |    x    |        |        |        |        |
      -------------------------------------------------------------------------
      | 3  | CH1 Proximity      |    x    |    x   |    x   |    x   |    x   |
      -------------------------------------------------------------------------
      | 4  | CH2 Touch          |    x    |        |        |        |        |
      -------------------------------------------------------------------------
      | 5  | CH2 Proximity      |    x    |        |        |        |        |
      |    | Antenna 2 Prox.*   |    x    |        |        |        |        |
      -------------------------------------------------------------------------
      | 6  | Metal (+) Touch**  |    x    |    x   |        |        |        |
      |    | Ant. 2 Deep Touch* |    x    |        |        |        |        |
      -------------------------------------------------------------------------
      | 7  | Metal (+) Prox.**  |    x    |    x   |        |        |        |
      |    | Antenna 2 Touch*   |    x    |        |        |        |        |
      -------------------------------------------------------------------------
      | 8  | Metal (-) Touch**  |    x    |    x   |        |        |        |
      -------------------------------------------------------------------------
      | 9  | Metal (-) Prox.**  |    x    |    x   |        |        |        |
      -------------------------------------------------------------------------
      | 10 | SAR Active***      |    x    |        |    x   |        |        |
      -------------------------------------------------------------------------
      | 11 | SAR Quick Rel.***  |    x    |        |    x   |        |        |
      -------------------------------------------------------------------------
      | 12 | SAR Movement***    |    x    |        |    x   |        |        |
      -------------------------------------------------------------------------
      | 13 | SAR Filter Halt*** |    x    |        |    x   |        |        |
      -------------------------------------------------------------------------
      | 14 | Wheel Up           |         |        |        |    x   |        |
      -------------------------------------------------------------------------
      | 15 | Wheel Down         |         |        |        |    x   |        |
      -------------------------------------------------------------------------
      *   Two-channel SAR. Replaces CH0-2 plus metal touch and proximity events
          if enabled via firmware.
      **  "+" and "-" refer to the polarity of a channel's delta (LTA - counts),
          where "LTA" is defined as the channel's long-term average.
      *** One-channel SAR. Replaces CH0-2 touch and proximity events if enabled
          via firmware.

patternProperties:
  "^hall-switch-(north|south)$":
    type: object
    $ref: input.yaml#
    description:
      Represents north/south-field Hall-effect sensor touch or proximity
      events. Note that north/south-field orientation is reversed on the
      IQS620AXzCSR device due to its flip-chip package.

    properties:
      linux,code: true

      azoteq,use-prox:
        $ref: /schemas/types.yaml#/definitions/flag
        description:
          If present, specifies that Hall-effect sensor reporting should
          use the device's wide-range proximity threshold instead of its
          close-range touch threshold (default).

    required:
      - linux,code

    additionalProperties: false

if:
  properties:
    compatible:
      contains:
        enum:
          - azoteq,iqs624-keys
          - azoteq,iqs625-keys
then:
  patternProperties:
    "^hall-switch-(north|south)$": false

required:
  - compatible
  - linux,keycodes

additionalProperties: false

...
```

## Documentation/devicetree/bindings/input/keys.txt
```
General Keys Properties:

Optional properties for Keys:
- power-off-time-sec: Duration in seconds which the key should be kept
	pressed for device to power off automatically. Device with key pressed
	shutdown feature can specify this property.
- linux,keycodes: Specifies the numeric keycode values to be used for
	reporting key presses.
```

## Documentation/devicetree/bindings/input/lpc32xx-key.txt
```
NXP LPC32xx Key Scan Interface

This binding is based on the matrix-keymap binding with the following
changes:

Required Properties:
- compatible: Should be "nxp,lpc3220-key"
- reg: Physical base address of the controller and length of memory mapped
  region.
- interrupts: The interrupt number to the cpu.
- clocks: phandle to clock controller plus clock-specifier pair
- nxp,debounce-delay-ms: Debounce delay in ms
- nxp,scan-delay-ms: Repeated scan period in ms
- linux,keymap: the key-code to be reported when the key is pressed
  and released, see also
  Documentation/devicetree/bindings/input/matrix-keymap.txt

Note: keypad,num-rows and keypad,num-columns are required, and must be equal
since LPC32xx only supports square matrices

Example:

	key@40050000 {
		compatible = "nxp,lpc3220-key";
		reg = <0x40050000 0x1000>;
		clocks = <&clk LPC32XX_CLK_KEY>;
		interrupt-parent = <&sic1>;
		interrupts = <22 IRQ_TYPE_LEVEL_HIGH>;
		keypad,num-rows = <1>;
		keypad,num-columns = <1>;
		nxp,debounce-delay-ms = <3>;
		nxp,scan-delay-ms = <34>;
		linux,keymap = <0x00000002>;
	};
```

## Documentation/devicetree/bindings/input/matrix-keymap.yaml
```yaml
# SPDX-License-Identifier: (GPL-2.0-only OR BSD-2-Clause)
%YAML 1.2
---
$id: http://devicetree.org/schemas/input/matrix-keymap.yaml#
$schema: http://devicetree.org/meta-schemas/core.yaml#

title: Common key matrices binding for matrix-connected key boards

maintainers:
  - Olof Johansson <olof@lixom.net>

description: |
  A simple common binding for matrix-connected key boards. Currently targeted at
  defining the keys in the scope of linux key codes since that is a stable and
  standardized interface at this time.

  Some users of this binding might choose to specify secondary keymaps for
  cases where there is a modifier key such as a Fn key. Proposed names
  for said properties are "linux,fn-keymap" or with another descriptive
  word for the modifier other from "Fn".

properties:
  linux,keymap:
    $ref: '/schemas/types.yaml#/definitions/uint32-array'
    description: |
      An array of packed 1-cell entries containing the equivalent of row,
      column and linux key-code. The 32-bit big endian cell is packed as:
          row << 24 | column << 16 | key-code

  keypad,num-rows:
    $ref: /schemas/types.yaml#/definitions/uint32
    description: Number of row lines connected to the keypad controller.

  keypad,num-columns:
    $ref: /schemas/types.yaml#/definitions/uint32
    description: Number of column lines connected to the keypad controller.

additionalProperties: true

examples:
  - |
    keypad {
        /* ... */
        linux,keymap = < 0x00030012
                         0x0102003a >;
        keypad,num-rows = <2>;
        keypad,num-columns = <8>;
    };
```

## Documentation/devicetree/bindings/input/max77650-onkey.txt
```
Onkey driver for MAX77650 PMIC from Maxim Integrated.

This module is part of the MAX77650 MFD device. For more details
see Documentation/devicetree/bindings/mfd/max77650.txt.

The onkey controller is represented as a sub-node of the PMIC node on
the device tree.

Required properties:
--------------------
- compatible:		Must be "maxim,max77650-onkey".

Optional properties:
- linux,code:		The key-code to be reported when the key is pressed.
			Defaults to KEY_POWER.
- maxim,onkey-slide:	The system's button is a slide switch, not the default
			push button.

Example:
--------

	onkey {
		compatible = "maxim,max77650-onkey";
		linux,code = <KEY_END>;
		maxim,onkey-slide;
	};
```

## Documentation/devicetree/bindings/input/max77650-onkey.yaml
```yaml
# SPDX-License-Identifier: GPL-2.0
%YAML 1.2
---
$id: http://devicetree.org/schemas/input/max77650-onkey.yaml#
$schema: http://devicetree.org/meta-schemas/core.yaml#

title: Onkey driver for MAX77650 PMIC from Maxim Integrated.

maintainers:
  - Bartosz Golaszewski <bgolaszewski@baylibre.com>

description: |
  This module is part of the MAX77650 MFD device. For more details
  see Documentation/devicetree/bindings/mfd/max77650.yaml.

  The onkey controller is represented as a sub-node of the PMIC node on
  the device tree.

allOf:
  - $ref: input.yaml#

properties:
  compatible:
    const: maxim,max77650-onkey

  linux,code:
    default: 116  # KEY_POWER

  maxim,onkey-slide:
    $ref: /schemas/types.yaml#/definitions/flag
    description:
      The system's button is a slide switch, not the default push button.

required:
  - compatible
additionalProperties: false

...
```

## Documentation/devicetree/bindings/input/mediatek,mt6779-keypad.yaml
```yaml
# SPDX-License-Identifier: (GPL-2.0 OR BSD-2-Clause)
%YAML 1.2
---
$id: http://devicetree.org/schemas/input/mediatek,mt6779-keypad.yaml#
$schema: http://devicetree.org/meta-schemas/core.yaml#

title: Mediatek's Keypad Controller

maintainers:
  - Mattijs Korpershoek <mkorpershoek@baylibre.com>

allOf:
  - $ref: "/schemas/input/matrix-keymap.yaml#"

description: |
  Mediatek's Keypad controller is used to interface a SoC with a matrix-type
  keypad device. The keypad controller supports multiple row and column lines.
  A key can be placed at each intersection of a unique row and a unique column.
  The keypad controller can sense a key-press and key-release and report the
  event using a interrupt to the cpu.

properties:
  compatible:
    oneOf:
      - const: mediatek,mt6779-keypad
      - items:
          - enum:
              - mediatek,mt6873-keypad
          - const: mediatek,mt6779-keypad

  reg:
    maxItems: 1

  interrupts:
    maxItems: 1

  clocks:
    maxItems: 1

  clock-names:
    items:
      - const: kpd

  wakeup-source:
    description: use any event on keypad as wakeup event
    type: boolean

  debounce-delay-ms:
    maximum: 256
    default: 16

  mediatek,keys-per-group:
    description: each (row, column) group has multiple keys
    $ref: /schemas/types.yaml#/definitions/uint32
    default: 1
    maximum: 2

required:
  - compatible
  - reg
  - interrupts
  - clocks
  - clock-names

unevaluatedProperties: false

examples:
  - |
    #include <dt-bindings/input/input.h>
    #include <dt-bindings/interrupt-controller/arm-gic.h>

    soc {
        #address-cells = <2>;
        #size-cells = <2>;

        keyboard@10010000 {
          compatible = "mediatek,mt6779-keypad";
          reg = <0 0x10010000 0 0x1000>;
          interrupts = <GIC_SPI 75 IRQ_TYPE_EDGE_FALLING>;
          clocks = <&clk26m>;
          clock-names = "kpd";
        };
    };
```

## Documentation/devicetree/bindings/input/mediatek,pmic-keys.yaml
```yaml
# SPDX-License-Identifier: (GPL-2.0 OR BSD-2-Clause)
%YAML 1.2
---
$id: http://devicetree.org/schemas/input/mediatek,pmic-keys.yaml#
$schema: http://devicetree.org/meta-schemas/core.yaml#

title: MediaTek PMIC Keys

maintainers:
  - Chen Zhong <chen.zhong@mediatek.com>

allOf:
  - $ref: input.yaml#

description: |
  There are two key functions provided by MT6397, MT6323 and other MediaTek
  PMICs: pwrkey and homekey.
  The key functions are defined as the subnode of the function node provided
  by the PMIC that is defined as a Multi-Function Device (MFD).

  For MediaTek MT6323/MT6397 PMIC bindings see
  Documentation/devicetree/bindings/mfd/mediatek,mt6397.yaml

properties:
  compatible:
    enum:
      - mediatek,mt6323-keys
      - mediatek,mt6328-keys
      - mediatek,mt6331-keys
      - mediatek,mt6357-keys
      - mediatek,mt6358-keys
      - mediatek,mt6359-keys
      - mediatek,mt6397-keys

  power-off-time-sec: true

  mediatek,long-press-mode:
    description: |
      Key long-press force shutdown setting
      0 - disabled
      1 - pwrkey
      2 - pwrkey+homekey
    $ref: /schemas/types.yaml#/definitions/uint32
    default: 0
    maximum: 2

patternProperties:
  "^((power|home)|(key-[a-z0-9-]+|[a-z0-9-]+-key))$":
    $ref: input.yaml#

    properties:
      interrupts:
        minItems: 1
        items:
          - description: Key press interrupt
          - description: Key release interrupt

      interrupt-names: true

      linux,keycodes:
        maxItems: 1

      wakeup-source: true

    required:
      - linux,keycodes

    if:
      properties:
        interrupt-names:
          contains:
            const: powerkey
    then:
      properties:
        interrupt-names:
          minItems: 1
          items:
            - const: powerkey
            - const: powerkey_r
    else:
      properties:
        interrupt-names:
          minItems: 1
          items:
            - const: homekey
            - const: homekey_r

    unevaluatedProperties: false

required:
  - compatible

unevaluatedProperties: false

...
```
