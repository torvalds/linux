## Documentation/devicetree/bindings/input/hid-over-i2c.yaml
```yaml
# SPDX-License-Identifier: GPL-2.0-only
%YAML 1.2
---
$id: http://devicetree.org/schemas/input/hid-over-i2c.yaml#
$schema: http://devicetree.org/meta-schemas/core.yaml#

title: HID over I2C Devices

maintainers:
  - Benjamin Tissoires <benjamin.tissoires@redhat.com>
  - Jiri Kosina <jkosina@suse.cz>

description: |+
  HID over I2C provides support for various Human Interface Devices over the
  I2C bus. These devices can be for example touchpads, keyboards, touch screens
  or sensors.

  The specification has been written by Microsoft and is currently available here:
  https://msdn.microsoft.com/en-us/library/windows/hardware/hh852380.aspx

  If this binding is used, the kernel module i2c-hid will handle the communication
  with the device and the generic hid core layer will handle the protocol.

allOf:
  - $ref: /schemas/input/touchscreen/touchscreen.yaml#

properties:
  compatible:
    oneOf:
      - items:
          - enum:
              - wacom,w9013
          - const: hid-over-i2c
      - description: Just "hid-over-i2c" alone is allowed, but not recommended.
        const: hid-over-i2c

  reg:
    maxItems: 1

  interrupts:
    maxItems: 1

  hid-descr-addr:
    description: HID descriptor address
    $ref: /schemas/types.yaml#/definitions/uint32

  panel: true

  post-power-on-delay-ms:
    description: Time required by the device after enabling its regulators
      or powering it on, before it is ready for communication.

  touchscreen-inverted-x: true

  touchscreen-inverted-y: true

  vdd-supply:
    description: 3.3V supply

  vddl-supply:
    description: 1.8V supply

  wakeup-source: true

required:
  - compatible
  - reg
  - interrupts

additionalProperties: false

examples:
  - |
    i2c {
        #address-cells = <1>;
        #size-cells = <0>;

        hid@2c {
            compatible = "hid-over-i2c";
            reg = <0x2c>;
            hid-descr-addr = <0x0020>;
            interrupts = <3 2>;
        };
    };
...
```

## Documentation/devicetree/bindings/input/ibm,op-panel.yaml
```yaml
# SPDX-License-Identifier: (GPL-2.0 OR BSD-2-Clause)
%YAML 1.2
---
$id: http://devicetree.org/schemas/input/ibm,op-panel.yaml#
$schema: http://devicetree.org/meta-schemas/core.yaml#

title: IBM Operation Panel

maintainers:
  - Eddie James <eajames@linux.ibm.com>

description: |
  The IBM Operation Panel provides a simple interface to control the connected
  server. It has a display and three buttons: two directional arrows and one
  'Enter' button.

properties:
  compatible:
    const: ibm,op-panel

  reg:
    maxItems: 1

required:
  - compatible
  - reg

additionalProperties: false

examples:
  - |
    #include <dt-bindings/i2c/i2c.h>
    i2c {
        #address-cells = <1>;
        #size-cells = <0>;

        ibm-op-panel@62 {
            compatible = "ibm,op-panel";
            reg = <(0x62 | I2C_OWN_SLAVE_ADDRESS)>;
        };
    };
```

## Documentation/devicetree/bindings/input/ilitek,ili2901.yaml
```yaml
# SPDX-License-Identifier: (GPL-2.0-only OR BSD-2-Clause)
%YAML 1.2
---
$id: http://devicetree.org/schemas/input/ilitek,ili2901.yaml#
$schema: http://devicetree.org/meta-schemas/core.yaml#

title: Ilitek ILI2901 touchscreen controller

maintainers:
  - Jiri Kosina <jkosina@suse.com>

description:
  Supports the Ilitek ILI2901 touchscreen controller.
  This touchscreen controller uses the i2c-hid protocol with a reset GPIO.

allOf:
  - $ref: /schemas/input/touchscreen/touchscreen.yaml#

properties:
  compatible:
    enum:
      - ilitek,ili2901

  reg:
    maxItems: 1

  interrupts:
    maxItems: 1

  panel: true

  reset-gpios:
    maxItems: 1

  vcc33-supply: true

  vccio-supply: true

required:
  - compatible
  - reg
  - interrupts
  - vcc33-supply

additionalProperties: false

examples:
  - |
    #include <dt-bindings/gpio/gpio.h>
    #include <dt-bindings/interrupt-controller/irq.h>

    i2c {
      #address-cells = <1>;
      #size-cells = <0>;

      touchscreen@41 {
        compatible = "ilitek,ili2901";
        reg = <0x41>;

        interrupt-parent = <&tlmm>;
        interrupts = <9 IRQ_TYPE_LEVEL_LOW>;

        reset-gpios = <&tlmm 8 GPIO_ACTIVE_LOW>;
        vcc33-supply = <&pp3300_ts>;
      };
    };
```

## Documentation/devicetree/bindings/input/ilitek,ili2xxx.txt
```
Ilitek ILI210x/ILI251x touchscreen controller

Required properties:
- compatible:
    ilitek,ili210x for ILI210x
    ilitek,ili251x for ILI251x

- reg: The I2C address of the device

- interrupts: The sink for the touchscreen's IRQ output
    See ../interrupt-controller/interrupts.txt

Optional properties for main touchpad device:

- reset-gpios: GPIO specifier for the touchscreen's reset pin (active low)

Example:

	touchscreen@41 {
		compatible = "ilitek,ili251x";
		reg = <0x41>;
		interrupt-parent = <&gpio4>;
		interrupts = <7 IRQ_TYPE_EDGE_FALLING>;
		reset-gpios = <&gpio5 21 GPIO_ACTIVE_LOW>;
	};
```

## Documentation/devicetree/bindings/input/ilitek,ili9882t.yaml
```yaml
# SPDX-License-Identifier: (GPL-2.0-only OR BSD-2-Clause)
%YAML 1.2
---
$id: http://devicetree.org/schemas/input/ilitek,ili9882t.yaml#
$schema: http://devicetree.org/meta-schemas/core.yaml#

title: Ilitek ili9882t touchscreen controller

maintainers:
  - Cong Yang <yangcong5@huaqin.corp-partner.google.com>

description:
  Supports the Ilitek ili9882t touchscreen controller.
  This touchscreen controller uses the i2c-hid protocol with a reset GPIO.

allOf:
  - $ref: /schemas/input/touchscreen/touchscreen.yaml#

properties:
  compatible:
    const: ilitek,ili9882t

  reg:
    const: 0x41

  interrupts:
    maxItems: 1

  panel: true

  reset-gpios:
    maxItems: 1
    description: Reset GPIO.

  vccio-supply:
    description: The 1.8V supply to the touchscreen.

required:
  - compatible
  - reg
  - interrupts
  - panel
  - vccio-supply

additionalProperties: false

examples:
  - |
    #include <dt-bindings/gpio/gpio.h>
    #include <dt-bindings/interrupt-controller/irq.h>

    i2c {
      #address-cells = <1>;
      #size-cells = <0>;

      touchscreen: touchscreen@41 {
        compatible = "ilitek,ili9882t";
        reg = <0x41>;

        interrupt-parent = <&pio>;
        interrupts = <12 IRQ_TYPE_LEVEL_LOW>;

        panel = <&panel>;
        reset-gpios = <&pio 60 GPIO_ACTIVE_LOW>;
        vccio-supply = <&mt6366_vio18_reg>;
      };
    };
```

## Documentation/devicetree/bindings/input/imagis,isa1200.yaml
```yaml
# SPDX-License-Identifier: (GPL-2.0-only OR BSD-2-Clause)
%YAML 1.2
---
$id: http://devicetree.org/schemas/input/imagis,isa1200.yaml#
$schema: http://devicetree.org/meta-schemas/core.yaml#

title: Imagis ISA1200 haptic motor driver

maintainers:
  - Svyatoslav Ryhel <clamor95@gmail.com>
  - Linus Walleij <linusw@kernel.org>

description:
  The ISA1200 is a high-performance enhanced haptic motor driver designed
  for mobile hand-held devices. It supports various voltages for both ERM
  (Eccentric Rotating Mass) and LRA (Linear Resonant Actuator) type
  actuators. Thanks to an embedded LDO, battery power can be used directly
  in handheld applications.

properties:
  compatible:
    const: imagis,isa1200

  reg:
    maxItems: 1

  control-gpios:
    description:
      One or two GPIOs flagged as active high linked to HEN and LEN pins
    minItems: 1
    maxItems: 2

  clocks:
    maxItems: 1

  pwms:
    maxItems: 1

  vdd-supply:
    description:
      Regulator for 2.4V - 5.5V power supply

  vddp-supply:
    description:
      Regulator for 2.4V - 3.6V IO power supply

  imagis,clk-div:
    $ref: /schemas/types.yaml#/definitions/uint32
    description:
      Divider for the external input clock/PWM
    enum: [128, 256, 512, 1024]
    default: 128

  imagis,pll-div:
    $ref: /schemas/types.yaml#/definitions/uint32
    description:
      Divider for the internal PLL clock
    minimum: 1
    maximum: 15
    default: 1

  imagis,mode:
    $ref: /schemas/types.yaml#/definitions/uint32
    description: |
      Defines the motor type isa1200 drives
      0 - LRA (Linear Resonant Actuator)
      1 - ERM (Eccentric Rotating Mass)
    enum: [0, 1]
    default: 0

  imagis,period-ns:
    description:
      Period of the internal PWM channel in nanoseconds.
    minimum: 10000
    maximum: 30000

  imagis,duty-cycle-ns:
    description:
      Duty cycle of the external/internal PWM channel in nanoseconds,
      defaults to 50% of the channel's period

  ldo:
    $ref: /schemas/regulator/regulator.yaml#
    type: object
    description:
      Embedded LDO regulator with voltage range 2.3V - 3.8V
    unevaluatedProperties: false

    required:
      - regulator-min-microvolt
      - regulator-max-microvolt

required:
  - compatible
  - reg
  - ldo

oneOf:
  - required:
      - clocks
      - imagis,period-ns
  - required:
      - pwms

additionalProperties: false

examples:
  - |
    #include <dt-bindings/gpio/gpio.h>

    i2c {
        #address-cells = <1>;
        #size-cells = <0>;

        haptic-engine@49 {
            compatible = "imagis,isa1200";
            reg = <0x49>;

            clocks = <&isa1200_refclk>;

            control-gpios = <&gpio 22 GPIO_ACTIVE_HIGH>,
                            <&gpio 23 GPIO_ACTIVE_HIGH>;

            vdd-supply = <&vdd_3v3_vbat>;
            vddp-supply = <&vdd_2v8_vvib>;

            imagis,clk-div = <256>;
            imagis,pll-div = <2>;

            imagis,mode = <0>; /* LRA_MODE */

            imagis,period-ns = <13400>;
            imagis,duty-cycle-ns = <100>;

            ldo {
                regulator-name = "vdd_vib";
                regulator-min-microvolt = <2300000>;
                regulator-max-microvolt = <2300000>;
            };
        };
    };
```

## Documentation/devicetree/bindings/input/imx-keypad.yaml
```yaml
# SPDX-License-Identifier: (GPL-2.0-only OR BSD-2-Clause)
%YAML 1.2
---
$id: http://devicetree.org/schemas/input/imx-keypad.yaml#
$schema: http://devicetree.org/meta-schemas/core.yaml#

title: Freescale i.MX Keypad Port(KPP)

maintainers:
  - Liu Ying <gnuiyl@gmail.com>

allOf:
  - $ref: "/schemas/input/matrix-keymap.yaml#"

description: |
  The KPP is designed to interface with a keypad matrix with 2-point contact
  or 3-point contact keys. The KPP is designed to simplify the software task
  of scanning a keypad matrix. The KPP is capable of detecting, debouncing,
  and decoding one or multiple keys pressed simultaneously on a keypad.

properties:
  compatible:
    oneOf:
      - const: fsl,imx21-kpp
      - items:
          - enum:
              - fsl,imx25-kpp
              - fsl,imx27-kpp
              - fsl,imx31-kpp
              - fsl,imx35-kpp
              - fsl,imx51-kpp
              - fsl,imx53-kpp
              - fsl,imx50-kpp
              - fsl,imx6q-kpp
              - fsl,imx6sx-kpp
              - fsl,imx6sl-kpp
              - fsl,imx6sll-kpp
              - fsl,imx6ul-kpp
              - fsl,imx7d-kpp
          - const: fsl,imx21-kpp

  reg:
    maxItems: 1

  interrupts:
    maxItems: 1

  clocks:
    maxItems: 1

required:
  - compatible
  - reg
  - interrupts
  - clocks
  - linux,keymap

unevaluatedProperties: false

examples:
  - |
    keypad@73f94000 {
        compatible = "fsl,imx51-kpp", "fsl,imx21-kpp";
        reg = <0x73f94000 0x4000>;
        interrupts = <60>;
        clocks = <&clks 0>;
        pinctrl-names = "default";
        pinctrl-0 = <&pinctrl_kpp_1>;
        linux,keymap = <0x00000067	/* KEY_UP */
                        0x0001006c	/* KEY_DOWN */
                        0x00020072	/* KEY_VOLUMEDOWN */
                        0x00030066	/* KEY_HOME */
                        0x0100006a	/* KEY_RIGHT */
                        0x01010069	/* KEY_LEFT */
                        0x0102001c	/* KEY_ENTER */
                        0x01030073	/* KEY_VOLUMEUP */
                        0x02000040	/* KEY_F6 */
                        0x02010042	/* KEY_F8 */
                        0x02020043	/* KEY_F9 */
                        0x02030044	/* KEY_F10 */
                        0x0300003b	/* KEY_F1 */
                        0x0301003c	/* KEY_F2 */
                        0x0302003d	/* KEY_F3 */
                        0x03030074>;	/* KEY_POWER */
    };
```

## Documentation/devicetree/bindings/input/input.yaml
```yaml
# SPDX-License-Identifier: (GPL-2.0 OR BSD-2-Clause)
%YAML 1.2
---
$id: http://devicetree.org/schemas/input/input.yaml#
$schema: http://devicetree.org/meta-schemas/core.yaml#

title: Input Devices Common Properties

maintainers:
  - Dmitry Torokhov <dmitry.torokhov@gmail.com>

properties:
  autorepeat:
    description: Enable autorepeat when key is pressed and held down.
    type: boolean

  linux,keycodes:
    description:
      Specifies an array of numeric keycode values to be used for reporting
      button presses.
    $ref: /schemas/types.yaml#/definitions/uint32-array
    items:
      minimum: 0
      maximum: 0x2ff

  linux,code:
    description:
      Specifies a single numeric keycode value to be used for reporting
      button/switch events. Specify KEY_RESERVED (0) to opt out of event
      reporting.
    $ref: /schemas/types.yaml#/definitions/uint32
    maximum: 0x2ff

  linux,input-type:
    $ref: /schemas/types.yaml#/definitions/uint32
    enum:
      - 1   # EV_KEY
      - 2   # EV_REL
      - 3   # EV_ABS
      - 5   # EV_SW
    description:
      Specifies whether the event is to be interpreted as a key, relative,
      absolute, or switch.

  poll-interval:
    description: Poll interval time in milliseconds.
    $ref: /schemas/types.yaml#/definitions/uint32

  power-off-time-sec:
    description:
      Duration in seconds which the key should be kept pressed for device to
      power off automatically. Device with key pressed shutdown feature can
      specify this property.

  reset-time-sec:
    description:
      Duration in seconds which the key should be kept pressed for device to
      reset automatically. Device with key pressed reset feature can specify
      this property.

dependencies:
  linux,input-type: [ "linux,code" ]

additionalProperties: true
```
