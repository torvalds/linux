## Documentation/devicetree/bindings/input/gpio-keys.yaml
```yaml
# SPDX-License-Identifier: GPL-2.0-only
%YAML 1.2
---
$id: http://devicetree.org/schemas/input/gpio-keys.yaml#
$schema: http://devicetree.org/meta-schemas/core.yaml#

title: GPIO attached keys

maintainers:
  - Rob Herring <robh@kernel.org>

properties:
  compatible:
    enum:
      - gpio-keys
      - gpio-keys-polled

  autorepeat: true

  label:
    description: Name of entire device

  poll-interval: true

patternProperties:
  "^(button|event|key|switch|(button|event|key|switch)-[a-z0-9-]+|[a-z0-9-]+-(button|event|key|switch))$":
    $ref: input.yaml#

    properties:
      gpios:
        maxItems: 1

      interrupts:
        maxItems: 1

      label:
        description: Descriptive name of the key.

      linux,code:
        description: Key / Axis code to emit.

      linux,input-type:
        default: 1  # EV_KEY

      linux,input-value:
        description: |
          If linux,input-type is EV_ABS or EV_REL then this
          value is sent for events this button generates when pressed.
          EV_ABS/EV_REL axis will generate an event with a value of 0
          when all buttons with linux,input-type == type and
          linux,code == axis are released. This value is interpreted
          as a signed 32 bit value, e.g. to make a button generate a
          value of -1 use:

          linux,input-value = <0xffffffff>; /* -1 */

        $ref: /schemas/types.yaml#/definitions/uint32

      debounce-interval:
        description:
          Debouncing interval time in milliseconds. If not specified defaults to 5.
        $ref: /schemas/types.yaml#/definitions/uint32

        default: 5

      wakeup-source:
        description: Button can wake-up the system.

      wakeup-event-action:
        description: |
          Specifies whether the key should wake the system when asserted, when
          deasserted, or both. This property is only valid for keys that wake up the
          system (e.g., when the "wakeup-source" property is also provided).

          Supported values are defined in linux-event-codes.h:

            EV_ACT_ANY        - both asserted and deasserted
            EV_ACT_ASSERTED   - asserted
            EV_ACT_DEASSERTED - deasserted
        $ref: /schemas/types.yaml#/definitions/uint32
        enum: [0, 1, 2]

      linux,can-disable:
        description:
          Indicates that button is connected to dedicated (not shared) interrupt
          which can be disabled to suppress events from the button.
        type: boolean

    required:
      - linux,code

    anyOf:
      - required:
          - interrupts
      - required:
          - interrupts-extended
      - required:
          - gpios

    dependencies:
      wakeup-event-action: [ wakeup-source ]
      linux,input-value: [ gpios ]

    unevaluatedProperties: false

allOf:
  - $ref: input.yaml#
  - if:
      properties:
        compatible:
          const: gpio-keys-polled
    then:
      required:
        - poll-interval
    else:
      properties:
        poll-interval: false

additionalProperties: false

examples:
  - |
    #include <dt-bindings/interrupt-controller/irq.h>

    gpio-keys {
        compatible = "gpio-keys";
        autorepeat;

        key-up {
            label = "GPIO Key UP";
            linux,code = <103>;
            gpios = <&gpio1 0 1>;
        };

        key-down {
            label = "GPIO Key DOWN";
            linux,code = <108>;
            interrupts = <1 IRQ_TYPE_EDGE_FALLING>;
        };
    };

...
```

## Documentation/devicetree/bindings/input/gpio-matrix-keypad.txt
```
* GPIO driven matrix keypad device tree bindings

GPIO driven matrix keypad is used to interface a SoC with a matrix keypad.
The matrix keypad supports multiple row and column lines, a key can be
placed at each intersection of a unique row and a unique column. The matrix
keypad can sense a key-press and key-release by means of GPIO lines and
report the event using GPIO interrupts to the cpu.

Required Properties:
- compatible:		Should be "gpio-matrix-keypad"
- row-gpios:		List of gpios used as row lines. The gpio specifier
			for this property depends on the gpio controller to
			which these row lines are connected.
- col-gpios:		List of gpios used as column lines. The gpio specifier
			for this property depends on the gpio controller to
			which these column lines are connected.
- linux,keymap:		The definition can be found at
			bindings/input/matrix-keymap.txt

Optional Properties:
- linux,no-autorepeat:	do no enable autorepeat feature.
- wakeup-source:	use any event on keypad as wakeup event.
- debounce-delay-ms:	debounce interval in milliseconds
- col-scan-delay-us:	delay, measured in microseconds, that is needed
			before we can scan keypad after activating column gpio

Example:
	matrix-keypad {
		compatible = "gpio-matrix-keypad";
		debounce-delay-ms = <5>;
		col-scan-delay-us = <2>;

		row-gpios = <&gpio2 25 0
			     &gpio2 26 0
			     &gpio2 27 0>;

		col-gpios = <&gpio2 21 0
			     &gpio2 22 0>;

		linux,keymap = <0x0000008B
				0x0100009E
				0x02000069
				0x0001006A
				0x0101001C
				0x0201006C>;
	};
```

## Documentation/devicetree/bindings/input/gpio-matrix-keypad.yaml
```yaml
# SPDX-License-Identifier: (GPL-2.0-only OR BSD-2-Clause)
%YAML 1.2
---

$id: http://devicetree.org/schemas/input/gpio-matrix-keypad.yaml#
$schema: http://devicetree.org/meta-schemas/core.yaml#

title: GPIO matrix keypad

maintainers:
  - Marek Vasut <marek.vasut@gmail.com>

description:
  GPIO driven matrix keypad is used to interface a SoC with a matrix keypad.
  The matrix keypad supports multiple row and column lines, a key can be
  placed at each intersection of a unique row and a unique column. The matrix
  keypad can sense a key-press and key-release by means of GPIO lines and
  report the event using GPIO interrupts to the cpu.

allOf:
  - $ref: /schemas/input/matrix-keymap.yaml#

properties:
  compatible:
    const: gpio-matrix-keypad

  row-gpios:
    description:
      List of GPIOs used as row lines. The gpio specifier for this property
      depends on the gpio controller to which these row lines are connected.

  col-gpios:
    description:
      List of GPIOs used as column lines. The gpio specifier for this property
      depends on the gpio controller to which these column lines are connected.

  linux,keymap: true

  linux,no-autorepeat:
    type: boolean
    description: Do not enable autorepeat feature.

  gpio-activelow:
    type: boolean
    description:
      Force GPIO polarity to active low.
      In the absence of this property GPIOs are treated as active high.

  debounce-delay-ms:
    description: Debounce interval in milliseconds.
    default: 0

  col-scan-delay-us:
    description:
      Delay, measured in microseconds, that is needed
      before we can scan keypad after activating column gpio.
    default: 0

  all-cols-on-delay-us:
    description:
      Delay, measured in microseconds, that is needed
      after activating all column gpios.
    default: 0

  drive-inactive-cols:
    type: boolean
    description:
      Drive inactive columns during scan,
      default is to turn inactive columns into inputs.

  wakeup-source: true

required:
  - compatible
  - row-gpios
  - col-gpios
  - linux,keymap

additionalProperties: false

examples:
  - |
    matrix-keypad {
        compatible = "gpio-matrix-keypad";
        debounce-delay-ms = <5>;
        col-scan-delay-us = <2>;

        row-gpios = <&gpio2 25 0
                     &gpio2 26 0
                     &gpio2 27 0>;

        col-gpios = <&gpio2 21 0
                     &gpio2 22 0>;

        linux,keymap = <0x0000008B
                        0x0100009E
                        0x02000069
                        0x0001006A
                        0x0101001C
                        0x0201006C>;

        wakeup-source;
    };
```

## Documentation/devicetree/bindings/input/gpio-mouse.txt
```
Device-Tree bindings for GPIO attached mice

This simply uses standard GPIO handles to define a simple mouse connected
to 5-7 GPIO lines.

Required properties:
	- compatible: must be "gpio-mouse"
	- scan-interval-ms: The scanning interval in milliseconds
	- up-gpios: GPIO line phandle to the line indicating "up"
	- down-gpios: GPIO line phandle to the line indicating "down"
	- left-gpios: GPIO line phandle to the line indicating "left"
	- right-gpios: GPIO line phandle to the line indicating "right"

Optional properties:
	- button-left-gpios: GPIO line handle to the left mouse button
	- button-middle-gpios: GPIO line handle to the middle mouse button
	- button-right-gpios: GPIO line handle to the right mouse button
Example:

#include <dt-bindings/gpio/gpio.h>

gpio-mouse {
	compatible = "gpio-mouse";
	scan-interval-ms = <50>;
	up-gpios = <&gpio0 0 GPIO_ACTIVE_LOW>;
	down-gpios = <&gpio0 1 GPIO_ACTIVE_LOW>;
	left-gpios = <&gpio0 2 GPIO_ACTIVE_LOW>;
	right-gpios = <&gpio0 3 GPIO_ACTIVE_LOW>;
	button-left-gpios = <&gpio0 4 GPIO_ACTIVE_LOW>;
	button-middle-gpios = <&gpio0 5 GPIO_ACTIVE_LOW>;
	button-right-gpios = <&gpio0 6 GPIO_ACTIVE_LOW>;
};
```

## Documentation/devicetree/bindings/input/gpio-mouse.yaml
```yaml
# SPDX-License-Identifier: (GPL-2.0-only OR BSD-2-Clause)
%YAML 1.2
---
$id: http://devicetree.org/schemas/input/gpio-mouse.yaml#
$schema: http://devicetree.org/meta-schemas/core.yaml#

title: GPIO attached mouse

description: |
  This simply uses standard GPIO handles to define a simple mouse connected
  to 5-7 GPIO lines.

maintainers:
  - Anshul Dalal <anshulusr@gmail.com>

properties:
  compatible:
    const: gpio-mouse

  scan-interval-ms:
    maxItems: 1

  up-gpios:
    maxItems: 1

  down-gpios:
    maxItems: 1

  left-gpios:
    maxItems: 1

  right-gpios:
    maxItems: 1

  button-left-gpios:
    maxItems: 1

  button-middle-gpios:
    maxItems: 1

  button-right-gpios:
    maxItems: 1

required:
  - compatible
  - scan-interval-ms
  - up-gpios
  - down-gpios
  - left-gpios
  - right-gpios

additionalProperties: false

examples:
  - |
    #include <dt-bindings/gpio/gpio.h>

    gpio-mouse {
        compatible = "gpio-mouse";
        scan-interval-ms = <50>;
        up-gpios = <&gpio0 0 GPIO_ACTIVE_LOW>;
        down-gpios = <&gpio0 1 GPIO_ACTIVE_LOW>;
        left-gpios = <&gpio0 2 GPIO_ACTIVE_LOW>;
        right-gpios = <&gpio0 3 GPIO_ACTIVE_LOW>;
        button-left-gpios = <&gpio0 4 GPIO_ACTIVE_LOW>;
        button-middle-gpios = <&gpio0 5 GPIO_ACTIVE_LOW>;
        button-right-gpios = <&gpio0 6 GPIO_ACTIVE_LOW>;
    };
```

## Documentation/devicetree/bindings/input/gpio-vibrator.yaml
```yaml
# SPDX-License-Identifier: GPL-2.0
%YAML 1.2
---
$id: http://devicetree.org/schemas/input/gpio-vibrator.yaml#
$schema: http://devicetree.org/meta-schemas/core.yaml#

title: GPIO vibrator

maintainers:
  - Luca Weiss <luca@z3ntu.xyz>

description: |+
  Registers a GPIO device as vibrator, where the on/off capability is controlled by a GPIO.

properties:
  compatible:
    const: gpio-vibrator

  enable-gpios:
    maxItems: 1

  vcc-supply:
    description: Regulator that provides power

required:
  - compatible
  - enable-gpios

additionalProperties: false

examples:
  - |
    #include <dt-bindings/gpio/gpio.h>

    vibrator {
        compatible = "gpio-vibrator";
        enable-gpios = <&msmgpio 86 GPIO_ACTIVE_HIGH>;
        vcc-supply = <&pm8941_l18>;
    };
```

## Documentation/devicetree/bindings/input/hid-over-i2c.txt
```
* HID over I2C Device-Tree bindings

HID over I2C provides support for various Human Interface Devices over the
I2C bus. These devices can be for example touchpads, keyboards, touch screens
or sensors.

The specification has been written by Microsoft and is currently available here:
http://msdn.microsoft.com/en-us/library/windows/hardware/hh852380.aspx

If this binding is used, the kernel module i2c-hid will handle the communication
with the device and the generic hid core layer will handle the protocol.

Required properties:
- compatible: must be "hid-over-i2c"
- reg: i2c slave address
- hid-descr-addr: HID descriptor address
- interrupt-parent: the phandle for the interrupt controller
- interrupts: interrupt line

Additional optional properties:

Some devices may support additional optional properties to help with, e.g.,
power sequencing. The following properties can be supported by one or more
device-specific compatible properties, which should be used in addition to the
"hid-over-i2c" string.

- compatible:
  * "wacom,w9013" (Wacom W9013 digitizer). Supports:
    - vdd-supply
    - post-power-on-delay-ms

- vdd-supply: phandle of the regulator that provides the supply voltage.
- post-power-on-delay-ms: time required by the device after enabling its regulators
  or powering it on, before it is ready for communication.

Example:

	i2c-hid-dev@2c {
		compatible = "hid-over-i2c";
		reg = <0x2c>;
		hid-descr-addr = <0x0020>;
		interrupt-parent = <&gpx3>;
		interrupts = <3 2>;
	};
```
