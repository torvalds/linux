## Documentation/devicetree/bindings/input/google,cros-ec-keyb.yaml
```yaml
# SPDX-License-Identifier: (GPL-2.0 OR BSD-2-Clause)
%YAML 1.2
---

$id: http://devicetree.org/schemas/input/google,cros-ec-keyb.yaml#
$schema: http://devicetree.org/meta-schemas/core.yaml#

title: ChromeOS EC Keyboard

maintainers:
  - Simon Glass <sjg@chromium.org>
  - Benson Leung <bleung@chromium.org>

description: |
  Google's ChromeOS EC Keyboard is a simple matrix keyboard
  implemented on a separate EC (Embedded Controller) device. It provides
  a message for reading key scans from the EC. These are then converted
  into keycodes for processing by the kernel. This device also supports
  switches/buttons like power and volume buttons.

properties:
  compatible:
    oneOf:
      - description: ChromeOS EC with only buttons/switches
        const: google,cros-ec-keyb-switches
      - description: ChromeOS EC with keyboard and possibly buttons/switches
        const: google,cros-ec-keyb

  google,needs-ghost-filter:
    description:
      Enable a ghost filter for the matrix keyboard. This is recommended
      if the EC does not have its own logic or hardware for this.
    type: boolean

  function-row-physmap:
    $ref: /schemas/types.yaml#/definitions/uint32-array
    minItems: 1
    maxItems: 15
    description: |
      An ordered u32 array describing the rows/columns (in the scan matrix)
      of top row keys from physical left (KEY_F1) to right. Each entry
      encodes the row/column as:
      (((row) & 0xFF) << 24) | (((column) & 0xFF) << 16)
      where the lower 16 bits are reserved. This property is specified only
      when the keyboard has a custom design for the top row keys.

dependencies:
  function-row-physmap: [ 'linux,keymap' ]
  google,needs-ghost-filter: [ 'linux,keymap' ]

required:
  - compatible

if:
  properties:
    compatible:
      contains:
        const: google,cros-ec-keyb
then:
  $ref: /schemas/input/matrix-keymap.yaml#
  required:
    - keypad,num-rows
    - keypad,num-columns
    - linux,keymap

unevaluatedProperties: false

examples:
  - |
    #include <dt-bindings/input/input.h>
    keyboard-controller {
        compatible = "google,cros-ec-keyb";
        keypad,num-rows = <8>;
        keypad,num-columns = <13>;
        google,needs-ghost-filter;
        function-row-physmap = <
            MATRIX_KEY(0x00, 0x02, 0)   /* T1 */
            MATRIX_KEY(0x03, 0x02, 0)   /* T2 */
            MATRIX_KEY(0x02, 0x02, 0)   /* T3 */
            MATRIX_KEY(0x01, 0x02, 0)   /* T4 */
            MATRIX_KEY(0x03, 0x04, 0)   /* T5 */
            MATRIX_KEY(0x02, 0x04, 0)   /* T6 */
            MATRIX_KEY(0x01, 0x04, 0)   /* T7 */
            MATRIX_KEY(0x02, 0x09, 0)   /* T8 */
            MATRIX_KEY(0x01, 0x09, 0)   /* T9 */
            MATRIX_KEY(0x00, 0x04, 0)   /* T10 */
        >;
        /*
         * Keymap entries take the form of 0xRRCCKKKK where
         * RR=Row CC=Column KKKK=Key Code
         * The values below are for a US keyboard layout and
         * are taken from the Linux driver. Note that the
         * 102ND key is not used for US keyboards.
         */
        linux,keymap = <
            /* CAPSLCK F1         B          F10     */
            0x0001003a 0x0002003b 0x00030030 0x00040044
            /* N       =          R_ALT      ESC     */
            0x00060031 0x0008000d 0x000a0064 0x01010001
            /* F4      G          F7         H       */
            0x0102003e 0x01030022 0x01040041 0x01060023
            /* '       F9         BKSPACE    L_CTRL  */
            0x01080028 0x01090043 0x010b000e 0x0200001d
            /* TAB     F3         T          F6      */
            0x0201000f 0x0202003d 0x02030014 0x02040040
            /* ]       Y          102ND      [       */
            0x0205001b 0x02060015 0x02070056 0x0208001a
            /* F8      GRAVE      F2         5       */
            0x02090042 0x03010029 0x0302003c 0x03030006
            /* F5      6          -          \       */
            0x0304003f 0x03060007 0x0308000c 0x030b002b
            /* R_CTRL  A          D          F       */
            0x04000061 0x0401001e 0x04020020 0x04030021
            /* S       K          J          ;       */
            0x0404001f 0x04050025 0x04060024 0x04080027
            /* L       ENTER      Z          C       */
            0x04090026 0x040b001c 0x0501002c 0x0502002e
            /* V       X          ,          M       */
            0x0503002f 0x0504002d 0x05050033 0x05060032
            /* L_SHIFT /          .          SPACE   */
            0x0507002a 0x05080035 0x05090034 0x050B0039
            /* 1       3          4          2       */
            0x06010002 0x06020004 0x06030005 0x06040003
            /* 8       7          0          9       */
            0x06050009 0x06060008 0x0608000b 0x0609000a
            /* L_ALT   DOWN       RIGHT      Q       */
            0x060a0038 0x060b006c 0x060c006a 0x07010010
            /* E       R          W          I       */
            0x07020012 0x07030013 0x07040011 0x07050017
            /* U       R_SHIFT    P          O       */
            0x07060016 0x07070036 0x07080019 0x07090018
            /* UP      LEFT    */
            0x070b0067 0x070c0069>;
    };
  - |
    /* No matrix keyboard, just buttons/switches */
    keyboard-controller {
        compatible = "google,cros-ec-keyb-switches";
    };
...
```

## Documentation/devicetree/bindings/input/google,goldfish-events-keypad.yaml
```yaml
# SPDX-License-Identifier: (GPL-2.0-only OR BSD-2-Clause)
%YAML 1.2
---
$id: http://devicetree.org/schemas/input/google,goldfish-events-keypad.yaml#
$schema: http://devicetree.org/meta-schemas/core.yaml#

title: Android Goldfish Events Keypad

maintainers:
  - Kuan-Wei Chiu <visitorckw@gmail.com>

allOf:
  - $ref: input.yaml#

description:
  Android goldfish events keypad device generated by android emulator.

properties:
  compatible:
    const: google,goldfish-events-keypad

  reg:
    maxItems: 1

  interrupts:
    maxItems: 1

required:
  - compatible
  - reg
  - interrupts

unevaluatedProperties: false

examples:
  - |
    keypad@9040000 {
        compatible = "google,goldfish-events-keypad";
        reg = <0x9040000 0x1000>;
        interrupts = <5>;
    };
```

## Documentation/devicetree/bindings/input/gpio-beeper.txt
```
* GPIO beeper device tree bindings

Register a beeper connected to GPIO pin.

Required properties:
- compatible:	Should be "gpio-beeper".
- gpios:	From common gpio binding; gpio connection to beeper enable pin.

Example:
	beeper: beeper {
		compatible = "gpio-beeper";
		gpios = <&gpio3 23 GPIO_ACTIVE_HIGH>;
	};
```

## Documentation/devicetree/bindings/input/gpio-beeper.yaml
```yaml
# SPDX-License-Identifier: GPL-2.0-only OR BSD-2-Clause
%YAML 1.2
---
$id: http://devicetree.org/schemas/input/gpio-beeper.yaml#
$schema: http://devicetree.org/meta-schemas/core.yaml#

title: GPIO controlled beeper

maintainers:
  - Fabio Estevam <festevam@denx.de>

properties:
  compatible:
    const: gpio-beeper

  gpios:
    maxItems: 1
    description:
      GPIO that drives the beeper.

required:
  - compatible
  - gpios

additionalProperties: false

examples:
  - |
    #include <dt-bindings/gpio/gpio.h>
    beeper {
        compatible = "gpio-beeper";
        gpios = <&gpio3 23 GPIO_ACTIVE_HIGH>;
    };
```

## Documentation/devicetree/bindings/input/gpio-charlieplex-keypad.yaml
```yaml
# SPDX-License-Identifier: (GPL-2.0-only OR BSD-2-Clause)
%YAML 1.2
---

$id: http://devicetree.org/schemas/input/gpio-charlieplex-keypad.yaml#
$schema: http://devicetree.org/meta-schemas/core.yaml#

title: GPIO charlieplex keypad

maintainers:
  - Hugo Villeneuve <hvilleneuve@dimonoff.com>

description: |
  The charlieplex keypad supports (N^2)-N different key combinations (where N is
  the number of I/O lines). Key presses and releases are detected by configuring
  only one line as output at a time, and reading other line states. This process
  is repeated for each line. Diodes are required to ensure current flows in only
  one direction between any pair of pins, as well as pull-up or pull-down
  resistors on all I/O lines.
  This mechanism doesn't allow to detect simultaneous key presses.

  Wiring example for 3 lines keyboard with 6 switches and 3 diodes (pull-up/down
  resistors not shown but needed on L0, L1 and L2):

  L0  --+---------------------+----------------------+
        |                     |                      |
  L1  -------+-----------+---------------------+     |
        |    |           |    |                |     |
  L2  -------------+----------------+-----+    |     |
        |    |     |     |    |     |     |    |     |
        |    |     |     |    |     |     |    |     |
        |  S1 \  S2 \    |  S3 \  S4 \    |  S5 \  S6 \
        |    |     |     |    |     |     |    |     |
        |    +--+--+     |    +--+--+     |    +--+--+
        |       |        |       |        |       |
        |    D1 v        |    D2 v        |    D3 v
        |       - (k)    |       - (k)    |       - (k)
        |       |        |       |        |       |
        +-------+        +-------+        +-------+

  L: GPIO line
  S: switch
  D: diode (k indicates cathode)

allOf:
  - $ref: input.yaml#
  - $ref: /schemas/input/matrix-keymap.yaml#

properties:
  compatible:
    const: gpio-charlieplex-keypad

  autorepeat: true

  debounce-delay-ms:
    default: 5

  line-gpios:
    description:
      List of GPIOs used as lines. The gpio specifier for this property
      depends on the gpio controller to which these lines are connected.

  linux,keymap: true

  poll-interval: true

  settling-time-us: true

  wakeup-source: true

required:
  - compatible
  - line-gpios
  - linux,keymap
  - poll-interval

additionalProperties: false

examples:
  - |
    #include <dt-bindings/gpio/gpio.h>
    #include <dt-bindings/input/input.h>

    keyboard {
        compatible = "gpio-charlieplex-keypad";
        debounce-delay-ms = <20>;
        poll-interval = <5>;
        settling-time-us = <2>;

        line-gpios = <&gpio2 25 (GPIO_ACTIVE_HIGH | GPIO_PULL_DOWN)
                      &gpio2 26 (GPIO_ACTIVE_HIGH | GPIO_PULL_DOWN)
                      &gpio2 27 (GPIO_ACTIVE_HIGH | GPIO_PULL_DOWN)>;

        /* MATRIX_KEY(output, input, key-code) */
        linux,keymap = <
            /*
             * According to wiring diagram above, if L1 is configured as
             * output and HIGH, and we detect a HIGH level on input L0,
             * then it means S1 is pressed: MATRIX_KEY(L1, L0, KEY...)
             */
            MATRIX_KEY(1, 0, KEY_F1) /* S1 */
            MATRIX_KEY(2, 0, KEY_F2) /* S2 */
            MATRIX_KEY(0, 1, KEY_F3) /* S3 */
            MATRIX_KEY(2, 1, KEY_F4) /* S4 */
            MATRIX_KEY(1, 2, KEY_F5) /* S5 */
            MATRIX_KEY(0, 2, KEY_F6) /* S6 */
        >;
    };
```

## Documentation/devicetree/bindings/input/gpio-decoder.txt
```
* GPIO Decoder DT bindings

Required Properties:
- compatible: should be "gpio-decoder"
- gpios: a spec of gpios (at least two) to be decoded to a number with
  first entry representing the MSB.

Optional Properties:
- decoder-max-value: Maximum possible value that can be reported by
  the gpios.
- linux,axis: the input subsystem axis to map to (ABS_X/ABS_Y).
  Defaults to 0 (ABS_X).

Example:
	gpio-decoder0 {
		compatible = "gpio-decoder";
		gpios = <&pca9536 3 GPIO_ACTIVE_HIGH>,
			<&pca9536 2 GPIO_ACTIVE_HIGH>,
			<&pca9536 1 GPIO_ACTIVE_HIGH>,
			<&pca9536 0 GPIO_ACTIVE_HIGH>;
		linux,axis = <0>; /* ABS_X */
		decoder-max-value = <9>;
	};
```

## Documentation/devicetree/bindings/input/gpio-keys-polled.txt
```
Device-Tree bindings for input/gpio_keys_polled.c keyboard driver

Required properties:
	- compatible = "gpio-keys-polled";
	- poll-interval: Poll interval time in milliseconds

Optional properties:
	- autorepeat: Boolean, Enable auto repeat feature of Linux input
	  subsystem.

Each button (key) is represented as a sub-node of "gpio-keys-polled":
Subnode properties:

	- gpios: OF device-tree gpio specification.
	- label: Descriptive name of the key.
	- linux,code: Key / Axis code to emit.

Optional subnode-properties:
	- linux,input-type: Specify event type this button/key generates.
	  If not specified defaults to <1> == EV_KEY.
	- linux,input-value: If linux,input-type is EV_ABS or EV_REL then this
	  value is sent for events this button generates when pressed.
	  EV_ABS/EV_REL axis will generate an event with a value of 0 when
	  all buttons with linux,input-type == type and linux,code == axis
	  are released. This value is interpreted as a signed 32 bit value,
	  e.g. to make a button generate a value of -1 use:
	  linux,input-value = <0xffffffff>; /* -1 */
	- debounce-interval: Debouncing interval time in milliseconds.
	  If not specified defaults to 5.
	- wakeup-source: Boolean, button can wake-up the system.
			 (Legacy property supported: "gpio-key,wakeup")

Example nodes:

	gpio_keys_polled {
			compatible = "gpio-keys-polled";
			poll-interval = <100>;
			autorepeat;

			button21 {
				label = "GPIO Key UP";
				linux,code = <103>;
				gpios = <&gpio1 0 1>;
			};
			...
```

## Documentation/devicetree/bindings/input/gpio-keys.txt
```
Device-Tree bindings for input/keyboard/gpio_keys.c keyboard driver

Required properties:
	- compatible = "gpio-keys";

Optional properties:
	- autorepeat: Boolean, Enable auto repeat feature of Linux input
	  subsystem.
	- label: String, name of the input device.

Each button (key) is represented as a sub-yesde of "gpio-keys":
Subyesde properties:

	- gpios: OF device-tree gpio specification.
	- interrupts: the interrupt line for that input.
	- label: Descriptive name of the key.
	- linux,code: Keycode to emit.

Note that either "interrupts" or "gpios" properties can be omitted, but yest
both at the same time. Specifying both properties is allowed.

Optional subyesde-properties:
	- linux,input-type: Specify event type this button/key generates.
	  If yest specified defaults to <1> == EV_KEY.
	- debounce-interval: Debouncing interval time in milliseconds.
	  If yest specified defaults to 5.
	- wakeup-source: Boolean, button can wake-up the system.
			 (Legacy property supported: "gpio-key,wakeup")
	- wakeup-event-action: Specifies whether the key should wake the
	  system when asserted, when deasserted, or both. This property is
	  only valid for keys that wake up the system (e.g., when the
	  "wakeup-source" property is also provided).
	  Supported values are defined in linux-event-codes.h:
		EV_ACT_ASSERTED		- asserted
		EV_ACT_DEASSERTED	- deasserted
		EV_ACT_ANY		- both asserted and deasserted
	- linux,can-disable: Boolean, indicates that button is connected
	  to dedicated (yest shared) interrupt which can be disabled to
	  suppress events from the button.

Example yesdes:

	gpio-keys {
			compatible = "gpio-keys";
			autorepeat;

			up {
				label = "GPIO Key UP";
				linux,code = <103>;
				gpios = <&gpio1 0 1>;
			};

			down {
				label = "GPIO Key DOWN";
				linux,code = <108>;
				interrupts = <1 IRQ_TYPE_LEVEL_HIGH 7>;
			};
			...
```
