## Documentation/devicetree/bindings/input/elan,ekth6915.yaml
```yaml
# SPDX-License-Identifier: (GPL-2.0-only OR BSD-2-Clause)
%YAML 1.2
---
$id: http://devicetree.org/schemas/input/elan,ekth6915.yaml#
$schema: http://devicetree.org/meta-schemas/core.yaml#

title: Elan eKTH6915 touchscreen controller

maintainers:
  - Douglas Anderson <dianders@chromium.org>

description:
  Supports the Elan eKTH6915 touchscreen controller.
  This touchscreen controller uses the i2c-hid protocol with a reset GPIO.

allOf:
  - $ref: /schemas/input/touchscreen/touchscreen.yaml#

properties:
  compatible:
    items:
      - const: elan,ekth6915

  reg:
    const: 0x10

  interrupts:
    maxItems: 1

  panel: true

  reset-gpios:
    description: Reset GPIO; not all touchscreens using eKTH6915 hook this up.

  vcc33-supply:
    description: The 3.3V supply to the touchscreen.

  vccio-supply:
    description:
      The IO supply to the touchscreen. Need not be specified if this is the
      same as the 3.3V supply.

required:
  - compatible
  - reg
  - interrupts
  - vcc33-supply

additionalProperties: false

examples:
  - |
    #include <dt-bindings/gpio/gpio.h>
    #include <dt-bindings/interrupt-controller/irq.h>

    i2c {
      #address-cells = <1>;
      #size-cells = <0>;

      ap_ts: touchscreen@10 {
        compatible = "elan,ekth6915";
        reg = <0x10>;

        interrupt-parent = <&tlmm>;
        interrupts = <9 IRQ_TYPE_LEVEL_LOW>;

        reset-gpios = <&tlmm 8 GPIO_ACTIVE_LOW>;
        vcc33-supply = <&pp3300_ts>;
      };
    };
```

## Documentation/devicetree/bindings/input/elan_i2c.txt
```
Elantech I2C Touchpad

Required properties:
- compatible: must be "elan,ekth3000".
- reg: I2C address of the chip.
- interrupts: interrupt to which the chip is connected (see interrupt
  binding[0]).

Optional properties:
- wakeup-source: touchpad can be used as a wakeup source.
- pinctrl-names: should be "default" (see pinctrl binding [1]).
- pinctrl-0: a phandle pointing to the pin settings for the device (see
  pinctrl binding [1]).
- vcc-supply: a phandle for the regulator supplying 3.3V power.
- elan,trackpoint: touchpad can support a trackpoint (boolean)
- elan,clickpad: touchpad is a clickpad (the entire surface is a button)
- elan,middle-button: touchpad has a physical middle button
- elan,x_traces: number of antennas on the x axis
- elan,y_traces: number of antennas on the y axis
- some generic touchscreen properties [2]:
  * touchscreen-size-x
  * touchscreen-size-y
  * touchscreen-x-mm
  * touchscreen-y-mm


[0]: Documentation/devicetree/bindings/interrupt-controller/interrupts.txt
[1]: Documentation/devicetree/bindings/pinctrl/pinctrl-bindings.txt
[2]: Documentation/devicetree/bindings/input/touchscreen/touchscreen.txt

Example:
	&i2c1 {
		/* ... */

		touchpad@15 {
			compatible = "elan,ekth3000";
			reg = <0x15>;
			interrupt-parent = <&gpio4>;
			interrupts = <0x0 IRQ_TYPE_EDGE_FALLING>;
			wakeup-source;
		};

		/* ... */
	};
```

## Documentation/devicetree/bindings/input/elants_i2c.txt
```
Elantech I2C Touchscreen

Required properties:
- compatible: must be "elan,ekth3500".
- reg: I2C address of the chip.
- interrupt-parent: a phandle for the interrupt controller (see interrupt
  binding[0]).
- interrupts: interrupt to which the chip is connected (see interrupt
  binding[0]).

Optional properties:
- wakeup-source: touchscreen can be used as a wakeup source.
- pinctrl-names: should be "default" (see pinctrl binding [1]).
- pinctrl-0: a phandle pointing to the pin settings for the device (see
  pinctrl binding [1]).
- reset-gpios: reset gpio the chip is connected to.
- vcc33-supply: a phandle for the regulator supplying 3.3V power.
- vccio-supply: a phandle for the regulator supplying IO power.

[0]: Documentation/devicetree/bindings/interrupt-controller/interrupts.txt
[1]: Documentation/devicetree/bindings/pinctrl/pinctrl-bindings.txt

Example:
	&i2c1 {
		/* ... */

		touchscreen@10 {
			compatible = "elan,ekth3500";
			reg = <0x10>;
			interrupt-parent = <&gpio4>;
			interrupts = <0x0 IRQ_TYPE_EDGE_FALLING>;
			wakeup-source;
		};

		/* ... */
	};
```

## Documentation/devicetree/bindings/input/focaltech,ft8112.yaml
```yaml
# SPDX-License-Identifier: (GPL-2.0-only OR BSD-2-Clause)
%YAML 1.2
---
$id: http://devicetree.org/schemas/input/focaltech,ft8112.yaml#
$schema: http://devicetree.org/meta-schemas/core.yaml#

title: FocalTech FT8112 touchscreen controller

maintainers:
  - Daniel Peng <Daniel_Peng@pegatron.corp-partner.google.com>

description:
  Supports the FocalTech FT8112 touchscreen controller.
  This touchscreen controller uses the i2c-hid protocol with a reset GPIO.

allOf:
  - $ref: /schemas/input/touchscreen/touchscreen.yaml#

properties:
  compatible:
    enum:
      - focaltech,ft8112

  reg:
    maxItems: 1

  interrupts:
    maxItems: 1

  panel: true

  reset-gpios:
    maxItems: 1

  vcc33-supply: true

  vccio-supply: true

required:
  - compatible
  - reg
  - interrupts
  - vcc33-supply

additionalProperties: false

examples:
  - |
    #include <dt-bindings/gpio/gpio.h>
    #include <dt-bindings/interrupt-controller/irq.h>

    i2c {
      #address-cells = <1>;
      #size-cells = <0>;

      touchscreen@38 {
        compatible = "focaltech,ft8112";
        reg = <0x38>;

        interrupt-parent = <&pio>;
        interrupts = <15 IRQ_TYPE_LEVEL_LOW>;

        reset-gpios = <&pio 126 GPIO_ACTIVE_LOW>;
        vcc33-supply = <&pp3300_tchscr_x>;
      };
    };
```

## Documentation/devicetree/bindings/input/fsl,mpr121-touchkey.yaml
```yaml
# SPDX-License-Identifier: (GPL-2.0 OR BSD-2-Clause)
%YAML 1.2
---
$id: http://devicetree.org/schemas/input/fsl,mpr121-touchkey.yaml#
$schema: http://devicetree.org/meta-schemas/core.yaml#

title: Freescale MPR121 capacitive touch sensor controller

maintainers:
  - Dmitry Torokhov <dmitry.torokhov@gmail.com>

description: |
  The MPR121 supports up to 12 completely independent electrodes/capacitance
  sensing inputs in which 8 are multifunctional for LED driving and GPIO.
  https://www.nxp.com/docs/en/data-sheet/MPR121.pdf

allOf:
  - $ref: input.yaml#

anyOf:
  - required: [ interrupts ]
  - required: [ poll-interval ]

properties:
  compatible:
    const: fsl,mpr121-touchkey

  reg:
    maxItems: 1

  interrupts:
    maxItems: 1

  vdd-supply: true

  linux,keycodes:
    minItems: 1
    maxItems: 12

  wakeup-source:
    description: Use any event on keypad as wakeup event.
    type: boolean

required:
  - compatible
  - reg
  - vdd-supply
  - linux,keycodes

unevaluatedProperties: false

examples:
  - |
    // Example with interrupts
    #include "dt-bindings/input/input.h"
    i2c {
        #address-cells = <1>;
        #size-cells = <0>;

        touchkey@5a {
            compatible = "fsl,mpr121-touchkey";
            reg = <0x5a>;
            interrupt-parent = <&gpio1>;
            interrupts = <28 2>;
            autorepeat;
            vdd-supply = <&ldo4_reg>;
            linux,keycodes = <KEY_0>, <KEY_1>, <KEY_2>, <KEY_3>,
                             <KEY_4>, <KEY_5>, <KEY_6>, <KEY_7>,
                             <KEY_8>, <KEY_9>, <KEY_A>, <KEY_B>;
        };
    };

  - |
    // Example with polling
    #include "dt-bindings/input/input.h"
    i2c {
        #address-cells = <1>;
        #size-cells = <0>;

        touchkey@5a {
            compatible = "fsl,mpr121-touchkey";
            reg = <0x5a>;
            poll-interval = <20>;
            autorepeat;
            vdd-supply = <&ldo4_reg>;
            linux,keycodes = <KEY_0>, <KEY_1>, <KEY_2>, <KEY_3>,
                             <KEY_4>, <KEY_5>, <KEY_6>, <KEY_7>,
                             <KEY_8>, <KEY_9>, <KEY_A>, <KEY_B>;
        };
    };
```

## Documentation/devicetree/bindings/input/fsl,scu-key.yaml
```yaml
# SPDX-License-Identifier: (GPL-2.0-only OR BSD-2-Clause)
%YAML 1.2
---
$id: http://devicetree.org/schemas/input/fsl,scu-key.yaml#
$schema: http://devicetree.org/meta-schemas/core.yaml#

title: i.MX SCU Client Device Analde - SCU Key Based on SCU Message Protocol

maintainers:
  - Dong Aisheng <aisheng.dong@nxp.com>

description: i.MX SCU Client Device Analde
  Client analdes are maintained as children of the relevant IMX-SCU device analde.

allOf:
  - $ref: input.yaml#

properties:
  compatible:
    items:
      - const: fsl,imx8qxp-sc-key
      - const: fsl,imx-sc-key

  linux,keycodes:
    maxItems: 1

  wakeup-source: true

required:
  - compatible
  - linux,keycodes

additionalProperties: false

examples:
  - |
    #include <dt-bindings/input/input.h>

    keys {
        compatible = "fsl,imx8qxp-sc-key", "fsl,imx-sc-key";
        linux,keycodes = <KEY_POWER>;
    };
```

## Documentation/devicetree/bindings/input/fsl-mma8450.txt
```
* Freescale MMA8450 3-Axis Accelerometer

Required properties:
- compatible : "fsl,mma8450".
- reg: the I2C address of MMA8450

Example:

accelerometer: mma8450@1c {
	compatible = "fsl,mma8450";
	reg = <0x1c>;
};
```

## Documentation/devicetree/bindings/input/goodix,gt7375p.yaml
```yaml
# SPDX-License-Identifier: (GPL-2.0-only OR BSD-2-Clause)
%YAML 1.2
---
$id: http://devicetree.org/schemas/input/goodix,gt7375p.yaml#
$schema: http://devicetree.org/meta-schemas/core.yaml#

title: Goodix GT7375P touchscreen

maintainers:
  - Douglas Anderson <dianders@chromium.org>

description:
  Supports the Goodix GT7375P touchscreen.
  This touchscreen uses the i2c-hid protocol but has some non-standard
  power sequencing required.

properties:
  compatible:
    oneOf:
      - const: goodix,gt7375p
      - items:
          - const: goodix,gt7986u
          - const: goodix,gt7375p

  reg:
    enum:
      - 0x5d
      - 0x14

  interrupts:
    maxItems: 1

  reset-gpios:
    true

  vdd-supply:
    description: The 3.3V supply to the touchscreen.

  mainboard-vddio-supply:
    description:
      The supply on the main board needed to power up IO signals going
      to the touchscreen. This supply need not go to the touchscreen
      itself as long as it allows the main board to make signals compatible
      with what the touchscreen is expecting for its IO rails.

  goodix,no-reset-during-suspend:
    description:
      Set this to true to enforce the driver to not assert the reset GPIO
      during suspend.
      Due to potential touchscreen hardware flaw, back-powering could happen in
      suspend if the power supply is on and with active-low reset GPIO asserted.
      This property is used to avoid the back-powering issue.
    type: boolean

required:
  - compatible
  - reg
  - interrupts
  - reset-gpios
  - vdd-supply

additionalProperties: false

examples:
  - |
    #include <dt-bindings/clock/qcom,rpmh.h>
    #include <dt-bindings/gpio/gpio.h>
    #include <dt-bindings/interrupt-controller/irq.h>

    i2c {
      #address-cells = <1>;
      #size-cells = <0>;

      ap_ts: touchscreen@5d {
        compatible = "goodix,gt7375p";
        reg = <0x5d>;

        interrupt-parent = <&tlmm>;
        interrupts = <9 IRQ_TYPE_LEVEL_LOW>;

        reset-gpios = <&tlmm 8 GPIO_ACTIVE_LOW>;
        vdd-supply = <&pp3300_ts>;
      };
    };
```

## Documentation/devicetree/bindings/input/goodix,gt7986u-spifw.yaml
```yaml
# SPDX-License-Identifier: (GPL-2.0-only OR BSD-2-Clause)
%YAML 1.2
---
$id: http://devicetree.org/schemas/input/goodix,gt7986u-spifw.yaml#
$schema: http://devicetree.org/meta-schemas/core.yaml#

title: Goodix GT7986U SPI HID Touchscreen

maintainers:
  - Charles Wang <charles.goodix@gmail.com>

description: |
  Supports the Goodix GT7986U touchscreen.
  This touch controller reports data packaged according to the HID protocol
  over the SPI bus, but it is incompatible with Microsoft's HID-over-SPI protocol.

  NOTE: these bindings are distinct from the bindings used with the
  GT7986U when the chip is running I2C firmware. This is because there's
  not a single device that talks over both I2C and SPI but rather
  distinct touchscreens that happen to be built with the same ASIC but
  that are distinct products running distinct firmware.

allOf:
  - $ref: /schemas/spi/spi-peripheral-props.yaml#

properties:
  compatible:
    enum:
      - goodix,gt7986u-spifw

  reg:
    maxItems: 1

  interrupts:
    maxItems: 1

  reset-gpios:
    maxItems: 1

  spi-max-frequency: true

required:
  - compatible
  - reg
  - interrupts
  - reset-gpios

unevaluatedProperties: false

examples:
  - |
    #include <dt-bindings/interrupt-controller/irq.h>
    #include <dt-bindings/gpio/gpio.h>

    spi {
      #address-cells = <1>;
      #size-cells = <0>;

      touchscreen@0 {
        compatible = "goodix,gt7986u-spifw";
        reg = <0>;
        interrupt-parent = <&gpio>;
        interrupts = <25 IRQ_TYPE_LEVEL_LOW>;
        reset-gpios = <&gpio1 1 GPIO_ACTIVE_LOW>;
        spi-max-frequency = <10000000>;
      };
    };

...
```

## Documentation/devicetree/bindings/input/goodix,gt7986u.yaml
```yaml
# SPDX-License-Identifier: (GPL-2.0-only OR BSD-2-Clause)
%YAML 1.2
---
$id: http://devicetree.org/schemas/input/goodix,gt7986u.yaml#
$schema: http://devicetree.org/meta-schemas/core.yaml#

title: GOODIX GT7986U SPI HID Touchscreen

maintainers:
  - Charles Wang <charles.goodix@gmail.com>

description: Supports the Goodix GT7986U touchscreen.
  This touch controller reports data packaged according to the HID protocol,
  but is incompatible with Microsoft's HID-over-SPI protocol.

allOf:
  - $ref: /schemas/spi/spi-peripheral-props.yaml#

properties:
  compatible:
    enum:
      - goodix,gt7986u

  reg:
    maxItems: 1

  interrupts:
    maxItems: 1

  reset-gpios:
    maxItems: 1

  goodix,hid-report-addr:
    $ref: /schemas/types.yaml#/definitions/uint32
    description:
      The register address for retrieving HID report data.
      This address is related to the device firmware and may
      change after a firmware update.

  spi-max-frequency: true

additionalProperties: false

required:
  - compatible
  - reg
  - interrupts
  - reset-gpios
  - goodix,hid-report-addr

examples:
  - |
    #include <dt-bindings/interrupt-controller/irq.h>
    #include <dt-bindings/gpio/gpio.h>

    spi {
      #address-cells = <1>;
      #size-cells = <0>;

      touchscreen@0 {
        compatible = "goodix,gt7986u";
        reg = <0>;
        interrupt-parent = <&gpio>;
        interrupts = <25 IRQ_TYPE_LEVEL_LOW>;
        reset-gpios = <&gpio1 1 GPIO_ACTIVE_LOW>;
        spi-max-frequency = <10000000>;
        goodix,hid-report-addr = <0x22c8c>;
      };
    };

...
```
