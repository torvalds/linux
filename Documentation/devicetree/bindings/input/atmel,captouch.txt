## Documentation/devicetree/bindings/input/cypress,tm2-touchkey.yaml
```yaml
# SPDX-License-Identifier: (GPL-2.0 OR BSD-2-Clause)
%YAML 1.2
---
$id: http://devicetree.org/schemas/input/cypress,tm2-touchkey.yaml#
$schema: http://devicetree.org/meta-schemas/core.yaml#

title: Samsung TM2 touch key controller

maintainers:
  - Stephan Gerhold <stephan@gerhold.net>

description: |
  Touch key controllers similar to the TM2 can be found in a wide range of
  Samsung devices. They are implemented using many different MCUs, but use
  a similar I2C protocol.

allOf:
  - $ref: input.yaml#

properties:
  compatible:
    enum:
      - cypress,tm2-touchkey
      - cypress,midas-touchkey
      - cypress,aries-touchkey
      - coreriver,tc360-touchkey

  reg:
    maxItems: 1

  interrupts:
    maxItems: 1

  vdd-supply:
    description: Optional regulator for LED voltage, 3.3V.

  vcc-supply:
    description: Optional regulator for MCU, 1.8V-3.3V (depending on MCU).

  vddio-supply:
    description: |
      Optional regulator that provides digital I/O voltage,
      e.g. for pulling up the interrupt line or the I2C pins.

  linux,keycodes:
    minItems: 1
    maxItems: 4

required:
  - compatible
  - reg
  - interrupts

additionalProperties: false

examples:
  - |
    #include <dt-bindings/input/input.h>
    #include <dt-bindings/interrupt-controller/irq.h>
    i2c {
        #address-cells = <1>;
        #size-cells = <0>;

        touchkey@20 {
            compatible = "cypress,tm2-touchkey";
            reg = <0x20>;
            interrupt-parent = <&gpa3>;
            interrupts = <2 IRQ_TYPE_EDGE_FALLING>;
            vcc-supply = <&ldo32_reg>;
            vdd-supply = <&ldo33_reg>;
            linux,keycodes = <KEY_MENU KEY_BACK>;
        };
    };
```

## Documentation/devicetree/bindings/input/cypress-sf.yaml
```yaml
# SPDX-License-Identifier: (GPL-2.0-only OR BSD-2-Clause)
%YAML 1.2
---
$id: http://devicetree.org/schemas/input/cypress-sf.yaml#
$schema: http://devicetree.org/meta-schemas/core.yaml#

title: Cypress StreetFighter touchkey controller

maintainers:
  - Yassine Oudjana <y.oudjana@protonmail.com>

allOf:
  - $ref: input.yaml#

properties:
  compatible:
    const: cypress,sf3155

  reg:
    maxItems: 1

  interrupts:
    maxItems: 1

  avdd-supply:
    description: Regulator for AVDD analog voltage

  vdd-supply:
    description: Regulator for VDD digital voltage

  linux,keycodes:
    minItems: 1
    maxItems: 8

required:
  - compatible
  - reg
  - interrupts
  - avdd-supply
  - vdd-supply

additionalProperties: false

examples:
  - |
    #include <dt-bindings/input/input.h>
    #include <dt-bindings/interrupt-controller/irq.h>
    i2c {
        #address-cells = <1>;
        #size-cells = <0>;

        touchkey@28 {
                compatible = "cypress,sf3155";
                reg = <0x28>;
                interrupt-parent = <&msmgpio>;
                interrupts = <77 IRQ_TYPE_EDGE_FALLING>;
                avdd-supply = <&vreg_l6a_1p8>;
                vdd-supply = <&vdd_3v2_tp>;
                linux,keycodes = <KEY_BACK KEY_MENU>;
        };
    };
```

## Documentation/devicetree/bindings/input/da9062-onkey.txt
```
* Dialog DA9061/62/63 OnKey Module

This module is part of the DA9061/DA9062/DA9063. For more details about entire
DA9062 and DA9061 chips see Documentation/devicetree/bindings/mfd/da9062.txt
For DA9063 see Documentation/devicetree/bindings/mfd/da9063.txt

This module provides the KEY_POWER event.

Required properties:

- compatible: should be one of the following valid compatible string lines:
	"dlg,da9061-onkey", "dlg,da9062-onkey"
	"dlg,da9062-onkey"
	"dlg,da9063-onkey"

Optional properties:

- dlg,disable-key-power : Disable power-down using a long key-press. If this
    entry exists the OnKey driver will remove support for the KEY_POWER key
    press when triggered using a long press of the OnKey.

Example: DA9063

	pmic0: da9063@58 {
		onkey {
			compatible = "dlg,da9063-onkey";
			dlg,disable-key-power;
		};
	};

Example: DA9062

	pmic0: da9062@58 {
		onkey {
			compatible = "dlg,da9062-onkey";
			dlg,disable-key-power;
		};
	};

Example: DA9061 using a fall-back compatible for the DA9062 onkey driver

	pmic0: da9061@58 {
		onkey {
			compatible = "dlg,da9061-onkey", "dlg,da9062-onkey";
			dlg,disable-key-power;
		};
	};
```

## Documentation/devicetree/bindings/input/dlg,da7280.txt
```
Dialog Semiconductor DA7280 Haptics bindings

Required properties:
- compatible: Should be "dlg,da7280".
- reg: Specifies the I2C slave address.

- interrupt-parent : Specifies the phandle of the interrupt controller to
  which the IRQs from DA7280 are delivered to.

- dlg,actuator-type: Set Actuator type. it should be one of:
  "LRA" - Linear Resonance Actuator type.
  "ERM-bar" - Bar type Eccentric Rotating Mass.
  "ERM-coin" - Coin type Eccentric Rotating Mass.

- dlg,const-op-mode: Haptic operation mode for FF_CONSTANT.
  Possible values:
	1 - Direct register override(DRO) mode triggered by i2c(default),
	2 - PWM data source mode controlled by PWM duty,
- dlg,periodic-op-mode: Haptic operation mode for FF_PERIODIC.
  Possible values:
	1 - Register triggered waveform memory(RTWM) mode, the pattern
	    assigned to the PS_SEQ_ID played as much times as PS_SEQ_LOOP,
	2 - Edge triggered waveform memory(ETWM) mode, external GPI(N)
	    control are required to enable/disable and it needs to keep
	    device enabled by sending magnitude (X > 0),
	    the pattern is assigned to the GPI(N)_SEQUENCE_ID below.
	The default value is 1 for both of the operation modes.
	For more details, please see the datasheet.

- dlg,nom-microvolt: Nominal actuator voltage rating.
  Valid values: 0 - 6000000.
- dlg,abs-max-microvolt: Absolute actuator maximum voltage rating.
  Valid values: 0 - 6000000.
- dlg,imax-microamp: Actuator max current rating.
  Valid values: 0 - 252000.
  Default: 130000.
- dlg,impd-micro-ohms: the impedance of the actuator in micro ohms.
  Valid values: 0 - 1500000000.

Optional properties:
- pwms : phandle to the physical PWM(Pulse Width Modulation) device.
  PWM properties should be named "pwms". And number of cell is different
  for each pwm device.
  (See Documentation/devicetree/bindings/pwm/pwm.txt
   for further information relating to pwm properties)

- dlg,ps-seq-id: the PS_SEQ_ID(pattern ID in waveform memory inside chip)
  to play back when RTWM-MODE is enabled.
  Valid range: 0 - 15.
- dlg,ps-seq-loop: the PS_SEQ_LOOP, Number of times the pre-stored sequence
  pointed to by PS_SEQ_ID or GPI(N)_SEQUENCE_ID is repeated.
  Valid range: 0 - 15.
- dlg,gpiN-seq-id: the GPI(N)_SEQUENCE_ID, pattern to play
  when gpi0 is triggered, 'N' must be 0 - 2.
  Valid range: 0 - 15.
- dlg,gpiN-mode: the pattern mode which can select either
  "Single-pattern" or "Multi-pattern", 'N' must be 0 - 2.
- dlg,gpiN-polarity: gpiN polarity which can be chosen among
  "Rising-edge", "Falling-edge" and "Both-edge",
  'N' must be 0 - 2
  Haptic will work by this edge option in case of ETWM mode.

- dlg,resonant-freq-hz: use in case of LRA.
  the frequency range: 50 - 300.
  Default: 205.

- dlg,bemf-sens-enable: Enable for internal loop computations.
- dlg,freq-track-enable: Enable for resonant frequency tracking.
- dlg,acc-enable: Enable for active acceleration.
- dlg,rapid-stop-enable: Enable for rapid stop.
- dlg,amp-pid-enable: Enable for the amplitude PID.
- dlg,mem-array: Customized waveform memory(patterns) data downloaded to
  the device during initialization. This is an array of 100 values(u8).

For further information, see device datasheet.

======

Example:

	haptics: da7280-haptics@4a {
		compatible = "dlg,da7280";
		reg = <0x4a>;
		interrupt-parent = <&gpio6>;
		interrupts = <11 IRQ_TYPE_LEVEL_LOW>;
		dlg,actuator-type = "LRA";
		dlg,dlg,const-op-mode = <1>;
		dlg,dlg,periodic-op-mode = <1>;
		dlg,nom-microvolt = <2000000>;
		dlg,abs-max-microvolt = <2000000>;
		dlg,imax-microamp = <170000>;
		dlg,resonant-freq-hz = <180>;
		dlg,impd-micro-ohms = <10500000>;
		dlg,freq-track-enable;
		dlg,rapid-stop-enable;
		dlg,mem-array = <
		  0x00 0x00 0x00 0x00 0x00 0x00 0x00 0x00 0x00 0x00
		  0x00 0x00 0x00 0x00 0x00 0x00 0x00 0x00 0x00 0x00
		  0x00 0x00 0x00 0x00 0x00 0x00 0x00 0x00 0x00 0x00
		  0x00 0x00 0x00 0x00 0x00 0x00 0x00 0x00 0x00 0x00
		  0x00 0x00 0x00 0x00 0x00 0x00 0x00 0x00 0x00 0x00
		  0x00 0x00 0x00 0x00 0x00 0x00 0x00 0x00 0x00 0x00
		  0x00 0x00 0x00 0x00 0x00 0x00 0x00 0x00 0x00 0x00
		  0x00 0x00 0x00 0x00 0x00 0x00 0x00 0x00 0x00 0x00
		  0x00 0x00 0x00 0x00 0x00 0x00 0x00 0x00 0x00 0x00
		  0x00 0x00 0x00 0x00 0x00 0x00 0x00 0x00 0x00 0x00
		>;
	};
```

## Documentation/devicetree/bindings/input/dlg,da7280.yaml
```yaml
# SPDX-License-Identifier: (GPL-2.0 OR BSD-2-Clause)
%YAML 1.2
---
$id: http://devicetree.org/schemas/input/dlg,da7280.yaml#
$schema: http://devicetree.org/meta-schemas/core.yaml#

title: Dialog Semiconductor DA7280 Low Power High-Definition Haptic Driver

maintainers:
  - Roy Im <roy.im.opensource@diasemi.com>

properties:
  compatible:
    const: dlg,da7280

  reg:
    maxItems: 1
    description: I2C address of the device.

  interrupts:
    maxItems: 1

  dlg,actuator-type:
    enum:
      - LRA # Linear Resonance Actuator type
      - ERM-bar # Bar type Eccentric Rotating Mass
      - ERM-coin # Coin type Eccentric Rotating Mass

  dlg,const-op-mode:
    $ref: /schemas/types.yaml#/definitions/uint32
    enum:
      - 1 # Direct register override (DRO) mode triggered by i2c (default)
      - 2 # PWM data source mode controlled by PWM duty
    description:
      Haptic operation mode for FF_CONSTANT

  dlg,periodic-op-mode:
    $ref: /schemas/types.yaml#/definitions/uint32
    enum:
      - 1 # Register triggered waveform memory(RTWM) mode, the pattern
          # assigned to the PS_SEQ_ID played as much times as PS_SEQ_LOOP
      - 2 # Edge triggered waveform memory(ETWM) mode, external GPI(N)
          # control are required to enable/disable and it needs to keep
          # device enabled by sending magnitude (X > 0),
          # the pattern is assigned to the GPI(N)_SEQUENCE_ID below
    default: 1
    description:
      Haptic operation mode for FF_PERIODIC.
      The default value is 1 for both of the operation modes.
      For more details, please see the datasheet

  dlg,nom-microvolt:
    minimum: 0
    maximum: 6000000
    description:
      Nominal actuator voltage rating

  dlg,abs-max-microvolt:
    minimum: 0
    maximum: 6000000
    description:
      Absolute actuator maximum voltage rating

  dlg,imax-microamp:
    minimum: 0
    maximum: 252000
    default: 130000
    description:
      Actuator max current rating

  dlg,impd-micro-ohms:
    minimum: 0
    maximum: 1500000000
    description:
      Impedance of the actuator

  pwms:
    maxItems: 1

  dlg,ps-seq-id:
    $ref: /schemas/types.yaml#/definitions/uint32
    minimum: 0
    maximum: 15
    description:
      The PS_SEQ_ID(pattern ID in waveform memory inside chip)
      to play back when RTWM-MODE is enabled

  dlg,ps-seq-loop:
    $ref: /schemas/types.yaml#/definitions/uint32
    minimum: 0
    maximum: 15
    description:
      The PS_SEQ_LOOP, Number of times the pre-stored sequence pointed to by
      PS_SEQ_ID or GPI(N)_SEQUENCE_ID is repeated

  dlg,gpi0-seq-id:
    $ref: /schemas/types.yaml#/definitions/uint32
    minimum: 0
    maximum: 15
    description:
      the GPI0_SEQUENCE_ID, pattern to play when gpi0 is triggered

  dlg,gpi1-seq-id:
    $ref: /schemas/types.yaml#/definitions/uint32
    minimum: 0
    maximum: 15
    description:
      the GPI1_SEQUENCE_ID, pattern to play when gpi1 is triggered

  dlg,gpi2-seq-id:
    $ref: /schemas/types.yaml#/definitions/uint32
    minimum: 0
    maximum: 15
    description:
      the GPI2_SEQUENCE_ID, pattern to play when gpi2 is triggered

  dlg,gpi0-mode:
    enum:
      - Single-pattern
      - Multi-pattern
    description:
      Pattern mode for gpi0

  dlg,gpi1-mode:
    enum:
      - Single-pattern
      - Multi-pattern
    description:
      Pattern mode for gpi1

  dlg,gpi2-mode:
    enum:
      - Single-pattern
      - Multi-pattern
    description:
      Pattern mode for gpi2

  dlg,gpi0-polarity:
    enum:
      - Rising-edge
      - Falling-edge
      - Both-edge
    description:
      gpi0 polarity, Haptic will work by this edge option in case of ETWM mode

  dlg,gpi1-polarity:
    enum:
      - Rising-edge
      - Falling-edge
      - Both-edge
    description:
      gpi1 polarity, Haptic will work by this edge option in case of ETWM mode

  dlg,gpi2-polarity:
    enum:
      - Rising-edge
      - Falling-edge
      - Both-edge
    description:
      gpi2 polarity, Haptic will work by this edge option in case of ETWM mode

  dlg,resonant-freq-hz:
    minimum: 50
    maximum: 300
    default: 205

  dlg,bemf-sens-enable:
    $ref: /schemas/types.yaml#/definitions/flag
    description:
      Enable for internal loop computations

  dlg,freq-track-enable:
    $ref: /schemas/types.yaml#/definitions/flag
    description:
      Enable for resonant frequency tracking

  dlg,acc-enable:
    $ref: /schemas/types.yaml#/definitions/flag
    description:
      Enable for active acceleration

  dlg,rapid-stop-enable:
    $ref: /schemas/types.yaml#/definitions/flag
    description:
      Enable for rapid stop

  dlg,amp-pid-enable:
    $ref: /schemas/types.yaml#/definitions/flag
    description:
      Enable for the amplitude PID

  dlg,mem-array:
    $ref: /schemas/types.yaml#/definitions/uint32-array
    minItems: 100
    description:
      Customized waveform memory (patterns) data downloaded to the device during initialization.
      Each entry value must be included between 0 and 255.

required:
  - compatible
  - reg
  - interrupts
  - dlg,actuator-type
  - dlg,const-op-mode
  - dlg,periodic-op-mode
  - dlg,nom-microvolt
  - dlg,abs-max-microvolt
  - dlg,imax-microamp
  - dlg,impd-micro-ohms

additionalProperties: false

examples:
  - |
    #include <dt-bindings/gpio/gpio.h>
    #include <dt-bindings/interrupt-controller/irq.h>

    i2c {
        #address-cells = <1>;
        #size-cells = <0>;

        haptics@4a {
            compatible = "dlg,da7280";
            reg = <0x4a>;
            interrupt-parent = <&gpio6>;
            interrupts = <11 IRQ_TYPE_LEVEL_LOW>;
            dlg,actuator-type = "LRA";
            dlg,const-op-mode = <1>;
            dlg,periodic-op-mode = <1>;
            dlg,nom-microvolt = <2000000>;
            dlg,abs-max-microvolt = <2000000>;
            dlg,imax-microamp = <170000>;
            dlg,resonant-freq-hz = <180>;
            dlg,impd-micro-ohms = <10500000>;
            dlg,freq-track-enable;
            dlg,rapid-stop-enable;
            dlg,mem-array = <0x00 0x00 0x00 0x00 0x00 0x00 0x00 0x00 0x00 0x00
                             0x00 0x00 0x00 0x00 0x00 0x00 0x00 0x00 0x00 0x00
                             0x00 0x00 0x00 0x00 0x00 0x00 0x00 0x00 0x00 0x00
                             0x00 0x00 0x00 0x00 0x00 0x00 0x00 0x00 0x00 0x00
                             0x00 0x00 0x00 0x00 0x00 0x00 0x00 0x00 0x00 0x00
                             0x00 0x00 0x00 0x00 0x00 0x00 0x00 0x00 0x00 0x00
                             0x00 0x00 0x00 0x00 0x00 0x00 0x00 0x00 0x00 0x00
                             0x00 0x00 0x00 0x00 0x00 0x00 0x00 0x00 0x00 0x00
                             0x00 0x00 0x00 0x00 0x00 0x00 0x00 0x00 0x00 0x00
                             0x00 0x00 0x00 0x00 0x00 0x00 0x00 0x00 0x00 0x00>;
        };
    };
```
