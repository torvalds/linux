## Documentation/devicetree/bindings/input/atmel,captouch.txt
```
Device tree bindings for Atmel capacitive touch device, typically
an Atmel touch sensor connected to AtmegaXX MCU running firmware
based on Qtouch library.

The node for this device must be a child of a I2C controller node, as the
device communicates via I2C.

Required properties:

	compatible:	Must be "atmel,captouch".
	reg:		The I2C slave address of the device.
	interrupts:	Property describing the interrupt line the device
			is connected to. The device only has one interrupt
			source.
	linux,keycodes:	Specifies an array of numeric keycode values to
			be used for reporting button presses. The array can
			contain up to 8 entries.

Optional properties:

	autorepeat:	Enables the Linux input system's autorepeat
			feature on the input device.

Example:

	atmel-captouch@51 {
		compatible = "atmel,captouch";
		reg = <0x51>;
		interrupt-parent = <&tlmm>;
		interrupts = <67 IRQ_TYPE_EDGE_FALLING>;
		linux,keycodes = <BTN_0>, <BTN_1>,
			<BTN_2>, <BTN_3>,
			<BTN_4>, <BTN_5>,
			<BTN_6>, <BTN_7>;
		autorepeat;
	};
```

## Documentation/devicetree/bindings/input/atmel,captouch.yaml
```yaml
# SPDX-License-Identifier: (GPL-2.0-only OR BSD-2-Clause)
%YAML 1.2
---
$id: http://devicetree.org/schemas/input/atmel,captouch.yaml#
$schema: http://devicetree.org/meta-schemas/core.yaml#

title: Atmel capacitive touch device

maintainers:
  - Dharma balasubiramani <dharma.b@microchip.com>

description:
  Atmel capacitive touch device, typically an Atmel touch sensor connected to
  AtmegaXX MCU running firmware based on Qtouch library.

allOf:
  - $ref: input.yaml#

properties:
  compatible:
    const: atmel,captouch

  reg:
    maxItems: 1

  interrupts:
    maxItems: 1

  linux,keycodes:
    minItems: 1
    maxItems: 8

required:
  - compatible
  - reg
  - interrupts
  - linux,keycodes

unevaluatedProperties: false

examples:
  - |
    #include <dt-bindings/interrupt-controller/irq.h>
    #include <dt-bindings/input/linux-event-codes.h>
    i2c {
      #address-cells = <1>;
      #size-cells = <0>;
      touch@51 {
        compatible = "atmel,captouch";
        reg = <0x51>;
        interrupt-parent = <&tlmm>;
        interrupts = <67 IRQ_TYPE_EDGE_FALLING>;
        linux,keycodes = <BTN_0>, <BTN_1>,
                         <BTN_2>, <BTN_3>,
                         <BTN_4>, <BTN_5>,
                         <BTN_6>, <BTN_7>;
        autorepeat;
      };
    };
```

## Documentation/devicetree/bindings/input/atmel,maxtouch.txt
```
Atmel maXTouch touchscreen/touchpad

Required properties:
- compatible:
    atmel,maxtouch

    The following compatibles have been used in various products but are
    deprecated:
	atmel,qt602240_ts
	atmel,atmel_mxt_ts
	atmel,atmel_mxt_tp
	atmel,mXT224

- reg: The I2C address of the device

- interrupts: The sink for the touchpad's IRQ output
    See ../interrupt-controller/interrupts.txt

Optional properties for main touchpad device:

- linux,gpio-keymap: When enabled, the SPT_GPIOPWN_T19 object sends messages
    on GPIO bit changes. An array of up to 8 entries can be provided
    indicating the Linux keycode mapped to each bit of the status byte,
    starting at the LSB. Linux keycodes are defined in
    <dt-bindings/input/input.h>.

    Note: the numbering of the GPIOs and the bit they start at varies between
    maXTouch devices. You must either refer to the documentation, or
    experiment to determine which bit corresponds to which input. Use
    KEY_RESERVED for unused padding values.

- reset-gpios: GPIO specifier for the touchscreen's reset pin (active low)

Example:

	touch@4b {
		compatible = "atmel,maxtouch";
		reg = <0x4b>;
		interrupt-parent = <&gpio>;
		interrupts = <TEGRA_GPIO(W, 3) IRQ_TYPE_LEVEL_LOW>;
	};
```

## Documentation/devicetree/bindings/input/atmel,maxtouch.yaml
```yaml
# SPDX-License-Identifier: (GPL-2.0-only OR BSD-2-Clause)
%YAML 1.2
---
$id: http://devicetree.org/schemas/input/atmel,maxtouch.yaml#
$schema: http://devicetree.org/meta-schemas/core.yaml#

title: Atmel maXTouch touchscreen/touchpad

maintainers:
  - Nick Dyer <nick@shmanahar.org>
  - Linus Walleij <linus.walleij@linaro.org>

description: |
  Atmel maXTouch touchscreen or touchpads such as the mXT244
  and similar devices.

allOf:
  - $ref: input.yaml#
  - $ref: touchscreen/touchscreen.yaml#

properties:
  compatible:
    const: atmel,maxtouch

  reg:
    maxItems: 1

  interrupts:
    maxItems: 1

  vdda-supply:
    description:
      Optional regulator for the AVDD analog voltage.

  vdd-supply:
    description:
      Optional regulator for the VDD digital voltage.

  reset-gpios:
    maxItems: 1
    description:
      Optional GPIO specifier for the touchscreen's reset pin
      (active low). The line must be flagged with
      GPIO_ACTIVE_LOW.

  wake-gpios:
    maxItems: 1
    description:
      Optional GPIO specifier for the touchscreen's wake pin
      (active low). The line must be flagged with
      GPIO_ACTIVE_LOW.

  linux,gpio-keymap:
    $ref: /schemas/types.yaml#/definitions/uint32-array
    description: |
      When enabled, the SPT_GPIOPWN_T19 object sends messages
      on GPIO bit changes. An array of up to 8 entries can be provided
      indicating the Linux keycode mapped to each bit of the status byte,
      starting at the LSB. Linux keycodes are defined in
      <dt-bindings/input/input.h>.

      Note: the numbering of the GPIOs and the bit they start at varies
      between maXTouch devices. You must either refer to the documentation,
      or experiment to determine which bit corresponds to which input. Use
      KEY_RESERVED for unused padding values.

  linux,keycodes:
    minItems: 1
    maxItems: 8

  atmel,wakeup-method:
    $ref: /schemas/types.yaml#/definitions/uint32
    description: |
      The WAKE line is an active-low input that is used to wake up the touch
      controller from deep-sleep mode before communication with the controller
      could be started. This optional feature used to minimize current
      consumption when the controller is in deep sleep mode. This feature is
      relevant only to some controller families, like mXT1386 controller for
      example.

      The WAKE pin can be connected in one of the following ways:
       1) left permanently low
       2) connected to the I2C-compatible SCL pin
       3) connected to a GPIO pin on the host
    enum:
      - 0 # ATMEL_MXT_WAKEUP_NONE
      - 1 # ATMEL_MXT_WAKEUP_I2C_SCL
      - 2 # ATMEL_MXT_WAKEUP_GPIO
    default: 0

  wakeup-source:
    type: boolean

required:
  - compatible
  - reg
  - interrupts

unevaluatedProperties: false

examples:
  - |
    #include <dt-bindings/interrupt-controller/irq.h>
    #include <dt-bindings/input/atmel-maxtouch.h>
    #include <dt-bindings/gpio/gpio.h>
    i2c {
      #address-cells = <1>;
      #size-cells = <0>;
      touchscreen@4a {
        compatible = "atmel,maxtouch";
        reg = <0x4a>;
        interrupt-parent = <&gpio>;
        interrupts = <26 IRQ_TYPE_EDGE_FALLING>;
        reset-gpios = <&gpio 27 GPIO_ACTIVE_LOW>;
        vdda-supply = <&ab8500_ldo_aux2_reg>;
        vdd-supply = <&ab8500_ldo_aux5_reg>;
        atmel,wakeup-method = <ATMEL_MXT_WAKEUP_I2C_SCL>;
      };
    };

...
```

## Documentation/devicetree/bindings/input/awinic,aw86927.yaml
```yaml
# SPDX-License-Identifier: (GPL-2.0-only OR BSD-2-Clause)
%YAML 1.2
---
$id: http://devicetree.org/schemas/input/awinic,aw86927.yaml#
$schema: http://devicetree.org/meta-schemas/core.yaml#

title: Awinic AW86927 LRA Haptic IC

maintainers:
  - Griffin Kroah-Hartman <griffin.kroah@fairphone.com>

properties:
  compatible:
    const: awinic,aw86927

  reg:
    maxItems: 1

  reset-gpios:
    maxItems: 1

  interrupts:
    maxItems: 1

required:
  - compatible
  - reg
  - reset-gpios
  - interrupts

additionalProperties: false

examples:
  - |
    #include <dt-bindings/gpio/gpio.h>
    #include <dt-bindings/interrupt-controller/irq.h>

    i2c {
        #address-cells = <1>;
        #size-cells = <0>;

        vibrator@5a {
            compatible = "awinic,aw86927";
            reg = <0x5a>;
            interrupts-extended = <&tlmm 101 IRQ_TYPE_EDGE_FALLING>;
            reset-gpios = <&tlmm 100 GPIO_ACTIVE_LOW>;
        };
    };
```
