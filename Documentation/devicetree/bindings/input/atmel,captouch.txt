## Documentation/devicetree/bindings/input/brcm,bcm-keypad.txt
```
* Broadcom Keypad Controller device tree bindings

Broadcom Keypad controller is used to interface a SoC with a matrix-type
keypad device. The keypad controller supports multiple row and column lines.
A key can be placed at each intersection of a unique row and a unique column.
The keypad controller can sense a key-press and key-release and report the
event using a interrupt to the cpu.

This binding is based on the matrix-keymap binding with the following
changes:

keypad,num-rows and keypad,num-columns are required.

Required SoC Specific Properties:
- compatible: should be "brcm,bcm-keypad"

- reg: physical base address of the controller and length of memory mapped
  region.

- interrupts: The interrupt number to the cpu.

Board Specific Properties:
- keypad,num-rows: Number of row lines connected to the keypad
  controller.

- keypad,num-columns: Number of column lines connected to the
  keypad controller.

- col-debounce-filter-period: The debounce period for the Column filter.

	KEYPAD_DEBOUNCE_1_ms	=	0
	KEYPAD_DEBOUNCE_2_ms	=	1
	KEYPAD_DEBOUNCE_4_ms	=	2
	KEYPAD_DEBOUNCE_8_ms	=	3
	KEYPAD_DEBOUNCE_16_ms	=	4
	KEYPAD_DEBOUNCE_32_ms	=	5
	KEYPAD_DEBOUNCE_64_ms	=	6
	KEYPAD_DEBOUNCE_128_ms	=	7

- status-debounce-filter-period: The debounce period for the Status filter.

	KEYPAD_DEBOUNCE_1_ms	=	0
	KEYPAD_DEBOUNCE_2_ms	=	1
	KEYPAD_DEBOUNCE_4_ms	=	2
	KEYPAD_DEBOUNCE_8_ms	=	3
	KEYPAD_DEBOUNCE_16_ms	=	4
	KEYPAD_DEBOUNCE_32_ms	=	5
	KEYPAD_DEBOUNCE_64_ms	=	6
	KEYPAD_DEBOUNCE_128_ms	=	7

- row-output-enabled: An optional property indicating whether the row or
  column is being used as output. If specified the row is being used
  as the output. Else defaults to column.

- pull-up-enabled: An optional property indicating the Keypad scan mode.
  If specified implies the keypad scan pull-up has been enabled.

- autorepeat: Boolean, Enable auto repeat feature of Linux input
	  subsystem (optional).

- linux,keymap: The keymap for keys as described in the binding document
  devicetree/bindings/input/matrix-keymap.txt.

Example:
#include "dt-bindings/input/input.h"

/ {
	keypad: keypad@180ac000 {
		/* Required SoC specific properties */
		compatible = "brcm,bcm-keypad";

		/* Required Board specific properties */
		keypad,num-rows = <5>;
		keypad,num-columns = <5>;
		status = "okay";

		linux,keymap = <MATRIX_KEY(0x00, 0x02, KEY_F) /* key_forward */
		MATRIX_KEY(0x00, 0x03, KEY_HOME) /* key_home */
		MATRIX_KEY(0x00, 0x04, KEY_M) /* key_message */
		MATRIX_KEY(0x01, 0x00, KEY_A) /* key_contacts */
		MATRIX_KEY(0x01, 0x01, KEY_1) /* key_1 */
		MATRIX_KEY(0x01, 0x02, KEY_2) /* key_2 */
		MATRIX_KEY(0x01, 0x03, KEY_3) /* key_3 */
		MATRIX_KEY(0x01, 0x04, KEY_S) /* key_speaker */
		MATRIX_KEY(0x02, 0x00, KEY_P) /* key_phone */
		MATRIX_KEY(0x02, 0x01, KEY_4) /* key_4 */
		MATRIX_KEY(0x02, 0x02, KEY_5) /* key_5 */
		MATRIX_KEY(0x02, 0x03, KEY_6) /* key_6 */
		MATRIX_KEY(0x02, 0x04, KEY_VOLUMEUP) /* key_vol_up */
		MATRIX_KEY(0x03, 0x00, KEY_C) /* key_call_log */
		MATRIX_KEY(0x03, 0x01, KEY_7) /* key_7 */
		MATRIX_KEY(0x03, 0x02, KEY_8) /* key_8 */
		MATRIX_KEY(0x03, 0x03, KEY_9) /* key_9 */
		MATRIX_KEY(0x03, 0x04, KEY_VOLUMEDOWN) /* key_vol_down */
		MATRIX_KEY(0x04, 0x00, KEY_H) /* key_headset */
		MATRIX_KEY(0x04, 0x01, KEY_KPASTERISK) /* key_* */
		MATRIX_KEY(0x04, 0x02, KEY_0) /* key_0 */
		MATRIX_KEY(0x04, 0x03, KEY_GRAVE) /* key_# */
		MATRIX_KEY(0x04, 0x04, KEY_MUTE) /* key_mute */
		>;

		/* Optional board specific properties */
		col-debounce-filter-period = <5>;
		row-output-enabled;
		pull-up-enabled;

	};
};
```

## Documentation/devicetree/bindings/input/cap1106.txt
```
Device tree bindings for Microchip CAP1106, 6 channel capacitive touch sensor

The node for this driver must be a child of a I2C controller node, as the
device communication via I2C only.

Required properties:

	compatible:		Must be "microchip,cap1106"

	reg:			The I2C slave address of the device.
				Only 0x28 is valid.

	interrupts:		Property describing the interrupt line the
				device's ALERT#/CM_IRQ# pin is connected to.
				The device only has one interrupt source.

Optional properties:

	autorepeat:		Enables the Linux input system's autorepeat
				feature on the input device.

	microchip,sensor-gain:	Defines the gain of the sensor circuitry. This
				effectively controls the sensitivity, as a
				smaller delta capacitance is required to
				generate the same delta count values.
				Valid values are 1, 2, 4, and 8.
				By default, a gain of 1 is set.

	linux,keycodes:		Specifies an array of numeric keycode values to
				be used for the channels. If this property is
				omitted, KEY_A, KEY_B, etc are used as
				defaults. The array must have exactly six
				entries.

Example:

i2c_controller {
	cap1106@28 {
		compatible = "microchip,cap1106";
		interrupt-parent = <&gpio1>;
		interrupts = <0 0>;
		reg = <0x28>;
		autorepeat;
		microchip,sensor-gain = <2>;

		linux,keycodes = <103		/* KEY_UP */
				  106		/* KEY_RIGHT */
				  108		/* KEY_DOWN */
				  105		/* KEY_LEFT */
				  109		/* KEY_PAGEDOWN */
				  104>;		/* KEY_PAGEUP */
	};
}
```

## Documentation/devicetree/bindings/input/cap11xx.txt
```
Device tree bindings for Microchip CAP11xx based capacitive touch sensors

The node for this device must be a child of a I2C controller node, as the
device communication via I2C only.

Required properties:

	compatible:		Must contain one of:
					"microchip,cap1106"
					"microchip,cap1126"
					"microchip,cap1188"

	reg:			The I2C slave address of the device.

	interrupts:		Property describing the interrupt line the
				device's ALERT#/CM_IRQ# pin is connected to.
				The device only has one interrupt source.

Optional properties:

	autorepeat:		Enables the Linux input system's autorepeat
				feature on the input device.

	microchip,sensor-gain:	Defines the gain of the sensor circuitry. This
				effectively controls the sensitivity, as a
				smaller delta capacitance is required to
				generate the same delta count values.
				Valid values are 1, 2, 4, and 8.
				By default, a gain of 1 is set.

	microchip,irq-active-high:	By default the interrupt pin is active low
				open drain. This property allows using the active
				high push-pull output.

	linux,keycodes:		Specifies an array of numeric keycode values to
				be used for the channels. If this property is
				omitted, KEY_A, KEY_B, etc are used as
				defaults. The array must have exactly six
				entries.

Example:

i2c_controller {
	cap1106@28 {
		compatible = "microchip,cap1106";
		interrupt-parent = <&gpio1>;
		interrupts = <0 0>;
		reg = <0x28>;
		autorepeat;
		microchip,sensor-gain = <2>;

		linux,keycodes = <103>,		/* KEY_UP */
				 <106>,		/* KEY_RIGHT */
				 <108>,		/* KEY_DOWN */
				 <105>,		/* KEY_LEFT */
				 <109>,		/* KEY_PAGEDOWN */
				 <104>;		/* KEY_PAGEUP */

		#address-cells = <1>;
		#size-cells = <0>;

		usr@0 {
			label = "cap11xx:green:usr0";
			reg = <0>;
		};

		usr@1 {
			label = "cap11xx:green:usr1";
			reg = <1>;
		};

		alive@2 {
			label = "cap11xx:green:alive";
			reg = <2>;
			linux,default_trigger = "heartbeat";
		};
	};
}
```

## Documentation/devicetree/bindings/input/cirrus,cs40l50.yaml
```yaml
# SPDX-License-Identifier: GPL-2.0-only OR BSD-2-Clause
%YAML 1.2
---
$id: http://devicetree.org/schemas/input/cirrus,cs40l50.yaml#
$schema: http://devicetree.org/meta-schemas/core.yaml#

title: Cirrus Logic CS40L50 Advanced Haptic Driver

maintainers:
  - James Ogletree <jogletre@opensource.cirrus.com>

description:
  CS40L50 is a haptic driver with waveform memory,
  integrated DSP, and closed-loop algorithms.

properties:
  compatible:
    enum:
      - cirrus,cs40l50

  reg:
    maxItems: 1

  interrupts:
    maxItems: 1

  reset-gpios:
    maxItems: 1

  vdd-a-supply:
    description: Power supply for internal analog circuits.

  vdd-p-supply:
    description: Power supply for always-on circuits.

  vdd-io-supply:
    description: Power supply for digital input/output.

  vdd-b-supply:
    description: Power supply for the boost converter.

required:
  - compatible
  - reg
  - interrupts
  - reset-gpios
  - vdd-io-supply

additionalProperties: false

examples:
  - |
    #include <dt-bindings/gpio/gpio.h>
    #include <dt-bindings/interrupt-controller/irq.h>

    i2c {
      #address-cells = <1>;
      #size-cells = <0>;

      haptic-driver@34 {
        compatible = "cirrus,cs40l50";
        reg = <0x34>;
        interrupt-parent = <&gpio>;
        interrupts = <113 IRQ_TYPE_LEVEL_LOW>;
        reset-gpios = <&gpio 112 GPIO_ACTIVE_LOW>;
        vdd-io-supply = <&vreg>;
      };
    };
```

## Documentation/devicetree/bindings/input/cirrus,ep9307-keypad.yaml
```yaml
# SPDX-License-Identifier: (GPL-2.0-only OR BSD-2-Clause)
%YAML 1.2
---
$id: http://devicetree.org/schemas/input/cirrus,ep9307-keypad.yaml#
$schema: http://devicetree.org/meta-schemas/core.yaml#

title: Cirrus ep93xx keypad

maintainers:
  - Alexander Sverdlin <alexander.sverdlin@gmail.com>

allOf:
  - $ref: /schemas/input/matrix-keymap.yaml#

description:
  The KPP is designed to interface with a keypad matrix with 2-point contact
  or 3-point contact keys. The KPP is designed to simplify the software task
  of scanning a keypad matrix. The KPP is capable of detecting, debouncing,
  and decoding one or multiple keys pressed simultaneously on a keypad.

properties:
  compatible:
    oneOf:
      - const: cirrus,ep9307-keypad
      - items:
          - enum:
              - cirrus,ep9312-keypad
              - cirrus,ep9315-keypad
          - const: cirrus,ep9307-keypad

  reg:
    maxItems: 1

  interrupts:
    maxItems: 1

  clocks:
    maxItems: 1

  debounce-delay-ms:
    description: |
          Time in microseconds that key must be pressed or
          released for state change interrupt to trigger.

  cirrus,prescale:
    description: row/column counter pre-scaler load value
    $ref: /schemas/types.yaml#/definitions/uint16
    maximum: 1023

required:
  - compatible
  - reg
  - interrupts
  - clocks
  - linux,keymap

unevaluatedProperties: false

examples:
  - |
    #include <dt-bindings/input/input.h>
    #include <dt-bindings/clock/cirrus,ep9301-syscon.h>
    keypad@800f0000 {
        compatible = "cirrus,ep9307-keypad";
        reg = <0x800f0000 0x0c>;
        interrupt-parent = <&vic0>;
        interrupts = <29>;
        clocks = <&eclk EP93XX_CLK_KEYPAD>;
        pinctrl-names = "default";
        pinctrl-0 = <&keypad_default_pins>;
        linux,keymap = <KEY_UP>,
                       <KEY_DOWN>,
                       <KEY_VOLUMEDOWN>,
                       <KEY_HOME>,
                       <KEY_RIGHT>,
                       <KEY_LEFT>,
                       <KEY_ENTER>,
                       <KEY_VOLUMEUP>,
                       <KEY_F6>,
                       <KEY_F8>,
                       <KEY_F9>,
                       <KEY_F10>,
                       <KEY_F1>,
                       <KEY_F2>,
                       <KEY_F3>,
                       <KEY_POWER>;
    };
```

## Documentation/devicetree/bindings/input/clps711x-keypad.txt
```
* Cirrus Logic CLPS711X matrix keypad device tree bindings

Required Properties:
- compatible:    Shall contain "cirrus,clps711x-keypad".
- row-gpios:     List of GPIOs used as row lines.
- poll-interval: Poll interval time in milliseconds.
- linux,keymap:  The definition can be found at
                 bindings/input/matrix-keymap.txt.

Optional Properties:
- autorepeat:    Enable autorepeat feature.

Example:
	keypad {
		compatible = "cirrus,ep7312-keypad", "cirrus,clps711x-keypad";
		autorepeat;
		poll-interval = <120>;
		row-gpios = <&porta 0 0>,
			    <&porta 1 0>;

		linux,keymap = <
			MATRIX_KEY(0, 0, KEY_UP)
			MATRIX_KEY(0, 1, KEY_DOWN)
			MATRIX_KEY(1, 0, KEY_LEFT)
			MATRIX_KEY(1, 1, KEY_RIGHT)
		>;
	};
```

## Documentation/devicetree/bindings/input/cpcap-pwrbutton.txt
```
Motorola CPCAP on key

This module is part of the CPCAP. For more details about the whole
chip see Documentation/devicetree/bindings/mfd/motorola-cpcap.txt.

This module provides a simple power button event via an Interrupt.

Required properties:
- compatible: should be one of the following
   - "motorola,cpcap-pwrbutton"
- interrupts: irq specifier for CPCAP's ON IRQ

Example:

&cpcap {
	cpcap_pwrbutton: pwrbutton {
		compatible = "motorola,cpcap-pwrbutton";
		interrupts = <23 IRQ_TYPE_NONE>;
	};
};
```

## Documentation/devicetree/bindings/input/cypress,cyapa.txt
```
Cypress I2C Touchpad

Required properties:
- compatible: must be "cypress,cyapa".
- reg: I2C address of the chip.
- interrupt-parent: a phandle for the interrupt controller (see interrupt
	binding[0]).
- interrupts: interrupt to which the chip is connected (see interrupt
	binding[0]).

Optional properties:
- wakeup-source: touchpad can be used as a wakeup source.
- pinctrl-names: should be "default" (see pinctrl binding [1]).
- pinctrl-0: a phandle pointing to the pin settings for the device (see
	pinctrl binding [1]).
- vcc-supply: a phandle for the regulator supplying 3.3V power.

[0]: Documentation/devicetree/bindings/interrupt-controller/interrupts.txt
[1]: Documentation/devicetree/bindings/pinctrl/pinctrl-bindings.txt

Example:
	&i2c0 {
		/* ... */

		/* Cypress Gen3 touchpad */
		touchpad@67 {
			compatible = "cypress,cyapa";
			reg = <0x67>;
			interrupt-parent = <&gpio>;
			interrupts = <2 IRQ_TYPE_EDGE_FALLING>;	/* GPIO 2 */
			wakeup-source;
		};

		/* Cypress Gen5 and later touchpad */
		touchpad@24 {
			compatible = "cypress,cyapa";
			reg = <0x24>;
			interrupt-parent = <&gpio>;
			interrupts = <2 IRQ_TYPE_EDGE_FALLING>;	/* GPIO 2 */
			wakeup-source;
		};

		/* ... */
	};
```

## Documentation/devicetree/bindings/input/cypress,cyapa.yaml
```yaml
# SPDX-License-Identifier: GPL-2.0-only OR BSD-2-Clause
%YAML 1.2
---
$id: http://devicetree.org/schemas/input/cypress,cyapa.yaml#
$schema: http://devicetree.org/meta-schemas/core.yaml#

title: Cypress All Points Addressable (APA) I2C Touchpad / Trackpad

maintainers:
  - Krzysztof Kozlowski <krzysztof.kozlowski@linaro.org>

properties:
  compatible:
    const: cypress,cyapa

  reg:
    maxItems: 1

  interrupts:
    maxItems: 1

  wakeup-source: true

  vcc-supply:
    description: 3.3V power

required:
  - compatible
  - reg
  - interrupts

additionalProperties: false

examples:
  - |
    #include <dt-bindings/interrupt-controller/irq.h>

    i2c {
        #address-cells = <1>;
        #size-cells = <0>;

        trackpad@67 {
            reg = <0x67>;
            compatible = "cypress,cyapa";
            interrupts = <2 IRQ_TYPE_EDGE_FALLING>;
            interrupt-parent = <&gpx1>;
            wakeup-source;
        };
    };
```

## Documentation/devicetree/bindings/input/cypress,tm2-touchkey.txt
```
Samsung tm2-touchkey

Required properties:
- compatible:
    * "cypress,tm2-touchkey" - for the touchkey found on the tm2 board
    * "cypress,midas-touchkey" - for the touchkey found on midas boards
    * "cypress,aries-touchkey" - for the touchkey found on aries boards
    * "coreriver,tc360-touchkey" - for the Coreriver TouchCore 360 touchkey
- reg: I2C address of the chip.
- interrupts: interrupt to which the chip is connected (see interrupt
	binding[0]).
- vcc-supply : internal regulator output. 1.8V
- vdd-supply : power supply for IC 3.3V

Optional properties:
- linux,keycodes: array of keycodes (max 4), default KEY_PHONE and KEY_BACK

[0]: Documentation/devicetree/bindings/interrupt-controller/interrupts.txt

Example:
	&i2c0 {
		/* ... */

		touchkey@20 {
			compatible = "cypress,tm2-touchkey";
			reg = <0x20>;
			interrupt-parent = <&gpa3>;
			interrupts = <2 IRQ_TYPE_EDGE_FALLING>;
			vcc-supply=<&ldo32_reg>;
			vdd-supply=<&ldo33_reg>;
			linux,keycodes = <KEY_PHONE KEY_BACK>;
		};
	};
```
