## Documentation/devicetree/bindings/input/dlg,da9062-onkey.yaml
```yaml
# SPDX-License-Identifier: (GPL-2.0 OR BSD-2-Clause)
%YAML 1.2
---
$id: http://devicetree.org/schemas/input/dlg,da9062-onkey.yaml#
$schema: http://devicetree.org/meta-schemas/core.yaml#

title: Dialog DA9061/62/63 OnKey Module

maintainers:
  - Biju Das <biju.das.jz@bp.renesas.com>

description: |
  This module is part of the DA9061/DA9062/DA9063. For more details about entire
  DA906{1,2,3} chips see Documentation/devicetree/bindings/mfd/dlg,da9063.yaml

  This module provides the KEY_POWER event.

properties:
  compatible:
    oneOf:
      - enum:
          - dlg,da9062-onkey
          - dlg,da9063-onkey
      - items:
          - const: dlg,da9061-onkey
          - const: dlg,da9062-onkey

  dlg,disable-key-power:
    type: boolean
    description:
      Disable power-down using a long key-press. If this entry exists
      the OnKey driver will remove support for the KEY_POWER key press
      when triggered using a long press of the OnKey.

required:
  - compatible

additionalProperties: false
```

## Documentation/devicetree/bindings/input/dlink,dir685-touchkeys.txt
```
* D-Link DIR-685 Touchkeys

This is a I2C one-off touchkey controller based on the Cypress Semiconductor
CY8C214 MCU with some firmware in its internal 8KB flash. The circuit
board inside the router is named E119921.

The touchkey device node should be placed inside an I2C bus node.

Required properties:
- compatible: must be "dlink,dir685-touchkeys"
- reg: the I2C address of the touchkeys
- interrupts: reference to the interrupt number

Example:

touchkeys@26 {
	compatible = "dlink,dir685-touchkeys";
	reg = <0x26>;
	interrupt-parent = <&gpio0>;
	interrupts = <17 IRQ_TYPE_EDGE_FALLING>;
};
```

## Documentation/devicetree/bindings/input/e3x0-button.txt
```
National Instruments Ettus Research USRP E3x0 button driver

This module is part of the NI Ettus Research USRP E3x0 SDR.

This module provides a simple power button event via two interrupts.

Required properties:
- compatible: should be one of the following
  - "ettus,e3x0-button": For devices such as the NI Ettus Research USRP E3x0
- interrupts: should be one of the following
  - <0 30 1>, <0 31 1>: For devices such as the NI Ettus Research USRP E3x0
- interrupt-names: should be one of the following
  - "press", "release": For devices such as the NI Ettus Research USRP E3x0

Note: Interrupt numbers might vary depending on the FPGA configuration.

Example:
	button {
		compatible = "ettus,e3x0-button";
		interrupt-parent = <&intc>;
		interrupts = <0 30 1>, <0 31 1>;
		interrupt-names = "press", "release";
	}
```

## Documentation/devicetree/bindings/input/elan,ekth3000.yaml
```yaml
# SPDX-License-Identifier: (GPL-2.0-only or BSD-2-Clause)
%YAML 1.2
---
$id: http://devicetree.org/schemas/input/elan,ekth3000.yaml#
$schema: http://devicetree.org/meta-schemas/core.yaml#

title: Elantech I2C Touchpad

maintainers:
  - Dmitry Torokhov <dmitry.torokhov@gmail.com>

allOf:
  - $ref: touchscreen/touchscreen.yaml#

properties:
  compatible:
    const: elan,ekth3000

  reg:
    maxItems: 1

  interrupts:
    maxItems: 1

  wakeup-source:
    type: boolean
    description: touchpad can be used as a wakeup source

  vcc-supply:
    description: a phandle for the regulator supplying 3.3V power

  elan,trackpoint:
    type: boolean
    description: touchpad can support a trackpoint

  elan,clickpad:
    type: boolean
    description: touchpad is a clickpad (the entire surface is a button)

  elan,middle-button:
    type: boolean
    description: touchpad has a physical middle button

  elan,x_traces:
    $ref: /schemas/types.yaml#/definitions/uint32
    description: number of antennas on the x axis

  elan,y_traces:
    $ref: /schemas/types.yaml#/definitions/uint32
    description: number of antennas on the y axis

  touchscreen-size-x: true

  touchscreen-size-y: true

  touchscreen-x-mm: true

  touchscreen-y-mm: true

required:
  - compatible
  - reg
  - interrupts

additionalProperties: false

examples:
  - |
    #include <dt-bindings/interrupt-controller/irq.h>
    i2c {
        #address-cells = <1>;
        #size-cells = <0>;

        touchpad@15 {
            compatible = "elan,ekth3000";
            reg = <0x15>;
            interrupt-parent = <&gpio4>;
            interrupts = <0x0 IRQ_TYPE_EDGE_FALLING>;
            wakeup-source;
        };
    };
```
