## Documentation/devicetree/bindings/input/nvidia,tegra20-kbc.txt
```
* Tegra keyboard controller
The key controller has maximum 24 pins to make matrix keypad. Any pin
can be configured as row or column. The maximum column pin can be 8
and maximum row pins can be 16 for Tegra20/Tegra30.

Required properties:
- compatible: "nvidia,tegra20-kbc"
- reg: Register base address of KBC.
- interrupts: Interrupt number for the KBC.
- nvidia,kbc-row-pins: The KBC pins which are configured as row. This is an
  array of pin numbers which is used as rows.
- nvidia,kbc-col-pins: The KBC pins which are configured as column. This is an
  array of pin numbers which is used as column.
- linux,keymap: The keymap for keys as described in the binding document
  devicetree/bindings/input/matrix-keymap.txt.
- clocks: Must contain one entry, for the module clock.
  See ../clocks/clock-bindings.txt for details.
- resets: Must contain an entry for each entry in reset-names.
  See ../reset/reset.txt for details.
- reset-names: Must include the following entries:
  - kbc

Optional properties, in addition to those specified by the shared
matrix-keyboard bindings:

- linux,fn-keymap: a second keymap, same specification as the
  matrix-keyboard-controller spec but to be used when the KEY_FN modifier
  key is pressed.
- nvidia,debounce-delay-ms: delay in milliseconds per row scan for debouncing
- nvidia,repeat-delay-ms: delay in milliseconds before repeat starts
- nvidia,ghost-filter: enable ghost filtering for this device
- nvidia,wakeup-source: configure keyboard as a wakeup source for suspend/resume

Example:

keyboard: keyboard {
	compatible = "nvidia,tegra20-kbc";
	reg = <0x7000e200 0x100>;
	interrupts = <0 85 0x04>;
	clocks = <&tegra_car 36>;
	resets = <&tegra_car 36>;
	reset-names = "kbc";
	nvidia,ghost-filter;
	nvidia,debounce-delay-ms = <640>;
	nvidia,kbc-row-pins = <0 1 2>;    /* pin 0, 1, 2 as rows */
	nvidia,kbc-col-pins = <11 12 13>; /* pin 11, 12, 13 as columns */
	linux,keymap = <0x00000074
			0x00010067
			0x00020066
			0x01010068
			0x02000069
			0x02010070
			0x02020071>;
};
```

## Documentation/devicetree/bindings/input/nxp,lpc3220-key.yaml
```yaml
# SPDX-License-Identifier: (GPL-2.0-only OR BSD-2-Clause)
%YAML 1.2
---
$id: http://devicetree.org/schemas/input/nxp,lpc3220-key.yaml#
$schema: http://devicetree.org/meta-schemas/core.yaml#

title: NXP LPC32xx Key Scan Interface

maintainers:
  - Frank Li <Frank.Li@nxp.com>

properties:
  compatible:
    const: nxp,lpc3220-key

  reg:
    maxItems: 1

  interrupts:
    maxItems: 1

  clocks:
    maxItems: 1

  nxp,debounce-delay-ms:
    description: Debounce delay in ms

  nxp,scan-delay-ms:
    description: Repeated scan period in ms

required:
  - compatible
  - reg
  - interrupts
  - clocks
  - nxp,debounce-delay-ms
  - nxp,scan-delay-ms
  - linux,keymap

allOf:
  - $ref: matrix-keymap.yaml#

unevaluatedProperties: false

examples:
  - |
    #include <dt-bindings/interrupt-controller/irq.h>
    #include <dt-bindings/clock/lpc32xx-clock.h>

    key@40050000 {
        compatible = "nxp,lpc3220-key";
        reg = <0x40050000 0x1000>;
        clocks = <&clk LPC32XX_CLK_KEY>;
        interrupt-parent = <&sic1>;
        interrupts = <22 IRQ_TYPE_LEVEL_HIGH>;
        keypad,num-rows = <1>;
        keypad,num-columns = <1>;
        nxp,debounce-delay-ms = <3>;
        nxp,scan-delay-ms = <34>;
        linux,keymap = <0x00000002>;
    };
```

## Documentation/devicetree/bindings/input/omap-keypad.txt
```
* TI's Keypad Controller device tree bindings

TI's Keypad controller is used to interface a SoC with a matrix-type
keypad device. The keypad controller supports multiple row and column lines.
A key can be placed at each intersection of a unique row and a unique column.
The keypad controller can sense a key-press and key-release and report the
event using a interrupt to the cpu.

Required SoC Specific Properties:
- compatible: should be one of the following
   - "ti,omap4-keypad": For controllers compatible with omap4 keypad
      controller.

Required Board Specific Properties, in addition to those specified by
the shared matrix-keyboard bindings:
- keypad,num-rows: Number of row lines connected to the keypad
  controller.

- keypad,num-columns: Number of column lines connected to the
  keypad controller.

Optional Properties specific to linux:
- linux,keypad-no-autorepeat: do no enable autorepeat feature.

Example:
	keypad@4ae1c000{
		compatible = "ti,omap4-keypad";
		keypad,num-rows = <2>;
		keypad,num-columns = <8>;
		linux,keypad-no-autorepeat;
	};
```

## Documentation/devicetree/bindings/input/pine64,pinephone-keyboard.yaml
```yaml
# SPDX-License-Identifier: (GPL-2.0-only OR BSD-2-Clause)
%YAML 1.2
---
$id: http://devicetree.org/schemas/input/pine64,pinephone-keyboard.yaml#
$schema: http://devicetree.org/meta-schemas/core.yaml#

title: Pine64 PinePhone keyboard

maintainers:
  - Samuel Holland <samuel@sholland.org>

description:
  A keyboard accessory is available for the Pine64 PinePhone and PinePhone Pro.
  It connects via I2C, providing a raw scan matrix, a flashing interface, and a
  subordinate I2C bus for communication with a battery charger IC.

properties:
  compatible:
    const: pine64,pinephone-keyboard

  reg:
    const: 0x15

  interrupts:
    maxItems: 1

  vbat-supply:
    description: Supply for the keyboard MCU

  wakeup-source: true

  i2c:
    $ref: /schemas/i2c/i2c-controller.yaml#

required:
  - compatible
  - reg
  - interrupts

additionalProperties: false

examples:
  - |
    #include <dt-bindings/input/input.h>
    #include <dt-bindings/interrupt-controller/irq.h>

    i2c {
      #address-cells = <1>;
      #size-cells = <0>;

      keyboard@15 {
        compatible = "pine64,pinephone-keyboard";
        reg = <0x15>;
        interrupt-parent = <&r_pio>;
        interrupts = <0 12 IRQ_TYPE_EDGE_FALLING>; /* PL12 */

        i2c {
          #address-cells = <1>;
          #size-cells = <0>;

          charger@75 {
            reg = <0x75>;
          };
        };
      };
    };
```

## Documentation/devicetree/bindings/input/ps2keyb-mouse-apbps2.txt
```
Aeroflex Gaisler APBPS2 PS/2 Core, supporting Keyboard or Mouse.

The APBPS2 PS/2 core is available in the GRLIB VHDL IP core library.

Note: In the ordinary environment for the APBPS2 core, a LEON SPARC system,
these properties are built from information in the AMBA plug&play and from
bootloader settings.

Required properties:

- name : Should be "GAISLER_APBPS2" or "01_060"
- reg : Address and length of the register set for the device
- interrupts : Interrupt numbers for this device

For further information look in the documentation for the GLIB IP core library:
http://www.gaisler.com/products/grlib/grip.pdf
```

## Documentation/devicetree/bindings/input/pwm-beeper.txt
```
* PWM beeper device tree bindings

Registers a PWM device as beeper.

Required properties:
- compatible: should be "pwm-beeper"
- pwms: phandle to the physical PWM device

Optional properties:
- amp-supply: phandle to a regulator that acts as an amplifier for the beeper
- beeper-hz:  bell frequency in Hz

Example:

beeper_amp: amplifier {
	compatible = "fixed-regulator";
	gpios = <&gpio0 1 GPIO_ACTIVE_HIGH>;
};

beeper {
	compatible = "pwm-beeper";
	pwms = <&pwm0>;
	amp-supply = <&beeper_amp>;
};
```

## Documentation/devicetree/bindings/input/pwm-beeper.yaml
```yaml
# SPDX-License-Identifier: (GPL-2.0-only OR BSD-2-Clause)
%YAML 1.2
---
$id: http://devicetree.org/schemas/input/pwm-beeper.yaml#
$schema: http://devicetree.org/meta-schemas/core.yaml#

title: PWM beeper

maintainers:
  - Sascha Hauer <s.hauer@pengutronix.de>

properties:
  compatible:
    const: pwm-beeper

  pwms:
    maxItems: 1

  amp-supply:
    description: an amplifier for the beeper

  beeper-hz:
    description: bell frequency in Hz
    minimum: 10
    maximum: 10000

required:
  - compatible
  - pwms

unevaluatedProperties: false

examples:
  - |
    #include <dt-bindings/gpio/gpio.h>
    beeper {
        compatible = "pwm-beeper";
        pwms = <&pwm0>;
        amp-supply = <&beeper_amp>;
        beeper-hz = <1000>;
    };
```

## Documentation/devicetree/bindings/input/pwm-vibrator.txt
```
* PWM vibrator device tree bindings

Registers a PWM device as vibrator. It is expected, that the vibrator's
strength increases based on the duty cycle of the enable PWM channel
(100% duty cycle meaning strongest vibration, 0% meaning no vibration).

The binding supports an optional direction PWM channel, that can be
driven at fixed duty cycle. If available this is can be used to increase
the vibration effect of some devices.

Required properties:
- compatible: should contain "pwm-vibrator"
- pwm-names: Should contain "enable" and optionally "direction"
- pwms: Should contain a PWM handle for each entry in pwm-names

Optional properties:
- vcc-supply: Phandle for the regulator supplying power
- direction-duty-cycle-ns: Duty cycle of the direction PWM channel in
                           nanoseconds, defaults to 50% of the channel's
			   period.

Example from Motorola Droid 4:

&omap4_pmx_core {
	vibrator_direction_pin: pinmux_vibrator_direction_pin {
		pinctrl-single,pins = <
		OMAP4_IOPAD(0x1ce, PIN_OUTPUT | MUX_MODE1) /* dmtimer8_pwm_evt (gpio_27) */
		>;
	};

	vibrator_enable_pin: pinmux_vibrator_enable_pin {
		pinctrl-single,pins = <
		OMAP4_IOPAD(0X1d0, PIN_OUTPUT | MUX_MODE1) /* dmtimer9_pwm_evt (gpio_28) */
		>;
	};
};

/ {
	pwm8: dmtimer-pwm {
		pinctrl-names = "default";
		pinctrl-0 = <&vibrator_direction_pin>;

		compatible = "ti,omap-dmtimer-pwm";
		#pwm-cells = <3>;
		ti,timers = <&timer8>;
		ti,clock-source = <0x01>;
	};

	pwm9: dmtimer-pwm {
		pinctrl-names = "default";
		pinctrl-0 = <&vibrator_enable_pin>;

		compatible = "ti,omap-dmtimer-pwm";
		#pwm-cells = <3>;
		ti,timers = <&timer9>;
		ti,clock-source = <0x01>;
	};

	vibrator {
		compatible = "pwm-vibrator";
		pwms = <&pwm8 0 1000000000 0>,
		       <&pwm9 0 1000000000 0>;
		pwm-names = "enable", "direction";
		direction-duty-cycle-ns = <1000000000>;
	};
};
```

## Documentation/devicetree/bindings/input/pwm-vibrator.yaml
```yaml
# SPDX-License-Identifier: (GPL-2.0-only OR BSD-2-Clause)
%YAML 1.2
---
$id: http://devicetree.org/schemas/input/pwm-vibrator.yaml#
$schema: http://devicetree.org/meta-schemas/core.yaml#

title: PWM vibrator

maintainers:
  - Sebastian Reichel <sre@kernel.org>

description: >
  Registers a PWM device as vibrator. It is expected, that the vibrator's
  strength increases based on the duty cycle of the enable PWM channel
  (100% duty cycle meaning strongest vibration, 0% meaning no vibration).

  The binding supports an optional direction PWM channel, that can be
  driven at fixed duty cycle. If available this is can be used to increase
  the vibration effect of some devices.

properties:
  compatible:
    const: pwm-vibrator

  pwm-names:
    items:
      - const: enable
      - const: direction
    minItems: 1

  pwms:
    minItems: 1
    maxItems: 2

  vcc-supply: true

  direction-duty-cycle-ns:
    description: >
      Duty cycle of the direction PWM channel in nanoseconds,
      defaults to 50% of the channel's period.

required:
  - compatible
  - pwm-names
  - pwms

additionalProperties: false

examples:
  - |
    vibrator {
        compatible = "pwm-vibrator";
        pwms = <&pwm9 0 1000000000 0>,
               <&pwm8 0 1000000000 0>;
        pwm-names = "enable", "direction";
        direction-duty-cycle-ns = <1000000000>;
    };
```

## Documentation/devicetree/bindings/input/pxa27x-keypad.txt
```
* Marvell PXA Keypad controller

Required Properties
- compatible : should be "marvell,pxa27x-keypad"
- reg : Address and length of the register set for the device
- interrupts : The interrupt for the keypad controller
- marvell,debounce-interval : How long time the key will be
  recognized when it is pressed. It is a u32 value, and bit[31:16]
  is debounce interval for direct key and bit[15:0] is debounce
  interval for matrix key. The value is in binary number of 2ms

Optional Properties For Matrix Keyes
Please refer to matrix-keymap.txt

Optional Properties for Direct Keyes
- marvell,direct-key-count : How many direct keyes are used.
- marvell,direct-key-mask : The mask indicates which keyes
  are used. If bit[X] of the mask is set, the direct key X
  is used.
- marvell,direct-key-low-active : Direct key status register
  tells the level of pins that connects to the direct keyes.
  When this property is set, it means that when the pin level
  is low, the key is pressed(active).
- marvell,direct-key-map : It is a u16 array. Each item indicates
  the linux key-code for the direct key.

Optional Properties For Rotary
- marvell,rotary0 : It is a u32 value. Bit[31:16] is the
  linux key-code for rotary up. Bit[15:0] is the linux key-code
  for rotary down. It is for rotary 0.
- marvell,rotary1 : Same as marvell,rotary0. It is for rotary 1.
- marvell,rotary-rel-key : When rotary is used for relative axes
  in the device, the value indicates the key-code for relative
  axes measurement in the device. It is a u32 value. Bit[31:16]
  is for rotary 1, and Bit[15:0] is for rotary 0.

Examples:
	keypad: keypad@d4012000 {
		keypad,num-rows = <3>;
		keypad,num-columns = <5>;
		linux,keymap = <0x0000000e	/* KEY_BACKSPACE */
				0x0001006b	/* KEY_END */
				0x00020061	/* KEY_RIGHTCTRL */
				0x0003000b	/* KEY_0 */
				0x00040002	/* KEY_1 */
				0x0100008b	/* KEY_MENU */
				0x01010066	/* KEY_HOME */
				0x010200e7	/* KEY_SEND */
				0x01030009	/* KEY_8 */
				0x0104000a	/* KEY_9 */
				0x02000160	/* KEY_OK */
				0x02010003	/* KEY_2 */
				0x02020004	/* KEY_3 */
				0x02030005	/* KEY_4 */
				0x02040006>;	/* KEY_5 */
		marvell,rotary0 = <0x006c0067>;	/* KEY_UP & KEY_DOWN */
		marvell,direct-key-count = <1>;
		marvell,direct-key-map = <0x001c>;
		marvell,debounce-interval = <0x001e001e>;
	};
```
