## Documentation/devicetree/bindings/input/qcom,pm8921-keypad.yaml
```yaml
# SPDX-License-Identifier: (GPL-2.0 OR BSD-2-Clause)
%YAML 1.2
---
$id: http://devicetree.org/schemas/input/qcom,pm8921-keypad.yaml#
$schema: http://devicetree.org/meta-schemas/core.yaml#

title: Qualcomm PM8921 PMIC KeyPad

maintainers:
  - Dmitry Baryshkov <dmitry.baryshkov@linaro.org>

allOf:
  - $ref: input.yaml#
  - $ref: matrix-keymap.yaml#

properties:
  compatible:
    enum:
      - qcom,pm8058-keypad
      - qcom,pm8921-keypad

  reg:
    maxItems: 1

  interrupts:
    items:
      - description: key sense
      - description: key stuck

  wakeup-source:
    type: boolean
    description: use any event on keypad as wakeup event

  linux,keypad-wakeup:
    type: boolean
    deprecated: true
    description: legacy version of the wakeup-source property

  debounce:
    description:
      Time in microseconds that key must be pressed or
      released for state change interrupt to trigger.
    $ref: /schemas/types.yaml#/definitions/uint32

  scan-delay:
    $ref: /schemas/types.yaml#/definitions/uint32
    description: time in microseconds to pause between successive scans of the
      matrix array

  row-hold:
    $ref: /schemas/types.yaml#/definitions/uint32
    description: time in nanoseconds to pause between scans of each row in the
      matrix array.

required:
  - compatible
  - reg
  - interrupts
  - linux,keymap

unevaluatedProperties: false

examples:
  - |
   #include <dt-bindings/input/input.h>
   #include <dt-bindings/interrupt-controller/irq.h>
   pmic {
       #address-cells = <1>;
       #size-cells = <0>;

       keypad@148 {
           compatible = "qcom,pm8921-keypad";
           reg = <0x148>;
           interrupt-parent = <&pmicintc>;
           interrupts = <74 IRQ_TYPE_EDGE_RISING>, <75 IRQ_TYPE_EDGE_RISING>;
           linux,keymap = <
               MATRIX_KEY(0, 0, KEY_VOLUMEUP)
               MATRIX_KEY(0, 1, KEY_VOLUMEDOWN)
               MATRIX_KEY(0, 2, KEY_CAMERA_FOCUS)
               MATRIX_KEY(0, 3, KEY_CAMERA)
           >;
           keypad,num-rows = <1>;
           keypad,num-columns = <5>;
           debounce = <15>;
           scan-delay = <32>;
           row-hold = <91500>;
       };
   };
...
```

## Documentation/devicetree/bindings/input/qcom,pm8921-pwrkey.yaml
```yaml
# SPDX-License-Identifier: (GPL-2.0 OR BSD-2-Clause)
%YAML 1.2
---
$id: http://devicetree.org/schemas/input/qcom,pm8921-pwrkey.yaml#
$schema: http://devicetree.org/meta-schemas/core.yaml#

title: Qualcomm PM8921 PMIC Power Key

maintainers:
  - Bjorn Andersson <andersson@kernel.org>

allOf:
  - $ref: input.yaml#

properties:
  compatible:
    oneOf:
      - enum:
          - qcom,pm8921-pwrkey
          - qcom,pm8058-pwrkey
      - items:
          - enum:
              - qcom,pm8018-pwrkey
          - const: qcom,pm8921-pwrkey

  reg:
    maxItems: 1

  interrupts:
    items:
      - description: key release
      - description: key press

  debounce:
    description:
      Time in microseconds that key must be pressed or
      released for state change interrupt to trigger.
    $ref: /schemas/types.yaml#/definitions/uint32

  pull-up:
    description:
      Presence of this property indicates that the KPDPWR_N
      pin should be configured for pull up.
    $ref: /schemas/types.yaml#/definitions/flag

required:
  - compatible
  - reg
  - interrupts

unevaluatedProperties: false

examples:
  - |
    #include <dt-bindings/interrupt-controller/irq.h>
    ssbi {
        #address-cells = <1>;
        #size-cells = <0>;

        pmic@0 {
            reg = <0x0>;
            #address-cells = <1>;
            #size-cells = <0>;

            pwrkey@1c {
                compatible = "qcom,pm8921-pwrkey";
                reg = <0x1c>;
                interrupt-parent = <&pmicint>;
                interrupts = <50 IRQ_TYPE_EDGE_RISING>, <51 IRQ_TYPE_EDGE_RISING>;
                debounce = <15625>;
                pull-up;
            };
        };
    };
...
```

## Documentation/devicetree/bindings/input/qcom,pm8941-pwrkey.txt
```
Qualcomm PM8941 PMIC Power Key

PROPERTIES

- compatible:
	Usage: required
	Value type: <string>
	Definition: must be one of:
		    "qcom,pm8941-pwrkey"
		    "qcom,pm8941-resin"

- reg:
	Usage: required
	Value type: <prop-encoded-array>
	Definition: base address of registers for block

- interrupts:
	Usage: required
	Value type: <prop-encoded-array>
	Definition: key change interrupt; The format of the specifier is
		    defined by the binding document describing the node's
		    interrupt parent.

- debounce:
	Usage: optional
	Value type: <u32>
	Definition: time in microseconds that key must be pressed or released
		    for state change interrupt to trigger.

- bias-pull-up:
	Usage: optional
	Value type: <empty>
	Definition: presence of this property indicates that the KPDPWR_N pin
		    should be configured for pull up.

- linux,code:
	Usage: optional
	Value type: <u32>
	Definition: The input key-code associated with the power key.
		    Use the linux event codes defined in
		    include/dt-bindings/input/linux-event-codes.h
		    When property is omitted KEY_POWER is assumed.

EXAMPLE

	pwrkey@800 {
		compatible = "qcom,pm8941-pwrkey";
		reg = <0x800>;
		interrupts = <0x0 0x8 0 IRQ_TYPE_EDGE_BOTH>;
		debounce = <15625>;
		bias-pull-up;
		linux,code = <KEY_POWER>;
	};
```

## Documentation/devicetree/bindings/input/qcom,pm8941-pwrkey.yaml
```yaml
# SPDX-License-Identifier: (GPL-2.0 OR BSD-2-Clause)
%YAML 1.2
---
$id: http://devicetree.org/schemas/input/qcom,pm8941-pwrkey.yaml#
$schema: http://devicetree.org/meta-schemas/core.yaml#

title: Qualcomm PM8941 PMIC Power Key

maintainers:
  - Courtney Cavin <courtney.cavin@sonymobile.com>
  - Vinod Koul <vkoul@kernel.org>

allOf:
  - $ref: input.yaml#

properties:
  compatible:
    enum:
      - qcom,pm8941-pwrkey
      - qcom,pm8941-resin
      - qcom,pmk8350-pwrkey
      - qcom,pmk8350-resin

  interrupts:
    maxItems: 1

  debounce:
    description: |
          Time in microseconds that key must be pressed or
          released for state change interrupt to trigger.
    $ref: /schemas/types.yaml#/definitions/uint32

  bias-pull-up:
    description: |
           Presence of this property indicates that the KPDPWR_N
           pin should be configured for pull up.
    $ref: /schemas/types.yaml#/definitions/flag

  linux,code:
    description: |
           The input key-code associated with the power key.
           Use the linux event codes defined in
           include/dt-bindings/input/linux-event-codes.h
           When property is omitted KEY_POWER is assumed.

required:
  - compatible
  - interrupts

unevaluatedProperties: false
...
```

## Documentation/devicetree/bindings/input/qcom,pm8xxx-keypad.txt
```
Qualcomm PM8xxx PMIC Keypad

PROPERTIES

- compatible:
	Usage: required
	Value type: <string>
	Definition: must be one of:
		    "qcom,pm8058-keypad"
		    "qcom,pm8921-keypad"

- reg:
	Usage: required
	Value type: <prop-encoded-array>
	Definition: address of keypad control register

- interrupts:
	Usage: required
	Value type: <prop-encoded-array>
	Definition: the first interrupt specifies the key sense interrupt
		    and the second interrupt specifies the key stuck interrupt.
		    The format of the specifier is defined by the binding
		    document describing the node's interrupt parent.

- linux,keymap:
	Usage: required
	Value type: <prop-encoded-array>
	Definition: the linux keymap. More information can be found in
		    input/matrix-keymap.txt.

- linux,keypad-no-autorepeat:
	Usage: optional
	Value type: <bool>
	Definition: don't enable autorepeat feature.

- wakeup-source:
	Usage: optional
	Value type: <bool>
	Definition: use any event on keypad as wakeup event.

- keypad,num-rows:
	Usage: required
	Value type: <u32>
	Definition: number of rows in the keymap. More information can be found
		    in input/matrix-keymap.txt.

- keypad,num-columns:
	Usage: required
	Value type: <u32>
	Definition: number of columns in the keymap. More information can be
		    found in input/matrix-keymap.txt.

- debounce:
	Usage: optional
	Value type: <u32>
	Definition: time in microseconds that key must be pressed or release
		    for key sense interrupt to trigger.

- scan-delay:
	Usage: optional
	Value type: <u32>
	Definition: time in microseconds to pause between successive scans
		    of the matrix array.

- row-hold:
	Usage: optional
	Value type: <u32>
	Definition: time in nanoseconds to pause between scans of each row in
		    the matrix array.

EXAMPLE

	keypad@148 {
		compatible = "qcom,pm8921-keypad";
		reg = <0x148>;
		interrupt-parent = <&pmicintc>;
		interrupts = <74 1>, <75 1>;
		linux,keymap = <
			MATRIX_KEY(0, 0, KEY_VOLUMEUP)
			MATRIX_KEY(0, 1, KEY_VOLUMEDOWN)
			MATRIX_KEY(0, 2, KEY_CAMERA_FOCUS)
			MATRIX_KEY(0, 3, KEY_CAMERA)
			>;
		keypad,num-rows = <1>;
		keypad,num-columns = <5>;
		debounce = <15>;
		scan-delay = <32>;
		row-hold = <91500>;
	};
```

## Documentation/devicetree/bindings/input/qcom,pm8xxx-pwrkey.txt
```
Qualcomm PM8xxx PMIC Power Key

PROPERTIES

- compatible:
	Usage: required
	Value type: <string>
	Definition: must be one of:
		    "qcom,pm8058-pwrkey"
		    "qcom,pm8921-pwrkey"

- reg:
	Usage: required
	Value type: <prop-encoded-array>
	Definition: address of power key control register

- interrupts:
	Usage: required
	Value type: <prop-encoded-array>
	Definition: the first interrupt specifies the key release interrupt
		    and the second interrupt specifies the key press interrupt.
		    The format of the specifier is defined by the binding
		    document describing the node's interrupt parent.

- debounce:
	Usage: optional
	Value type: <u32>
	Definition: time in microseconds that key must be pressed or release
		    for state change interrupt to trigger.

- pull-up:
	Usage: optional
	Value type: <empty>
	Definition: presence of this property indicates that the KPDPWR_N pin
		    should be configured for pull up.

EXAMPLE

	pwrkey@1c {
		compatible = "qcom,pm8921-pwrkey";
		reg = <0x1c>;
		interrupt-parent = <&pmicintc>;
		interrupts = <50 1>, <51 1>;
		debounce = <15625>;
		pull-up;
	};
```

## Documentation/devicetree/bindings/input/qcom,pm8xxx-vib.txt
```
Qualcomm PM8xxx PMIC Vibrator

PROPERTIES

- compatible:
	Usage: required
	Value type: <string>
	Definition: must be one of:
		    "qcom,pm8058-vib"
		    "qcom,pm8921-vib"

- reg:
	Usage: required
	Value type: <prop-encoded-array>
	Definition: address of vibration control register

EXAMPLE

	vibrator@4a {
		compatible = "qcom,pm8058-vib";
		reg = <0x4a>;
	};
```

## Documentation/devicetree/bindings/input/qcom,pm8xxx-vib.yaml
```yaml
# SPDX-License-Identifier: (GPL-2.0 OR BSD-2-Clause)
%YAML 1.2
---
$id: http://devicetree.org/schemas/input/qcom,pm8xxx-vib.yaml#
$schema: http://devicetree.org/meta-schemas/core.yaml#

title: Qualcomm PM8xxx PMIC Vibrator

maintainers:
  - Bjorn Andersson <andersson@kernel.org>

properties:
  compatible:
    enum:
      - qcom,pm8058-vib
      - qcom,pm8916-vib
      - qcom,pm8921-vib

  reg:
    maxItems: 1

required:
  - compatible
  - reg

additionalProperties: false

examples:
  - |
    pmic {
        #address-cells = <1>;
        #size-cells = <0>;

        vibrator@4a {
            compatible = "qcom,pm8058-vib";
            reg = <0x4a>;
        };
    };
```

## Documentation/devicetree/bindings/input/raydium_i2c_ts.txt
```
Raydium I2C touchscreen

Required properties:
- compatible: must be "raydium,rm32380"
- reg: The I2C address of the device
- interrupts: interrupt to which the chip is connected
    See ../interrupt-controller/interrupts.txt
Optional properties:
- avdd-supply: analog power supply needed to power device
- vccio-supply: IO Power source
- reset-gpios: reset gpio the chip is connected to.

Example:
	touchscreen@39 {
		compatible = "raydium,rm32380";
		reg = <0x39>;
		interrupt-parent = <&gpio>;
		interrupts = <0x0 IRQ_TYPE_EDGE_FALLING>;
	};
```

## Documentation/devicetree/bindings/input/regulator-haptic.txt
```
* Regulator Haptic Device Tree Bindings

Required Properties:
 - compatible : Should be "regulator-haptic"
 - haptic-supply : Power supply to the haptic motor.
	[*] refer Documentation/devicetree/bindings/regulator/regulator.txt

 - max-microvolt : The maximum voltage value supplied to the haptic motor.
		[The unit of the voltage is a micro]

 - min-microvolt : The minimum voltage value supplied to the haptic motor.
		[The unit of the voltage is a micro]

Example:

	haptics {
		compatible = "regulator-haptic";
		haptic-supply = <&motor_regulator>;
		max-microvolt = <2700000>;
		min-microvolt = <1100000>;
	};
```

## Documentation/devicetree/bindings/input/regulator-haptic.yaml
```yaml
# SPDX-License-Identifier: GPL-2.0
%YAML 1.2
---
$id: "http://devicetree.org/schemas/input/regulator-haptic.yaml#"
$schema: "http://devicetree.org/meta-schemas/core.yaml#"

title: Regulator Haptic

maintainers:
  - Jaewon Kim <jaewon02.kim@samsung.com>

properties:
  compatible:
    const: regulator-haptic

  haptic-supply:
    description: >
      Power supply to the haptic motor

  max-microvolt:
    description: >
      The maximum voltage value supplied to the haptic motor

  min-microvolt:
    description: >
      The minimum voltage value supplied to the haptic motor

required:
  - compatible
  - haptic-supply
  - max-microvolt
  - min-microvolt

additionalProperties: false

examples:
  - |
    haptics {
        compatible = "regulator-haptic";
        haptic-supply = <&motor_regulator>;
        max-microvolt = <2700000>;
        min-microvolt = <1100000>;
    };
```

## Documentation/devicetree/bindings/input/rmi4/rmi_2d_sensor.txt
```
Synaptics RMI4 2D Sensor Device Binding

The Synaptics RMI4 core is able to support RMI4 devices using different
transports and different functions. This file describes the device tree
bindings for devices which contain 2D sensors using Function 11 or
Function 12. Complete documentation for transports and other functions
can be found in:
Documentation/devicetree/bindings/input/rmi4.

RMI4 Function 11 and Function 12 are for 2D touch position sensing.
Additional documentation for F11 can be found at:
http://www.synaptics.com/sites/default/files/511-000136-01-Rev-E-RMI4-Interfacing-Guide.pdf

Optional Touch Properties:
Description in Documentation/devicetree/bindings/input/touch
- touchscreen-inverted-x
- touchscreen-inverted-y
- touchscreen-swapped-x-y
- touchscreen-x-mm
- touchscreen-y-mm

Optional Properties:
- syna,clip-x-low: Sets a minimum value for X.
- syna,clip-y-low: Sets a minimum value for Y.
- syna,clip-x-high: Sets a maximum value for X.
- syna,clip-y-high: Sets a maximum value for Y.
- syna,offset-x: Add an offset to X.
- syna,offset-y: Add an offset to Y.
- syna,delta-x-threshold: Set the minimum distance on the X axis required
				to generate an interrupt in reduced reporting
				mode.
- syna,delta-y-threshold: Set the minimum distance on the Y axis required
				to generate an interrupt in reduced reporting
				mode.
- syna,sensor-type: Set the sensor type. 1 for touchscreen 2 for touchpad.
- syna,disable-report-mask: Mask for disabling posiiton reporting. Used to
				disable reporing absolute position data.
- syna,rezero-wait-ms: Time in miliseconds to wait after issuing a rezero
				command.


Example of a RMI4 I2C device with F11:
Example:
	&i2c1 {
		rmi4-i2c-dev@2c {
			compatible = "syna,rmi4-i2c";

			...

			rmi4-f11@11 {
				reg = <0x11>;
				touchscreen-inverted-y;
				syna,sensor-type = <2>;
			};
		};
	};
```
