## Documentation/devicetree/bindings/input/sun4i-lradc-keys.txt
```
Allwinner sun4i low res adc attached tablet keys
------------------------------------------------

Required properties:
 - compatible: "allwinner,sun4i-a10-lradc-keys"
 - reg: mmio address range of the chip
 - interrupts: interrupt to which the chip is connected
 - vref-supply: powersupply for the lradc reference voltage

Each key is represented as a sub-node of "allwinner,sun4i-a10-lradc-keys":

Required subnode-properties:
	- label: Descriptive name of the key.
	- linux,code: Keycode to emit.
	- channel: Channel this key is attached to, must be 0 or 1.
	- voltage: Voltage in µV at lradc input when this key is pressed.

Example:

#include <dt-bindings/input/input.h>

	lradc: lradc@1c22800 {
		compatible = "allwinner,sun4i-a10-lradc-keys";
		reg = <0x01c22800 0x100>;
		interrupts = <31>;
		vref-supply = <&reg_vcc3v0>;

		button@191 {
			label = "Volume Up";
			linux,code = <KEY_VOLUMEUP>;
			channel = <0>;
			voltage = <191274>;
		};

		button@392 {
			label = "Volume Down";
			linux,code = <KEY_VOLUMEDOWN>;
			channel = <0>;
			voltage = <392644>;
		};

		button@601 {
			label = "Menu";
			linux,code = <KEY_MENU>;
			channel = <0>;
			voltage = <601151>;
		};

		button@795 {
			label = "Enter";
			linux,code = <KEY_ENTER>;
			channel = <0>;
			voltage = <795090>;
		};

		button@987 {
			label = "Home";
			linux,code = <KEY_HOMEPAGE>;
			channel = <0>;
			voltage = <987387>;
		};
	};
```

## Documentation/devicetree/bindings/input/syna,rmi4.yaml
```yaml
# SPDX-License-Identifier: GPL-2.0-only OR BSD-2-Clause
%YAML 1.2
---
$id: http://devicetree.org/schemas/input/syna,rmi4.yaml#
$schema: http://devicetree.org/meta-schemas/core.yaml#

title: Synaptics RMI4 compliant devices

maintainers:
  - Jason A. Donenfeld <Jason@zx2c4.com>
  - Matthias Schiffer <matthias.schiffer@ew.tq-group.com
  - Vincent Huang <vincent.huang@tw.synaptics.com>

description: |
  The Synaptics RMI4 (Register Mapped Interface 4) core is able to support RMI4
  devices using different transports (I2C, SPI) and different functions (e.g.
  Function 1, 2D sensors using Function 11 or 12).

properties:
  compatible:
    enum:
      - syna,rmi4-i2c
      - syna,rmi4-spi

  reg:
    maxItems: 1

  '#address-cells':
    const: 1

  '#size-cells':
    const: 0

  interrupts:
    maxItems: 1

  reset-gpios:
    maxItems: 1
    description: Active low signal

  spi-cpha: true
  spi-cpol: true

  syna,reset-delay-ms:
    description:
      Delay to wait after resetting the device.

  syna,startup-delay-ms:
    description:
      Delay to wait after powering on the device.

  vdd-supply: true
  vio-supply: true

  rmi4-f01@1:
    type: object
    additionalProperties: false
    description:
      Function 1

    properties:
      reg:
        maxItems: 1

      syna,nosleep-mode:
        $ref: /schemas/types.yaml#/definitions/uint32
        enum: [0, 1, 2]
        description:
          If set the device will run at full power without sleeping.  nosleep
          has 3 modes, 0 will not change the default setting, 1 will disable
          nosleep (allow sleeping), and 2 will enable nosleep (disabling
          sleep).

      syna,wakeup-threshold:
        $ref: /schemas/types.yaml#/definitions/uint32
        description:
          Defines the amplitude of the disturbance to the background
          capacitance that will cause the device to wake from dozing.

      syna,doze-holdoff-ms:
        description:
          The delay to wait after the last finger lift and the first doze
          cycle.

      syna,doze-interval-ms:
        description:
          The time period that the device sleeps between finger activity.

    required:
      - reg

  rmi4-f1a@1a:
    type: object
    additionalProperties: false
    $ref: input.yaml#
    description:
      RMI4 Function 1A is for capacitive keys.

    properties:
      reg:
        maxItems: 1

      linux,keycodes:
        minItems: 1
        maxItems: 4

    required:
      - reg

patternProperties:
  "^rmi4-f1[12]@1[12]$":
    type: object
    unevaluatedProperties: false
    $ref: /schemas/input/touchscreen/touchscreen.yaml#
    description:
      RMI4 Function 11 and Function 12 are for 2D touch position sensing.

    properties:
      reg:
        maxItems: 1

      syna,clip-x-low:
        $ref: /schemas/types.yaml#/definitions/uint32
        description:
          Minimum value for X.

      syna,clip-y-low:
        $ref: /schemas/types.yaml#/definitions/uint32
        description:
          Minimum value for Y.

      syna,clip-x-high:
        $ref: /schemas/types.yaml#/definitions/uint32
        description:
          Maximum value for X.

      syna,clip-y-high:
        $ref: /schemas/types.yaml#/definitions/uint32
        description:
          Maximum value for Y.

      syna,offset-x:
        $ref: /schemas/types.yaml#/definitions/uint32
        description:
          Add an offset to X.

      syna,offset-y:
        $ref: /schemas/types.yaml#/definitions/uint32
        description:
          Add an offset to Y.

      syna,delta-x-threshold:
        $ref: /schemas/types.yaml#/definitions/uint32
        description:
          Minimum distance on the X axis required to generate an interrupt in
          reduced reporting mode.

      syna,delta-y-threshold:
        $ref: /schemas/types.yaml#/definitions/uint32
        description:
          Minimum distance on the Y axis required to generate an interrupt in
          reduced reporting mode.

      syna,sensor-type:
        $ref: /schemas/types.yaml#/definitions/uint32
        enum: [1, 2]
        description: |
          Sensor type: 1 for touchscreen 2 for touchpad.

      syna,disable-report-mask:
        $ref: /schemas/types.yaml#/definitions/uint32
        description:
          Mask for disabling posiiton reporting. Used to disable reporing
          absolute position data.

      syna,rezero-wait-ms:
        description:
          Time to wait after issuing a rezero command.

    required:
      - reg

  "^rmi4-f[0-9a-f]+@[0-9a-f]+$":
    type: object
    additionalProperties: true

    description:
      Other functions, not documented yet.

    properties:
      reg:
        maxItems: 1

    required:
      - reg

required:
  - compatible
  - reg

unevaluatedProperties: false

allOf:
  - $ref: /schemas/spi/spi-peripheral-props.yaml#

  - if:
      properties:
        compatible:
          contains:
            const: syna,rmi4-i2c
    then:
      properties:
        spi-rx-delay-us: false
        spi-tx-delay-us: false
    else:
      properties:
        syna,reset-delay-ms: false
        syna,startup-delay-ms: false

examples:
  - |
    #include <dt-bindings/input/linux-event-codes.h>
    #include <dt-bindings/interrupt-controller/irq.h>

    i2c {
        #address-cells = <1>;
        #size-cells = <0>;

        touchscreen@20 {
            compatible = "syna,rmi4-i2c";
            reg = <0x20>;
            interrupt-parent = <&gpx1>;
            interrupts = <6 IRQ_TYPE_EDGE_FALLING>;

            syna,startup-delay-ms = <100>;
            vdd-supply = <&tsp_vdd>;
            vio-supply = <&ldo32_reg>;

            pinctrl-0 = <&touch_irq>;
            pinctrl-names = "default";
            #address-cells = <1>;
            #size-cells = <0>;

            rmi4-f01@1 {
                reg = <0x1>;
                syna,nosleep-mode = <1>;
            };

            rmi4-f12@12 {
                reg = <0x12>;
                syna,sensor-type = <1>;
            };

            rmi4-f1a@1a {
                reg = <0x1a>;
                linux,keycodes = <KEY_BACK KEY_HOME KEY_MENU>;
            };
        };
    };

  - |
    #include <dt-bindings/interrupt-controller/irq.h>

    spi {
        #address-cells = <1>;
        #size-cells = <0>;

        touchscreen@0 {
            compatible = "syna,rmi4-spi";
            reg = <0x0>;
            interrupt-parent = <&gpx1>;
            interrupts = <6 IRQ_TYPE_EDGE_FALLING>;

            spi-max-frequency = <4000000>;
            spi-rx-delay-us = <30>;
            spi-cpha;
            spi-cpol;

            #address-cells = <1>;
            #size-cells = <0>;

            rmi4-f01@1 {
                reg = <0x1>;
                syna,nosleep-mode = <1>;
            };

            rmi4-f11@11 {
                reg = <0x11>;
                touchscreen-inverted-y;
                syna,sensor-type = <2>;
            };
        };
    };
```

## Documentation/devicetree/bindings/input/tca8418_keypad.txt
```
This binding is based on the matrix-keymap binding with the following
changes:

keypad,num-rows and keypad,num-columns are required.

Required properties:
- compatible: "ti,tca8418"
- reg: the I2C address
- interrupts: IRQ line number, should trigger on falling edge
- linux,keymap: Keys definitions, see keypad-matrix.
```

## Documentation/devicetree/bindings/input/tegra-kbc.txt
```
* Tegra keyboard controller

Required properties:
- compatible: "nvidia,tegra20-kbc"

Optional properties, in addition to those specified by the shared
matrix-keyboard bindings:

- linux,fn-keymap: a second keymap, same specification as the
  matrix-keyboard-controller spec but to be used when the KEY_FN modifier
  key is pressed.
- nvidia,debounce-delay-ms: delay in milliseconds per row scan for debouncing
- nvidia,repeat-delay-ms: delay in milliseconds before repeat starts
- nvidia,ghost-filter: enable ghost filtering for this device
- nvidia,wakeup-source: configure keyboard as a wakeup source for suspend/resume

Example:

keyboard: keyboard {
	compatible = "nvidia,tegra20-kbc";
	reg = <0x7000e200 0x100>;
	nvidia,ghost-filter;
};
```

## Documentation/devicetree/bindings/input/ti,drv260x.txt
```
* Texas Instruments - drv260x Haptics driver family

Required properties:
	- compatible - One of:
		"ti,drv2604" - DRV2604
		"ti,drv2605" - DRV2605
		"ti,drv2605l" - DRV2605L
	- reg -  I2C slave address
	- vbat-supply - Required supply regulator
	- mode - Power up mode of the chip (defined in include/dt-bindings/input/ti-drv260x.h)
		DRV260X_LRA_MODE - Linear Resonance Actuator mode (Piezoelectric)
		DRV260X_LRA_NO_CAL_MODE - This is a LRA Mode but there is no calibration
				sequence during init.  And the device is configured for real
				time playback mode (RTP mode).
		DRV260X_ERM_MODE - Eccentric Rotating Mass mode (Rotary vibrator)
	- library-sel - These are ROM based waveforms pre-programmed into the IC.
				This should be set to set the library to use at power up.
				(defined in include/dt-bindings/input/ti-drv260x.h)
		DRV260X_LIB_EMPTY - Do not use a pre-programmed library
		DRV260X_ERM_LIB_A - Pre-programmed Library
		DRV260X_ERM_LIB_B - Pre-programmed Library
		DRV260X_ERM_LIB_C - Pre-programmed Library
		DRV260X_ERM_LIB_D - Pre-programmed Library
		DRV260X_ERM_LIB_E - Pre-programmed Library
		DRV260X_ERM_LIB_F - Pre-programmed Library
		DRV260X_LIB_LRA - Pre-programmed LRA Library

Optional properties:
	- enable-gpio - gpio pin to enable/disable the device.
	- vib-rated-mv - The rated voltage of the actuator in millivolts.
			  If this is not set then the value will be defaulted to
			  3.2 v.
	- vib-overdrive-mv - The overdrive voltage of the actuator in millivolts.
			  If this is not set then the value will be defaulted to
			  3.2 v.
Example:

haptics: haptics@5a {
	compatible = "ti,drv2605l";
	reg = <0x5a>;
	vbat-supply = <&vbat>;
	enable-gpio = <&gpio1 28 GPIO_ACTIVE_HIGH>;
	mode = <DRV260X_LRA_MODE>;
	library-sel = <DRV260X_LIB_LRA>;
	vib-rated-mv = <3200>;
	vib-overdriver-mv = <3200>;
}

For more product information please see the link below:
http://www.ti.com/product/drv2605
```

## Documentation/devicetree/bindings/input/ti,drv260x.yaml
```yaml
# SPDX-License-Identifier: (GPL-2.0 OR BSD-2-Clause)
%YAML 1.2
---
$id: http://devicetree.org/schemas/input/ti,drv260x.yaml#
$schema: http://devicetree.org/meta-schemas/core.yaml#

title: Texas Instruments - drv260x Haptics driver family

maintainers:
  - Andrew Davis <afd@ti.com>

properties:
  compatible:
    enum:
      - ti,drv2604
      - ti,drv2605
      - ti,drv2605l

  reg:
    maxItems: 1

  vbat-supply:
    description: Power supply to the haptic motor

  # TODO: Deprecate 'mode' in favor of differently named property
  mode:
    $ref: /schemas/types.yaml#/definitions/uint32
    description: |
      Power up mode of the chip
      (defined in include/dt-bindings/input/ti-drv260x.h)

      DRV260X_LRA_MODE
        Linear Resonance Actuator mode (Piezoelectric)

      DRV260X_LRA_NO_CAL_MODE
        This is a LRA Mode but there is no calibration sequence during init.
        And the device is configured for real time playback mode (RTP mode).

      DRV260X_ERM_MODE
        Eccentric Rotating Mass mode (Rotary vibrator)
    enum: [ 0, 1, 2 ]

  library-sel:
    $ref: /schemas/types.yaml#/definitions/uint32
    description: |
      These are ROM based waveforms pre-programmed into the IC.
      This should be set to set the library to use at power up.
      (defined in include/dt-bindings/input/ti-drv260x.h)

      DRV260X_LIB_EMPTY - Do not use a pre-programmed library
      DRV260X_ERM_LIB_A - Pre-programmed Library
      DRV260X_ERM_LIB_B - Pre-programmed Library
      DRV260X_ERM_LIB_C - Pre-programmed Library
      DRV260X_ERM_LIB_D - Pre-programmed Library
      DRV260X_ERM_LIB_E - Pre-programmed Library
      DRV260X_ERM_LIB_F - Pre-programmed Library
      DRV260X_LIB_LRA - Pre-programmed LRA Library
    enum: [ 0, 1, 2, 3, 4, 5, 6, 7 ]

  enable-gpio:
    maxItems: 1
    deprecated: true

  enable-gpios:
    maxItems: 1

  vib-rated-mv:
    $ref: /schemas/types.yaml#/definitions/uint32
    description: |
      The rated voltage of the actuator in millivolts.
      If this is not set then the value will be defaulted to 3200 mV.
    default: 3200

  vib-overdrive-mv:
    $ref: /schemas/types.yaml#/definitions/uint32
    description: |
      The overdrive voltage of the actuator in millivolts.
      If this is not set then the value will be defaulted to 3200 mV.
    default: 3200

required:
  - compatible
  - reg
  - enable-gpios
  - mode
  - library-sel

additionalProperties: false

examples:
  - |
    #include <dt-bindings/gpio/gpio.h>
    #include <dt-bindings/input/ti-drv260x.h>

    i2c {
        #address-cells = <1>;
        #size-cells = <0>;

        haptics@5a {
            compatible = "ti,drv2605l";
            reg = <0x5a>;
            vbat-supply = <&vbat>;
            enable-gpios = <&gpio1 28 GPIO_ACTIVE_HIGH>;
            mode = <DRV260X_LRA_MODE>;
            library-sel = <DRV260X_LIB_LRA>;
            vib-rated-mv = <3200>;
            vib-overdrive-mv = <3200>;
        };
    };
```

## Documentation/devicetree/bindings/input/ti,drv2665.txt
```
* Texas Instruments - drv2665 Haptics driver

Required properties:
	- compatible - "ti,drv2665" - DRV2665
	- reg -  I2C slave address
	- vbat-supply - Required supply regulator

Example:

haptics: haptics@59 {
	compatible = "ti,drv2665";
	reg = <0x59>;
	vbat-supply = <&vbat>;
};

For more product information please see the link below:
http://www.ti.com/product/drv2665
```

## Documentation/devicetree/bindings/input/ti,drv2667.txt
```
* Texas Instruments - drv2667 Haptics driver

Required properties:
	- compatible - "ti,drv2667" - DRV2667
	- reg -  I2C slave address
	- vbat-supply - Required supply regulator

Example:

haptics: haptics@59 {
	compatible = "ti,drv2667";
	reg = <0x59>;
	vbat-supply = <&vbat>;
};

For more product information please see the link below:
http://www.ti.com/product/drv2667
```
