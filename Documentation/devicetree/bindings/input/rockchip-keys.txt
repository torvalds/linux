## Documentation/devicetree/bindings/input/ti,drv266x.yaml
```yaml
# SPDX-License-Identifier: (GPL-2.0-only OR BSD-2-Clause)
%YAML 1.2
---
$id: http://devicetree.org/schemas/input/ti,drv266x.yaml#
$schema: http://devicetree.org/meta-schemas/core.yaml#

title: Texas Instruments - drv266x Haptics driver

description: |
  Product Page:
    http://www.ti.com/product/drv2665
    http://www.ti.com/product/drv2667

maintainers:
  - Anshul Dalal <anshulusr@gmail.com>

properties:
  compatible:
    enum:
      - ti,drv2665
      - ti,drv2667

  reg:
    maxItems: 1

  vbat-supply:
    description: Required supply regulator

required:
  - compatible
  - reg
  - vbat-supply

additionalProperties: false

examples:
  - |
    #include <dt-bindings/gpio/gpio.h>


    i2c {
        #address-cells = <1>;
        #size-cells = <0>;

        haptics@59 {
            compatible = "ti,drv2667";
            reg = <0x59>;
            vbat-supply = <&vbat>;
        };
    };
```

## Documentation/devicetree/bindings/input/ti,nspire-keypad.txt
```
TI-NSPIRE Keypad

Required properties:
- compatible: Compatible property value should be "ti,nspire-keypad".

- reg: Physical base address of the peripheral and length of memory mapped
  region.

- interrupts: The interrupt number for the peripheral.

- scan-interval: How often to scan in us. Based on a APB speed of 33MHz, the
	maximum and minimum delay time is ~2000us and ~500us respectively

- row-delay: How long to wait before scanning each row.

- clocks: The clock this peripheral is attached to.

- linux,keymap: The keymap to use
	(see Documentation/devicetree/bindings/input/matrix-keymap.txt)

Optional properties:
- active-low: Specify that the keypad is active low (i.e. logical low signifies
	a key press).

Example:

input {
	compatible = "ti,nspire-keypad";
	reg = <0x900E0000 0x1000>;
	interrupts = <16>;

	scan-interval = <1000>;
	row-delay = <200>;

	clocks = <&apb_pclk>;

	linux,keymap = <
	0x0000001c	0x0001001c	0x00040039
	0x0005002c	0x00060015	0x0007000b
	0x0008000f	0x0100002d	0x01010011
	0x0102002f	0x01030004	0x01040016
	0x01050014	0x0106001f	0x01070002
	0x010a006a	0x02000013	0x02010010
	0x02020019	0x02030007	0x02040018
	0x02050031	0x02060032	0x02070005
	0x02080028	0x0209006c	0x03000026
	0x03010025	0x03020024	0x0303000a
	0x03040017	0x03050023	0x03060022
	0x03070008	0x03080035	0x03090069
	0x04000021	0x04010012	0x04020020
	0x0404002e	0x04050030	0x0406001e
	0x0407000d	0x04080037	0x04090067
	0x05010038	0x0502000c	0x0503001b
	0x05040034	0x0505001a	0x05060006
	0x05080027	0x0509000e	0x050a006f
	0x0600002b	0x0602004e	0x06030068
	0x06040003	0x0605006d	0x06060009
	0x06070001	0x0609000f	0x0708002a
	0x0709001d	0x070a0033	>;
};
```

## Documentation/devicetree/bindings/input/ti,nspire-keypad.yaml
```yaml
# SPDX-License-Identifier: (GPL-2.0 OR BSD-2-Clause)
%YAML 1.2
---
$id: http://devicetree.org/schemas/input/ti,nspire-keypad.yaml#
$schema: http://devicetree.org/meta-schemas/core.yaml#

title: TI-NSPIRE Keypad

maintainers:
  - Andrew Davis <afd@ti.com>

allOf:
  - $ref: input.yaml#
  - $ref: matrix-keymap.yaml#

properties:
  compatible:
    enum:
      - ti,nspire-keypad

  reg:
    maxItems: 1

  interrupts:
    maxItems: 1

  clocks:
    maxItems: 1

  scan-interval:
    $ref: /schemas/types.yaml#/definitions/uint32
    description: How often to scan in us. Based on a APB speed of 33MHz, the
      maximum and minimum delay time is ~2000us and ~500us respectively

  row-delay:
    $ref: /schemas/types.yaml#/definitions/uint32
    description: How long to wait between scanning each row in us.

  active-low:
    description: Specify that the keypad is active low.

required:
  - compatible
  - reg
  - interrupts
  - clocks
  - scan-interval
  - row-delay
  - linux,keymap

unevaluatedProperties: false

examples:
  - |
    #include <dt-bindings/input/input.h>
    keypad@900e0000 {
        compatible = "ti,nspire-keypad";
        reg = <0x900e0000 0x1000>;
        interrupts = <16>;

        clocks = <&apb_pclk>;

        scan-interval = <1000>;
        row-delay = <200>;

        linux,keymap = <
            MATRIX_KEY(0,  0, KEY_ENTER)
            MATRIX_KEY(0,  1, KEY_ENTER)
            MATRIX_KEY(0,  4, KEY_SPACE)
            MATRIX_KEY(0,  5, KEY_Z)
            MATRIX_KEY(0,  6, KEY_Y)
            MATRIX_KEY(0,  7, KEY_0)
        >;
    };
```

## Documentation/devicetree/bindings/input/ti,palmas-pwrbutton.txt
```
Texas Instruments Palmas family power button module

This module is part of the Palmas family of PMICs. For more details
about the whole chip see:
Documentation/devicetree/bindings/mfd/palmas.txt.

This module provides a simple power button event via an Interrupt.

Required properties:
- compatible: should be one of the following
   - "ti,palmas-pwrbutton": For Palmas compatible power on button
- interrupt-parent: Parent interrupt device, must be handle of palmas node.
- interrupts: Interrupt number of power button submodule on device.

Optional Properties:

- ti,palmas-long-press-seconds: Duration in seconds which the power
  button should be kept pressed for Palmas to power off automatically.
  NOTE: This depends on OTP support and POWERHOLD signal configuration
  on platform. Valid values are 6, 8, 10 and 12.
- ti,palmas-pwron-debounce-milli-seconds: Duration in milliseconds
  which the power button should be kept pressed for Palmas to register
  a press for debouncing purposes. NOTE: This depends on specific
  Palmas variation capability. Valid values are 15, 100, 500 and 1000.

Example:

&palmas {
	palmas_pwr_button: pwrbutton {
		compatible = "ti,palmas-pwrbutton";
		interrupt-parent = <&tps659038>;
		interrupts = <1 IRQ_TYPE_EDGE_FALLING>;
		ti,palmas-long-press-seconds = <12>;
		ti,palmas-pwron-debounce-milli-seconds = <15>;
	};
};
```

## Documentation/devicetree/bindings/input/ti,tca8418.yaml
```yaml
# SPDX-License-Identifier: (GPL-2.0-only OR BSD-2-Clause)
%YAML 1.2
---
$id: http://devicetree.org/schemas/input/ti,tca8418.yaml#
$schema: http://devicetree.org/meta-schemas/core.yaml#

title: TI TCA8418 I2C/SMBus keypad scanner

maintainers:
  - Frank Li <Frank.Li@nxp.com>

properties:
  compatible:
    enum:
      - ti,tca8418

  reg:
    maxItems: 1

  interrupts:
    maxItems: 1

required:
  - compatible
  - reg
  - interrupts

allOf:
  - $ref: matrix-keymap.yaml#

unevaluatedProperties: false

examples:
  - |
    #include <dt-bindings/input/input.h>
    #include <dt-bindings/interrupt-controller/irq.h>

    i2c {
        #address-cells = <1>;
        #size-cells = <0>;

        keypad@34 {
            compatible = "ti,tca8418";
            reg = <0x34>;
            interrupt-parent = <&gpio5>;
            interrupts = <11 IRQ_TYPE_EDGE_FALLING>;
            keypad,num-rows = <4>;
            keypad,num-columns = <4>;
            linux,keymap = < MATRIX_KEY(0x00, 0x01, BTN_0)
                             MATRIX_KEY(0x00, 0x00, BTN_1)
                             MATRIX_KEY(0x01, 0x01, BTN_2)
                             MATRIX_KEY(0x01, 0x00, BTN_3)
                             MATRIX_KEY(0x02, 0x00, BTN_4)
                             MATRIX_KEY(0x00, 0x03, BTN_5)
                             MATRIX_KEY(0x00, 0x02, BTN_6)
                             MATRIX_KEY(0x01, 0x03, BTN_7)
                             MATRIX_KEY(0x01, 0x02, BTN_8)
                             MATRIX_KEY(0x02, 0x02, BTN_9)
            >;
        };
    };
```

## Documentation/devicetree/bindings/input/ti,twl4030-keypad.yaml
```yaml
# SPDX-License-Identifier: (GPL-2.0-only OR BSD-2-Clause)
%YAML 1.2
---
$id: http://devicetree.org/schemas/input/ti,twl4030-keypad.yaml#
$schema: http://devicetree.org/meta-schemas/core.yaml#

title: Texas Instruments TWL4030-family Keypad Controller

maintainers:
  - Peter Ujfalusi <peter.ujfalusi@gmail.com>

description:
  TWL4030's Keypad controller is used to interface a SoC with a matrix-type
  keypad device. The keypad controller supports multiple row and column lines.
  A key can be placed at each intersection of a unique row and a unique column.
  The keypad controller can sense a key-press and key-release and report the
  event using a interrupt to the cpu.

allOf:
  - $ref: matrix-keymap.yaml#

properties:
  compatible:
    const: ti,twl4030-keypad

  interrupts:
    maxItems: 1

required:
  - compatible
  - interrupts
  - keypad,num-rows
  - keypad,num-columns
  - linux,keymap

unevaluatedProperties: false

examples:
  - |
    #include <dt-bindings/input/input.h>

    keypad {
        compatible = "ti,twl4030-keypad";
        interrupts = <1>;
        keypad,num-rows = <8>;
        keypad,num-columns = <8>;
        linux,keymap = <
            /* row 0 */
            MATRIX_KEY(0, 0, KEY_1)
            MATRIX_KEY(0, 1, KEY_2)
            MATRIX_KEY(0, 2, KEY_3)

            /* ...and so on for a full 8x8 matrix... */

            /* row 7 */
            MATRIX_KEY(7, 6, KEY_Y)
            MATRIX_KEY(7, 7, KEY_Z)
        >;
    };
```
