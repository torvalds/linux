## Documentation/devicetree/bindings/input/rockchip-keys.txt
```
ROCKCHIP ADC attached resistor ladder buttons
------------------------------------

Required properties:
 - compatible: "rockchip,key"
 - io-channels: Phandle to an ADC channel

Each button (key) is represented as a sub-node of "rockchip,key":

Required subnode-properties:
	- label: Descriptive name of the key.
	- linux,code: Keycode to emit.
	- rockchip,adc_value:: Voltage ADC input when this key is pressed.

Example:

#include <dt-bindings/input/input.h>

	rk_key: rockchip-key {
		compatible = "rockchip,key";
		status = "okay";

		io-channels = <&saradc 1>;

		vol-up-key {
			linux,code = <115>;
			label = "volume up";
			rockchip,adc_value = <1>;
		};

		vol-down-key {
			linux,code = <114>;
			label = "volume down";
			rockchip,adc_value = <170>;
		};

		power-key {
			gpios = <&gpio0 5 GPIO_ACTIVE_LOW>;
			linux,code = <116>;
			pinctrl-names = "default";
			pinctrl-0 = <&pwrbtn>;
			label = "power";
			gpio-key,wakeup;
		};

		menu-key {
			linux,code = <59>;
			label = "menu";
			rockchip,adc_value = <355>;
		};

		home-key {
			linux,code = <102>;
			label = "home";
			rockchip,adc_value = <746>;
		};

		back-key {
			linux,code = <158>;
			label = "back";
			rockchip,adc_value = <560>;
		};

		camera-key {
			linux,code = <212>;
			label = "camera";
			rockchip,adc_value = <450>;
		};
	};
```

## Documentation/devicetree/bindings/input/rotary-encoder.txt
```
Rotary encoder DT bindings

Required properties:
- gpios: a spec for at least two GPIOs to be used, most significant first

Optional properties:
- linux,axis: the input subsystem axis to map to this rotary encoder.
  Defaults to 0 (ABS_X / REL_X)
- rotary-encoder,steps: Number of steps in a full turnaround of the
  encoder. Only relevant for absolute axis. Defaults to 24 which is a
  typical value for such devices.
- rotary-encoder,relative-axis: register a relative axis rather than an
  absolute one. Relative axis will only generate +1/-1 events on the input
  device, hence no steps need to be passed.
- rotary-encoder,rollover: Automatic rollover when the rotary value becomes
  greater than the specified steps or smaller than 0. For absolute axis only.
- rotary-encoder,steps-per-period: Number of steps (stable states) per period.
  The values have the following meaning:
  1: Full-period mode (default)
  2: Half-period mode
  4: Quarter-period mode
- wakeup-source: Boolean, rotary encoder can wake up the system.
- rotary-encoder,encoding: String, the method used to encode steps.
  Supported are "gray" (the default and more common) and "binary".

Deprecated properties:
- rotary-encoder,half-period: Makes the driver work on half-period mode.
  This property is deprecated. Instead, a 'steps-per-period ' value should
  be used, such as "rotary-encoder,steps-per-period = <2>".

See Documentation/input/rotary-encoder.txt for more information.

Example:

		rotary@0 {
			compatible = "rotary-encoder";
			gpios = <&gpio 19 1>, <&gpio 20 0>; /* GPIO19 is inverted */
			linux,axis = <0>; /* REL_X */
			rotary-encoder,encoding = "gray";
			rotary-encoder,relative-axis;
		};

		rotary@1 {
			compatible = "rotary-encoder";
			gpios = <&gpio 21 0>, <&gpio 22 0>;
			linux,axis = <1>; /* ABS_Y */
			rotary-encoder,steps = <24>;
			rotary-encoder,encoding = "binary";
			rotary-encoder,rollover;
		};
```

## Documentation/devicetree/bindings/input/rotary-encoder.yaml
```yaml
# SPDX-License-Identifier: (GPL-2.0-only OR BSD-2-Clause)
%YAML 1.2
---
$id: http://devicetree.org/schemas/input/rotary-encoder.yaml#
$schema: http://devicetree.org/meta-schemas/core.yaml#

title: Rotary encoder

maintainers:
  - Frank Li <Frank.Li@nxp.com>

description:
  See Documentation/input/devices/rotary-encoder.rst for more information.

properties:
  compatible:
    const: rotary-encoder

  gpios:
    minItems: 2

  linux,axis:
    default: 0
    description:
      the input subsystem axis to map to this rotary encoder.
      Defaults to 0 (ABS_X / REL_X)

  rotary-encoder,steps:
    $ref: /schemas/types.yaml#/definitions/uint32
    default: 24
    description:
      Number of steps in a full turnaround of the
      encoder. Only relevant for absolute axis. Defaults to 24 which is a
      typical value for such devices.

  rotary-encoder,relative-axis:
    $ref: /schemas/types.yaml#/definitions/flag
    description:
      register a relative axis rather than an
      absolute one. Relative axis will only generate +1/-1 events on the input
      device, hence no steps need to be passed.

  rotary-encoder,rollover:
    $ref: /schemas/types.yaml#/definitions/int32
    description:
      Automatic rollover when the rotary value becomes
      greater than the specified steps or smaller than 0. For absolute axis only.

  rotary-encoder,steps-per-period:
    $ref: /schemas/types.yaml#/definitions/uint32
    default: 1
    enum: [1, 2, 4]
    description: |
      Number of steps (stable states) per period.
      The values have the following meaning:
      1: Full-period mode (default)
      2: Half-period mode
      4: Quarter-period mode

  wakeup-source: true

  rotary-encoder,encoding:
    $ref: /schemas/types.yaml#/definitions/string
    description: the method used to encode steps.
    enum: [gray, binary]

  rotary-encoder,half-period:
    $ref: /schemas/types.yaml#/definitions/flag
    deprecated: true
    description:
      Makes the driver work on half-period mode.
      This property is deprecated. Instead, a 'steps-per-period ' value should
      be used, such as "rotary-encoder,steps-per-period = <2>".

required:
  - compatible
  - gpios

additionalProperties: false

examples:
  - |
    rotary {
        compatible = "rotary-encoder";
        gpios = <&gpio 19 1>, <&gpio 20 0>; /* GPIO19 is inverted */
        linux,axis = <0>; /* REL_X */
        rotary-encoder,encoding = "gray";
        rotary-encoder,relative-axis;
    };
```

## Documentation/devicetree/bindings/input/samsung-keypad.txt
```
* Samsung's Keypad Controller device tree bindings

Samsung's Keypad controller is used to interface a SoC with a matrix-type
keypad device. The keypad controller supports multiple row and column lines.
A key can be placed at each intersection of a unique row and a unique column.
The keypad controller can sense a key-press and key-release and report the
event using a interrupt to the cpu.

Required SoC Specific Properties:
- compatible: should be one of the following
  - "samsung,s3c6410-keypad": For controllers compatible with s3c6410 keypad
    controller.
  - "samsung,s5pv210-keypad": For controllers compatible with s5pv210 keypad
    controller.

- reg: physical base address of the controller and length of memory mapped
  region.

- interrupts: The interrupt number to the cpu.

Required Board Specific Properties:
- samsung,keypad-num-rows: Number of row lines connected to the keypad
  controller.

- samsung,keypad-num-columns: Number of column lines connected to the
  keypad controller.

- Keys represented as child nodes: Each key connected to the keypad
  controller is represented as a child node to the keypad controller
  device node and should include the following properties.
  - keypad,row: the row number to which the key is connected.
  - keypad,column: the column number to which the key is connected.
  - linux,code: the key-code to be reported when the key is pressed
    and released.

- pinctrl-0: Should specify pin control groups used for this controller.
- pinctrl-names: Should contain only one value - "default".

Optional Properties:
- wakeup-source: use any event on keypad as wakeup event.
		 (Legacy property supported: "linux,input-wakeup")

Optional Properties specific to linux:
- linux,keypad-no-autorepeat: do no enable autorepeat feature.


Example:
	keypad@100a0000 {
		compatible = "samsung,s5pv210-keypad";
		reg = <0x100A0000 0x100>;
		interrupts = <173>;
		samsung,keypad-num-rows = <2>;
		samsung,keypad-num-columns = <8>;
		linux,input-no-autorepeat;
		wakeup-source;

		pinctrl-names = "default";
		pinctrl-0 = <&keypad_rows &keypad_columns>;

		key_1 {
			keypad,row = <0>;
			keypad,column = <3>;
			linux,code = <2>;
		};

		key_2 {
			keypad,row = <0>;
			keypad,column = <4>;
			linux,code = <3>;
		};

		key_3 {
			keypad,row = <0>;
			keypad,column = <5>;
			linux,code = <4>;
		};
	};
```

## Documentation/devicetree/bindings/input/sensors/rk_sensor.txt
```
* Sensor Controller

Required properties:
- compatible: the sensor name,exampel: "gs_mma8452";
- reg: i2c slave address;
- type: sensor type;
- irq-gpio: sensor interrupt gpio pin;
- irq_enable: 1 use irq; 0 use pull mode;
- poll_delay_ms: pull delay time if use pull mode;
- layout: sensor orientation, choose 1-8 to make product work fine;

Example:

	hall_sensor: hall-mh248 {
		compatible = "hall-mh248";
		pinctrl-names = "default";
		pinctrl-0 = <&mh248_irq_gpio>;
		irq-gpio = <&gpio1 2 IRQ_TYPE_EDGE_RISING>;
		hall-active = <1>;
		status = "okay";
	};
  	sensor@1d {
		compatible = "gs_mma8452";
		reg = <0x1d>;
		type = <SENSOR_TYPE_ACCEL>;
		irq-gpio = <&gpio8 GPIO_A0 IRQ_TYPE_EDGE_FALLING>;
		irq_enable = <1>;
		poll_delay_ms = <30>;
		layout = <1>;
	};
		sensor@19 {
		compatible = "gs_lis3dh";
		reg = <0x19>;
		type = <SENSOR_TYPE_ACCEL>;
		irq-gpio = <&gpio0 GPIO_A0 IRQ_TYPE_LEVEL_LOW>;
		irq_enable = <1>;
		poll_delay_ms = <30>;
		layout = <1>;
	};



TYPE: 
      
	 SENSOR_TYPE_NULL  0     
	 SENSOR_TYPE_ANGLE 1
	 SENSOR_TYPE_ACCEL 2
	 SENSOR_TYPE_COMPASS 3   
	 SENSOR_TYPE_GYROSCOPE 4 
	 SENSOR_TYPE_LIGHT 5     
	 SENSOR_TYPE_PROXIMITY 6
	 SENSOR_TYPE_TEMPERATURE 7       
 	 SENSOR_TYPE_PRESSURE 8
	 SENSOR_TYPE_HALL 9
	 define SENSOR_NUM_TYPES 10
```

## Documentation/devicetree/bindings/input/spear-keyboard.txt
```
* SPEAr keyboard controller

Required properties:
- compatible: "st,spear300-kbd"

Optional properties, in addition to those specified by the shared
matrix-keyboard bindings:
- autorepeat: bool: enables key autorepeat
- st,mode: keyboard mode: 0 - 9x9, 1 - 6x6, 2 - 2x2

Example:

kbd@fc400000 {
	compatible = "st,spear300-kbd";
	reg = <0xfc400000 0x100>;
	linux,keymap = < 0x00030012
			 0x0102003a >;
	autorepeat;
	st,mode = <0>;
};
```

## Documentation/devicetree/bindings/input/sprd,sc27xx-vibra.txt
```
Spreadtrum SC27xx PMIC Vibrator

Required properties:
- compatible: should be "sprd,sc2731-vibrator".
- reg: address of vibrator control register.

Example :

	sc2731_pmic: pmic@0 {
		compatible = "sprd,sc2731";
		reg = <0>;
		spi-max-frequency = <26000000>;
		interrupts = <GIC_SPI 31 IRQ_TYPE_LEVEL_HIGH>;
		interrupt-controller;
		#interrupt-cells = <2>;
		#address-cells = <1>;
		#size-cells = <0>;

		vibrator@eb4 {
			compatible = "sprd,sc2731-vibrator";
			reg = <0xeb4>;
		};
	};
```

## Documentation/devicetree/bindings/input/sprd,sc27xx-vibrator.yaml
```yaml
# SPDX-License-Identifier: (GPL-2.0-only OR BSD-2-Clause)
# Copyright 2020 Unisoc Inc.
%YAML 1.2
---
$id: http://devicetree.org/schemas/input/sprd,sc27xx-vibrator.yaml#
$schema: http://devicetree.org/meta-schemas/core.yaml#

title: Spreadtrum SC27xx PMIC Vibrator

maintainers:
  - Orson Zhai <orsonzhai@gmail.com>
  - Baolin Wang <baolin.wang7@gmail.com>
  - Chunyan Zhang <zhang.lyra@gmail.com>

properties:
  compatible:
    enum:
      - sprd,sc2721-vibrator
      - sprd,sc2730-vibrator
      - sprd,sc2731-vibrator

  reg:
    maxItems: 1

required:
  - compatible
  - reg

additionalProperties: false

...
```

## Documentation/devicetree/bindings/input/st,stpmic1-onkey.txt
```
STMicroelectronics STPMIC1 Onkey

Required properties:

- compatible = "st,stpmic1-onkey";
- interrupts: interrupt line to use
- interrupt-names = "onkey-falling", "onkey-rising"
	onkey-falling: happens when onkey is pressed; IT_PONKEY_F of pmic
	onkey-rising: happens when onkey is released; IT_PONKEY_R of pmic

Optional properties:

- st,onkey-clear-cc-flag: onkey is able power on after an
  over-current shutdown event.
- st,onkey-pu-inactive: onkey pull up is not active
- power-off-time-sec: Duration in seconds which the key should be kept
        pressed for device to power off automatically (from 1 to 16 seconds).
        see See Documentation/devicetree/bindings/input/keys.txt

Example:

onkey {
	compatible = "st,stpmic1-onkey";
	interrupt-parent = <&pmic>;
	interrupts = <IT_PONKEY_F 0>,<IT_PONKEY_R 1>;
	interrupt-names = "onkey-falling", "onkey-rising";
	power-off-time-sec = <10>;
};
```

## Documentation/devicetree/bindings/input/st-keyscan.txt
```
* ST Keyscan controller Device Tree bindings

The ST keyscan controller Device Tree binding is based on the
matrix-keymap.

Required properties:
- compatible: "st,sti-keyscan"

- reg: Register base address and size of st-keyscan controller.

- interrupts: Interrupt number for the st-keyscan controller.

- clocks: Must contain one entry, for the module clock.
  See ../clocks/clock-bindings.txt for details.

- pinctrl: Should specify pin control groups used for this controller.
  See ../pinctrl/pinctrl-bindings.txt for details.

- linux,keymap: The keymap for keys as described in the binding document
  devicetree/bindings/input/matrix-keymap.txt.

- keypad,num-rows: Number of row lines connected to the keypad controller.

- keypad,num-columns: Number of column lines connected to the keypad
  controller.

Optional property:
- st,debounce_us: Debouncing interval time in microseconds

Example:

keyscan: keyscan@fe4b0000 {
	compatible = "st,sti-keyscan";
	reg = <0xfe4b0000 0x2000>;
	interrupts = <GIC_SPI 212 IRQ_TYPE_NONE>;
	clocks	= <&CLK_SYSIN>;
	pinctrl-names = "default";
	pinctrl-0 = <&pinctrl_keyscan>;

	keypad,num-rows = <4>;
	keypad,num-columns = <4>;
	st,debounce_us = <5000>;

	linux,keymap = < MATRIX_KEY(0x00, 0x00, KEY_F13)
			 MATRIX_KEY(0x00, 0x01, KEY_F9)
			 MATRIX_KEY(0x00, 0x02, KEY_F5)
			 MATRIX_KEY(0x00, 0x03, KEY_F1)
			 MATRIX_KEY(0x01, 0x00, KEY_F14)
			 MATRIX_KEY(0x01, 0x01, KEY_F10)
			 MATRIX_KEY(0x01, 0x02, KEY_F6)
			 MATRIX_KEY(0x01, 0x03, KEY_F2)
			 MATRIX_KEY(0x02, 0x00, KEY_F15)
			 MATRIX_KEY(0x02, 0x01, KEY_F11)
			 MATRIX_KEY(0x02, 0x02, KEY_F7)
			 MATRIX_KEY(0x02, 0x03, KEY_F3)
			 MATRIX_KEY(0x03, 0x00, KEY_F16)
			 MATRIX_KEY(0x03, 0x01, KEY_F12)
			 MATRIX_KEY(0x03, 0x02, KEY_F8)
			 MATRIX_KEY(0x03, 0x03, KEY_F4) >;
	};
```

## Documentation/devicetree/bindings/input/stmpe-keypad.txt
```
* STMPE Keypad

Required properties:
 - compatible               : "st,stmpe-keypad"
 - linux,keymap             : See ./matrix-keymap.txt

Optional properties:
 - debounce-interval        : Debouncing interval time in milliseconds
 - st,scan-count            : Scanning cycles elapsed before key data is updated
 - st,no-autorepeat         : If specified device will not autorepeat

Example:

	stmpe_keypad {
		compatible = "st,stmpe-keypad";

		debounce-interval = <64>;
		st,scan-count = <8>;
		st,no-autorepeat;

		linux,keymap = <0x205006b
				0x4010074
				0x3050072
				0x1030004
				0x502006a
				0x500000a
				0x5008b
				0x706001c
				0x405000b
				0x6070003
				0x3040067
				0x303006c
				0x60400e7
				0x602009e
				0x4020073
				0x5050002
				0x4030069
				0x3020008>;
	};
```
