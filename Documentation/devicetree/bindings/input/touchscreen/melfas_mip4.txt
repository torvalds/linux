## Documentation/devicetree/bindings/input/touchscreen/melfas_mip4.txt
```
* MELFAS MIP4 Touchscreen

Required properties:
- compatible: must be "melfas,mip4_ts"
- reg: I2C slave address of the chip (0x48 or 0x34)
- interrupts: interrupt to which the chip is connected

Optional properties:
- ce-gpios: GPIO connected to the CE (chip enable) pin of the chip

Example:
	i2c@00000000 {
		touchscreen: melfas_mip4@48 {
			compatible = "melfas,mip4_ts";
			reg = <0x48>;
			interrupt-parent = <&gpio>;
			interrupts = <0 IRQ_TYPE_EDGE_FALLING>;
			ce-gpios = <&gpio 0 GPIO_ACTIVE_HIGH>;
		};
	};
```

## Documentation/devicetree/bindings/input/touchscreen/mms114.txt
```
* MELFAS MMS114/MMS152 touchscreen controller

Required properties:
- compatible: should be one of:
	- "melfas,mms114"
	- "melfas,mms152"
- reg: I2C address of the chip
- interrupts: interrupt to which the chip is connected
- touchscreen-size-x: See [1]
- touchscreen-size-y: See [1]

Optional properties:
- touchscreen-fuzz-x: See [1]
- touchscreen-fuzz-y: See [1]
- touchscreen-fuzz-pressure: See [1]
- touchscreen-inverted-x: See [1]
- touchscreen-inverted-y: See [1]
- touchscreen-swapped-x-y: See [1]

[1]: Documentation/devicetree/bindings/input/touchscreen/touchscreen.txt

Example:

	i2c@00000000 {
		/* ... */

		touchscreen@48 {
			compatible = "melfas,mms114";
			reg = <0x48>;
			interrupts = <39 0>;
			touchscreen-size-x = <720>;
			touchscreen-size-y = <1280>;
			touchscreen-fuzz-x = <10>;
			touchscreen-fuzz-y = <10>;
			touchscreen-fuzz-pressure = <10>;
			touchscreen-inverted-x;
			touchscreen-inverted-y;
		};

		/* ... */
	};
```

## Documentation/devicetree/bindings/input/touchscreen/mstar,msg2638.yaml
```yaml
# SPDX-License-Identifier: (GPL-2.0-only OR BSD-2-Clause)
%YAML 1.2
---
$id: http://devicetree.org/schemas/input/touchscreen/mstar,msg2638.yaml#
$schema: http://devicetree.org/meta-schemas/core.yaml#

title: MStar msg2638 touchscreen controller

maintainers:
  - Vincent Knecht <vincent.knecht@mailoo.org>

allOf:
  - $ref: touchscreen.yaml#

properties:
  compatible:
    enum:
      - mstar,msg2138
      - mstar,msg2638

  reg:
    const: 0x26

  interrupts:
    maxItems: 1

  reset-gpios:
    maxItems: 1

  vdd-supply:
    description: Power supply regulator for the chip

  vddio-supply:
    description: Power supply regulator for the I2C bus

  touchscreen-size-x: true
  touchscreen-size-y: true

  linux,keycodes:
    minItems: 1
    maxItems: 4

additionalProperties: false

required:
  - compatible
  - reg
  - interrupts
  - reset-gpios
  - touchscreen-size-x
  - touchscreen-size-y

examples:
  - |
    #include <dt-bindings/gpio/gpio.h>
    #include <dt-bindings/interrupt-controller/irq.h>
    i2c {
      #address-cells = <1>;
      #size-cells = <0>;
      touchscreen@26 {
        compatible = "mstar,msg2638";
        reg = <0x26>;
        interrupt-parent = <&msmgpio>;
        interrupts = <13 IRQ_TYPE_EDGE_FALLING>;
        reset-gpios = <&msmgpio 100 GPIO_ACTIVE_LOW>;
        pinctrl-names = "default";
        pinctrl-0 = <&ts_int_reset_default>;
        vdd-supply = <&pm8916_l17>;
        vddio-supply = <&pm8916_l5>;
        touchscreen-size-x = <2048>;
        touchscreen-size-y = <2048>;
      };
    };

...
```

## Documentation/devicetree/bindings/input/touchscreen/neonode,zforce.yaml
```yaml
# SPDX-License-Identifier: GPL-2.0-only OR BSD-2-Clause
%YAML 1.2
---
$id: http://devicetree.org/schemas/input/touchscreen/neonode,zforce.yaml#
$schema: http://devicetree.org/meta-schemas/core.yaml#

title: Neonode infrared touchscreen controller

maintainers:
  - Heiko Stuebner <heiko@sntech.de>

allOf:
  - $ref: touchscreen.yaml#

properties:
  compatible:
    const: neonode,zforce

  reg:
    maxItems: 1

  interrupts:
    maxItems: 1

  reset-gpios:
    maxItems: 1

  irq-gpios:
    maxItems: 1

  x-size:
    deprecated: true
    $ref: /schemas/types.yaml#/definitions/uint32

  y-size:
    deprecated: true
    $ref: /schemas/types.yaml#/definitions/uint32

  vdd-supply: true

required:
  - compatible
  - reg
  - interrupts
  - reset-gpios

unevaluatedProperties: false

examples:
  - |
    #include <dt-bindings/interrupt-controller/irq.h>

    i2c {
        #address-cells = <1>;
        #size-cells = <0>;

        touchscreen@50 {
            compatible = "neonode,zforce";
            reg = <0x50>;
            interrupts = <2 0>;
            vdd-supply = <&reg_zforce_vdd>;

            reset-gpios = <&gpio5 9 0>; /* RST */
            irq-gpios = <&gpio5 6 0>; /* IRQ, optional */

            touchscreen-min-x = <0>;
            touchscreen-size-x = <800>;
            touchscreen-min-y = <0>;
            touchscreen-size-y = <600>;
        };
    };
...
```

## Documentation/devicetree/bindings/input/touchscreen/novatek,nvt-ts.yaml
```yaml
# SPDX-License-Identifier: (GPL-2.0-only OR BSD-2-Clause)
%YAML 1.2
---
$id: http://devicetree.org/schemas/input/touchscreen/novatek,nvt-ts.yaml#
$schema: http://devicetree.org/meta-schemas/core.yaml#

title: Novatek NVT Touchscreen Controller

maintainers:
  - Hans de Goede <hdegoede@redhat.com>

allOf:
  - $ref: touchscreen.yaml#

properties:
  compatible:
    enum:
      - novatek,nt11205-ts
      - novatek,nt36672a-ts

  reg:
    maxItems: 1

  interrupts:
    maxItems: 1

  reset-gpios:
    maxItems: 1

  vcc-supply: true
  iovcc-supply: true

required:
  - compatible
  - reg
  - interrupts

unevaluatedProperties: false

examples:
  - |
    #include <dt-bindings/gpio/gpio.h>
    #include <dt-bindings/interrupt-controller/arm-gic.h>
    i2c {
        #address-cells = <1>;
        #size-cells = <0>;
        touchscreen@1 {
            compatible = "novatek,nt36672a-ts";
            reg = <0x01>;
            interrupts-extended = <&tlmm 31 IRQ_TYPE_EDGE_RISING>;
            reset-gpios = <&tlmm 32 GPIO_ACTIVE_LOW>;
            vcc-supply = <&vreg_l22a_2p85>;
            iovcc-supply = <&vreg_l14a_1p8>;
            pinctrl-0 = <&ts_int_default &ts_reset_default>;
            pinctrl-1 = <&ts_int_sleep &ts_reset_sleep>;
            pinctrl-names = "default", "sleep";
            touchscreen-size-x = <1080>;
            touchscreen-size-y = <2246>;
        };
    };

...
```

## Documentation/devicetree/bindings/input/touchscreen/nxp,lpc3220-tsc.yaml
```yaml
# SPDX-License-Identifier: (GPL-2.0-only OR BSD-2-Clause)
%YAML 1.2
---
$id: http://devicetree.org/schemas/input/touchscreen/nxp,lpc3220-tsc.yaml#
$schema: http://devicetree.org/meta-schemas/core.yaml#

title: NXP LPC32xx SoC Touchscreen Controller (TSC)

maintainers:
  - Frank Li <Frank.Li@nxp.com>

properties:
  compatible:
    const: nxp,lpc3220-tsc

  reg:
    maxItems: 1

  clocks:
    maxItems: 1

  interrupts:
    maxItems: 1

required:
  - compatible
  - reg
  - clocks
  - interrupts

additionalProperties: false

examples:
  - |
    #include <dt-bindings/clock/lpc32xx-clock.h>

    touchscreen@40048000 {
        compatible = "nxp,lpc3220-tsc";
        reg = <0x40048000 0x1000>;
        interrupt-parent = <&mic>;
        interrupts = <39 0>;
        clocks = <&clk LPC32XX_CLK_ADC>;
    };
```

## Documentation/devicetree/bindings/input/touchscreen/pixcir,pixcir_ts.yaml
```yaml
# SPDX-License-Identifier: GPL-2.0
%YAML 1.2
---
$id: http://devicetree.org/schemas/input/touchscreen/pixcir,pixcir_ts.yaml#
$schema: http://devicetree.org/meta-schemas/core.yaml#

title: Pixcir Touchscreen Controller

maintainers:
  - Dmitry Torokhov <dmitry.torokhov@gmail.com>

allOf:
  - $ref: touchscreen.yaml#

properties:
  compatible:
    enum:
      - pixcir,pixcir_ts
      - pixcir,pixcir_tangoc

  reg:
    maxItems: 1

  interrupts:
    maxItems: 1

  attb-gpio:
    maxItems: 1

  reset-gpios:
    maxItems: 1

  enable-gpios:
    maxItems: 1

  wake-gpios:
    maxItems: 1

unevaluatedProperties: false

required:
  - compatible
  - reg
  - interrupts
  - attb-gpio
  - touchscreen-size-x
  - touchscreen-size-y

examples:
  - |
    #include <dt-bindings/gpio/gpio.h>
    #include <dt-bindings/interrupt-controller/arm-gic.h>

    i2c {
        #address-cells = <1>;
        #size-cells = <0>;

        touchscreen@5c {
            compatible = "pixcir,pixcir_ts";
            reg = <0x5c>;
            interrupts = <2 0>;
            attb-gpio = <&gpf 2 0 2>;
            touchscreen-size-x = <800>;
            touchscreen-size-y = <600>;
        };
    };

...
```

## Documentation/devicetree/bindings/input/touchscreen/pixcir_i2c_ts.txt
```
* Pixcir I2C touchscreen controllers

Required properties:
- compatible: must be "pixcir,pixcir_ts" or "pixcir,pixcir_tangoc"
- reg: I2C address of the chip
- interrupts: interrupt to which the chip is connected
- attb-gpio: GPIO connected to the ATTB line of the chip
- touchscreen-size-x: horizontal resolution of touchscreen (in pixels)
- touchscreen-size-y: vertical resolution of touchscreen (in pixels)

Optional properties:
- reset-gpios: GPIO connected to the RESET line of the chip
- enable-gpios: GPIO connected to the ENABLE line of the chip
- wake-gpios: GPIO connected to the WAKE line of the chip

Example:

	i2c@00000000 {
		/* ... */

		pixcir_ts@5c {
			compatible = "pixcir,pixcir_ts";
			reg = <0x5c>;
			interrupts = <2 0>;
			attb-gpio = <&gpf 2 0 2>;
			touchscreen-size-x = <800>;
			touchscreen-size-y = <600>;
		};

		/* ... */
	};
```

## Documentation/devicetree/bindings/input/touchscreen/resistive-adc-touch.txt
```
Generic resistive touchscreen ADC

Required properties:

 - compatible: must be "resistive-adc-touch"
The device must be connected to an ADC device that provides channels for
position measurement and optional pressure.
Refer to ../iio/iio-bindings.txt for details
 - iio-channels: must have at least two channels connected to an ADC device.
These should correspond to the channels exposed by the ADC device and should
have the right index as the ADC device registers them. These channels
represent the relative position on the "x" and "y" axes.
 - iio-channel-names: must have all the channels' names. Mandatory channels
are "x" and "y".

Optional properties:
 - iio-channels: The third channel named "pressure" is optional and can be
used if the ADC device also measures pressure besides position.
If this channel is missing, pressure will be ignored and the touchscreen
will only report position.
 - iio-channel-names: optional channel named "pressure".

Example:

	resistive_touch: resistive_touch {
		compatible = "resistive-adc-touch";
		touchscreen-min-pressure = <50000>;
		io-channels = <&adc 24>, <&adc 25>, <&adc 26>;
		io-channel-names = "x", "y", "pressure";
	};
```

## Documentation/devicetree/bindings/input/touchscreen/resistive-adc-touch.yaml
```yaml
# SPDX-License-Identifier: (GPL-2.0 OR BSD-2-Clause)
%YAML 1.2
---
$id: http://devicetree.org/schemas/input/touchscreen/resistive-adc-touch.yaml#
$schema: http://devicetree.org/meta-schemas/core.yaml#

title: Generic resistive touchscreen ADC

maintainers:
  - Oleksij Rempel <o.rempel@pengutronix.de>

description: |
  Generic ADC based resistive touchscreen controller
  The device must be connected to an ADC device that provides channels for
  position measurement and optional pressure.

allOf:
  - $ref: touchscreen.yaml#

properties:
  compatible:
    const: resistive-adc-touch

  io-channels:
    minItems: 2
    items:
      - description: x
      - description: y
      - description: pressure (optional)
      - description: z1 (optional)
      - description: z2 (optional)

  io-channel-names:
    oneOf:
      - items:
          - enum: [x, y]
          - enum: [x, y]
      - items:
          - enum: [x, y, pressure]
          - enum: [x, y, pressure]
          - enum: [x, y, pressure]
      - items:
          - enum: [x, y, z1, z2]
          - enum: [x, y, z1, z2]
          - enum: [x, y, z1, z2]
          - enum: [x, y, z1, z2]

  touchscreen-size-x: true
  touchscreen-size-y: true
  touchscreen-fuzz-x: true
  touchscreen-fuzz-y: true
  touchscreen-inverted-x: true
  touchscreen-inverted-y: true
  touchscreen-swapped-x-y: true
  touchscreen-min-pressure: true
  touchscreen-x-plate-ohms: true

additionalProperties: false

required:
  - compatible
  - io-channels
  - io-channel-names

examples:
  - |
    touchscreen {
      compatible = "resistive-adc-touch";
      io-channels = <&adc 24>, <&adc 25>;
      io-channel-names = "y", "x";
    };
  - |
    touchscreen {
      compatible = "resistive-adc-touch";
      touchscreen-min-pressure = <50000>;
      io-channels = <&adc 24>, <&adc 25>, <&adc 26>;
      io-channel-names = "y", "pressure", "x";
    };
  - |
    touchscreen {
      compatible = "resistive-adc-touch";
      touchscreen-min-pressure = <50000>;
      io-channels = <&adc 1>, <&adc 2>, <&adc 3>, <&adc 4>;
      io-channel-names = "x", "z1", "z2", "y";
      touchscreen-x-plate-ohms = <800>;
    };
```

## Documentation/devicetree/bindings/input/touchscreen/rohm,bu21013.yaml
```yaml
# SPDX-License-Identifier: (GPL-2.0-only OR BSD-2-Clause)
%YAML 1.2
---
$id: http://devicetree.org/schemas/input/touchscreen/rohm,bu21013.yaml#
$schema: http://devicetree.org/meta-schemas/core.yaml#

title: Rohm BU21013 touchscreen

description:
  Rohm BU21013 I2C driven touchscreen controller.

maintainers:
  - Dario Binacchi <dario.binacchi@amarulasolutions.com>

allOf:
  - $ref: touchscreen.yaml#

properties:
  compatible:
    enum:
      - rohm,bu21013_tp

  reg:
    maxItems: 1

  interrupts:
    maxItems: 1

  reset-gpios:
    maxItems: 1

  touch-gpios:
    maxItems: 1
    description: GPIO registering a touch event.

  avdd-supply:
    description: Analogic power supply

  rohm,touch-max-x:
    deprecated: true
    description: Maximum value on the X axis.
    $ref: /schemas/types.yaml#/definitions/uint32

  rohm,touch-max-y:
    deprecated: true
    description: Maximum value on the Y axis.
    $ref: /schemas/types.yaml#/definitions/uint32

  rohm,flip-x:
    deprecated: true
    description: Flip touch coordinates on the X axis
    type: boolean

  rohm,flip-y:
    deprecated: true
    description: Flip touch coordinates on the Y axis
    type: boolean

  touchscreen-inverted-x: true
  touchscreen-inverted-y: true
  touchscreen-size-x: true
  touchscreen-size-y: true
  touchscreen-swapped-x-y: true

additionalProperties: false

required:
  - compatible
  - reg
  - reset-gpios
  - interrupts

examples:
  - |
    #include <dt-bindings/gpio/gpio.h>
    #include <dt-bindings/interrupt-controller/irq.h>
    i2c {
        #address-cells = <1>;
        #size-cells = <0>;

        touchscreen@5c {
            compatible = "rohm,bu21013_tp";
            reg = <0x5c>;

            interrupt-parent = <&gpio2>;
            interrupts = <0x20 IRQ_TYPE_LEVEL_LOW>;
            reset-gpios = <&gpio2 19 GPIO_ACTIVE_LOW>;
            touch-gpios = <&gpio2 20 GPIO_ACTIVE_LOW>;
            avdd-supply = <&ab8500_ldo_aux1_reg>;

            touchscreen-size-x = <384>;
            touchscreen-size-y = <704>;
            touchscreen-inverted-y;
        };
    };
```

## Documentation/devicetree/bindings/input/touchscreen/samsung,s6sy761.txt
```
* Samsung S6SY761 touchscreen controller

Required properties:
- compatible		: must be "samsung,s6sy761"
- reg			: I2C slave address, (e.g. 0x48)
- interrupt-parent	: the phandle to the interrupt controller which provides
			  the interrupt
- interrupts		: interrupt specification
- avdd-supply		: analogic power supply
- vdd-supply		: power supply

Optional properties:
- touchscreen-size-x	: see touchscreen.txt. This property is embedded in the
			  device. If defined it forces a different x resolution.
- touchscreen-size-y	: see touchscreen.txt. This property is embedded in the
			  device. If defined it forces a different y resolution.

Example:

i2c@00000000 {

	/* ... */

	touchscreen@48 {
		compatible = "samsung,s6sy761";
		reg = <0x48>;
		interrupt-parent = <&gpa1>;
		interrupts = <1 IRQ_TYPE_NONE>;
		avdd-supply = <&ldo30_reg>;
		vdd-supply = <&ldo31_reg>;
		touchscreen-size-x = <4096>;
		touchscreen-size-y = <4096>;
	};
};
```
