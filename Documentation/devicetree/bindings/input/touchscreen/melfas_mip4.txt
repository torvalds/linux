## Documentation/devicetree/bindings/input/touchscreen/samsung,s6sy761.yaml
```yaml
# SPDX-License-Identifier: (GPL-2.0-only OR BSD-2-Clause)
%YAML 1.2
---
$id: http://devicetree.org/schemas/input/touchscreen/samsung,s6sy761.yaml#
$schema: http://devicetree.org/meta-schemas/core.yaml#

title: Samsung S6SY761 touchscreen controller

maintainers:
  - Andi Shyti <andi.shyti@kernel.org>

allOf:
  - $ref: touchscreen.yaml#

properties:
  compatible:
    const: samsung,s6sy761

  reg:
    maxItems: 1

  interrupts:
    maxItems: 1

  avdd-supply: true
  vdd-supply: true

unevaluatedProperties: false

required:
  - compatible
  - reg
  - interrupts
  - avdd-supply
  - vdd-supply

examples:
  - |
    #include <dt-bindings/interrupt-controller/irq.h>
    i2c {
        #address-cells = <1>;
        #size-cells = <0>;

        touchscreen@48 {
            compatible = "samsung,s6sy761";
            reg = <0x48>;
            interrupt-parent = <&gpa1>;
            interrupts = <1 IRQ_TYPE_LEVEL_HIGH>;
            avdd-supply = <&ldo30_reg>;
            vdd-supply = <&ldo31_reg>;
            touchscreen-size-x = <4096>;
            touchscreen-size-y = <4096>;
        };
    };
```

## Documentation/devicetree/bindings/input/touchscreen/semtech,sx8654.yaml
```yaml
# SPDX-License-Identifier: (GPL-2.0-only OR BSD-2-Clause)
%YAML 1.2
---
$id: http://devicetree.org/schemas/input/touchscreen/semtech,sx8654.yaml#
$schema: http://devicetree.org/meta-schemas/core.yaml#

title: Semtech SX8654 I2C Touchscreen Controller

maintainers:
  - Frank Li <Frank.Li@nxp.com>

properties:
  compatible:
    enum:
      - semtech,sx8650
      - semtech,sx8654
      - semtech,sx8655
      - semtech,sx8656

  reg:
    maxItems: 1

  interrupts:
    maxItems: 1

  reset-gpios:
    maxItems: 1

required:
  - compatible
  - reg
  - interrupts

additionalProperties: false

examples:
  - |
    #include <dt-bindings/gpio/gpio.h>
    #include <dt-bindings/interrupt-controller/irq.h>

    i2c {
        #address-cells = <1>;
        #size-cells = <0>;

        touchscreen@48 {
            compatible = "semtech,sx8654";
            reg = <0x48>;
            interrupt-parent = <&gpio6>;
            interrupts = <3 IRQ_TYPE_EDGE_FALLING>;
            reset-gpios = <&gpio4 2 GPIO_ACTIVE_LOW>;
        };
    };
```

## Documentation/devicetree/bindings/input/touchscreen/silead,gsl1680.yaml
```yaml
# SPDX-License-Identifier: GPL-2.0
%YAML 1.2
---
$id: http://devicetree.org/schemas/input/touchscreen/silead,gsl1680.yaml#
$schema: http://devicetree.org/meta-schemas/core.yaml#

title: Silead GSL1680 Touchscreen Controller Device Tree Bindings

maintainers:
  - Dmitry Torokhov <dmitry.torokhov@gmail.com>

allOf:
  - $ref: touchscreen.yaml#

properties:
  compatible:
    enum:
      - silead,gsl1680
      - silead,gsl1688
      - silead,gsl3670
      - silead,gsl3675
      - silead,gsl3692

  reg:
    maxItems: 1

  interrupts:
    maxItems: 1

  power-gpios:
    maxItems: 1

  firmware-name:
    $ref: /schemas/types.yaml#/definitions/string
    description: >
      File basename for board specific firmware

  silead,max-fingers:
    $ref: /schemas/types.yaml#/definitions/uint32
    maximum: 5
    description: >
      Maximum number of fingers the touchscreen can detect

  silead,home-button:
    type: boolean
    description: >
      Does the device have a capacitive home-button build into the
      touchscreen?

  avdd-supply:
    description: >
      Regulator phandle for controller AVDD

  vddio-supply:
    description: >
      Regulator phandle for controller VDDIO

unevaluatedProperties: false

required:
  - compatible
  - reg
  - interrupts
  - power-gpios
  - touchscreen-size-x
  - touchscreen-size-y

examples:
  - |
    #include <dt-bindings/gpio/gpio.h>
    #include <dt-bindings/interrupt-controller/arm-gic.h>

    i2c {
        #address-cells = <1>;
        #size-cells = <0>;

        touchscreen@40 {
            compatible = "silead,gsl1680";
            reg = <0x40>;
            interrupt-parent = <&pio>;
            interrupts = <6 11 IRQ_TYPE_EDGE_FALLING>;
            power-gpios = <&pio 1 3 GPIO_ACTIVE_HIGH>;
            touchscreen-size-x = <480>;
            touchscreen-size-y = <800>;
            touchscreen-inverted-x;
            touchscreen-swapped-x-y;
            silead,max-fingers = <5>;
        };
    };

...
```

## Documentation/devicetree/bindings/input/touchscreen/silead_gsl1680.txt
```
* GSL 1680 touchscreen controller

Required properties:
- compatible		  : "silead,gsl1680"
- reg			  : I2C slave address of the chip (0x40)
- interrupt-parent	  : a phandle pointing to the interrupt controller
			    serving the interrupt for this chip
- interrupts		  : interrupt specification for the gsl1680 interrupt
- power-gpios		  : Specification for the pin connected to the gsl1680's
			    shutdown input. This needs to be driven high to take the
			    gsl1680 out of its low power state
- touchscreen-size-x	  : See touchscreen.txt
- touchscreen-size-y	  : See touchscreen.txt

Optional properties:
- firmware-name		  : File basename (string) for board specific firmware
- touchscreen-inverted-x  : See touchscreen.txt
- touchscreen-inverted-y  : See touchscreen.txt
- touchscreen-swapped-x-y : See touchscreen.txt
- silead,max-fingers	  : maximum number of fingers the touchscreen can detect
- vddio-supply		  : regulator phandle for controller VDDIO
- avdd-supply		  : regulator phandle for controller AVDD

Example:

i2c@00000000 {
	gsl1680: touchscreen@40 {
		compatible = "silead,gsl1680";
		reg = <0x40>;
		interrupt-parent = <&pio>;
		interrupts = <6 11 IRQ_TYPE_EDGE_FALLING>;
		power-gpios = <&pio 1 3 GPIO_ACTIVE_HIGH>;
		touchscreen-size-x = <480>;
		touchscreen-size-y = <800>;
		touchscreen-inverted-x;
		touchscreen-swapped-x-y;
		silead,max-fingers = <5>;
	};
};
```

## Documentation/devicetree/bindings/input/touchscreen/sis_i2c.txt
```
* SiS I2C Multiple Touch Controller

Required properties:
- compatible: must be "sis,9200-ts"
- reg: i2c slave address
- interrupt-parent: the phandle for the interrupt controller
  (see interrupt binding [0])
- interrupts: touch controller interrupt (see interrupt
  binding [0])

Optional properties:
- pinctrl-names: should be "default" (see pinctrl binding [1]).
- pinctrl-0: a phandle pointing to the pin settings for the
  device (see pinctrl binding [1]).
- attn-gpios: the gpio pin used as attention line
- reset-gpios: the gpio pin used to reset the controller
- wakeup-source: touchscreen can be used as a wakeup source

[0]: Documentation/devicetree/bindings/interrupt-controller/interrupts.txt
[1]: Documentation/devicetree/bindings/pinctrl/pinctrl-bindings.txt

Example:

	sis9255@5c  {
		compatible = "sis,9200-ts";
		reg = <0x5c>;
		pinctrl-names = "default";
		pinctrl-0 = <&pinctrl_sis>;
		interrupt-parent = <&gpio3>;
		interrupts = <19 IRQ_TYPE_EDGE_FALLING>;
		irq-gpios = <&gpio3 19 GPIO_ACTIVE_LOW>;
		reset-gpios = <&gpio2 30 GPIO_ACTIVE_LOW>;
	};
```

## Documentation/devicetree/bindings/input/touchscreen/sitronix,st1232.yaml
```yaml
# SPDX-License-Identifier: (GPL-2.0-only OR BSD-2-Clause)
%YAML 1.2
---
$id: http://devicetree.org/schemas/input/touchscreen/sitronix,st1232.yaml#
$schema: http://devicetree.org/meta-schemas/core.yaml#

title: Sitronix st1232 or st1633 touchscreen controller

maintainers:
  - Bastian Hecht <hechtb@gmail.com>

allOf:
  - $ref: touchscreen.yaml#

properties:
  compatible:
    enum:
      - sitronix,st1232
      - sitronix,st1633

  reg:
    maxItems: 1

  interrupts:
    maxItems: 1

  gpios:
    description: A phandle to the reset GPIO
    maxItems: 1

required:
  - compatible
  - reg
  - interrupts

unevaluatedProperties: false

examples:
  - |
    #include <dt-bindings/input/linux-event-codes.h>
    i2c {
            #address-cells = <1>;
            #size-cells = <0>;

            touchscreen@55 {
                    compatible = "sitronix,st1232";
                    reg = <0x55>;
                    interrupts = <2 0>;
                    gpios = <&gpio1 166 0>;

                    touch-overlay {
                            segment-0 {
                                    label = "Touchscreen";
                                    x-origin = <0>;
                                    x-size = <240>;
                                    y-origin = <40>;
                                    y-size = <280>;
                            };

                            segment-1a {
                                    label = "Camera light";
                                    linux,code = <KEY_LIGHTS_TOGGLE>;
                                    x-origin = <40>;
                                    x-size = <40>;
                                    y-origin = <0>;
                                    y-size = <40>;
                            };

                            segment-2a {
                                    label = "Power";
                                    linux,code = <KEY_POWER>;
                                    x-origin = <160>;
                                    x-size = <40>;
                                    y-origin = <0>;
                                    y-size = <40>;
                            };
                    };
            };
    };
```

## Documentation/devicetree/bindings/input/touchscreen/sitronix-st1232.txt
```
* Sitronix st1232 or st1633 touchscreen controller

Required properties:
- compatible: must contain one of
  * "sitronix,st1232"
  * "sitronix,st1633"
- reg: I2C address of the chip
- interrupts: interrupt to which the chip is connected

Optional properties:
- gpios: a phandle to the reset GPIO

For additional optional properties see: touchscreen.txt

Example:

	i2c@00000000 {
		/* ... */

		touchscreen@55 {
			compatible = "sitronix,st1232";
			reg = <0x55>;
			interrupts = <2 0>;
			gpios = <&gpio1 166 0>;
		};

		/* ... */
	};
```

## Documentation/devicetree/bindings/input/touchscreen/st,stmfts.txt
```
* ST-Microelectronics FingerTip touchscreen controller

The ST-Microelectronics FingerTip device provides a basic touchscreen
functionality. Along with it the user can enable the touchkey which can work as
a basic HOME and BACK key for phones.

The driver supports also hovering as an absolute single touch event with x, y, z
coordinates.

Required properties:
- compatible		: must be "st,stmfts"
- reg			: I2C slave address, (e.g. 0x49)
- interrupt-parent	: the phandle to the interrupt controller which provides
			  the interrupt
- interrupts		: interrupt specification
- avdd-supply		: analogic power supply
- vdd-supply		: power supply
- touchscreen-size-x	: see touchscreen.txt
- touchscreen-size-y	: see touchscreen.txt

Optional properties:
- touch-key-connected	: specifies whether the touchkey feature is connected
- ledvdd-supply		: power supply to the touch key leds

Example:

i2c@00000000 {

	/* ... */

	touchscreen@49 {
		compatible = "st,stmfts";
		reg = <0x49>;
		interrupt-parent = <&gpa1>;
		interrupts = <1 IRQ_TYPE_NONE>;
		touchscreen-size-x = <1599>;
		touchscreen-size-y = <2559>;
		touch-key-connected;
		avdd-supply = <&ldo30_reg>;
		vdd-supply = <&ldo31_reg>;
		ledvdd-supply = <&ldo33_reg>;
	};
};
```

## Documentation/devicetree/bindings/input/touchscreen/st,stmfts.yaml
```yaml
# SPDX-License-Identifier: GPL-2.0-only OR BSD-2-Clause
%YAML 1.2
---
$id: http://devicetree.org/schemas/input/touchscreen/st,stmfts.yaml#
$schema: http://devicetree.org/meta-schemas/core.yaml#

title: ST-Microelectronics FingerTip touchscreen controller

maintainers:
  - Krzysztof Kozlowski <krzysztof.kozlowski@linaro.org>

description:
  The ST-Microelectronics FingerTip device provides a basic touchscreen
  functionality. Along with it the user can enable the touchkey which can work
  as a basic HOME and BACK key for phones.

allOf:
  - $ref: touchscreen.yaml#

properties:
  compatible:
    const: st,stmfts

  reg:
    maxItems: 1

  avdd-supply:
    description: Analogic power supply

  interrupts:
    maxItems: 1

  ledvdd-supply:
    description: Power supply to the touch key leds

  touch-key-connected:
    type: boolean
    description: The touchkey feature is connected

  vdd-supply:
    description: Power supply

required:
  - compatible
  - reg
  - avdd-supply
  - interrupts
  - vdd-supply

unevaluatedProperties: false

examples:
  - |
    #include <dt-bindings/interrupt-controller/irq.h>

    i2c {
        #address-cells = <1>;
        #size-cells = <0>;

        touchscreen@49 {
            compatible = "st,stmfts";
            reg = <0x49>;
            interrupt-parent = <&gpa1>;
            interrupts = <1 IRQ_TYPE_LEVEL_LOW>;
            touchscreen-size-x = <1599>;
            touchscreen-size-y = <2559>;
            touch-key-connected;
            avdd-supply = <&ldo30_reg>;
            vdd-supply = <&ldo31_reg>;
            ledvdd-supply = <&ldo33_reg>;
        };
    };
```

## Documentation/devicetree/bindings/input/touchscreen/stmpe.txt
```
STMPE Touchscreen
----------------

Required properties:
 - compatible: "st,stmpe-ts"

Optional properties:
- st,ave-ctrl		: Sample average control
				0 -> 1 sample
				1 -> 2 samples
				2 -> 4 samples
				3 -> 8 samples
- st,touch-det-delay	: Touch detect interrupt delay (recommended is 3)
				0 -> 10 us
				1 -> 50 us
				2 -> 100 us
				3 -> 500 us
				4 -> 1 ms
				5 -> 5 ms
				6 -> 10 ms
				7 -> 50 ms
- st,settling		: Panel driver settling time (recommended is 2)
				0 -> 10 us
				1 -> 100 us
				2 -> 500 us
				3 -> 1 ms
				4 -> 5 ms
				5 -> 10 ms
				6 -> 50 ms
				7 -> 100 ms
- st,fraction-z		: Length of the fractional part in z (recommended is 7)
			  (fraction-z ([0..7]) = Count of the fractional part)
- st,i-drive		: current limit value of the touchscreen drivers
				0 -> 20 mA (typical 35mA max)
				1 -> 50 mA (typical 80 mA max)

Optional properties common with MFD (deprecated):
 - st,sample-time	: ADC conversion time in number of clock.
				0 -> 36 clocks
				1 -> 44 clocks
				2 -> 56 clocks
				3 -> 64 clocks
				4 -> 80 clocks (recommended)
				5 -> 96 clocks
				6 -> 124 clocks
 - st,mod-12b		: ADC Bit mode
				0 -> 10bit ADC
				1 -> 12bit ADC
 - st,ref-sel		: ADC reference source
				0 -> internal
				1 -> external
 - st,adc-freq		: ADC Clock speed
				0 -> 1.625 MHz
				1 -> 3.25 MHz
				2 || 3 -> 6.5 MHz

Node should be child node of stmpe node to which it belongs.

Note that common ADC settings of stmpe_touchscreen (child) will take precedence
over the settings done in MFD.

Example:

stmpe811@41 {
	compatible = "st,stmpe811";
	pinctrl-names = "default";
	pinctrl-0 = <&pinctrl_touch_int>;
	#address-cells = <1>;
	#size-cells = <0>;
	reg = <0x41>;
	interrupts = <10 IRQ_TYPE_LEVEL_LOW>;
	interrupt-parent = <&gpio4>;
	interrupt-controller;
	id = <0>;
	blocks = <0x5>;
	irq-trigger = <0x1>;
	/* Common ADC settings */
	/* 3.25 MHz ADC clock speed */
	st,adc-freq = <1>;
	/* 12-bit ADC */
	st,mod-12b = <1>;
	/* internal ADC reference */
	st,ref-sel = <0>;
	/* ADC converstion time: 80 clocks */
	st,sample-time = <4>;

	stmpe_touchscreen {
		compatible = "st,stmpe-ts";
		reg = <0>;
		/* 8 sample average control */
		st,ave-ctrl = <3>;
		/* 5 ms touch detect interrupt delay */
		st,touch-det-delay = <5>;
		/* 1 ms panel driver settling time */
		st,settling = <3>;
		/* 7 length fractional part in z */
		st,fraction-z = <7>;
		/*
		 * 50 mA typical 80 mA max touchscreen drivers
		 * current limit value
		 */
		st,i-drive = <1>;
	};
	stmpe_adc {
		compatible = "st,stmpe-adc";
		st,norequest-mask = <0x0F>;
	};
};
```
