## Documentation/devicetree/bindings/input/touchscreen/ti,am3359-tsc.yaml
```yaml
# SPDX-License-Identifier: (GPL-2.0-only OR BSD-2-Clause)
%YAML 1.2
---
$id: http://devicetree.org/schemas/input/touchscreen/ti,am3359-tsc.yaml#
$schema: http://devicetree.org/meta-schemas/core.yaml#

title: TI AM3359 Touchscreen controller

maintainers:
  - Miquel Raynal <miquel.raynal@bootlin.com>

properties:
  compatible:
    const: ti,am3359-tsc

  ti,wires:
    description: Wires refer to application modes i.e. 4/5/8 wire touchscreen
      support on the platform.
    $ref: /schemas/types.yaml#/definitions/uint32
    enum: [4, 5, 8]

  ti,x-plate-resistance:
    description: X plate resistance
    $ref: /schemas/types.yaml#/definitions/uint32

  ti,coordinate-readouts:
    description: The sequencer supports a total of 16 programmable steps. Each
      step is used to read a single coordinate. A single readout is enough but
      multiple reads can increase the quality. A value of 5 means, 5 reads for
      X, 5 for Y and 2 for Z (always). This utilises 12 of the 16 software steps
      available. The remaining 4 can be used by the ADC.
    $ref: /schemas/types.yaml#/definitions/uint32
    minimum: 1
    maximum: 6

  ti,wire-config:
    description: Different boards could have a different order for connecting
      wires on touchscreen. We need to provide an 8-bit number where the
      first four bits represent the analog lines and the next 4 bits represent
      positive/negative terminal on that input line. Notations to represent the
      input lines and terminals respectively are as follows, AIN0 = 0, AIN1 = 1
      and so on until AIN7 = 7. XP = 0, XN = 1, YP = 2, YN = 3.
    $ref: /schemas/types.yaml#/definitions/uint32-array
    minItems: 4
    maxItems: 8

  ti,charge-delay:
    description: Length of touch screen charge delay step in terms of ADC clock
      cycles. Charge delay value should be large in order to avoid false pen-up
      events. This value effects the overall sampling speed, hence need to be
      kept as low as possible, while avoiding false pen-up event. Start from a
      lower value, say 0x400, and increase value until false pen-up events are
      avoided. The pen-up detection happens immediately after the charge step,
      so this does in fact function as a hardware knob for adjusting the amount
      of "settling time".
    $ref: /schemas/types.yaml#/definitions/uint32

required:
  - compatible
  - ti,wires
  - ti,x-plate-resistance
  - ti,coordinate-readouts
  - ti,wire-config

additionalProperties: false

examples:
  - |
    tsc {
        compatible = "ti,am3359-tsc";
        ti,wires = <4>;
        ti,x-plate-resistance = <200>;
        ti,coordinate-readouts = <5>;
        ti,wire-config = <0x00 0x11 0x22 0x33>;
        ti,charge-delay = <0x400>;
    };
```

## Documentation/devicetree/bindings/input/touchscreen/ti,tsc2005.yaml
```yaml
# SPDX-License-Identifier: (GPL-2.0-only OR BSD-2-Clause)
%YAML 1.2
---
$id: http://devicetree.org/schemas/input/touchscreen/ti,tsc2005.yaml#
$schema: http://devicetree.org/meta-schemas/core.yaml#

title: Texas Instruments TSC2004 and TSC2005 touchscreen controller bindings

maintainers:
  - Marek Vasut <marex@denx.de>
  - Michael Welling <mwelling@ieee.org>

properties:
  $nodename:
    pattern: "^touchscreen(@.*)?$"

  compatible:
    enum:
      - ti,tsc2004
      - ti,tsc2005

  reg:
    maxItems: 1
    description: |
      I2C address when used on the I2C bus, or the SPI chip select index
      when used on the SPI bus

  interrupts:
    maxItems: 1

  reset-gpios:
    maxItems: 1
    description: GPIO specifier for the controller reset line

  spi-max-frequency:
    description: TSC2005 SPI bus clock frequency.
    maximum: 25000000

  ti,x-plate-ohms:
    description: resistance of the touchscreen's X plates in ohm (defaults to 280)

  ti,esd-recovery-timeout-ms:
    description: |
        if the touchscreen does not respond after the configured time
        (in milli seconds), the driver will reset it. This is disabled
        by default.

  vio-supply:
    description: Regulator specifier

  touchscreen-fuzz-pressure: true
  touchscreen-fuzz-x: true
  touchscreen-fuzz-y: true
  touchscreen-max-pressure: true
  touchscreen-size-x: true
  touchscreen-size-y: true

allOf:
  - $ref: touchscreen.yaml#
  - if:
      properties:
        compatible:
          contains:
            const: ti,tsc2004
    then:
      properties:
        spi-max-frequency: false

additionalProperties: false

required:
  - compatible
  - reg
  - interrupts

examples:
  - |
    #include <dt-bindings/interrupt-controller/irq.h>
    #include <dt-bindings/gpio/gpio.h>
    i2c {
        #address-cells = <1>;
        #size-cells = <0>;
        touchscreen@48 {
            compatible = "ti,tsc2004";
            reg = <0x48>;
            vio-supply = <&vio>;

            reset-gpios = <&gpio4 8 GPIO_ACTIVE_HIGH>;
            interrupts-extended = <&gpio1 27 IRQ_TYPE_EDGE_RISING>;

            touchscreen-fuzz-x = <4>;
            touchscreen-fuzz-y = <7>;
            touchscreen-fuzz-pressure = <2>;
            touchscreen-size-x = <4096>;
            touchscreen-size-y = <4096>;
            touchscreen-max-pressure = <2048>;

            ti,x-plate-ohms = <280>;
            ti,esd-recovery-timeout-ms = <8000>;
        };
    };
  - |
    #include <dt-bindings/interrupt-controller/irq.h>
    #include <dt-bindings/gpio/gpio.h>
    spi {
        #address-cells = <1>;
        #size-cells = <0>;
        touchscreen@0 {
            compatible = "ti,tsc2005";
            spi-max-frequency = <6000000>;
            reg = <0>;

            vio-supply = <&vio>;

            reset-gpios = <&gpio4 8 GPIO_ACTIVE_HIGH>; /* 104 */
            interrupts-extended = <&gpio4 4 IRQ_TYPE_EDGE_RISING>; /* 100 */

            touchscreen-fuzz-x = <4>;
            touchscreen-fuzz-y = <7>;
            touchscreen-fuzz-pressure = <2>;
            touchscreen-size-x = <4096>;
            touchscreen-size-y = <4096>;
            touchscreen-max-pressure = <2048>;

            ti,x-plate-ohms = <280>;
            ti,esd-recovery-timeout-ms = <8000>;
        };
    };
```

## Documentation/devicetree/bindings/input/touchscreen/ti,tsc2007.yaml
```yaml
# SPDX-License-Identifier: (GPL-2.0-only OR BSD-2-Clause)
%YAML 1.2
---
$id: http://devicetree.org/schemas/input/touchscreen/ti,tsc2007.yaml#
$schema: http://devicetree.org/meta-schemas/core.yaml#

title: Texas Instruments tsc2007 touchscreen controller

maintainers:
  - Frank Li <Frank.Li@nxp.com>

properties:
  compatible:
    const: ti,tsc2007

  reg:
    maxItems: 1

  interrupts:
    maxItems: 1

  ti,x-plate-ohms:
    description: X-plate resistance in ohms.

  gpios: true

  pendown-gpio: true

  wakeup-source: true

  ti,max-rt:
    $ref: /schemas/types.yaml#/definitions/uint32
    description: maximum pressure.

  ti,fuzzx:
    $ref: /schemas/types.yaml#/definitions/uint32
    description:
      specifies the absolute input fuzz x value.
      If set, it will permit noise in the data up to +- the value given to the fuzz
      parameter, that is used to filter noise from the event stream.

  ti,fuzzy:
    $ref: /schemas/types.yaml#/definitions/uint32
    description: specifies the absolute input fuzz y value.

  ti,fuzzz:
    $ref: /schemas/types.yaml#/definitions/uint32
    description: specifies the absolute input fuzz z value.

  ti,poll-period:
    $ref: /schemas/types.yaml#/definitions/uint32
    description:
      how much time to wait (in milliseconds) before reading again the
      values from the tsc2007.

required:
  - compatible
  - reg
  - ti,x-plate-ohms

additionalProperties: false

examples:
  - |
    i2c {
        #address-cells = <1>;
        #size-cells = <0>;

        touch@49 {
           compatible = "ti,tsc2007";
           reg = <0x49>;
           interrupt-parent = <&gpio4>;
           interrupts = <0x0 0x8>;
           gpios = <&gpio4 0 0>;
           ti,x-plate-ohms = <180>;
        };
    };
```

## Documentation/devicetree/bindings/input/touchscreen/ti-tsc-adc.txt
```
* TI - TSC ADC (Touschscreen and analog digital converter)
~~~~~~~~~~~~~~~~~~~~~~~~~~~~~~~~~~~~~~~~~~~~~~~~~~~~~~~~~~

Required properties:
- mfd
	compatible: Should be
		"ti,am3359-tscadc" for AM335x/AM437x SoCs
		"ti,am654-tscadc", "ti,am3359-tscadc" for AM654 SoCs
- child "tsc"
	compatible: Should be "ti,am3359-tsc".
	ti,wires: Wires refer to application modes i.e. 4/5/8 wire touchscreen
		  support on the platform.
	ti,x-plate-resistance: X plate resistance
	ti,coordinate-readouts: The sequencer supports a total of 16
				programmable steps each step is used to
				read a single coordinate. A single
                                readout is enough but multiple reads can
				increase the quality.
				A value of 5 means, 5 reads for X, 5 for
				Y and 2 for Z (always). This utilises 12
				of the 16 software steps available. The
				remaining 4 can be used by the ADC.
	ti,wire-config: Different boards could have a different order for
			connecting wires on touchscreen. We need to provide an
			8 bit number where in the 1st four bits represent the
			analog lines and the next 4 bits represent positive/
			negative terminal on that input line. Notations to
			represent the input lines and terminals resoectively
			is as follows:
			AIN0 = 0, AIN1 = 1 and so on till AIN7 = 7.
			XP  = 0, XN = 1, YP = 2, YN = 3.
- child "adc"
	compatible: Should be
		    "ti,am3359-adc" for AM335x/AM437x SoCs
		    "ti,am654-adc", "ti,am3359-adc" for AM654 SoCs
	ti,adc-channels: List of analog inputs available for ADC.
			 AIN0 = 0, AIN1 = 1 and so on till AIN7 = 7.

Optional properties:
- child "tsc"
	ti,charge-delay: Length of touch screen charge delay step in terms of
			 ADC clock cycles. Charge delay value should be large
			 in order to avoid false pen-up events. This value
			 effects the overall sampling speed, hence need to be
			 kept as low as possible, while avoiding false pen-up
			 event. Start from a lower value, say 0x400, and
			 increase value until false pen-up events are avoided.
			 The pen-up detection happens immediately after the
			 charge step, so this does in fact function as a
			 hardware knob for adjusting the amount of "settling
			 time".

- child "adc"
	ti,chan-step-opendelay: List of open delays for each channel of
				ADC in the order of ti,adc-channels. The
				value corresponds to the number of ADC
				clock cycles to wait after applying the
				step configuration registers and before
				sending the start of ADC conversion.
				Maximum value is 0x3FFFF.
       ti,chan-step-sampledelay: List of sample delays for each channel
				  of ADC in the order of ti,adc-channels.
				  The value corresponds to the number of
				  ADC clock cycles to sample (to hold
				  start of conversion high).
				  Maximum value is 0xFF.
       ti,chan-step-avg: Number of averages to be performed for each
			  channel of ADC. If average is 16 then input
			  is sampled 16 times and averaged to get more
			  accurate value. This increases the time taken
			  by ADC to generate a sample. Valid range is 0
			  average to 16 averages. Maximum value is 16.

Example:
	tscadc: tscadc@44e0d000 {
		compatible = "ti,am3359-tscadc";
		tsc {
			ti,wires = <4>;
			ti,x-plate-resistance = <200>;
			ti,coordiante-readouts = <5>;
			ti,wire-config = <0x00 0x11 0x22 0x33>;
			ti,charge-delay = <0x400>;
		};

		adc {
			ti,adc-channels = <4 5 6 7>;
			ti,chan-step-opendelay = <0x098 0x3ffff 0x098 0x0>;
			ti,chan-step-sampledelay = <0xff 0x0 0xf 0x0>;
			ti,chan-step-avg = <16 2 4 8>;
		};
	}
```

## Documentation/devicetree/bindings/input/touchscreen/toradex,vf50-touchscreen.yaml
```yaml
# SPDX-License-Identifier: (GPL-2.0-only OR BSD-2-Clause)
%YAML 1.2
---
$id: http://devicetree.org/schemas/input/touchscreen/toradex,vf50-touchscreen.yaml#
$schema: http://devicetree.org/meta-schemas/core.yaml#

title: Toradex Colibri VF50 Touchscreen

maintainers:
  - Dmitry Torokhov <dmitry.torokhov@gmail.com>
  - Sanchayan Maity <maitysanchayan@gmail.com>

properties:
  compatible:
    const: toradex,vf50-touchscreen

  interrupts:
    maxItems: 1

  io-channels:
    maxItems: 4
    description:
      adc channels being used by the Colibri VF50 module
      IIO ADC for Y-, X-, Y+, X+ connections

  xp-gpios:
    description: FET gate driver for input of X+

  xm-gpios:
    description: FET gate driver for input of X-

  yp-gpios:
    description: FET gate driver for input of Y+

  ym-gpios:
    description: FET gate driver for input of Y-

  vf50-ts-min-pressure:
    $ref: /schemas/types.yaml#/definitions/uint32
    minimum: 50
    maximum: 2000
    description: pressure level at which to stop measuring X/Y values

required:
  - compatible
  - io-channels
  - xp-gpios
  - xm-gpios
  - yp-gpios
  - ym-gpios
  - interrupts
  - vf50-ts-min-pressure

allOf:
  - $ref: touchscreen.yaml#

unevaluatedProperties: false

examples:
  - |
    #include <dt-bindings/interrupt-controller/irq.h>
    #include <dt-bindings/gpio/gpio.h>

    touchscreen {
        compatible = "toradex,vf50-touchscreen";
        interrupt-parent = <&gpio0>;
        interrupts = <8 IRQ_TYPE_LEVEL_LOW>;
        io-channels = <&adc1 0>, <&adc0 0>, <&adc0 1>, <&adc1 2>;
        xp-gpios = <&gpio0 13 GPIO_ACTIVE_LOW>;
        xm-gpios = <&gpio2 29 GPIO_ACTIVE_HIGH>;
        yp-gpios = <&gpio0 12 GPIO_ACTIVE_LOW>;
        ym-gpios = <&gpio0 4 GPIO_ACTIVE_HIGH>;
        pinctrl-names = "idle", "default";
        pinctrl-0 = <&pinctrl_touchctrl_idle>, <&pinctrl_touchctrl_gpios>;
        pinctrl-1 = <&pinctrl_touchctrl_default>, <&pinctrl_touchctrl_gpios>;
        vf50-ts-min-pressure = <200>;
    };
```
