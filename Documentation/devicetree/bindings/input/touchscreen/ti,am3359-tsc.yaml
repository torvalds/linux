## Documentation/devicetree/bindings/input/touchscreen/touchscreen.yaml
```yaml
# SPDX-License-Identifier: GPL-2.0
%YAML 1.2
---
$id: http://devicetree.org/schemas/input/touchscreen/touchscreen.yaml#
$schema: http://devicetree.org/meta-schemas/core.yaml#

title: Common touchscreen

maintainers:
  - Dmitry Torokhov <dmitry.torokhov@gmail.com>

properties:
  panel:
    description: If this touchscreen is integrally connected to a panel, this
      is a reference to that panel. The presence of this reference indicates
      that the touchscreen should be power sequenced together with the panel
      and that they may share power and/or reset signals.
    $ref: /schemas/types.yaml#/definitions/phandle

  touchscreen-min-x:
    description: minimum x coordinate reported
    $ref: /schemas/types.yaml#/definitions/uint32
    default: 0

  touchscreen-min-y:
    description: minimum y coordinate reported
    $ref: /schemas/types.yaml#/definitions/uint32
    default: 0

  touchscreen-size-x:
    description: horizontal resolution of touchscreen (maximum x coordinate reported + 1)
    $ref: /schemas/types.yaml#/definitions/uint32

  touchscreen-size-y:
    description: vertical resolution of touchscreen (maximum y coordinate reported + 1)
    $ref: /schemas/types.yaml#/definitions/uint32

  touchscreen-max-pressure:
    description: maximum reported pressure (arbitrary range dependent on the controller)
    $ref: /schemas/types.yaml#/definitions/uint32

  touchscreen-min-pressure:
    description: minimum pressure on the touchscreen to be achieved in order
      for the touchscreen driver to report a touch event.
    $ref: /schemas/types.yaml#/definitions/uint32

  touchscreen-fuzz-x:
    description: horizontal noise value of the absolute input device (in pixels)
    $ref: /schemas/types.yaml#/definitions/uint32

  touchscreen-fuzz-y:
    description: vertical noise value of the absolute input device (in pixels)
    $ref: /schemas/types.yaml#/definitions/uint32

  touchscreen-fuzz-pressure:
    description: pressure noise value of the absolute input device (arbitrary
      range dependent on the controller)
    $ref: /schemas/types.yaml#/definitions/uint32

  touchscreen-average-samples:
    description: Number of data samples which are averaged for each read (valid
      values dependent on the controller)
    $ref: /schemas/types.yaml#/definitions/uint32

  touchscreen-inverted-x:
    description: X axis is inverted
    type: boolean

  touchscreen-inverted-y:
    description: Y axis is inverted
    type: boolean

  touchscreen-swapped-x-y:
    description: X and Y axis are swapped
                 Swapping is done after inverting the axis
    type: boolean

  touchscreen-x-mm:
    description: horizontal length in mm of the touchscreen

  touchscreen-y-mm:
    description: vertical length in mm of the touchscreen

  touchscreen-x-plate-ohms:
    description: Resistance of the X-plate in Ohms

  touchscreen-y-plate-ohms:
    description: Resistance of the Y-plate in Ohms

  touch-overlay:
    description: |
      List of nodes defining segments (touch areas) on the touchscreen.

      This object can be used to describe a series of segments to restrict
      the region within touch events are reported or buttons with a specific
      functionality.

      This is of special interest if the touchscreen is shipped with a physical
      overlay on top of it with a frame that hides some part of the original
      touchscreen area. Printed buttons on that overlay are also a typical
      use case.

      A new touchscreen area is defined as a sub-node without a key code. If a
      key code is defined in the sub-node, it will be interpreted as a button.

      The x-origin and y-origin properties of a touchscreen area define the
      offset of a new origin from where the touchscreen events are referenced.
      This offset is applied to the events accordingly. The x-size and y-size
      properties define the size of the touchscreen effective area.

      The following example shows a new touchscreen area with the new origin
      (0',0') for the touch events generated by the device.

                   Touchscreen (full area)
         ┌────────────────────────────────────────┐
         │    ┌───────────────────────────────┐   │
         │    │                               │   │
         │    ├ y-size                        │   │
         │    │                               │   │
         │    │       touchscreen area        │   │
         │    │         (no key code)         │   │
         │    │                               │   │
         │    │            x-size             │   │
         │   ┌└──────────────┴────────────────┘   │
         │(0',0')                                 │
        ┌└────────────────────────────────────────┘
      (0,0)

      where (0',0') = (0+x-origin,0+y-origin)

      Sub-nodes with key codes report the touch events on their surface as key
      events instead.

      The following example shows a touchscreen with a single button on it.

              Touchscreen (full area)
        ┌───────────────────────────────────┐
        │                                   │
        │                                   │
        │   ┌─────────┐                     │
        │   │button 0 │                     │
        │   │KEY_POWER│                     │
        │   └─────────┘                     │
        │                                   │
        │                                   │
       ┌└───────────────────────────────────┘
      (0,0)

      Segments defining buttons and clipped toushcreen areas can be combined
      as shown in the following example.
      In that case only the events within the touchscreen area are reported
      as touch events. Events within the button areas report their associated
      key code. Any events outside the defined areas are ignored.

                  Touchscreen (full area)
        ┌─────────┬──────────────────────────────┐
        │         │                              │
        │         │    ┌───────────────────────┐ │
        │ button 0│    │                       │ │
        │KEY_POWER│    │                       │ │
        │         │    │                       │ │
        ├─────────┤    │   touchscreen area    │ │
        │         │    │     (no key code)     │ │
        │         │    │                       │ │
        │ button 1│    │                       │ │
        │ KEY_INFO│   ┌└───────────────────────┘ │
        │         │(0',0')                       │
       ┌└─────────┴──────────────────────────────┘
      (0,0)

    type: object

    patternProperties:
      '^segment-':
        type: object
        description:
          Each segment is represented as a sub-node.
        properties:
          x-origin:
            description: horizontal origin of the node area
            $ref: /schemas/types.yaml#/definitions/uint32

          y-origin:
            description: vertical origin of the node area
            $ref: /schemas/types.yaml#/definitions/uint32

          x-size:
            description: horizontal resolution of the node area
            $ref: /schemas/types.yaml#/definitions/uint32

          y-size:
            description: vertical resolution of the node area
            $ref: /schemas/types.yaml#/definitions/uint32

          label:
            description: descriptive name of the segment
            $ref: /schemas/types.yaml#/definitions/string

          linux,code: true

        required:
          - x-origin
          - y-origin
          - x-size
          - y-size

        unevaluatedProperties: false

  debounce-delay-us:
    description: Minimum duration in microseconds a signal must remain stable
      to be considered valid.

dependencies:
  touchscreen-size-x: [ touchscreen-size-y ]
  touchscreen-size-y: [ touchscreen-size-x ]
  touchscreen-x-mm: [ touchscreen-y-mm ]
  touchscreen-y-mm: [ touchscreen-x-mm ]

additionalProperties: true
```

## Documentation/devicetree/bindings/input/touchscreen/trivial-touch.yaml
```yaml
# SPDX-License-Identifier: (GPL-2.0-only OR BSD-2-Clause)
%YAML 1.2
---
$id: http://devicetree.org/schemas/input/touchscreen/trivial-touch.yaml#
$schema: http://devicetree.org/meta-schemas/core.yaml#

title: Trivial touch screen controller with i2c interface

maintainers:
  - Frank Li <Frank.Li@nxp.com>

properties:
  compatible:
    enum:
      # The Azoteq IQS550, IQS572 and IQS525 trackpad and touchscreen controllers
      - azoteq,iqs550
      - azoteq,iqs572
      - azoteq,iqs525
      # Himax hx83100a touchscreen controller
      - himax,hx83100a
      # Himax hx83112b touchscreen controller
      - himax,hx83112b
      # Hynitron cstxxx series touchscreen controller
      - hynitron,cst340
      # Ilitek I2C Touchscreen Controller
      - ilitek,ili210x
      - ilitek,ili2117
      - ilitek,ili2120
      - ilitek,ili2130
      - ilitek,ili2131
      - ilitek,ili2132
      - ilitek,ili2316
      - ilitek,ili2322
      - ilitek,ili2323
      - ilitek,ili2326
      - ilitek,ili251x
      - ilitek,ili2520
      - ilitek,ili2521
      # MAXI MAX11801 Resistive touch screen controller with i2c interface
      - maxim,max11801
      # Microchip AR1020 and AR1021 touchscreen interface (I2C)
      - microchip,ar1021-i2c
      # Trivial touch screen controller with i2c interface
      - semtech,sx8650
      - semtech,sx8654
      - semtech,sx8655
      - semtech,sx8656

  reg:
    maxItems: 1

  interrupts:
    maxItems: 1

  reset-gpios:
    maxItems: 1

  wakeup-source: true

allOf:
  - $ref: touchscreen.yaml

required:
  - compatible
  - reg
  - interrupts

unevaluatedProperties: false

examples:
  - |
    #include <dt-bindings/interrupt-controller/irq.h>

    i2c {
        #address-cells = <1>;
        #size-cells = <0>;

        touchscreen@48 {
            compatible = "maxim,max11801";
            reg = <0x48>;
            interrupt-parent = <&gpio3>;
            interrupts = <31 IRQ_TYPE_EDGE_FALLING>;
        };
    };
```

## Documentation/devicetree/bindings/input/touchscreen/ts4800-ts.txt
```
* TS-4800 Touchscreen bindings

Required properties:
- compatible: must be "technologic,ts4800-ts"
- reg: physical base address of the controller and length of memory mapped
  region.
- syscon: phandle / integers array that points to the syscon node which
          describes the FPGA's syscon registers.
          - phandle to FPGA's syscon
          - offset to the touchscreen register
          - offset to the touchscreen enable bit
```

## Documentation/devicetree/bindings/input/touchscreen/tsc2005.txt
```
* Texas Instruments tsc2004 and tsc2005 touchscreen controllers

Required properties:
 - compatible		      : "ti,tsc2004" or "ti,tsc2005"
 - reg			      : Device address
 - interrupts		      : IRQ specifier
 - spi-max-frequency	      : Maximum SPI clocking speed of the device
			        (for tsc2005)

Optional properties:
 - vio-supply		      : Regulator specifier
 - reset-gpios		      : GPIO specifier for the controller reset line
 - ti,x-plate-ohms	      : integer, resistance of the touchscreen's X plates
				in ohm (defaults to 280)
 - ti,esd-recovery-timeout-ms : integer, if the touchscreen does not respond after
				the configured time (in milli seconds), the driver
				will reset it. This is disabled by default.
 - properties defined in touchscreen.txt

Example:

&i2c3 {
	tsc2004@48 {
		compatible = "ti,tsc2004";
		reg = <0x48>;
		vio-supply = <&vio>;

		reset-gpios = <&gpio4 8 GPIO_ACTIVE_HIGH>;
		interrupts-extended = <&gpio1 27 IRQ_TYPE_EDGE_RISING>;

		touchscreen-fuzz-x = <4>;
		touchscreen-fuzz-y = <7>;
		touchscreen-fuzz-pressure = <2>;
		touchscreen-size-x = <4096>;
		touchscreen-size-y = <4096>;
		touchscreen-max-pressure = <2048>;

		ti,x-plate-ohms = <280>;
		ti,esd-recovery-timeout-ms = <8000>;
	};
}

&mcspi1 {
	tsc2005@0 {
		compatible = "ti,tsc2005";
		spi-max-frequency = <6000000>;
		reg = <0>;

		vio-supply = <&vio>;

		reset-gpios = <&gpio4 8 GPIO_ACTIVE_HIGH>; /* 104 */
		interrupts-extended = <&gpio4 4 IRQ_TYPE_EDGE_RISING>; /* 100 */

		touchscreen-fuzz-x = <4>;
		touchscreen-fuzz-y = <7>;
		touchscreen-fuzz-pressure = <2>;
		touchscreen-size-x = <4096>;
		touchscreen-size-y = <4096>;
		touchscreen-max-pressure = <2048>;

		ti,x-plate-ohms = <280>;
		ti,esd-recovery-timeout-ms = <8000>;
	};
}
```

## Documentation/devicetree/bindings/input/touchscreen/tsc2007.txt
```
* Texas Instruments tsc2007 touchscreen controller

Required properties:
- compatible: must be "ti,tsc2007".
- reg: I2C address of the chip.
- ti,x-plate-ohms: X-plate resistance in ohms.

Optional properties:
- gpios: the interrupt gpio the chip is connected to (trough the penirq pin).
  The penirq pin goes to low when the panel is touched.
  (see GPIO binding[1] for more details).
- interrupts: (gpio) interrupt to which the chip is connected
  (see interrupt binding[0]).
- ti,max-rt: maximum pressure.
- ti,fuzzx: specifies the absolute input fuzz x value.
  If set, it will permit noise in the data up to +- the value given to the fuzz
  parameter, that is used to filter noise from the event stream.
- ti,fuzzy: specifies the absolute input fuzz y value.
- ti,fuzzz: specifies the absolute input fuzz z value.
- ti,poll-period: how much time to wait (in milliseconds) before reading again the
  values from the tsc2007.

[0]: Documentation/devicetree/bindings/interrupt-controller/interrupts.txt
[1]: Documentation/devicetree/bindings/gpio/gpio.txt

Example:
	&i2c1 {
		/* ... */
		tsc2007@49 {
			compatible = "ti,tsc2007";
			reg = <0x49>;
			interrupt-parent = <&gpio4>;
			interrupts = <0x0 0x8>;
			gpios = <&gpio4 0 0>;
			ti,x-plate-ohms = <180>;
		};

		/* ... */
	};
```

## Documentation/devicetree/bindings/input/touchscreen/vtl_ts.txt
```
* VTL Touchscreen Controller

Required properties:
- compatible: must be "vtl,ct365"
- reg: i2c slave address
- interrupt-parent: the phandle for the interrupt controller
- interrupts: touch controller interrupt
- gpios: the gpio pin to be used for reset

Example:

        touchscreen@01 {
                compatible = "vtl,ct365";
                reg = <0x01>;
                interrupt-parent = <&gpio6>;
                interrupts = <14 0>;
                gpios = <&gpio4 10 0>;
        };
```

## Documentation/devicetree/bindings/input/touchscreen/wacom,w9007a-lt03.yaml
```yaml
# SPDX-License-Identifier: (GPL-2.0-only OR BSD-2-Clause)
%YAML 1.2
---
$id: http://devicetree.org/schemas/input/touchscreen/wacom,w9007a-lt03.yaml#
$schema: http://devicetree.org/meta-schemas/core.yaml#

title: Wacom W9000-series penabled I2C touchscreen

maintainers:
  - Hendrik Noack <hendrik-noack@gmx.de>

description: |
  The W9000-series are penabled touchscreen controllers by Wacom.

  The firmware of controllers in different devices may differ. This can also
  affect the controller's behavior.

allOf:
  - $ref: touchscreen.yaml#

properties:
  compatible:
    enum:
      - wacom,w9002
      - wacom,w9007a-lt03
      - wacom,w9007a-v1

  reg:
    maxItems: 1

  interrupts:
    maxItems: 1

  vdd-supply: true

  flash-mode-gpios:
    maxItems: 1

  reset-gpios:
    maxItems: 1

required:
  - compatible
  - reg
  - interrupts

unevaluatedProperties: false

examples:
  - |
    #include <dt-bindings/gpio/gpio.h>
    #include <dt-bindings/interrupt-controller/irq.h>

    i2c {
        #address-cells = <1>;
        #size-cells = <0>;

        digitizer@56 {
            compatible = "wacom,w9007a-lt03";
            reg = <0x56>;
            interrupt-parent = <&gpd1>;
            interrupts = <1 IRQ_TYPE_EDGE_RISING>;

            vdd-supply = <&stylus_reg>;

            flash-mode-gpios = <&gpd1 3 GPIO_ACTIVE_HIGH>;
            reset-gpios = <&gpx0 1 GPIO_ACTIVE_LOW>;

            touchscreen-x-mm = <216>;
            touchscreen-y-mm = <135>;
            touchscreen-inverted-x;
        };
    };
```
