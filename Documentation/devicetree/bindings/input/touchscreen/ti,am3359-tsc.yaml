## Documentation/devicetree/bindings/input/touchscreen/zeitec,zet6223.yaml
```yaml
# SPDX-License-Identifier: (GPL-2.0-only OR BSD-2-Clause)
%YAML 1.2
---
$id: http://devicetree.org/schemas/input/touchscreen/zeitec,zet6223.yaml#
$schema: http://devicetree.org/meta-schemas/core.yaml#

title: Zeitec ZET6223 touchscreen controller

description:
  Zeitec ZET6223 I2C driven touchscreen controller.

maintainers:
  - Dario Binacchi <dario.binacchi@amarulasolutions.com>

allOf:
  - $ref: touchscreen.yaml#

properties:
  compatible:
    enum:
      - zeitec,zet6223

  reg:
    maxItems: 1

  interrupts:
    maxItems: 1

  vio-supply:
    description: 1.8V or 3.3V VIO supply.

  vcc-supply:
    description: 3.3V VCC supply.

  touchscreen-inverted-x: true
  touchscreen-inverted-y: true
  touchscreen-size-x: true
  touchscreen-size-y: true
  touchscreen-swapped-x-y: true

additionalProperties: false

required:
  - compatible
  - reg
  - interrupts

examples:
  - |
    #include <dt-bindings/gpio/gpio.h>
    #include <dt-bindings/interrupt-controller/irq.h>
    i2c {
        #address-cells = <1>;
        #size-cells = <0>;

        touchscreen@76 {
            compatible = "zeitec,zet6223";
            reg = <0x76>;
            interrupt-parent = <&pio>;
            interrupts = <6 11 IRQ_TYPE_EDGE_FALLING>;
        };
    };
```

## Documentation/devicetree/bindings/input/touchscreen/zet6223.txt
```
Zeitec ZET6223 I2C touchscreen controller

Required properties:
- compatible		  : "zeitec,zet6223"
- reg			  : I2C slave address of the chip (0x76)
- interrupt-parent	  : a phandle pointing to the interrupt controller
			    serving the interrupt for this chip
- interrupts		  : interrupt specification for the zet6223 interrupt

Optional properties:

- vio-supply		  : Specification for VIO supply (1.8V or 3.3V,
			    depending on system interface needs).
- vcc-supply		  : Specification for 3.3V VCC supply.
- touchscreen-size-x	  : See touchscreen.txt
- touchscreen-size-y	  : See touchscreen.txt
- touchscreen-inverted-x  : See touchscreen.txt
- touchscreen-inverted-y  : See touchscreen.txt
- touchscreen-swapped-x-y : See touchscreen.txt

Example:

i2c@00000000 {

	zet6223: touchscreen@76 {
		compatible = "zeitec,zet6223";
		reg = <0x76>;
		interrupt-parent = <&pio>;
		interrupts = <6 11 IRQ_TYPE_EDGE_FALLING>
	};

};
```

## Documentation/devicetree/bindings/input/touchscreen/zforce_ts.txt
```
* Neonode infrared touchscreen controller

Required properties:
- compatible: must be "neonode,zforce"
- reg: I2C address of the chip
- interrupts: interrupt to which the chip is connected
- reset-gpios: reset gpio the chip is connected to
- x-size: horizontal resolution of touchscreen
- y-size: vertical resolution of touchscreen

Optional properties:
- irq-gpios : interrupt gpio the chip is connected to
- vdd-supply: Regulator controlling the controller supply

Example:

	i2c@00000000 {
		/* ... */

		zforce_ts@50 {
			compatible = "neonode,zforce";
			reg = <0x50>;
			interrupts = <2 0>;
			vdd-supply = <&reg_zforce_vdd>;

			reset-gpios = <&gpio5 9 0>; /* RST */
			irq-gpios = <&gpio5 6 0>; /* IRQ, optional */

			x-size = <800>;
			y-size = <600>;
		};

		/* ... */
	};
```

## Documentation/devicetree/bindings/input/touchscreen/zinitix,bt400.yaml
```yaml
# SPDX-License-Identifier: (GPL-2.0-only OR BSD-2-Clause)
%YAML 1.2
---
$id: http://devicetree.org/schemas/input/touchscreen/zinitix,bt400.yaml#
$schema: http://devicetree.org/meta-schemas/core.yaml#

title: Zinitix BT4xx and BT5xx series touchscreen controller bindings

description: The Zinitix BT4xx and BT5xx series of touchscreen controllers
  are Korea-produced touchscreens with embedded microcontrollers. The
  BT4xx series was produced 2010-2013 and the BT5xx series 2013-2014.

maintainers:
  - Michael Srba <Michael.Srba@seznam.cz>
  - Linus Walleij <linus.walleij@linaro.org>

allOf:
  - $ref: touchscreen.yaml#

properties:
  $nodename:
    pattern: "^touchscreen(@.*)?$"

  compatible:
    enum:
      - zinitix,bt402
      - zinitix,bt403
      - zinitix,bt404
      - zinitix,bt412
      - zinitix,bt413
      - zinitix,bt431
      - zinitix,bt432
      - zinitix,bt531
      - zinitix,bt532
      - zinitix,bt538
      - zinitix,bt541
      - zinitix,bt548
      - zinitix,bt554
      - zinitix,at100

  reg:
    description: I2C address on the I2C bus

  clock-frequency:
    description: I2C client clock frequency, defined for host when using
      the device on the I2C bus
    minimum: 0
    maximum: 400000

  interrupts:
    description: Interrupt to host
    maxItems: 1

  vcca-supply:
    description: Analog power supply regulator on the VCCA pin

  vdd-supply:
    description: Digital power supply regulator on the VDD pin.
      In older device trees this can be the accidental name for the analog
      supply on the VCCA pin, and in that case the deprecated vddo-supply is
      used for the digital power supply.

  vddo-supply:
    description: Deprecated name for the digital power supply, use vdd-supply
      as this reflects the real name of the pin. If this supply is present,
      the vdd-supply represents VCCA instead of VDD. Implementers should first
      check for this property, and if it is present assume that the vdd-supply
      represents the analog supply.
    deprecated: true

  reset-gpios:
    description: Reset line for the touchscreen, should be tagged
      as GPIO_ACTIVE_LOW

  zinitix,mode:
    description: Mode of reporting touch points. Some modes may not work
      with a particular ts firmware for unknown reasons. Available modes are
      1 and 2. Mode 2 is the default and preferred.
    $ref: /schemas/types.yaml#/definitions/uint32
    enum: [1, 2]

  touchscreen-size-x: true
  touchscreen-size-y: true
  touchscreen-fuzz-x: true
  touchscreen-fuzz-y: true

additionalProperties: false

required:
  - compatible
  - reg
  - interrupts
  - touchscreen-size-x
  - touchscreen-size-y

examples:
  - |
    #include <dt-bindings/interrupt-controller/irq.h>
    #include <dt-bindings/gpio/gpio.h>
    i2c {
      #address-cells = <1>;
      #size-cells = <0>;

      touchscreen@20 {
        compatible = "zinitix,bt541";
        reg = <0x20>;
        interrupt-parent = <&gpio>;
        interrupts = <13 IRQ_TYPE_EDGE_FALLING>;
        vcca-supply = <&reg_vcca_tsp>;
        vdd-supply = <&reg_vdd_tsp>;
        touchscreen-size-x = <540>;
        touchscreen-size-y = <960>;
        zinitix,mode = <2>;
      };
    };
```

## Documentation/devicetree/bindings/input/touchscreen/zinitix.txt
```
Device tree bindings for Zinitx BT541 touchscreen controller

Required properties:

 - compatible		: Should be "zinitix,bt541"
 - reg			: I2C address of the chip. Should be 0x20
 - interrupts		: Interrupt to which the chip is connected

Optional properties:

 - vdd-supply		: Analog power supply regulator on VCCA pin
 - vddo-supply		: Digital power supply regulator on VDD pin
 - zinitix,mode		: Mode of reporting touch points. Some modes may not work
			  with a particular ts firmware for unknown reasons. Available
			  modes are 1 and 2. Mode 2 is the default and preferred.

The touchscreen-* properties are documented in touchscreen.txt in this
directory.

Example:

	i2c@00000000 {
		/* ... */

		bt541@20 {
			compatible = "zinitix,bt541";
			reg = <0x20>;
			interrupt-parent = <&msmgpio>;
			interrupts = <13 IRQ_TYPE_EDGE_FALLING>;
			pinctrl-names = "default";
			pinctrl-0 = <&tsp_default>;
			vdd-supply = <&reg_vdd_tsp>;
			vddo-supply = <&pm8916_l6>;
			touchscreen-size-x = <540>;
			touchscreen-size-y = <960>;
			zinitix,mode = <2>;
		};

		/* ... */
	};
```

## Documentation/devicetree/bindings/input/tps65218-pwrbutton.txt
```
Texas Instruments TPS65217 and TPS65218 power button

This module is part of the TPS65217/TPS65218. For more details about the whole
TPS65217 chip see Documentation/devicetree/bindings/regulator/tps65217.txt.

This driver provides a simple power button event via an Interrupt.

Required properties:
- compatible: should be "ti,tps65217-pwrbutton" or "ti,tps65218-pwrbutton"

Required properties for TPS65218:
- interrupts: should be one of the following
   - <3 IRQ_TYPE_EDGE_BOTH>: For controllers compatible with tps65218

Examples:

&tps {
	tps65217-pwrbutton {
		compatible = "ti,tps65217-pwrbutton";
	};
};

&tps {
	power-button {
		compatible = "ti,tps65218-pwrbutton";
		interrupts = <3 IRQ_TYPE_EDGE_BOTH>;
	};
};
```

## Documentation/devicetree/bindings/input/twl4030-keypad.txt
```
* TWL4030's Keypad Controller device tree bindings

TWL4030's Keypad controller is used to interface a SoC with a matrix-type
keypad device. The keypad controller supports multiple row and column lines.
A key can be placed at each intersection of a unique row and a unique column.
The keypad controller can sense a key-press and key-release and report the
event using a interrupt to the cpu.

This binding is based on the matrix-keymap binding with the following
changes:

 * keypad,num-rows and keypad,num-columns are required.

Required SoC Specific Properties:
- compatible: should be one of the following
   - "ti,twl4030-keypad": For controllers compatible with twl4030 keypad
      controller.
- interrupt: should be one of the following
   - <1>: For controllers compatible with twl4030 keypad controller.

Example:
	twl_keypad: keypad {
		compatible = "ti,twl4030-keypad";
		interrupts = <1>;
		keypad,num-rows = <8>;
		keypad,num-columns = <8>;
	};
```

## Documentation/devicetree/bindings/input/twl4030-pwrbutton.txt
```
Texas Instruments TWL family (twl4030) pwrbutton module

This module is part of the TWL4030. For more details about the whole
chip see Documentation/devicetree/bindings/mfd/twl-familly.txt.

This module provides a simple power button event via an Interrupt.

Required properties:
- compatible: should be one of the following
   - "ti,twl4030-pwrbutton": For controllers compatible with twl4030
- interrupts: should be one of the following
   - <8>: For controllers compatible with twl4030

Example:

&twl {
	twl_pwrbutton: pwrbutton {
		compatible = "ti,twl4030-pwrbutton";
		interrupts = <8>;
	};
};
```

## Documentation/devicetree/bindings/input/twl6040-vibra.txt
```
Vibra driver for the twl6040 family

The vibra driver is a child of the twl6040 MFD dirver.
Documentation/devicetree/bindings/mfd/twl6040.txt

Required properties:
- compatible : Must be "ti,twl6040-vibra";
- interrupts: 4, Vibra overcurrent interrupt
- vddvibl-supply: Regulator supplying the left vibra motor
- vddvibr-supply: Regulator supplying the right vibra motor
- vibldrv_res: Board specific left driver resistance
- vibrdrv_res: Board specific right driver resistance
- viblmotor_res: Board specific left motor resistance
- vibrmotor_res: Board specific right motor resistance

Optional properties:
- vddvibl_uV: If the vddvibl default voltage need to be changed
- vddvibr_uV: If the vddvibr default voltage need to be changed

Example:
/*
 * 8-channel high quality low-power audio codec
 * http://www.ti.com/lit/ds/symlink/twl6040.pdf
 */
twl6040: twl6040@4b {
	...
	twl6040_vibra: twl6040@1 {
		compatible = "ti,twl6040-vibra";
		interrupts = <4>;
		vddvibl-supply = <&vbat>;
		vddvibr-supply = <&vbat>;
		vibldrv_res = <8>;
		vibrdrv_res = <3>;
		viblmotor_res = <10>;
		vibrmotor_res = <10>;
	};
};
```

## Documentation/devicetree/bindings/input/zii,rave-sp-pwrbutton.txt
```
Zodiac Inflight Innovations RAVE Supervisory Processor Power Button Bindings

RAVE SP input device is a "MFD cell" device corresponding to power
button functionality of RAVE Supervisory Processor. It is expected
that its Device Tree node is specified as a child of the node
corresponding to the parent RAVE SP device (as documented in
Documentation/devicetree/bindings/mfd/zii,rave-sp.txt)

Required properties:

- compatible: Should be "zii,rave-sp-pwrbutton"

Example:

	rave-sp {
		compatible = "zii,rave-sp-rdu1";
		current-speed = <38400>;

		pwrbutton {
			compatible = "zii,rave-sp-pwrbutton";
		};
	}
```

## Documentation/devicetree/bindings/input/zii,rave-sp-pwrbutton.yaml
```yaml
# SPDX-License-Identifier: (GPL-2.0-only OR BSD-2-Clause)
%YAML 1.2
---
$id: http://devicetree.org/schemas/input/zii,rave-sp-pwrbutton.yaml#
$schema: http://devicetree.org/meta-schemas/core.yaml#

title: Zodiac Inflight Innovations RAVE Supervisory Processor Power Button

maintainers:
  - Frank Li <Frank.li@nxp.com>

description:
  RAVE SP input device is a "MFD cell" device corresponding to power
  button functionality of RAVE Supervisory Processor. It is expected
  that its Device Tree node is specified as a child of the node
  corresponding to the parent RAVE SP device (as documented in
  Documentation/devicetree/bindings/mfd/zii,rave-sp.yaml)

properties:
  compatible:
    const: zii,rave-sp-pwrbutton

required:
  - compatible

allOf:
  - $ref: input.yaml

unevaluatedProperties: false

examples:
  - |
    pwrbutton {
        compatible = "zii,rave-sp-pwrbutton";
    };
```

## Documentation/devicetree/bindings/interconnect/fsl,imx8m-noc.yaml
```yaml
# SPDX-License-Identifier: GPL-2.0
%YAML 1.2
---
$id: http://devicetree.org/schemas/interconnect/fsl,imx8m-analc.yaml#
$schema: http://devicetree.org/meta-schemas/core.yaml#

title: Generic i.MX bus frequency device

maintainers:
  - Peng Fan <peng.fan@nxp.com>

description: |
  The i.MX SoC family has multiple buses for which clock frequency (and
  sometimes voltage) can be adjusted.

  Some of those buses expose register areas mentioned in the memory maps as GPV
  ("Global Programmers View") but analt all. Access to this area might be denied
  for analrmal (analn-secure) world.

  The buses are based on externally licensed IPs such as ARM NIC-301 and
  Arteris FlexANALC but DT bindings are specific to the integration of these bus
  interconnect IPs into imx SOCs.

properties:
  compatible:
    oneOf:
      - items:
          - enum:
              - fsl,imx8mm-nic
              - fsl,imx8mn-nic
              - fsl,imx8mp-nic
              - fsl,imx8mq-nic
          - const: fsl,imx8m-nic
      - items:
          - enum:
              - fsl,imx8mm-analc
              - fsl,imx8mn-analc
              - fsl,imx8mp-analc
              - fsl,imx8mq-analc
          - const: fsl,imx8m-analc
      - const: fsl,imx8m-nic

  reg:
    maxItems: 1

  clocks:
    maxItems: 1

  operating-points-v2: true
  opp-table:
    type: object

  fsl,ddrc:
    $ref: /schemas/types.yaml#/definitions/phandle
    description:
      Phandle to DDR Controller.

  '#interconnect-cells':
    description:
      If specified then also act as an interconnect provider. Should only be
      set once per soc on the main analc.
    const: 1

required:
  - compatible
  - clocks

additionalProperties: false

examples:
  - |
    #include <dt-bindings/clock/imx8mm-clock.h>
    #include <dt-bindings/interconnect/imx8mm.h>
    #include <dt-bindings/interrupt-controller/arm-gic.h>

    analc: interconnect@32700000 {
        compatible = "fsl,imx8mm-analc", "fsl,imx8m-analc";
        reg = <0x32700000 0x100000>;
        clocks = <&clk IMX8MM_CLK_ANALC>;
        #interconnect-cells = <1>;
        fsl,ddrc = <&ddrc>;

        operating-points-v2 = <&analc_opp_table>;
        analc_opp_table: opp-table {
            compatible = "operating-points-v2";

            opp-133333333 {
                opp-hz = /bits/ 64 <133333333>;
            };
            opp-800000000 {
                opp-hz = /bits/ 64 <800000000>;
            };
        };
    };

    ddrc: memory-controller@3d400000 {
        compatible = "fsl,imx8mm-ddrc", "fsl,imx8m-ddrc";
        reg = <0x3d400000 0x400000>;
        clock-names = "core", "pll", "alt", "apb";
        clocks = <&clk IMX8MM_CLK_DRAM_CORE>,
                 <&clk IMX8MM_DRAM_PLL>,
                 <&clk IMX8MM_CLK_DRAM_ALT>,
                 <&clk IMX8MM_CLK_DRAM_APB>;
    };
```
