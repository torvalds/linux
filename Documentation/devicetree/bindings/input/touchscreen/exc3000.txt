## Documentation/devicetree/bindings/input/touchscreen/exc3000.txt
```
* EETI EXC3000 Multiple Touch Controller

Required properties:
- compatible: must be "eeti,exc3000"
- reg: i2c slave address
- interrupts: touch controller interrupt
- touchscreen-size-x: See touchscreen.txt
- touchscreen-size-y: See touchscreen.txt

Optional properties:
- touchscreen-inverted-x: See touchscreen.txt
- touchscreen-inverted-y: See touchscreen.txt
- touchscreen-swapped-x-y: See touchscreen.txt

Example:

	touchscreen@2a {
		compatible = "eeti,exc3000";
		reg = <0x2a>;
		interrupt-parent = <&gpio1>;
		interrupts = <9 IRQ_TYPE_LEVEL_LOW>;
		touchscreen-size-x = <4096>;
		touchscreen-size-y = <4096>;
		touchscreen-inverted-x;
		touchscreen-swapped-x-y;
	};
```

## Documentation/devicetree/bindings/input/touchscreen/focaltech-ft6236.txt
```
* FocalTech FT6236 I2C touchscreen controller

Required properties:
 - compatible		  : "focaltech,ft6236"
 - reg			  : I2C slave address of the chip (0x38)
 - interrupt-parent	  : a phandle pointing to the interrupt controller
			    serving the interrupt for this chip
 - interrupts		  : interrupt specification for the touch controller
			    interrupt
 - reset-gpios		  : GPIO specification for the RSTN input
 - touchscreen-size-x	  : horizontal resolution of touchscreen (in pixels)
 - touchscreen-size-y	  : vertical resolution of touchscreen (in pixels)

Optional properties:
 - touchscreen-fuzz-x	  : horizontal noise value of the absolute input
			    device (in pixels)
 - touchscreen-fuzz-y	  : vertical noise value of the absolute input
			    device (in pixels)
 - touchscreen-inverted-x : X axis is inverted (boolean)
 - touchscreen-inverted-y : Y axis is inverted (boolean)
 - touchscreen-swapped-x-y: X and Y axis are swapped (boolean)
			    Swapping is done after inverting the axis

Example:

	ft6x06@38 {
		compatible = "focaltech,ft6236";
		reg = <0x38>;
		interrupt-parent = <&gpio>;
		interrupts = <23 2>;
		touchscreen-size-x = <320>;
		touchscreen-size-y = <480>;
		touchscreen-inverted-x;
		touchscreen-swapped-x-y;
	};
```

## Documentation/devicetree/bindings/input/touchscreen/fsl,imx25-tcq.yaml
```yaml
# SPDX-License-Identifier: GPL-2.0-only OR BSD-2-Clause
%YAML 1.2
---
$id: http://devicetree.org/schemas/input/touchscreen/fsl,imx25-tcq.yaml#
$schema: http://devicetree.org/meta-schemas/core.yaml#

title: Freescale mx25 TS conversion queue module

maintainers:
  - Frank Li <Frank.Li@nxp.com>

description:
  mx25 touchscreen conversion queue module which controls the ADC unit of the
  mx25 for attached touchscreens.

properties:
  compatible:
    const: fsl,imx25-tcq

  reg:
    maxItems: 1

  interrupts:
    maxItems: 1

  fsl,wires:
    description: touch wires number.
    $ref: /schemas/types.yaml#/definitions/uint32
    enum: [4, 5]

  fsl,pen-debounce-ns:
    description:
      Pen debounce time in nanoseconds.

  fsl,pen-threshold:
    $ref: /schemas/types.yaml#/definitions/uint32
    description:
      Pen-down threshold for the touchscreen. This is a value
      between 1 and 4096. It is the ratio between the internal reference voltage
      and the measured voltage after the plate was precharged. Resistance between
      plates and therefore the voltage decreases with pressure so that a smaller
      value is equivalent to a higher pressure.

  fsl,settling-time-ns:
    description:
      Settling time in nanoseconds. The settling time is before
      the actual touch detection to wait for an even charge distribution in the
      plate.

allOf:
  - $ref: touchscreen.yaml

required:
  - compatible
  - reg
  - interrupts
  - fsl,wires

unevaluatedProperties: false

examples:
  - |
    touchscreen@50030400 {
        compatible = "fsl,imx25-tcq";
        reg = <0x50030400 0x60>;
        interrupt-parent = <&tscadc>;
        interrupts = <0>;
        fsl,wires = <4>;
    };
```

## Documentation/devicetree/bindings/input/touchscreen/fsl,imx6ul-tsc.yaml
```yaml
# SPDX-License-Identifier: (GPL-2.0-only OR BSD-2-Clause)
%YAML 1.2
---
$id: http://devicetree.org/schemas/input/touchscreen/fsl,imx6ul-tsc.yaml#
$schema: http://devicetree.org/meta-schemas/core.yaml#

title: Freescale i.MX6UL Touch Controller

maintainers:
  - Haibo Chen <haibo.chen@nxp.com>
  - Shawn Guo <shawnguo@kernel.org>
  - Sascha Hauer <s.hauer@pengutronix.de>

properties:
  compatible:
    const: fsl,imx6ul-tsc

  reg:
    items:
      - description: touch controller address
      - description: ADC2 address

  interrupts:
    items:
      - description: touch controller address
      - description: ADC2 address

  clocks:
    maxItems: 2

  clock-names:
    items:
      - const: tsc
      - const: adc

  xnur-gpios:
    maxItems: 1
    description:
      The X- gpio this controller connect to. This xnur-gpio returns to
      low once the finger leave the touch screen (The last touch event
      the touch controller capture).

  measure-delay-time:
    $ref: /schemas/types.yaml#/definitions/uint32
    description:
      The value of measure delay time. Before X-axis or Y-axis measurement,
      the screen need some time before even potential distribution ready.
    default: 0xffff
    minimum: 0
    maximum: 0xffffff

  pre-charge-time:
    $ref: /schemas/types.yaml#/definitions/uint32
    description:
      The touch screen need some time to precharge.
    default: 0xfff
    minimum: 0
    maximum: 0xffffffff

  touchscreen-average-samples:
    $ref: /schemas/types.yaml#/definitions/uint32
    description: Number of data samples which are averaged for each read.
    enum: [ 1, 4, 8, 16, 32 ]

  debounce-delay-us:
    description: |
      Minimum duration in microseconds a signal must remain stable
      to be considered valid.

      Drivers must convert this value to IPG clock cycles and map
      it to one of the four discrete thresholds exposed by the
      TSC_DEBUG_MODE2 register:

        0: 8191 IPG cycles
        1: 4095 IPG cycles
        2: 2047 IPG cycles
        3: 1023 IPG cycles

required:
  - compatible
  - reg
  - interrupts
  - clocks
  - clock-names
  - xnur-gpios

allOf:
  - $ref: touchscreen.yaml#

additionalProperties: false

examples:
  - |
    #include <dt-bindings/interrupt-controller/arm-gic.h>
    #include <dt-bindings/clock/imx6ul-clock.h>
    #include <dt-bindings/gpio/gpio.h>
    touchscreen@2040000 {
        compatible = "fsl,imx6ul-tsc";
        reg = <0x02040000 0x4000>, <0x0219c000 0x4000>;
        interrupts = <GIC_SPI 3 IRQ_TYPE_LEVEL_HIGH>,
                     <GIC_SPI 101 IRQ_TYPE_LEVEL_HIGH>;
        clocks = <&clks IMX6UL_CLK_IPG>,
                 <&clks IMX6UL_CLK_ADC2>;
        clock-names = "tsc", "adc";
        pinctrl-names = "default";
        pinctrl-0 = <&pinctrl_tsc>;
        xnur-gpios = <&gpio1 3 GPIO_ACTIVE_LOW>;
        measure-delay-time = <0xfff>;
        pre-charge-time = <0xffff>;
        touchscreen-average-samples = <32>;
    };
```

## Documentation/devicetree/bindings/input/touchscreen/fsl-mx25-tcq.txt
```
Freescale mx25 TS conversion queue module

mx25 touchscreen conversion queue module which controls the ADC unit of the
mx25 for attached touchscreens.

Required properties:
 - compatible: Should be "fsl,imx25-tcq".
 - reg: Memory range of the device.
 - interrupts: Should be the interrupt number associated with this module within
   the tscadc unit (<0>).
 - fsl,wires: Should be '<4>' or '<5>'

Optional properties:
 - fsl,pen-debounce-ns: Pen debounce time in nanoseconds.
 - fsl,pen-threshold: Pen-down threshold for the touchscreen. This is a value
   between 1 and 4096. It is the ratio between the internal reference voltage
   and the measured voltage after the plate was precharged. Resistance between
   plates and therefore the voltage decreases with pressure so that a smaller
   value is equivalent to a higher pressure.
 - fsl,settling-time-ns: Settling time in nanoseconds. The settling time is before
   the actual touch detection to wait for an even charge distribution in the
   plate.

This device includes two conversion queues which can be added as subnodes.
The first queue is for the touchscreen, the second for general purpose ADC.

Example:
	tsc: tcq@50030400 {
		compatible = "fsl,imx25-tcq";
		reg = <0x50030400 0x60>;
		interrupt-parent = <&tscadc>;
		interrupts = <0>;
		fsl,wires = <4>;
	};
```

## Documentation/devicetree/bindings/input/touchscreen/goodix,gt9916.yaml
```yaml
# SPDX-License-Identifier: GPL-2.0-only OR BSD-2-Clause
%YAML 1.2
---
$id: http://devicetree.org/schemas/input/touchscreen/goodix,gt9916.yaml#
$schema: http://devicetree.org/meta-schemas/core.yaml#

title: Goodix Berlin series touchscreen controller

description: The Goodix Berlin series of touchscreen controllers
  be connected to either I2C or SPI buses.

maintainers:
  - Neil Armstrong <neil.armstrong@linaro.org>

allOf:
  - $ref: touchscreen.yaml#
  - $ref: /schemas/spi/spi-peripheral-props.yaml#

properties:
  compatible:
    enum:
      - goodix,gt9916

  reg:
    maxItems: 1

  interrupts:
    maxItems: 1

  reset-gpios:
    maxItems: 1

  avdd-supply:
    description: Analog power supply regulator on AVDD pin

  vddio-supply:
    description: power supply regulator on VDDIO pin

  spi-max-frequency: true
  touchscreen-inverted-x: true
  touchscreen-inverted-y: true
  touchscreen-size-x: true
  touchscreen-size-y: true
  touchscreen-swapped-x-y: true

additionalProperties: false

required:
  - compatible
  - reg
  - interrupts
  - avdd-supply
  - touchscreen-size-x
  - touchscreen-size-y

examples:
  - |
    #include <dt-bindings/interrupt-controller/irq.h>
    #include <dt-bindings/gpio/gpio.h>
    i2c {
      #address-cells = <1>;
      #size-cells = <0>;
      touchscreen@5d {
        compatible = "goodix,gt9916";
        reg = <0x5d>;
        interrupt-parent = <&gpio>;
        interrupts = <25 IRQ_TYPE_LEVEL_LOW>;
        reset-gpios = <&gpio1 1 GPIO_ACTIVE_LOW>;
        avdd-supply = <&ts_avdd>;
        touchscreen-size-x = <1024>;
        touchscreen-size-y = <768>;
      };
    };
  - |
    #include <dt-bindings/interrupt-controller/irq.h>
    #include <dt-bindings/gpio/gpio.h>
    spi {
      #address-cells = <1>;
      #size-cells = <0>;
      num-cs = <1>;
      cs-gpios = <&gpio 2 GPIO_ACTIVE_HIGH>;
      touchscreen@0 {
        compatible = "goodix,gt9916";
        reg = <0>;
        interrupt-parent = <&gpio>;
        interrupts = <25 IRQ_TYPE_LEVEL_LOW>;
        reset-gpios = <&gpio1 1 GPIO_ACTIVE_LOW>;
        avdd-supply = <&ts_avdd>;
        spi-max-frequency = <1000000>;
        touchscreen-size-x = <1024>;
        touchscreen-size-y = <768>;
      };
    };

...
```

## Documentation/devicetree/bindings/input/touchscreen/goodix.txt
```
Device tree bindings for Goodix GT9xx series touchscreen controller

Required properties:

 - compatible		: Should be "goodix,gt1151"
				 or "goodix,gt5688"
				 or "goodix,gt911"
				 or "goodix,gt9110"
				 or "goodix,gt912"
				 or "goodix,gt927"
				 or "goodix,gt9271"
				 or "goodix,gt928"
				 or "goodix,gt967"
 - reg			: I2C address of the chip. Should be 0x5d or 0x14
 - interrupts		: Interrupt to which the chip is connected

Optional properties:

 - irq-gpios		: GPIO pin used for IRQ. The driver uses the
			  interrupt gpio pin as output to reset the device.
 - reset-gpios		: GPIO pin used for reset
 - touchscreen-inverted-x
 - touchscreen-inverted-y
 - touchscreen-size-x
 - touchscreen-size-y
 - touchscreen-swapped-x-y

The touchscreen-* properties are documented in touchscreen.txt in this
directory.

Example:

	i2c@00000000 {
		/* ... */

		gt928@5d {
			compatible = "goodix,gt928";
			reg = <0x5d>;
			interrupt-parent = <&gpio>;
			interrupts = <0 0>;

			irq-gpios = <&gpio1 0 0>;
			reset-gpios = <&gpio1 1 0>;
		};

		/* ... */
	};
```

## Documentation/devicetree/bindings/input/touchscreen/goodix.yaml
```yaml
# SPDX-License-Identifier: GPL-2.0
%YAML 1.2
---
$id: http://devicetree.org/schemas/input/touchscreen/goodix.yaml#
$schema: http://devicetree.org/meta-schemas/core.yaml#

title: Goodix GT9xx series touchscreen controller

maintainers:
  - Dmitry Torokhov <dmitry.torokhov@gmail.com>

allOf:
  - $ref: touchscreen.yaml#

properties:
  compatible:
    enum:
      - goodix,gt1151
      - goodix,gt1158
      - goodix,gt5663
      - goodix,gt5688
      - goodix,gt911
      - goodix,gt9110
      - goodix,gt912
      - goodix,gt9147
      - goodix,gt917s
      - goodix,gt927
      - goodix,gt9271
      - goodix,gt928
      - goodix,gt9286
      - goodix,gt967

  reg:
    enum: [ 0x5d, 0x14 ]

  interrupts:
    maxItems: 1

  irq-gpios:
    description: GPIO pin used for IRQ input. Additionally, this line is
      sampled by the device on reset deassertion to select the I2C client
      address, thus it can be driven by the host during the reset sequence.
    maxItems: 1

  reset-gpios:
    maxItems: 1

  AVDD28-supply:
    description: Analog power supply regulator on AVDD28 pin

  VDDIO-supply:
    description: GPIO power supply regulator on VDDIO pin

  touchscreen-inverted-x: true
  touchscreen-inverted-y: true
  touchscreen-size-x: true
  touchscreen-size-y: true
  touchscreen-swapped-x-y: true

additionalProperties: false

required:
  - compatible
  - reg
  - interrupts

examples:
  - |
    i2c {
      #address-cells = <1>;
      #size-cells = <0>;
      touchscreen@5d {
        compatible = "goodix,gt928";
        reg = <0x5d>;
        interrupt-parent = <&gpio>;
        interrupts = <0 0>;
        irq-gpios = <&gpio1 0 0>;
        reset-gpios = <&gpio1 1 0>;
      };
    };

...
```

## Documentation/devicetree/bindings/input/touchscreen/goodix_gt1x.txt
```
Goodix GT1x series touch controller

Required properties:

 - compatible			: Should be "goodix,gt1x", compatible with the
				  of_match_table defined in driver.
 - reg				: I2C slave address of the device.

 - goodix,irq-gpio		: Interrupt gpio which is to provide interrupts to
				  host, same as "interrupts" node.
 - goodix,rst-gpio:		: Reset gpio to control the reset of chip.

Optional properties:

 - power-supply			: Power supply needed to power up the device, when use
				  external regulator, do not add this property.
 - goodix,ic_type		: Specify touch IC type.

Example:

        i2c@00000000 {
                /* ... */

                gt9xx@14 {
                        compatible = "goodix,gt1x";
                        reg = <0x14>;
                        status = "okay";

                        goodix,rst-gpio = <&msm_gpio 12 0x0>;
                        goodix,irq-gpio = <&msm_gpio 13 0x2800>;
                        goodix,ic_type	= "gt5688";
                };

                /* ... */
        };
```

## Documentation/devicetree/bindings/input/touchscreen/hideep.txt
```
* HiDeep Finger and Stylus touchscreen controller

Required properties:
- compatible		: must be "hideep,hideep-ts"
- reg			: I2C slave address, (e.g. 0x6C).
- interrupt-parent : Interrupt controller to which the chip is connected.
- interrupts : Interrupt to which the chip is connected.

Optional properties:
- vdd-supply	: It is the controller supply for controlling
					 main voltage(3.3V) through the regulator.
- vid-supply	: It is the controller supply for controlling
					IO voltage(1.8V) through the regulator.
- reset-gpios	: Define for reset gpio pin.
						It is to use for reset IC.
- touchscreen-size-x	: X axis size of touchscreen
- touchscreen-size-y	: Y axis size of touchscreen
- linux,keycodes	: Specifies an array of numeric keycode values to
			be used for reporting button presses. The array can
			contain up to 3 entries.

Example:

#include "dt-bindings/input/input.h"

i2c@00000000 {

	/* ... */

	touchscreen@6c {
		compatible = "hideep,hideep-ts";
		reg = <0x6c>;
		interrupt-parent = <&gpx1>;
		interrupts = <2 IRQ_TYPE_LEVEL_LOW>;
		vdd-supply = <&ldo15_reg>;
		vid-supply = <&ldo18_reg>;
		reset-gpios = <&gpx1 5 0>;
		touchscreen-size-x = <1080>;
		touchscreen-size-y = <1920>;
		linux,keycodes = <KEY_HOME>, <KEY_MENU>, <KEY_BACK>;
	};
};
```
