## Documentation/devicetree/bindings/input/touchscreen/himax,hx83112b.yaml
```yaml
# SPDX-License-Identifier: (GPL-2.0-only OR BSD-2-Clause)
%YAML 1.2
---
$id: http://devicetree.org/schemas/input/touchscreen/himax,hx83112b.yaml#
$schema: http://devicetree.org/meta-schemas/core.yaml#

title: Himax hx83112b touchscreen controller

maintainers:
  - Job Noorman <job@noorman.info>

allOf:
  - $ref: touchscreen.yaml#

properties:
  compatible:
    enum:
      - himax,hx83112b

  reg:
    maxItems: 1

  interrupts:
    maxItems: 1

  reset-gpios:
    maxItems: 1

  touchscreen-inverted-x: true
  touchscreen-inverted-y: true
  touchscreen-size-x: true
  touchscreen-size-y: true
  touchscreen-swapped-x-y: true

additionalProperties: false

required:
  - compatible
  - reg
  - interrupts
  - reset-gpios
  - touchscreen-size-x
  - touchscreen-size-y

examples:
  - |
    #include <dt-bindings/interrupt-controller/irq.h>
    #include <dt-bindings/gpio/gpio.h>
    i2c {
      #address-cells = <1>;
      #size-cells = <0>;
      touchscreen@48 {
        compatible = "himax,hx83112b";
        reg = <0x48>;
        interrupt-parent = <&tlmm>;
        interrupts = <65 IRQ_TYPE_LEVEL_LOW>;
        touchscreen-size-x = <1080>;
        touchscreen-size-y = <2160>;
        reset-gpios = <&tlmm 64 GPIO_ACTIVE_LOW>;
      };
    };

...
```

## Documentation/devicetree/bindings/input/touchscreen/himax,hx852es.yaml
```yaml
# SPDX-License-Identifier: (GPL-2.0-only OR BSD-2-Clause)
%YAML 1.2
---
$id: http://devicetree.org/schemas/input/touchscreen/himax,hx852es.yaml#
$schema: http://devicetree.org/meta-schemas/core.yaml#

title: Himax HX852x(ES) touch panel controller

maintainers:
  - Stephan Gerhold <stephan@gerhold.net>

allOf:
  - $ref: touchscreen.yaml#

properties:
  compatible:
    items:
      - enum:
          - himax,hx8525e
          - himax,hx8526e
          - himax,hx8527e
      - const: himax,hx852es

  reg:
    maxItems: 1

  interrupts:
    maxItems: 1
    description: Touch Screen Interrupt (TSIX), active low

  reset-gpios:
    maxItems: 1
    description: External Reset (XRES), active low

  vcca-supply:
    description: Analog power supply (VCCA)

  vccd-supply:
    description: Digital power supply (VCCD)

  touchscreen-inverted-x: true
  touchscreen-inverted-y: true
  touchscreen-size-x: true
  touchscreen-size-y: true
  touchscreen-swapped-x-y: true

  linux,keycodes:
    minItems: 1
    maxItems: 4

required:
  - compatible
  - reg
  - interrupts
  - reset-gpios

additionalProperties: false

examples:
  - |
    #include <dt-bindings/gpio/gpio.h>
    #include <dt-bindings/input/input.h>
    #include <dt-bindings/interrupt-controller/irq.h>

    i2c {
      #address-cells = <1>;
      #size-cells = <0>;

      touchscreen@48 {
        compatible = "himax,hx8527e", "himax,hx852es";
        reg = <0x48>;
        interrupt-parent = <&tlmm>;
        interrupts = <13 IRQ_TYPE_LEVEL_LOW>;
        reset-gpios = <&tlmm 12 GPIO_ACTIVE_LOW>;
        vcca-supply = <&reg_ts_vcca>;
        vccd-supply = <&pm8916_l6>;
        linux,keycodes = <KEY_BACK KEY_HOMEPAGE KEY_APPSELECT>;
      };
    };

...
```

## Documentation/devicetree/bindings/input/touchscreen/hycon,hy46xx.yaml
```yaml
# SPDX-License-Identifier: (GPL-2.0-only OR BSD-2-Clause)
%YAML 1.2
---
$id: http://devicetree.org/schemas/input/touchscreen/hycon,hy46xx.yaml#
$schema: http://devicetree.org/meta-schemas/core.yaml#

title: Hycon HY46XX series touchscreen controller

description: |
  There are 6 variants of the chip for various touch panel sizes and cover lens material
   Glass: 0.3mm--4.0mm
    PET/PMMA: 0.2mm--2.0mm
    HY4613(B)-N048  < 6"
    HY4614(B)-N068  7" .. 10.1"
    HY4621-NS32  < 5"
    HY4623-NS48  5.1" .. 7"
   Glass: 0.3mm--8.0mm
    PET/PMMA: 0.2mm--4.0mm
    HY4633(B)-N048  < 6"
    HY4635(B)-N048  < 7" .. 10.1"

maintainers:
  - Giulio Benetti <giulio.benetti@benettiengineering.com>

allOf:
  - $ref: touchscreen.yaml#

properties:
  compatible:
    enum:
      - hycon,hy4613
      - hycon,hy4614
      - hycon,hy4621
      - hycon,hy4623
      - hycon,hy4633
      - hycon,hy4635

  reg:
    maxItems: 1

  interrupts:
    maxItems: 1

  reset-gpios:
    maxItems: 1

  vcc-supply: true

  hycon,threshold:
    description: Allows setting the sensitivity in the range from 0 to 255.
    $ref: /schemas/types.yaml#/definitions/uint32
    minimum: 0
    maximum: 255

  hycon,glove-enable:
    type: boolean
    description: Allows enabling glove setting.

  hycon,report-speed-hz:
    description: Allows setting the report speed in Hertz.
    minimum: 1
    maximum: 255

  hycon,noise-filter-enable:
    type: boolean
    description: Allows enabling power noise filter.

  hycon,filter-data:
    description: Allows setting how many samples throw before reporting touch
                 in the range from 0 to 5.
    $ref: /schemas/types.yaml#/definitions/uint32
    minimum: 0
    maximum: 5

  hycon,gain:
    description: Allows setting the sensitivity distance in the range from 0 to 5.
    $ref: /schemas/types.yaml#/definitions/uint32
    minimum: 0
    maximum: 5

  hycon,edge-offset:
    description: Allows setting the edge compensation in the range from 0 to 16.
    $ref: /schemas/types.yaml#/definitions/uint32
    minimum: 0
    maximum: 16

  touchscreen-size-x: true
  touchscreen-size-y: true
  touchscreen-fuzz-x: true
  touchscreen-fuzz-y: true
  touchscreen-inverted-x: true
  touchscreen-inverted-y: true
  touchscreen-swapped-x-y: true
  interrupt-controller: true

additionalProperties: false

required:
  - compatible
  - reg
  - interrupts

examples:
  - |
    #include <dt-bindings/gpio/gpio.h>
    #include <dt-bindings/interrupt-controller/arm-gic.h>
    i2c {
      #address-cells = <1>;
      #size-cells = <0>;
      touchscreen@1c {
        compatible = "hycon,hy4633";
        reg = <0x1c>;
        interrupt-parent = <&gpio2>;
        interrupts = <5 IRQ_TYPE_EDGE_FALLING>;
        reset-gpios = <&gpio2 6 GPIO_ACTIVE_LOW>;
      };
    };

...
```

## Documentation/devicetree/bindings/input/touchscreen/hynitron,cst816x.yaml
```yaml
# SPDX-License-Identifier: (GPL-2.0-only OR BSD-2-Clause)
%YAML 1.2
---
$id: http://devicetree.org/schemas/input/touchscreen/hynitron,cst816x.yaml#
$schema: http://devicetree.org/meta-schemas/core.yaml#

title: Hynitron CST816x Series Capacitive Touch controller

maintainers:
  - Oleh Kuzhylnyi <kuzhylol@gmail.com>

description: |
  Bindings for CST816x high performance self-capacitance touch chip series
  with single point gesture and real two-point operation.

properties:
  compatible:
    enum:
      - hynitron,cst816s

  reg:
    maxItems: 1

  interrupts:
    maxItems: 1

  reset-gpios:
    maxItems: 1

  linux,keycodes:
    minItems: 1
    items:
      - description: Slide up gesture
      - description: Slide down gesture
      - description: Slide left gesture
      - description: Slide right gesture
      - description: Long press gesture

required:
  - compatible
  - reg
  - interrupts

additionalProperties: false

examples:
  - |
    #include <dt-bindings/gpio/gpio.h>
    #include <dt-bindings/input/linux-event-codes.h>
    #include <dt-bindings/interrupt-controller/irq.h>
    i2c {
        #address-cells = <1>;
        #size-cells = <0>;
        touchscreen@15 {
            compatible = "hynitron,cst816s";
            reg = <0x15>;
            interrupt-parent = <&gpio0>;
            interrupts = <4 IRQ_TYPE_EDGE_RISING>;
            reset-gpios = <&gpio 17 GPIO_ACTIVE_LOW>;
            linux,keycodes = <KEY_UP>, <KEY_DOWN>, <KEY_LEFT>, <KEY_RIGHT>,
                             <BTN_TOOL_TRIPLETAP>;
        };
    };

...
```

## Documentation/devicetree/bindings/input/touchscreen/hynitron,cstxxx.yaml
```yaml
# SPDX-License-Identifier: (GPL-2.0-only OR BSD-2-Clause)
%YAML 1.2
---
$id: http://devicetree.org/schemas/input/touchscreen/hynitron,cstxxx.yaml#
$schema: http://devicetree.org/meta-schemas/core.yaml#

title: Hynitron cstxxx series touchscreen controller

description: |
  Bindings for Hynitron cstxxx series multi-touch touchscreen
  controllers.

maintainers:
  - Chris Morgan <macromorgan@hotmail.com>

allOf:
  - $ref: touchscreen.yaml#

properties:
  compatible:
    enum:
      - hynitron,cst340

  reg:
    maxItems: 1

  interrupts:
    maxItems: 1

  reset-gpios:
    maxItems: 1

  touchscreen-size-x: true
  touchscreen-size-y: true
  touchscreen-inverted-x: true
  touchscreen-inverted-y: true
  touchscreen-swapped-x-y: true

additionalProperties: false

required:
  - compatible
  - reg
  - interrupts
  - reset-gpios

examples:
  - |
    #include <dt-bindings/gpio/gpio.h>
    #include <dt-bindings/interrupt-controller/arm-gic.h>
    i2c {
      #address-cells = <1>;
      #size-cells = <0>;
      touchscreen@1a {
        compatible = "hynitron,cst340";
        reg = <0x1a>;
        interrupt-parent = <&gpio4>;
        interrupts = <9 IRQ_TYPE_EDGE_FALLING>;
        reset-gpios = <&gpio4 6 GPIO_ACTIVE_LOW>;
        touchscreen-size-x = <640>;
        touchscreen-size-y = <480>;
      };
    };

...
```

## Documentation/devicetree/bindings/input/touchscreen/ilitek,ili210x.yaml
```yaml
# SPDX-License-Identifier: (GPL-2.0-only OR BSD-2-Clause)
%YAML 1.2
---
$id: http://devicetree.org/schemas/input/touchscreen/ilitek,ili210x.yaml#
$schema: http://devicetree.org/meta-schemas/core.yaml#

title: Ilitek ILI21xx/ILI251x V3/V6 touch screen controller with i2c interface

maintainers:
  - Frank Li <Frank.Li@nxp.com>
  - Marek Vasut <marek.vasut+renesas@mailbox.org>

properties:
  compatible:
    enum:
      - ilitek,ili210x
      - ilitek,ili2117
      - ilitek,ili2120
      - ilitek,ili251x

  reg:
    maxItems: 1

  interrupts:
    maxItems: 1

  reset-gpios:
    maxItems: 1

  wakeup-source: true

required:
  - compatible
  - reg

allOf:
  - $ref: touchscreen.yaml

unevaluatedProperties: false

examples:
  - |
    i2c {
        #address-cells = <1>;
        #size-cells = <0>;

        touchscreen@41 {
            compatible = "ilitek,ili2120";
            reg = <0x41>;
        };
    };
```

## Documentation/devicetree/bindings/input/touchscreen/ilitek_ts_i2c.yaml
```yaml
# SPDX-License-Identifier: (GPL-2.0-only OR BSD-2-Clause)
%YAML 1.2
---
$id: http://devicetree.org/schemas/input/touchscreen/ilitek_ts_i2c.yaml#
$schema: http://devicetree.org/meta-schemas/core.yaml#

title: Ilitek I2C Touchscreen Controller

maintainers:
  - Dmitry Torokhov <dmitry.torokhov@gmail.com>

allOf:
  - $ref: touchscreen.yaml#

properties:
  compatible:
    enum:
      - ilitek,ili210x
      - ilitek,ili2117
      - ilitek,ili2120
      - ilitek,ili2130
      - ilitek,ili2131
      - ilitek,ili2132
      - ilitek,ili2316
      - ilitek,ili2322
      - ilitek,ili2323
      - ilitek,ili2326
      - ilitek,ili251x
      - ilitek,ili2520
      - ilitek,ili2521

  reg:
    maxItems: 1

  interrupts:
    maxItems: 1

  reset-gpios:
    maxItems: 1

  wakeup-source:
    type: boolean
    description: touchscreen can be used as a wakeup source.

  touchscreen-size-x: true
  touchscreen-size-y: true
  touchscreen-inverted-x: true
  touchscreen-inverted-y: true
  touchscreen-swapped-x-y: true

additionalProperties: false

required:
  - compatible
  - reg
  - interrupts

examples:
  - |
    #include <dt-bindings/interrupt-controller/irq.h>
    #include <dt-bindings/gpio/gpio.h>
    i2c {
        #address-cells = <1>;
        #size-cells = <0>;

        touchscreen@41 {
            compatible = "ilitek,ili2520";
            reg = <0x41>;

            interrupt-parent = <&gpio1>;
            interrupts = <7 IRQ_TYPE_LEVEL_LOW>;
            reset-gpios = <&gpio1 8 GPIO_ACTIVE_LOW>;
            touchscreen-inverted-y;
            wakeup-source;
        };
    };
```

## Documentation/devicetree/bindings/input/touchscreen/imagis,ist3038c.yaml
```yaml
# SPDX-License-Identifier: (GPL-2.0-only OR BSD-2-Clause)
%YAML 1.2
---
$id: http://devicetree.org/schemas/input/touchscreen/imagis,ist3038c.yaml#
$schema: http://devicetree.org/meta-schemas/core.yaml#

title: Imagis IST30XXC family touchscreen controller

maintainers:
  - Markuss Broks <markuss.broks@gmail.com>

properties:
  $nodename:
    pattern: "^touchscreen@[0-9a-f]+$"

  compatible:
    enum:
      - imagis,ist3032c
      - imagis,ist3038b
      - imagis,ist3038c

  reg:
    maxItems: 1

  interrupts:
    maxItems: 1

  vdd-supply:
    description: Power supply regulator for the chip

  vddio-supply:
    description: Power supply regulator for the I2C bus

  linux,keycodes:
    description: Keycodes for the touch keys
    maxItems: 5

  touchscreen-size-x: true
  touchscreen-size-y: true
  touchscreen-fuzz-x: true
  touchscreen-fuzz-y: true
  touchscreen-inverted-x: true
  touchscreen-inverted-y: true
  touchscreen-swapped-x-y: true

additionalProperties: false

allOf:
  - $ref: touchscreen.yaml#
  - if:
      not:
        properties:
          compatible:
            contains:
              const: imagis,ist3032c
    then:
      properties:
        linux,keycodes: false

required:
  - compatible
  - reg
  - interrupts
  - touchscreen-size-x
  - touchscreen-size-y

examples:
  - |
    #include <dt-bindings/interrupt-controller/irq.h>
    i2c {
      #address-cells = <1>;
      #size-cells = <0>;
      touchscreen@50 {
        compatible = "imagis,ist3038c";
        reg = <0x50>;
        interrupt-parent = <&gpio>;
        interrupts = <13 IRQ_TYPE_EDGE_FALLING>;
        vdd-supply = <&ldo1_reg>;
        vddio-supply = <&ldo2_reg>;
        touchscreen-size-x = <720>;
        touchscreen-size-y = <1280>;
        touchscreen-fuzz-x = <10>;
        touchscreen-fuzz-y = <10>;
        touchscreen-inverted-x;
        touchscreen-inverted-y;
      };
    };

...
```

## Documentation/devicetree/bindings/input/touchscreen/imx6ul_tsc.txt
```
* Freescale i.MX6UL Touch Controller

Required properties:
- compatible: must be "fsl,imx6ul-tsc".
- reg: this touch controller address and the ADC2 address.
- interrupts: the interrupt of this touch controller and ADC2.
- clocks: the root clock of touch controller and ADC2.
- clock-names; must be "tsc" and "adc".
- xnur-gpio: the X- gpio this controller connect to.
  This xnur-gpio returns to low once the finger leave the touch screen (The
  last touch event the touch controller capture).

Optional properties:
- measure-delay-time: the value of measure delay time.
  Before X-axis or Y-axis measurement, the screen need some time before
  even potential distribution ready.
  This value depends on the touch screen.
- pre-charge-time: the touch screen need some time to precharge.
  This value depends on the touch screen.
- touchscreen-average-samples: Number of data samples which are averaged for
  each read. Valid values are 1, 4, 8, 16 and 32.

Example:
	tsc: tsc@2040000 {
		compatible = "fsl,imx6ul-tsc";
		reg = <0x02040000 0x4000>, <0x0219c000 0x4000>;
		interrupts = <GIC_SPI 3 IRQ_TYPE_LEVEL_HIGH>,
			     <GIC_SPI 101 IRQ_TYPE_LEVEL_HIGH>;
		clocks = <&clks IMX6UL_CLK_IPG>,
			 <&clks IMX6UL_CLK_ADC2>;
		clock-names = "tsc", "adc";
		pinctrl-names = "default";
		pinctrl-0 = <&pinctrl_tsc>;
		xnur-gpio = <&gpio1 3 GPIO_ACTIVE_LOW>;
		measure-delay-time = <0xfff>;
		pre-charge-time = <0xffff>;
		touchscreen-average-samples = <32>;
	};
```
