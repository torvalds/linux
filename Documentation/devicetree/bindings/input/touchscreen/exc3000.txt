## Documentation/devicetree/bindings/input/touchscreen/iqs5xx.txt
```
Azoteq IQS550/572/525 Trackpad/Touchscreen Controller

Required properties:

- compatible			: Must be equal to one of the following:
				  "azoteq,iqs550"
				  "azoteq,iqs572"
				  "azoteq,iqs525"

- reg				: I2C slave address for the device.

- interrupts			: GPIO to which the device's active-high RDY
				  output is connected (see [0]).

- reset-gpios			: GPIO to which the device's active-low NRST
				  input is connected (see [1]).

Optional properties:

- touchscreen-min-x		: See [2].

- touchscreen-min-y		: See [2].

- touchscreen-size-x		: See [2]. If this property is omitted, the
				  maximum x-coordinate is specified by the
				  device's "X Resolution" register.

- touchscreen-size-y		: See [2]. If this property is omitted, the
				  maximum y-coordinate is specified by the
				  device's "Y Resolution" register.

- touchscreen-max-pressure	: See [2]. Pressure is expressed as the sum of
				  the deltas across all channels impacted by a
				  touch event. A channel's delta is calculated
				  as its count value minus a reference, where
				  the count value is inversely proportional to
				  the channel's capacitance.

- touchscreen-fuzz-x		: See [2].

- touchscreen-fuzz-y		: See [2].

- touchscreen-fuzz-pressure	: See [2].

- touchscreen-inverted-x	: See [2]. Inversion is applied relative to that
				  which may already be specified by the device's
				  FLIP_X and FLIP_Y register fields.

- touchscreen-inverted-y	: See [2]. Inversion is applied relative to that
				  which may already be specified by the device's
				  FLIP_X and FLIP_Y register fields.

- touchscreen-swapped-x-y	: See [2]. Swapping is applied relative to that
				  which may already be specified by the device's
				  SWITCH_XY_AXIS register field.

[0]: Documentation/devicetree/bindings/interrupt-controller/interrupts.txt
[1]: Documentation/devicetree/bindings/gpio/gpio.txt
[2]: Documentation/devicetree/bindings/input/touchscreen/touchscreen.txt

Example:

	&i2c1 {
		/* ... */

		touchscreen@74 {
			compatible = "azoteq,iqs550";
			reg = <0x74>;
			interrupt-parent = <&gpio>;
			interrupts = <17 4>;
			reset-gpios = <&gpio 27 1>;

			touchscreen-size-x = <640>;
			touchscreen-size-y = <480>;

			touchscreen-max-pressure = <16000>;
		};

		/* ... */
	};
```

## Documentation/devicetree/bindings/input/touchscreen/lpc32xx-tsc.txt
```
* NXP LPC32xx SoC Touchscreen Controller (TSC)

Required properties:
- compatible: must be "nxp,lpc3220-tsc"
- reg: physical base address of the controller and length of memory mapped
  region.
- interrupts: The TSC/ADC interrupt

Example:

	tsc@40048000 {
		compatible = "nxp,lpc3220-tsc";
		reg = <0x40048000 0x1000>;
		interrupt-parent = <&mic>;
		interrupts = <39 0>;
	};
```

## Documentation/devicetree/bindings/input/touchscreen/max11801-ts.txt
```
* MAXI MAX11801 Resistive touch screen controller with i2c interface

Required properties:
- compatible: must be "maxim,max11801"
- reg: i2c slave address
- interrupt-parent: the phandle for the interrupt controller
- interrupts: touch controller interrupt

Example:

&i2c1 {
	max11801: touchscreen@48 {
		compatible = "maxim,max11801";
		reg = <0x48>;
		interrupt-parent = <&gpio3>;
		interrupts = <31 IRQ_TYPE_EDGE_FALLING>;
	};
};
```

## Documentation/devicetree/bindings/input/touchscreen/maxim,max11801.yaml
```yaml
# SPDX-License-Identifier: (GPL-2.0-only OR BSD-2-Clause)
%YAML 1.2
---
$id: http://devicetree.org/schemas/input/touchscreen/maxim,max11801.yaml#
$schema: http://devicetree.org/meta-schemas/core.yaml#

title: MAXI MAX11801 Resistive touch screen controller with i2c interface

maintainers:
  - Frank Li <Frank.Li@nxp.com>

properties:
  compatible:
    const: maxim,max11801

  reg:
    maxItems: 1

  interrupts:
    maxItems: 1

allOf:
  - $ref: touchscreen.yaml

required:
  - compatible
  - reg
  - interrupts

unevaluatedProperties: false

examples:
  - |
    #include <dt-bindings/interrupt-controller/irq.h>

    i2c {
        #address-cells = <1>;
        #size-cells = <0>;

        touchscreen@48 {
            compatible = "maxim,max11801";
            reg = <0x48>;
            interrupt-parent = <&gpio3>;
            interrupts = <31 IRQ_TYPE_EDGE_FALLING>;
        };
    };
```

## Documentation/devicetree/bindings/input/touchscreen/melfas,mip4_ts.yaml
```yaml
# SPDX-License-Identifier: (GPL-2.0 OR BSD-2-Clause)
%YAML 1.2
---
$id: http://devicetree.org/schemas/input/touchscreen/melfas,mip4_ts.yaml#
$schema: http://devicetree.org/meta-schemas/core.yaml#

title: MELFAS MIP4 Touchscreen

maintainers:
  - Ariel D'Alessandro <ariel.dalessandro@collabora.com>

properties:
  compatible:
    const: melfas,mip4_ts

  reg:
    description: I2C address of the chip (0x48 or 0x34)
    maxItems: 1

  interrupts:
    maxItems: 1

  ce-gpios:
    description:
      GPIO connected to the CE (chip enable) pin of the chip (active high)
    maxItems: 1

required:
  - compatible
  - reg
  - interrupts

additionalProperties: false

examples:
  - |
    #include <dt-bindings/gpio/gpio.h>
    #include <dt-bindings/interrupt-controller/irq.h>

    i2c {
        #address-cells = <1>;
        #size-cells = <0>;

        touchscreen@34 {
            compatible = "melfas,mip4_ts";
            reg = <0x34>;

            interrupts-extended = <&tlmm 13 IRQ_TYPE_EDGE_FALLING>;
            ce-gpios = <&tlmm 12 GPIO_ACTIVE_HIGH>;

            pinctrl-0 = <&touchscreen_default>;
            pinctrl-names = "default";
        };
    };

...
```

## Documentation/devicetree/bindings/input/touchscreen/melfas,mms114.yaml
```yaml
# SPDX-License-Identifier: (GPL-2.0-only OR BSD-2-Clause)
%YAML 1.2
---
$id: http://devicetree.org/schemas/input/touchscreen/melfas,mms114.yaml#
$schema: http://devicetree.org/meta-schemas/core.yaml#

title: Melfas MMS114 family touchscreen controller bindings

maintainers:
  - Linus Walleij <linus.walleij@linaro.org>

allOf:
  - $ref: touchscreen.yaml#

properties:
  $nodename:
    pattern: "^touchscreen(@.*)?$"

  compatible:
    items:
      - enum:
          - melfas,mms114
          - melfas,mms134s
          - melfas,mms136
          - melfas,mms152
          - melfas,mms345l

  reg:
    description: I2C address

  clock-frequency:
    description: I2C client clock frequency, defined for host
    minimum: 100000
    maximum: 400000

  interrupts:
    maxItems: 1

  avdd-supply:
    description: Analog power supply regulator on AVDD pin

  vdd-supply:
    description: Digital power supply regulator on VDD pin

  touchscreen-size-x: true
  touchscreen-size-y: true
  touchscreen-fuzz-x: true
  touchscreen-fuzz-y: true
  touchscreen-fuzz-pressure: true
  touchscreen-inverted-x: true
  touchscreen-inverted-y: true
  touchscreen-swapped-x-y: true
  touchscreen-max-pressure: true

additionalProperties: false

required:
  - compatible
  - reg
  - interrupts
  - touchscreen-size-x
  - touchscreen-size-y

examples:
  - |
    #include <dt-bindings/interrupt-controller/irq.h>
    i2c {
      #address-cells = <1>;
      #size-cells = <0>;
      touchscreen@48 {
        compatible = "melfas,mms114";
        reg = <0x48>;
        interrupt-parent = <&gpio>;
        interrupts = <39 IRQ_TYPE_EDGE_FALLING>;
        avdd-supply = <&ldo1_reg>;
        vdd-supply = <&ldo2_reg>;
        touchscreen-size-x = <720>;
        touchscreen-size-y = <1280>;
        touchscreen-fuzz-x = <10>;
        touchscreen-fuzz-y = <10>;
        touchscreen-fuzz-pressure = <10>;
        touchscreen-inverted-x;
        touchscreen-inverted-y;
      };
    };

...
```
