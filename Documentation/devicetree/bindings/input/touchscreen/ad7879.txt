## Documentation/devicetree/bindings/input/touchscreen/eeti,exc3000.yaml
```yaml
# SPDX-License-Identifier: (GPL-2.0 OR BSD-2-Clause)
%YAML 1.2
---
$id: http://devicetree.org/schemas/input/touchscreen/eeti,exc3000.yaml#
$schema: http://devicetree.org/meta-schemas/core.yaml#

title: EETI EXC3000 series touchscreen controller

maintainers:
  - Dmitry Torokhov <dmitry.torokhov@gmail.com>

properties:
  compatible:
    oneOf:
      - const: eeti,exc3000
      - const: eeti,exc80h60
      - const: eeti,exc80h84
      - const: eeti,egalax_ts # Do NOT use for new binding
      - const: eeti,exc3000-i2c
        deprecated: true
      - items:
          - enum:
              - eeti,exc81w32
          - const: eeti,exc80h84
  reg:
    enum: [0x4, 0xa, 0x2a]
  interrupts:
    maxItems: 1
  reset-gpios:
    maxItems: 1
  wakeup-gpios:
    maxItems: 1
  vdd-supply:
    description: Power supply regulator for the chip
  attn-gpios:
    deprecated: true
    maxItems: 1
    description: Phandle to a GPIO to check whether interrupt is still
                 latched. This is necessary for platforms that lack
                 support for level-triggered IRQs.
  touchscreen-size-x: true
  touchscreen-size-y: true
  touchscreen-inverted-x: true
  touchscreen-inverted-y: true
  touchscreen-swapped-x-y: true

required:
  - compatible
  - reg
  - interrupts

additionalProperties: false

allOf:
  - $ref: touchscreen.yaml#

  - if:
      properties:
        compatible:
          not:
            contains:
              enum:
                - eeti,egalax_ts
                - eeti,exc3000-i2c
    then:
      properties:
        reg:
          const: 0x2a

        wakeup-gpios: false

        attn-gpios: false

      required:
        - touchscreen-size-x
        - touchscreen-size-y

examples:
  - |
    #include "dt-bindings/interrupt-controller/irq.h"
    i2c {
        #address-cells = <1>;
        #size-cells = <0>;
        touchscreen@2a {
                compatible = "eeti,exc3000";
                reg = <0x2a>;
                interrupt-parent = <&gpio1>;
                interrupts = <9 IRQ_TYPE_LEVEL_LOW>;
                touchscreen-size-x = <4096>;
                touchscreen-size-y = <4096>;
                touchscreen-inverted-x;
                touchscreen-swapped-x-y;
        };
    };
```

## Documentation/devicetree/bindings/input/touchscreen/eeti.txt
```
Bindings for EETI touchscreen controller

Required properties:
- compatible:	should be "eeti,exc3000-i2c"
- reg:		I2C address of the chip. Should be set to <0xa>
- interrupts:	interrupt to which the chip is connected

Optional properties:
- attn-gpios:	A handle to a GPIO to check whether interrupt is still
		latched. This is necessary for platforms that lack
		support for level-triggered IRQs.

The following optional properties described in touchscreen.txt are
also supported:

- touchscreen-inverted-x
- touchscreen-inverted-y
- touchscreen-swapped-x-y

Example:

i2c-master {
	touchscreen@a {
		compatible = "eeti,exc3000-i2c";
		reg = <0xa>;
		interrupt-parent = <&gpio>;
		interrupts = <123 IRQ_TYPE_EDGE_RISING>;
		attn-gpios = <&gpio 123 GPIO_ACTIVE_HIGH>;
	};
};
```

## Documentation/devicetree/bindings/input/touchscreen/egalax-ts.txt
```
* EETI eGalax Multiple Touch Controller

Required properties:
- compatible: must be "eeti,egalax_ts"
- reg: i2c slave address
- interrupts: touch controller interrupt
- wakeup-gpios: the gpio pin to be used for waking up the controller
  and also used as irq pin

Example:

	touchscreen@4 {
		compatible = "eeti,egalax_ts";
		reg = <0x04>;
		interrupt-parent = <&gpio1>;
		interrupts = <9 IRQ_TYPE_LEVEL_LOW>;
		wakeup-gpios = <&gpio1 9 GPIO_ACTIVE_LOW>;
	};
```

## Documentation/devicetree/bindings/input/touchscreen/ektf2127.txt
```
* Elan eKTF2127 I2C touchscreen controller

Required properties:
 - compatible		  : "elan,ektf2127"
 - reg			  : I2C slave address of the chip (0x40)
 - interrupt-parent	  : a phandle pointing to the interrupt controller
			    serving the interrupt for this chip
 - interrupts		  : interrupt specification for the ektf2127 interrupt
 - power-gpios		  : GPIO specification for the pin connected to the
			    ektf2127's wake input. This needs to be driven high
			    to take ektf2127 out of it's low power state

For additional optional properties see: touchscreen.txt

Example:

i2c@00000000 {
	ektf2127: touchscreen@15 {
		compatible = "elan,ektf2127";
		reg = <0x15>;
		interrupt-parent = <&pio>;
		interrupts = <6 11 IRQ_TYPE_EDGE_FALLING>
		power-gpios = <&pio 1 3 GPIO_ACTIVE_HIGH>;
		touchscreen-inverted-x;
		touchscreen-swapped-x-y;
	};
};
```

## Documentation/devicetree/bindings/input/touchscreen/elan,ektf2127.yaml
```yaml
# SPDX-License-Identifier: GPL-2.0-only OR BSD-2-Clause
%YAML 1.2
---
$id: http://devicetree.org/schemas/input/touchscreen/elan,ektf2127.yaml#
$schema: http://devicetree.org/meta-schemas/core.yaml#

title: Elan eKTF2127 I2C touchscreen controller

maintainers:
  - Siebren Vroegindeweij <siebren.vroegindeweij@hotmail.com>

allOf:
  - $ref: touchscreen.yaml#

properties:
  compatible:
    enum:
      - elan,ektf2127
      - elan,ektf2132
      - elan,ektf2232

  reg:
    maxItems: 1

  interrupts:
    maxItems: 1

  power-gpios:
    maxItems: 1

required:
  - compatible
  - reg
  - interrupts
  - power-gpios

unevaluatedProperties: false

examples:
  - |
    #include <dt-bindings/gpio/gpio.h>
    #include <dt-bindings/interrupt-controller/irq.h>

    i2c {
        #address-cells = <1>;
        #size-cells = <0>;

        touchscreen@15 {
            compatible = "elan,ektf2127";
            reg = <0x15>;
            interrupt-parent = <&pio>;
            interrupts = <6 11 IRQ_TYPE_EDGE_FALLING>;
            power-gpios = <&pio 1 3 GPIO_ACTIVE_HIGH>;
            touchscreen-inverted-x;
            touchscreen-swapped-x-y;
        };
    };
...
```

## Documentation/devicetree/bindings/input/touchscreen/elan,elants_i2c.yaml
```yaml
# SPDX-License-Identifier: (GPL-2.0-only OR BSD-2-Clause)
%YAML 1.2
---
$id: "http://devicetree.org/schemas/input/touchscreen/elan,elants_i2c.yaml#"
$schema: "http://devicetree.org/meta-schemas/core.yaml#"

title: Elantech I2C Touchscreen

maintainers:
  - David Heidelberg <david@ixit.cz>

allOf:
  - $ref: touchscreen.yaml#

properties:
  compatible:
    oneOf:
      - enum:
          - elan,ektf3624
          - elan,ekth3500
      - items:
          - const: elan,ekth3915
          - const: elan,ekth3500

  reg:
    maxItems: 1

  interrupts:
    maxItems: 1

  wakeup-source:
    type: boolean
    description: touchscreen can be used as a wakeup source.

  reset-gpios:
    maxItems: 1
    description: reset gpio the chip is connected to.

  vcc33-supply:
    description: a phandle for the regulator supplying 3.3V power.

  vccio-supply:
    description: a phandle for the regulator supplying IO power.

  touchscreen-inverted-x: true
  touchscreen-inverted-y: true
  touchscreen-size-x: true
  touchscreen-size-y: true
  touchscreen-swapped-x-y: true

additionalProperties: false

required:
  - compatible
  - reg
  - interrupts

examples:
  - |
    #include <dt-bindings/interrupt-controller/irq.h>

    i2c {
        #address-cells = <1>;
        #size-cells = <0>;

        touchscreen@10 {
            compatible = "elan,ekth3500";
            reg = <0x10>;

            interrupt-parent = <&gpio4>;
            interrupts = <0x0 IRQ_TYPE_EDGE_FALLING>;
            wakeup-source;
        };
    };
```
