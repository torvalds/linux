## Documentation/devicetree/bindings/input/touchscreen/brcm,iproc-touchscreen.txt
```
* Broadcom's IPROC Touchscreen Controller

Required properties:
- compatible: must be "brcm,iproc-touchscreen"
- ts_syscon: handler of syscon node defining physical base
  address of the controller and length of memory mapped region.
  If this property is selected please make sure MFD_SYSCON config
  is enabled in the defconfig file.
- clocks:  The clock provided by the SOC to driver the tsc
- clock-names:  name for the clock
- interrupts: The touchscreen controller's interrupt
- address-cells: Specify the number of u32 entries needed in child nodes.
  Should set to 1.
- size-cells: Specify number of u32 entries needed to specify child nodes size
  in reg property. Should set to 1.

Optional properties:
- scanning_period: Time between scans. Each step is 1024 us.  Valid 1-256.
- debounce_timeout: Each step is 512 us.  Valid 0-255
- settling_timeout: The settling duration (in ms) is the amount of time
                    the tsc waits to allow the voltage to settle after
                    turning on the drivers in detection mode.
                    Valid values: 0-11
                    0 =  0.008 ms
                    1 =  0.01 ms
                    2 =  0.02 ms
                    3 =  0.04 ms
                    4 =  0.08 ms
                    5 =  0.16 ms
                    6 =  0.32 ms
                    7 =  0.64 ms
                    8 =  1.28 ms
                    9 =  2.56 ms
                   10 =  5.12 ms
                   11 = 10.24 ms
- touch_timeout: The continuous number of scan periods in which touch is
                not detected before the controller returns to idle state.
                Valid values 0-255.
- average_data: Number of data samples which are averaged before a final
                data point is placed into the FIFO
                Valid values 0-7
                0 =   1 sample
                1 =   2 samples
                2 =   4 samples
                3 =   8 samples
                4 =  16 samples
                5 =  32 samples
                6 =  64 samples
                7 = 128 samples
- fifo_threshold: Interrupt is generated whenever the number of fifo
                entries exceeds this value
                Valid values 0-31
- touchscreen-size-x: horizontal resolution of touchscreen (in pixels)
- touchscreen-size-y: vertical resolution of touchscreen (in pixels)
- touchscreen-fuzz-x: horizontal noise value of the absolute input
                      device (in pixels)
- touchscreen-fuzz-y: vertical noise value of the absolute input
                      device (in pixels)
- touchscreen-inverted-x: X axis is inverted (boolean)
- touchscreen-inverted-y: Y axis is inverted (boolean)

Example: An example of touchscreen node

	ts_adc_syscon: ts_adc_syscon@180a6000 {
		compatible = "brcm,iproc-ts-adc-syscon","syscon";
		reg = <0x180a6000 0xc30>;
	};

	touchscreen: touchscreen@180A6000 {
		compatible = "brcm,iproc-touchscreen";
		#address-cells = <1>;
		#size-cells = <1>;
		ts_syscon = <&ts_adc_syscon>;
		clocks = <&adc_clk>;
		clock-names = "tsc_clk";
		interrupts = <GIC_SPI 164 IRQ_TYPE_LEVEL_HIGH>;

		scanning_period = <5>;
		debounce_timeout = <40>;
		settling_timeout = <7>;
		touch_timeout = <10>;
		average_data = <5>;
		fifo_threshold = <1>;
		/* Touchscreen is rotated 180 degrees. */
		touchscreen-inverted-x;
		touchscreen-inverted-y;
	};
```

## Documentation/devicetree/bindings/input/touchscreen/bu21013.txt
```
* Rohm BU21013 Touch Screen

Required properties:
 - compatible              : "rohm,bu21013_tp"
 - reg                     : I2C device address
 - reset-gpios             : GPIO pin enabling (selecting) chip (CS)
 - interrupt-parent        : the phandle for the gpio controller
 - interrupts              : (gpio) interrupt to which the chip is connected

Optional properties:
 - touch-gpios             : GPIO pin registering a touch event
 - <supply_name>-supply    : Phandle to a regulator supply
 - touchscreen-size-x      : General touchscreen binding, see [1].
 - touchscreen-size-y      : General touchscreen binding, see [1].
 - touchscreen-inverted-x  : General touchscreen binding, see [1].
 - touchscreen-inverted-y  : General touchscreen binding, see [1].
 - touchscreen-swapped-x-y : General touchscreen binding, see [1].

[1] All general touchscreen properties are described in
    Documentation/devicetree/bindings/input/touchscreen/touchscreen.txt.

Deprecated properties:
 - rohm,touch-max-x        : Maximum outward permitted limit in the X axis
 - rohm,touch-max-y        : Maximum outward permitted limit in the Y axis
 - rohm,flip-x             : Flip touch coordinates on the X axis
 - rohm,flip-y             : Flip touch coordinates on the Y axis

Example:

	i2c@80110000 {
		bu21013_tp@5c {
			compatible = "rohm,bu21013_tp";
			reg = <0x5c>;
			interrupt-parent = <&gpio2>;
			interrupts <&20 IRQ_TYPE_LEVEL_LOW>;
			touch-gpio = <&gpio2 20 GPIO_ACTIVE_LOW>;
			avdd-supply = <&ab8500_ldo_aux1_reg>;

			touchscreen-size-x = <384>;
			touchscreen-size-y = <704>;
			touchscreen-inverted-y;
		};
	};
```

## Documentation/devicetree/bindings/input/touchscreen/bu21029.txt
```
* Rohm BU21029 Touch Screen Controller

Required properties:
 - compatible              : must be "rohm,bu21029"
 - reg                     : i2c device address of the chip (0x40 or 0x41)
 - interrupt-parent        : the phandle for the gpio controller
 - interrupts              : (gpio) interrupt to which the chip is connected
 - rohm,x-plate-ohms       : x-plate resistance in Ohm

Optional properties:
 - reset-gpios             : gpio pin to reset the chip (active low)
 - touchscreen-size-x      : horizontal resolution of touchscreen (in pixels)
 - touchscreen-size-y      : vertical resolution of touchscreen (in pixels)
 - touchscreen-max-pressure: maximum pressure value
 - vdd-supply              : power supply for the controller

Example:

	&i2c1 {
		/* ... */

		bu21029: bu21029@40 {
			compatible = "rohm,bu21029";
			reg = <0x40>;
			interrupt-parent = <&gpio1>;
			interrupts = <4 IRQ_TYPE_EDGE_FALLING>;
			reset-gpios = <&gpio6 16 GPIO_ACTIVE_LOW>;
			rohm,x-plate-ohms = <600>;
			touchscreen-size-x = <800>;
			touchscreen-size-y = <480>;
			touchscreen-max-pressure = <4095>;
		};

		/* ... */
	};
```

## Documentation/devicetree/bindings/input/touchscreen/chipone,icn8318.yaml
```yaml
# SPDX-License-Identifier: GPL-2.0
%YAML 1.2
---
$id: http://devicetree.org/schemas/input/touchscreen/chipone,icn8318.yaml#
$schema: http://devicetree.org/meta-schemas/core.yaml#

title: ChipOne ICN8318 Touchscreen Controller Device Tree Bindings

maintainers:
  - Dmitry Torokhov <dmitry.torokhov@gmail.com>

allOf:
  - $ref: touchscreen.yaml#

properties:
  compatible:
    const: chipone,icn8318

  reg:
    maxItems: 1

  interrupts:
    maxItems: 1

  wake-gpios:
    maxItems: 1

unevaluatedProperties: false

required:
  - compatible
  - reg
  - interrupts
  - wake-gpios
  - touchscreen-size-x
  - touchscreen-size-y

examples:
  - |
    #include <dt-bindings/gpio/gpio.h>
    #include <dt-bindings/interrupt-controller/arm-gic.h>

    i2c {
        #address-cells = <1>;
        #size-cells = <0>;

        touchscreen@40 {
            compatible = "chipone,icn8318";
            reg = <0x40>;
            interrupt-parent = <&pio>;
            interrupts = <9 IRQ_TYPE_EDGE_FALLING>; /* EINT9 (PG9) */
            pinctrl-names = "default";
            pinctrl-0 = <&ts_wake_pin_p66>;
            wake-gpios = <&pio 1 3 GPIO_ACTIVE_HIGH>; /* PB3 */
            touchscreen-size-x = <800>;
            touchscreen-size-y = <480>;
            touchscreen-inverted-x;
            touchscreen-swapped-x-y;
        };
    };

...
```

## Documentation/devicetree/bindings/input/touchscreen/chipone_icn8318.txt
```
* ChipOne icn8318 I2C touchscreen controller

Required properties:
 - compatible		  : "chipone,icn8318"
 - reg			  : I2C slave address of the chip (0x40)
 - interrupts		  : interrupt specification for the icn8318 interrupt
 - wake-gpios		  : GPIO specification for the WAKE input
 - touchscreen-size-x	  : horizontal resolution of touchscreen (in pixels)
 - touchscreen-size-y	  : vertical resolution of touchscreen (in pixels)

Optional properties:
 - pinctrl-names	  : should be "default"
 - pinctrl-0:		  : a phandle pointing to the pin settings for the
			    control gpios
 - touchscreen-fuzz-x	  : horizontal noise value of the absolute input
			    device (in pixels)
 - touchscreen-fuzz-y	  : vertical noise value of the absolute input
			    device (in pixels)
 - touchscreen-inverted-x : X axis is inverted (boolean)
 - touchscreen-inverted-y : Y axis is inverted (boolean)
 - touchscreen-swapped-x-y	  : X and Y axis are swapped (boolean)
			    Swapping is done after inverting the axis

Example:

i2c@00000000 {
	/* ... */

	chipone_icn8318@40 {
		compatible = "chipone,icn8318";
		reg = <0x40>;
		interrupt-parent = <&pio>;
		interrupts = <9 IRQ_TYPE_EDGE_FALLING>; /* EINT9 (PG9) */
		pinctrl-names = "default";
		pinctrl-0 = <&ts_wake_pin_p66>;
		wake-gpios = <&pio 1 3 GPIO_ACTIVE_HIGH>; /* PB3 */
		touchscreen-size-x = <800>;
		touchscreen-size-y = <480>;
		touchscreen-inverted-x;
		touchscreen-swapped-x-y;
	};

	/* ... */
};
```

## Documentation/devicetree/bindings/input/touchscreen/colibri-vf50-ts.txt
```
* Toradex Colibri VF50 Touchscreen driver

Required Properties:
- compatible must be toradex,vf50-touchscreen
- io-channels: adc channels being used by the Colibri VF50 module
- xp-gpios: FET gate driver for input of X+
- xm-gpios: FET gate driver for input of X-
- yp-gpios: FET gate driver for input of Y+
- ym-gpios: FET gate driver for input of Y-
- interrupt-parent: phandle for the interrupt controller
- interrupts: pen irq interrupt for touch detection
- pinctrl-names: "idle", "default", "gpios"
- pinctrl-0: pinctrl node for pen/touch detection state pinmux
- pinctrl-1: pinctrl node for X/Y and pressure measurement (ADC) state pinmux
- pinctrl-2: pinctrl node for gpios functioning as FET gate drivers
- vf50-ts-min-pressure: pressure level at which to stop measuring X/Y values

Example:

	touchctrl: vf50_touchctrl {
		compatible = "toradex,vf50-touchscreen";
		io-channels = <&adc1 0>,<&adc0 0>,
				<&adc0 1>,<&adc1 2>;
		xp-gpios = <&gpio0 13 GPIO_ACTIVE_LOW>;
		xm-gpios = <&gpio2 29 GPIO_ACTIVE_HIGH>;
		yp-gpios = <&gpio0 12 GPIO_ACTIVE_LOW>;
		ym-gpios = <&gpio0 4 GPIO_ACTIVE_HIGH>;
		interrupt-parent = <&gpio0>;
		interrupts = <8 IRQ_TYPE_LEVEL_LOW>;
		pinctrl-names = "idle","default","gpios";
		pinctrl-0 = <&pinctrl_touchctrl_idle>;
		pinctrl-1 = <&pinctrl_touchctrl_default>;
		pinctrl-2 = <&pinctrl_touchctrl_gpios>;
		vf50-ts-min-pressure = <200>;
	};
```

## Documentation/devicetree/bindings/input/touchscreen/cypress,cy8ctma140.yaml
```yaml
# SPDX-License-Identifier: (GPL-2.0-only OR BSD-2-Clause)
%YAML 1.2
---
$id: http://devicetree.org/schemas/input/touchscreen/cypress,cy8ctma140.yaml#
$schema: http://devicetree.org/meta-schemas/core.yaml#

title: Cypress CY8CTMA140 series touchscreen controller bindings

maintainers:
  - Linus Walleij <linus.walleij@linaro.org>

allOf:
  - $ref: touchscreen.yaml#

properties:
  compatible:
    const: cypress,cy8ctma140

  reg:
    const: 0x20

  clock-frequency:
    description: I2C client clock frequency, defined for host
    minimum: 100000
    maximum: 400000

  interrupts:
    maxItems: 1

  vcpin-supply:
    description: Analog power supply regulator on VCPIN pin

  vdd-supply:
    description: Digital power supply regulator on VDD pin

  touchscreen-inverted-x: true
  touchscreen-inverted-y: true
  touchscreen-size-x: true
  touchscreen-size-y: true
  touchscreen-swapped-x-y: true
  touchscreen-max-pressure: true

additionalProperties: false

required:
  - compatible
  - reg
  - interrupts
  - touchscreen-size-x
  - touchscreen-size-y
  - touchscreen-max-pressure

examples:
- |
    #include <dt-bindings/interrupt-controller/irq.h>
    i2c {
      #address-cells = <1>;
      #size-cells = <0>;
      touchscreen@20 {
        compatible = "cypress,cy8ctma140";
        reg = <0x20>;
        touchscreen-size-x = <480>;
        touchscreen-size-y = <800>;
        touchscreen-max-pressure = <255>;
        interrupt-parent = <&gpio6>;
        interrupts = <26 IRQ_TYPE_EDGE_FALLING>;
        vdd-supply = <&ab8500_ldo_aux2_reg>;
        vcpin-supply = <&ab8500_ldo_aux2_reg>;
      };
    };

...
```
