## Documentation/devicetree/bindings/input/touchscreen/cypress,cy8ctma340.yaml
```yaml
# SPDX-License-Identifier: (GPL-2.0-only OR BSD-2-Clause)
%YAML 1.2
---
$id: http://devicetree.org/schemas/input/touchscreen/cypress,cy8ctma340.yaml#
$schema: http://devicetree.org/meta-schemas/core.yaml#

title: Cypress CY8CTMA340 series touchscreen controller

description: The Cypress CY8CTMA340 series (also known as "CYTTSP" after
  the marketing name Cypress TrueTouch Standard Product) touchscreens can
  be connected to either I2C or SPI buses.

maintainers:
  - Javier Martinez Canillas <javier@dowhile0.org>
  - Linus Walleij <linus.walleij@linaro.org>

allOf:
  - $ref: touchscreen.yaml#

properties:
  $nodename:
    pattern: "^touchscreen(@.*)?$"

  compatible:
    oneOf:
      - const: cypress,cy8ctma340
      - const: cypress,cy8ctst341
      - const: cypress,cyttsp-spi
        description: Legacy compatible for SPI connected CY8CTMA340
        deprecated: true
      - const: cypress,cyttsp-i2c
        description: Legacy compatible for I2C connected CY8CTMA340
        deprecated: true

  reg:
    description: I2C address when used on the I2C bus, or the SPI chip
      select index when used on the SPI bus

  clock-frequency:
    description: I2C client clock frequency, defined for host when using
      the device on the I2C bus
    minimum: 0
    maximum: 400000

  spi-max-frequency:
    description: SPI clock frequency, defined for host, defined when using
      the device on the SPI bus. The throughput is maximum 2 Mbps so the
      typical value is 2000000, if higher rates are used the total throughput
      needs to be restricted to 2 Mbps.
    minimum: 0
    maximum: 6000000

  interrupts:
    description: Interrupt to host
    maxItems: 1

  vcpin-supply:
    description: Analog power supply regulator on VCPIN pin

  vdd-supply:
    description: Digital power supply regulator on VDD pin

  reset-gpios:
    description: Reset line for the touchscreen, should be tagged
      as GPIO_ACTIVE_LOW

  bootloader-key:
    description: the 8-byte bootloader key that is required to switch
      the chip from bootloader mode (default mode) to application mode
    $ref: /schemas/types.yaml#/definitions/uint8-array
    minItems: 8
    maxItems: 8

  touchscreen-size-x: true
  touchscreen-size-y: true
  touchscreen-fuzz-x: true
  touchscreen-fuzz-y: true

  active-distance:
    description: the distance in pixels beyond which a touch must move
      before movement is detected and reported by the device
    $ref: /schemas/types.yaml#/definitions/uint32
    minimum: 0
    maximum: 15

  active-interval-ms:
    description: the minimum period in ms between consecutive
      scanning/processing cycles when the chip is in active mode
    minimum: 0
    maximum: 255

  lowpower-interval-ms:
    description: the minimum period in ms between consecutive
      scanning/processing cycles when the chip is in low-power mode
    minimum: 0
    maximum: 2550

  touch-timeout-ms:
    description: minimum time in ms spent in the active power state while no
      touches are detected before entering low-power mode
    minimum: 0
    maximum: 2550

  use-handshake:
    description: enable register-based handshake (boolean). This should only
      be used if the chip is configured to use 'blocking communication with
      timeout' (in this case the device generates an interrupt at the end of
      every scanning/processing cycle)
    $ref: /schemas/types.yaml#/definitions/flag

additionalProperties: false

required:
  - compatible
  - reg
  - interrupts
  - bootloader-key
  - touchscreen-size-x
  - touchscreen-size-y

examples:
  - |
    #include <dt-bindings/interrupt-controller/irq.h>
    #include <dt-bindings/gpio/gpio.h>
    spi {
      #address-cells = <1>;
      #size-cells = <0>;
      num-cs = <1>;
      cs-gpios = <&gpio 2 GPIO_ACTIVE_HIGH>;

      touchscreen@0 {
        compatible = "cypress,cy8ctma340";
        reg = <0>;
        interrupt-parent = <&gpio>;
        interrupts = <20 IRQ_TYPE_EDGE_FALLING>;
        reset-gpios = <&gpio 21 GPIO_ACTIVE_LOW>;
        vdd-supply = <&ldo_aux1_reg>;
        vcpin-supply = <&ldo_aux2_reg>;
        bootloader-key = /bits/ 8 <0x00 0x01 0x02 0x03 0x04 0x05 0x06 0x07>;
        touchscreen-size-x = <480>;
        touchscreen-size-y = <800>;
        active-interval-ms = <0>;
        touch-timeout-ms = <255>;
        lowpower-interval-ms = <10>;
      };
    };

...
```

## Documentation/devicetree/bindings/input/touchscreen/cypress,tt21000.yaml
```yaml
# SPDX-License-Identifier: GPL-2.0-only OR BSD-2-Clause
%YAML 1.2
---
$id: http://devicetree.org/schemas/input/touchscreen/cypress,tt21000.yaml#
$schema: http://devicetree.org/meta-schemas/core.yaml#

title: Cypress TT21000 touchscreen controller

description: The Cypress TT21000 series (also known as "CYTTSP5" after
  the marketing name Cypress TrueTouch Standard Product series 5).

maintainers:
  - Alistair Francis <alistair@alistair23.me>

allOf:
  - $ref: touchscreen.yaml#

properties:
  compatible:
    const: cypress,tt21000

  reg:
    maxItems: 1

  '#address-cells':
    const: 1

  '#size-cells':
    const: 0

  interrupts:
    maxItems: 1

  vdd-supply:
    description: Regulator for voltage.

  reset-gpios:
    maxItems: 1

  linux,keycodes:
    description: EV_ABS specific event code generated by the axis.

patternProperties:
  "^button@[0-9]+$":
    type: object
    $ref: ../input.yaml#
    properties:
      reg:
        maxItems: 1
      linux,keycodes:
        description: Keycode to emit

    required:
      - reg
      - linux,keycodes

    additionalProperties: false

required:
  - compatible
  - reg
  - interrupts
  - vdd-supply

unevaluatedProperties: false

examples:
  - |
    #include <dt-bindings/interrupt-controller/irq.h>
    #include <dt-bindings/gpio/gpio.h>
    #include <dt-bindings/input/linux-event-codes.h>

    i2c {
        #address-cells = <1>;
        #size-cells = <0>;

        touchscreen@24 {
            #address-cells = <1>;
            #size-cells = <0>;

            compatible = "cypress,tt21000";
            reg = <0x24>;
            pinctrl-names = "default";
            pinctrl-0 = <&tp_reset_ds203>;
            interrupt-parent = <&pio>;
            interrupts = <1 5 IRQ_TYPE_LEVEL_LOW>;
            reset-gpios = <&pio 7 1 GPIO_ACTIVE_LOW>;
            vdd-supply = <&reg_touch>;

            button@0 {
                reg = <0>;
                linux,keycodes = <KEY_HOMEPAGE>;
            };

            button@1 {
                reg = <1>;
                linux,keycodes = <KEY_MENU>;
            };

            button@2 {
                reg = <2>;
                linux,keycodes = <KEY_BACK>;
            };
        };
    };
...
```

## Documentation/devicetree/bindings/input/touchscreen/cyttsp.txt
```
* Cypress cyttsp touchscreen controller

Required properties:
 - compatible		: must be "cypress,cyttsp-i2c" or "cypress,cyttsp-spi"
 - reg			: Device I2C address or SPI chip select number
 - spi-max-frequency	: Maximum SPI clocking speed of the device (for cyttsp-spi)
 - interrupt-parent	: the phandle for the gpio controller
			  (see interrupt binding[0]).
 - interrupts		: (gpio) interrupt to which the chip is connected
			  (see interrupt binding[0]).
 - bootloader-key	: the 8-byte bootloader key that is required to switch
			  the chip from bootloader mode (default mode) to
			  application mode.
			  This property has to be specified as an array of 8
			  '/bits/ 8' values.

Optional properties:
 - reset-gpios		: the reset gpio the chip is connected to
			  (see GPIO binding[1] for more details).
 - touchscreen-size-x	: horizontal resolution of touchscreen (in pixels)
 - touchscreen-size-y	: vertical resolution of touchscreen (in pixels)
 - touchscreen-fuzz-x	: horizontal noise value of the absolute input device
			  (in pixels)
 - touchscreen-fuzz-y	: vertical noise value of the absolute input device
			  (in pixels)
 - active-distance	: the distance in pixels beyond which a touch must move
			  before movement is detected and reported by the device.
			  Valid values: 0-15.
 - active-interval-ms	: the minimum period in ms between consecutive
			  scanning/processing cycles when the chip is in active mode.
			  Valid values: 0-255.
 - lowpower-interval-ms	: the minimum period in ms between consecutive
			  scanning/processing cycles when the chip is in low-power mode.
			  Valid values: 0-2550
 - touch-timeout-ms	: minimum time in ms spent in the active power state while no
			  touches are detected before entering low-power mode.
			  Valid values: 0-2550
 - use-handshake	: enable register-based handshake (boolean). This should
			  only be used if the chip is configured to use 'blocking
			  communication with timeout' (in this case the device
			  generates an interrupt at the end of every
			  scanning/processing cycle).

[0]: Documentation/devicetree/bindings/interrupt-controller/interrupts.txt
[1]: Documentation/devicetree/bindings/gpio/gpio.txt

Example:
	&i2c1 {
		/* ... */
		cyttsp@a {
			compatible = "cypress,cyttsp-i2c";
			reg = <0xa>;
			interrupt-parent = <&gpio0>;
			interrupts = <28 0>;
			reset-gpios = <&gpio3 4 GPIO_ACTIVE_LOW>;

			touchscreen-size-x = <800>;
			touchscreen-size-y = <480>;
			touchscreen-fuzz-x = <4>;
			touchscreen-fuzz-y = <7>;

			bootloader-key = /bits/ 8 <0x01 0x02 0x03 0x04 0x05 0x06 0x07 0x08>;
			active-distance = <8>;
			active-interval-ms = <0>;
			lowpower-interval-ms = <200>;
			touch-timeout-ms = <100>;
		};

		/* ... */
	};

	&mcspi1 {
		/* ... */
		cyttsp@0 {
			compatible = "cypress,cyttsp-spi";
			spi-max-frequency = <6000000>;
			reg = <0>;
			interrupt-parent = <&gpio0>;
			interrupts = <28 0>;
			reset-gpios = <&gpio3 4 GPIO_ACTIVE_LOW>;

			touchscreen-size-x = <800>;
			touchscreen-size-y = <480>;
			touchscreen-fuzz-x = <4>;
			touchscreen-fuzz-y = <7>;

			bootloader-key = /bits/ 8 <0x01 0x02 0x03 0x04 0x05 0x06 0x07 0x08>;
			active-distance = <8>;
			active-interval-ms = <0>;
			lowpower-interval-ms = <200>;
			touch-timeout-ms = <100>;
		};

		/* ... */
	};
```

## Documentation/devicetree/bindings/input/touchscreen/edt-ft5x06.txt
```
FocalTech EDT-FT5x06 Polytouch driver
=====================================

There are 5 variants of the chip for various touch panel sizes
FT5206GE1  2.8" .. 3.8"
FT5306DE4  4.3" .. 7"
FT5406EE8  7"   .. 8.9"
FT5506EEG  7"   .. 8.9"
FT5726NEI  5.7” .. 11.6"

The software interface is identical for all those chips, so that
currently there is no need for the driver to distinguish between the
different chips. Nevertheless distinct compatible strings are used so
that a distinction can be added if necessary without changing the DT
bindings.


Required properties:
 - compatible:  "edt,edt-ft5206"
           or:  "edt,edt-ft5306"
           or:  "edt,edt-ft5406"
           or:  "edt,edt-ft5506"
           or:  "evervision,ev-ft5726"
           or:  "focaltech,ft6236"

 - reg:         I2C slave address of the chip (0x38)
 - interrupts:       interrupt specification for the touchdetect
                     interrupt

Optional properties:
 - reset-gpios: GPIO specification for the RESET input
 - wake-gpios:  GPIO specification for the WAKE input
 - vcc-supply:  Regulator that supplies the touchscreen

 - pinctrl-names: should be "default"
 - pinctrl-0:   a phandle pointing to the pin settings for the
                control gpios

 - wakeup-source: If present the device will act as wakeup-source

 - threshold:   allows setting the "click"-threshold in the range
                from 0 to 80.

 - gain:        allows setting the sensitivity in the range from 0 to
                31. Note that lower values indicate higher
                sensitivity.

 - offset:      allows setting the edge compensation in the range from
                0 to 31.

 - offset-x:    Same as offset, but applies only to the horizontal position.
                Range from 0 to 80, only supported by evervision,ev-ft5726
                devices.

 - offset-y:    Same as offset, but applies only to the vertical position.
                Range from 0 to 80, only supported by evervision,ev-ft5726
                devices.

 - touchscreen-size-x	   : See touchscreen.txt
 - touchscreen-size-y	   : See touchscreen.txt
 - touchscreen-fuzz-x      : See touchscreen.txt
 - touchscreen-fuzz-y      : See touchscreen.txt
 - touchscreen-inverted-x  : See touchscreen.txt
 - touchscreen-inverted-y  : See touchscreen.txt
 - touchscreen-swapped-x-y : See touchscreen.txt

Example:
	polytouch: edt-ft5x06@38 {
		compatible = "edt,edt-ft5406", "edt,edt-ft5x06";
		reg = <0x38>;
		pinctrl-names = "default";
		pinctrl-0 = <&edt_ft5x06_pins>;
		interrupt-parent = <&gpio2>;
		interrupts = <5 IRQ_TYPE_EDGE_FALLING>;
		reset-gpios = <&gpio2 6 GPIO_ACTIVE_LOW>;
		wake-gpios = <&gpio4 9 GPIO_ACTIVE_HIGH>;
	};
```

## Documentation/devicetree/bindings/input/touchscreen/edt-ft5x06.yaml
```yaml
# SPDX-License-Identifier: GPL-2.0
%YAML 1.2
---
$id: http://devicetree.org/schemas/input/touchscreen/edt-ft5x06.yaml#
$schema: http://devicetree.org/meta-schemas/core.yaml#

title: FocalTech EDT-FT5x06 Polytouch Bindings

description: |
             There are 5 variants of the chip for various touch panel sizes
              FT5206GE1  2.8" .. 3.8"
              FT5306DE4  4.3" .. 7"
              FT5406EE8  7"   .. 8.9"
              FT5506EEG  7"   .. 8.9"
              FT5726NEI  5.7” .. 11.6"

maintainers:
  - Dmitry Torokhov <dmitry.torokhov@gmail.com>

allOf:
  - $ref: touchscreen.yaml#
  - if:
      properties:
        compatible:
          contains:
            enum:
              - evervision,ev-ft5726

    then:
      properties:
        offset-x: true
        offset-y: true

properties:
  compatible:
    enum:
      - edt,edt-ft5206
      - edt,edt-ft5306
      - edt,edt-ft5406
      - edt,edt-ft5506
      - evervision,ev-ft5726
      - focaltech,ft6236

  reg:
    maxItems: 1

  interrupts:
    maxItems: 1

  reset-gpios:
    maxItems: 1

  wake-gpios:
    maxItems: 1

  wakeup-source: true

  vcc-supply: true

  gain:
    description: Allows setting the sensitivity in the range from 0 to 31.
                 Note that lower values indicate higher sensitivity.
    $ref: /schemas/types.yaml#/definitions/uint32
    minimum: 0
    maximum: 31

  offset:
    description: Allows setting the edge compensation in the range from 0 to 31.
    $ref: /schemas/types.yaml#/definitions/uint32
    minimum: 0
    maximum: 31

  offset-x:
    description: Same as offset, but applies only to the horizontal position.
                 Range from 0 to 80, only supported by evervision,ev-ft5726 devices.
    $ref: /schemas/types.yaml#/definitions/uint32
    minimum: 0
    maximum: 80

  offset-y:
    description: Same as offset, but applies only to the vertical position.
                 Range from 0 to 80, only supported by evervision,ev-ft5726 devices.
    $ref: /schemas/types.yaml#/definitions/uint32
    minimum: 0
    maximum: 80

  touchscreen-size-x: true
  touchscreen-size-y: true
  touchscreen-fuzz-x: true
  touchscreen-fuzz-y: true
  touchscreen-inverted-x: true
  touchscreen-inverted-y: true
  touchscreen-swapped-x-y: true
  interrupt-controller: true

additionalProperties: false

required:
  - compatible
  - reg
  - interrupts

examples:
  - |
    #include <dt-bindings/gpio/gpio.h>
    #include <dt-bindings/interrupt-controller/arm-gic.h>
    i2c {
      #address-cells = <1>;
      #size-cells = <0>;
      edt-ft5x06@38 {
        compatible = "edt,edt-ft5406";
        reg = <0x38>;
        interrupt-parent = <&gpio2>;
        interrupts = <5 IRQ_TYPE_EDGE_FALLING>;
        reset-gpios = <&gpio2 6 GPIO_ACTIVE_LOW>;
        wake-gpios = <&gpio4 9 GPIO_ACTIVE_HIGH>;
      };
    };

...
```
