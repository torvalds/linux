## Documentation/devicetree/bindings/pci/apple,pcie.yaml
```yaml
# SPDX-License-Identifier: (GPL-2.0-only OR BSD-2-Clause)
%YAML 1.2
---
$id: http://devicetree.org/schemas/pci/apple,pcie.yaml#
$schema: http://devicetree.org/meta-schemas/core.yaml#

title: Apple PCIe host controller

maintainers:
  - Mark Kettenis <kettenis@openbsd.org>

description: |
  The Apple PCIe host controller is a PCIe host controller with
  multiple root ports present in Apple ARM SoC platforms, including
  various iPhone and iPad devices and the "Apple Silicon" Macs.
  The controller incorporates Synopsys DesigWare PCIe logic to
  implements its root ports.  But the ATU found on most DesignWare
  PCIe host bridges is absent.

  All root ports share a single ECAM space, but separate GPIOs are
  used to take the PCI devices on those ports out of reset.  Therefore
  the standard "reset-gpios" and "max-link-speed" properties appear on
  the child nodes that represent the PCI bridges that correspond to
  the individual root ports.

  MSIs are handled by the PCIe controller and translated into regular
  interrupts.  A range of 32 MSIs is provided.  These 32 MSIs can be
  distributed over the root ports as the OS sees fit by programming
  the PCIe controller's port registers.

properties:
  compatible:
    items:
      - enum:
          - apple,t8103-pcie
          - apple,t6000-pcie
      - const: apple,pcie

  reg:
    minItems: 3
    maxItems: 6

  reg-names:
    minItems: 3
    items:
      - const: config
      - const: rc
      - const: port0
      - const: port1
      - const: port2
      - const: port3

  ranges:
    minItems: 2
    maxItems: 2

  interrupts:
    description:
      Interrupt specifiers, one for each root port.
    minItems: 1
    maxItems: 4

  msi-parent: true

  msi-ranges:
    maxItems: 1

  iommu-map: true
  iommu-map-mask: true

required:
  - compatible
  - reg
  - reg-names
  - bus-range
  - interrupts
  - msi-controller
  - msi-parent
  - msi-ranges

unevaluatedProperties: false

allOf:
  - $ref: /schemas/pci/pci-bus.yaml#
  - $ref: /schemas/interrupt-controller/msi-controller.yaml#
  - if:
      properties:
        compatible:
          contains:
            const: apple,t8103-pcie
    then:
      properties:
        reg:
          maxItems: 5
        interrupts:
          maxItems: 3

examples:
  - |
    #include <dt-bindings/interrupt-controller/apple-aic.h>

    soc {
      #address-cells = <2>;
      #size-cells = <2>;

      pcie0: pcie@690000000 {
        compatible = "apple,t8103-pcie", "apple,pcie";
        device_type = "pci";

        reg = <0x6 0x90000000 0x0 0x1000000>,
              <0x6 0x80000000 0x0 0x100000>,
              <0x6 0x81000000 0x0 0x4000>,
              <0x6 0x82000000 0x0 0x4000>,
              <0x6 0x83000000 0x0 0x4000>;
        reg-names = "config", "rc", "port0", "port1", "port2";

        interrupt-parent = <&aic>;
        interrupts = <AIC_IRQ 695 IRQ_TYPE_LEVEL_HIGH>,
                     <AIC_IRQ 698 IRQ_TYPE_LEVEL_HIGH>,
                     <AIC_IRQ 701 IRQ_TYPE_LEVEL_HIGH>;

        msi-controller;
        msi-parent = <&pcie0>;
        msi-ranges = <&aic AIC_IRQ 704 IRQ_TYPE_EDGE_RISING 32>;

        iommu-map = <0x100 &dart0 1 1>,
                    <0x200 &dart1 1 1>,
                    <0x300 &dart2 1 1>;
        iommu-map-mask = <0xff00>;

        bus-range = <0 3>;
        #address-cells = <3>;
        #size-cells = <2>;
        ranges = <0x43000000 0x6 0xa0000000 0x6 0xa0000000 0x0 0x20000000>,
                 <0x02000000 0x0 0xc0000000 0x6 0xc0000000 0x0 0x40000000>;

        power-domains = <&ps_apcie>, <&ps_apcie_gp>, <&ps_pcie_ref>;
        pinctrl-0 = <&pcie_pins>;
        pinctrl-names = "default";

        pci@0,0 {
          device_type = "pci";
          reg = <0x0 0x0 0x0 0x0 0x0>;
          reset-gpios = <&pinctrl_ap 152 0>;

          #address-cells = <3>;
          #size-cells = <2>;
          ranges;
        };

        pci@1,0 {
          device_type = "pci";
          reg = <0x800 0x0 0x0 0x0 0x0>;
          reset-gpios = <&pinctrl_ap 153 0>;

          #address-cells = <3>;
          #size-cells = <2>;
          ranges;
        };

        pci@2,0 {
          device_type = "pci";
          reg = <0x1000 0x0 0x0 0x0 0x0>;
          reset-gpios = <&pinctrl_ap 33 0>;

          #address-cells = <3>;
          #size-cells = <2>;
          ranges;
        };
      };
    };
```

## Documentation/devicetree/bindings/pci/arm,juno-r1-pcie.txt
```
* ARM Juno R1 PCIe interface

This PCIe host controller is based on PLDA XpressRICH3-AXI IP
and thus inherits all the common properties defined in plda,xpressrich3-axi.txt
as well as the base properties defined in host-generic-pci.txt.

Required properties:
 - compatible: "arm,juno-r1-pcie"
 - dma-coherent: The host controller bridges the AXI transactions into PCIe bus
   in a manner that makes the DMA operations to appear coherent to the CPUs.
```

## Documentation/devicetree/bindings/pci/aspeed,ast2600-pcie.yaml
```yaml
# SPDX-License-Identifier: (GPL-2.0-only OR BSD-2-Clause)
%YAML 1.2
---
$id: http://devicetree.org/schemas/pci/aspeed,ast2600-pcie.yaml#
$schema: http://devicetree.org/meta-schemas/core.yaml#

title: ASPEED PCIe Root Complex Controller

maintainers:
  - Jacky Chou <jacky_chou@aspeedtech.com>

description:
  The ASPEED PCIe Root Complex controller provides PCI Express Root Complex
  functionality for ASPEED SoCs, such as the AST2600 and AST2700.
  This controller enables connectivity to PCIe endpoint devices, supporting
  memory and I/O windows, MSI and INTx interrupts, and integration with
  the SoC's clock, reset, and pinctrl subsystems. On AST2600, the PCIe Root
  Port device number is always 8.

properties:
  compatible:
    enum:
      - aspeed,ast2600-pcie
      - aspeed,ast2700-pcie

  reg:
    maxItems: 1

  ranges:
    minItems: 2
    maxItems: 2

  interrupts:
    maxItems: 1
    description: INTx and MSI interrupt

  resets:
    items:
      - description: PCIe controller reset

  reset-names:
    items:
      - const: h2x

  aspeed,ahbc:
    $ref: /schemas/types.yaml#/definitions/phandle
    description:
      Phandle to the ASPEED AHB Controller (AHBC) syscon node.
      This reference is used by the PCIe controller to access
      system-level configuration registers related to the AHB bus.
      To enable AHB access for the PCIe controller.

  aspeed,pciecfg:
    $ref: /schemas/types.yaml#/definitions/phandle
    description:
      Phandle to the ASPEED PCIe configuration syscon node.
      This reference allows the PCIe controller to access
      SoC-specific PCIe configuration registers. There are the others
      functions such PCIe RC and PCIe EP will use this common register
      to configure the SoC interfaces.

  interrupt-controller: true

patternProperties:
  "^pcie@[0-9a-f]+,0$":
    type: object
    $ref: /schemas/pci/pci-pci-bridge.yaml#

    properties:
      reg:
        maxItems: 1

      resets:
        items:
          - description: PERST# signal

      reset-names:
        items:
          - const: perst

      clocks:
        maxItems: 1

      phys:
        maxItems: 1

    required:
      - resets
      - reset-names
      - clocks
      - phys
      - ranges

    unevaluatedProperties: false

allOf:
  - $ref: /schemas/pci/pci-host-bridge.yaml#
  - $ref: /schemas/interrupt-controller/msi-controller.yaml#
  - if:
      properties:
        compatible:
          contains:
            const: aspeed,ast2600-pcie
    then:
      required:
        - aspeed,ahbc
    else:
      properties:
        aspeed,ahbc: false
  - if:
      properties:
        compatible:
          contains:
            const: aspeed,ast2700-pcie
    then:
      required:
        - aspeed,pciecfg
    else:
      properties:
        aspeed,pciecfg: false

required:
  - reg
  - interrupts
  - bus-range
  - ranges
  - resets
  - reset-names
  - msi-controller
  - interrupt-controller
  - interrupt-map-mask
  - interrupt-map

unevaluatedProperties: false

examples:
  - |
    #include <dt-bindings/interrupt-controller/arm-gic.h>
    #include <dt-bindings/clock/ast2600-clock.h>

    pcie0: pcie@1e770000 {
      compatible = "aspeed,ast2600-pcie";
      device_type = "pci";
      reg = <0x1e770000 0x100>;
      #address-cells = <3>;
      #size-cells = <2>;
      interrupts = <GIC_SPI 168 IRQ_TYPE_LEVEL_HIGH>;
      bus-range = <0x00 0xff>;

      ranges = <0x01000000 0x0 0x00018000 0x00018000 0x0 0x00008000
                0x02000000 0x0 0x60000000 0x60000000 0x0 0x20000000>;

      resets = <&syscon ASPEED_RESET_H2X>;
      reset-names = "h2x";

      #interrupt-cells = <1>;
      msi-controller;

      aspeed,ahbc = <&ahbc>;

      interrupt-controller;
      interrupt-map-mask = <0 0 0 7>;
      interrupt-map = <0 0 0 1 &pcie0 0>,
                      <0 0 0 2 &pcie0 1>,
                      <0 0 0 3 &pcie0 2>,
                      <0 0 0 4 &pcie0 3>;

      pcie@8,0 {
        compatible = "pciclass,0604";
        reg = <0x00004000 0 0 0 0>;
        #address-cells = <3>;
        #size-cells = <2>;
        device_type = "pci";
        resets = <&syscon ASPEED_RESET_PCIE_RC_O>;
        reset-names = "perst";
        clocks = <&syscon ASPEED_CLK_GATE_BCLK>;
        pinctrl-names = "default";
        pinctrl-0 = <&pinctrl_pcierc1_default>;
        phys = <&pcie_phy1>;
        ranges;
      };
    };
```

## Documentation/devicetree/bindings/pci/axis,artpec6-pcie.txt
```
* Axis ARTPEC-6 PCIe interface

This PCIe host controller is based on the Synopsys DesignWare PCIe IP
and thus inherits all the common properties defined in snps,dw-pcie.yaml.

Required properties:
- compatible: "axis,artpec6-pcie", "snps,dw-pcie" for ARTPEC-6 in RC mode;
	      "axis,artpec6-pcie-ep", "snps,dw-pcie" for ARTPEC-6 in EP mode;
	      "axis,artpec7-pcie", "snps,dw-pcie" for ARTPEC-7 in RC mode;
	      "axis,artpec7-pcie-ep", "snps,dw-pcie" for ARTPEC-7 in EP mode;
- reg: base addresses and lengths of the PCIe controller (DBI),
	the PHY controller, and configuration address space.
- reg-names: Must include the following entries:
	- "dbi"
	- "phy"
	- "config"
- interrupts: A list of interrupt outputs of the controller. Must contain an
  entry for each entry in the interrupt-names property.
- interrupt-names: Must include the following entries:
	- "msi": The interrupt that is asserted when an MSI is received
- axis,syscon-pcie: A phandle pointing to the ARTPEC-6 system controller,
	used to enable and control the Synopsys IP.

Example:

	pcie@f8050000 {
		compatible = "axis,artpec6-pcie", "snps,dw-pcie";
		reg = <0xf8050000 0x2000
		       0xf8040000 0x1000
		       0xc0000000 0x2000>;
		reg-names = "dbi", "phy", "config";
		#address-cells = <3>;
		#size-cells = <2>;
		device_type = "pci";
			  /* downstream I/O */
		ranges = <0x81000000 0 0 0xc0002000 0 0x00010000
			  /* non-prefetchable memory */
			  0x82000000 0 0xc0012000 0xc0012000 0 0x1ffee000>;
		num-lanes = <2>;
		bus-range = <0x00 0xff>;
		interrupts = <GIC_SPI 148 IRQ_TYPE_LEVEL_HIGH>;
		interrupt-names = "msi";
		#interrupt-cells = <1>;
		interrupt-map-mask = <0 0 0 0x7>;
		interrupt-map = <0 0 0 1 &intc GIC_SPI 144 IRQ_TYPE_LEVEL_HIGH>,
		                <0 0 0 2 &intc GIC_SPI 145 IRQ_TYPE_LEVEL_HIGH>,
		                <0 0 0 3 &intc GIC_SPI 146 IRQ_TYPE_LEVEL_HIGH>,
		                <0 0 0 4 &intc GIC_SPI 147 IRQ_TYPE_LEVEL_HIGH>;
		axis,syscon-pcie = <&syscon>;
	};
```

## Documentation/devicetree/bindings/pci/axis,artpec6-pcie.yaml
```yaml
# SPDX-License-Identifier: (GPL-2.0-only OR BSD-2-Clause)
# Copyright 2025 Axis AB
%YAML 1.2
---
$id: http://devicetree.org/schemas/pci/axis,artpec6-pcie.yaml#
$schema: http://devicetree.org/meta-schemas/core.yaml#

title: Axis ARTPEC-6 PCIe host controller

maintainers:
  - Jesper Nilsson <jesper.nilsson@axis.com>

description:
  This PCIe host controller is based on the Synopsys DesignWare PCIe IP.

select:
  properties:
    compatible:
      contains:
        enum:
          - axis,artpec6-pcie
          - axis,artpec6-pcie-ep
          - axis,artpec7-pcie
          - axis,artpec7-pcie-ep
  required:
    - compatible

properties:
  compatible:
    items:
      - enum:
          - axis,artpec6-pcie
          - axis,artpec6-pcie-ep
          - axis,artpec7-pcie
          - axis,artpec7-pcie-ep
      - const: snps,dw-pcie

  reg:
    minItems: 3
    maxItems: 4

  reg-names:
    minItems: 3
    maxItems: 4

  interrupts:
    maxItems: 1

  interrupt-names:
    items:
      - const: msi

  axis,syscon-pcie:
    $ref: /schemas/types.yaml#/definitions/phandle
    description:
      System controller phandle used to enable and control the Synopsys IP.

required:
  - compatible
  - reg
  - reg-names
  - interrupts
  - interrupt-names
  - axis,syscon-pcie

oneOf:
  - $ref: snps,dw-pcie.yaml#
    properties:
      reg:
        maxItems: 3

      reg-names:
        items:
          - const: dbi
          - const: phy
          - const: config

  - $ref: snps,dw-pcie-ep.yaml#
    properties:
      reg:
        minItems: 4

      reg-names:
        items:
          - const: dbi
          - const: dbi2
          - const: phy
          - const: addr_space

unevaluatedProperties: false

examples:
  - |
    #include <dt-bindings/interrupt-controller/arm-gic.h>

    pcie@f8050000 {
        compatible = "axis,artpec6-pcie", "snps,dw-pcie";
        device_type = "pci";
        reg = <0xf8050000 0x2000
              0xf8040000 0x1000
              0xc0000000 0x2000>;
        reg-names = "dbi", "phy", "config";
        #address-cells = <3>;
        #size-cells = <2>;
        ranges = <0x81000000 0 0 0xc0002000 0 0x00010000>,
                 <0x82000000 0 0xc0012000 0xc0012000 0 0x1ffee000>;
        num-lanes = <2>;
        bus-range = <0x00 0xff>;
        interrupts = <GIC_SPI 148 IRQ_TYPE_LEVEL_HIGH>;
        interrupt-names = "msi";
        #interrupt-cells = <1>;
        interrupt-map-mask = <0 0 0 0x7>;
        interrupt-map = <0 0 0 1 &intc GIC_SPI 144 IRQ_TYPE_LEVEL_HIGH>,
                        <0 0 0 2 &intc GIC_SPI 145 IRQ_TYPE_LEVEL_HIGH>,
                        <0 0 0 3 &intc GIC_SPI 146 IRQ_TYPE_LEVEL_HIGH>,
                        <0 0 0 4 &intc GIC_SPI 147 IRQ_TYPE_LEVEL_HIGH>;
        axis,syscon-pcie = <&syscon>;
    };
```
