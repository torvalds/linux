## Documentation/devicetree/bindings/pci/amd,versal2-mdb-host.yaml
```yaml
# SPDX-License-Identifier: (GPL-2.0-only OR BSD-2-Clause)
%YAML 1.2
---
$id: http://devicetree.org/schemas/pci/amd,versal2-mdb-host.yaml#
$schema: http://devicetree.org/meta-schemas/core.yaml#

title: AMD Versal2 MDB(Multimedia DMA Bridge) Host Controller

maintainers:
  - Thippeswamy Havalige <thippeswamy.havalige@amd.com>

allOf:
  - $ref: /schemas/pci/pci-host-bridge.yaml#
  - $ref: /schemas/pci/snps,dw-pcie.yaml#

properties:
  compatible:
    const: amd,versal2-mdb-host

  reg:
    items:
      - description: MDB System Level Control and Status Register (SLCR) Base
      - description: configuration region
      - description: data bus interface
      - description: address translation unit register

  reg-names:
    items:
      - const: slcr
      - const: config
      - const: dbi
      - const: atu

  ranges:
    maxItems: 2

  msi-map:
    maxItems: 1

  interrupts:
    maxItems: 1

  interrupt-map-mask:
    items:
      - const: 0
      - const: 0
      - const: 0
      - const: 7

  interrupt-map:
    maxItems: 4

  "#interrupt-cells":
    const: 1

  interrupt-controller:
    description: identifies the node as an interrupt controller
    type: object
    additionalProperties: false
    properties:
      interrupt-controller: true

      "#address-cells":
        const: 0

      "#interrupt-cells":
        const: 1

    required:
      - interrupt-controller
      - "#address-cells"
      - "#interrupt-cells"

patternProperties:
  '^pcie@[0-2],0$':
    type: object
    $ref: /schemas/pci/pci-pci-bridge.yaml#

    properties:
      reg:
        maxItems: 1

    unevaluatedProperties: false

required:
  - reg
  - reg-names
  - interrupts
  - interrupt-map
  - interrupt-map-mask
  - msi-map
  - "#interrupt-cells"
  - interrupt-controller

unevaluatedProperties: false

examples:
  - |
    #include <dt-bindings/interrupt-controller/arm-gic.h>
    #include <dt-bindings/interrupt-controller/irq.h>
    #include <dt-bindings/gpio/gpio.h>

    soc {
        #address-cells = <2>;
        #size-cells = <2>;
        pcie@ed931000 {
            compatible = "amd,versal2-mdb-host";
            reg = <0x0 0xed931000 0x0 0x2000>,
                  <0x1000 0x100000 0x0 0xff00000>,
                  <0x1000 0x0 0x0 0x1000>,
                  <0x0 0xed860000 0x0 0x2000>;
            reg-names = "slcr", "config", "dbi", "atu";
            ranges = <0x2000000 0x00 0xa0000000 0x00 0xa0000000 0x00 0x10000000>,
                     <0x43000000 0x1100 0x00 0x1100 0x00 0x00 0x1000000>;
            interrupts = <GIC_SPI 165 IRQ_TYPE_LEVEL_HIGH>;
            interrupt-parent = <&gic>;
            interrupt-map-mask = <0 0 0 7>;
            interrupt-map = <0 0 0 1 &pcie_intc_0 0>,
                            <0 0 0 2 &pcie_intc_0 1>,
                            <0 0 0 3 &pcie_intc_0 2>,
                            <0 0 0 4 &pcie_intc_0 3>;
            msi-map = <0x0 &gic_its 0x00 0x10000>;
            #address-cells = <3>;
            #size-cells = <2>;
            #interrupt-cells = <1>;
            device_type = "pci";

            pcie@0,0 {
                device_type = "pci";
                reg = <0x0 0x0 0x0 0x0 0x0>;
                reset-gpios = <&tca6416_u37 7 GPIO_ACTIVE_LOW>;
                #address-cells = <3>;
                #size-cells = <2>;
                ranges;
            };

            pcie_intc_0: interrupt-controller {
                #address-cells = <0>;
                #interrupt-cells = <1>;
                interrupt-controller;
            };
        };
    };
```

## Documentation/devicetree/bindings/pci/amlogic,axg-pcie.yaml
```yaml
# SPDX-License-Identifier: (GPL-2.0-only OR BSD-2-Clause)
%YAML 1.2
---
$id: http://devicetree.org/schemas/pci/amlogic,axg-pcie.yaml#
$schema: http://devicetree.org/meta-schemas/core.yaml#

title: Amlogic Meson AXG DWC PCIe SoC controller

maintainers:
  - Neil Armstrong <neil.armstrong@linaro.org>

description:
  Amlogic Meson PCIe host controller is based on the Synopsys DesignWare PCI core.

allOf:
  - $ref: /schemas/pci/pci-host-bridge.yaml#
  - $ref: /schemas/pci/snps,dw-pcie-common.yaml#

# We need a select here so we don't match all nodes with 'snps,dw-pcie'
select:
  properties:
    compatible:
      enum:
        - amlogic,axg-pcie
        - amlogic,g12a-pcie
  required:
    - compatible

properties:
  compatible:
    items:
      - enum:
          - amlogic,axg-pcie
          - amlogic,g12a-pcie
      - const: snps,dw-pcie

  reg:
    items:
      - description: External local bus interface registers
      - description: Meson designed configuration registers
      - description: PCIe configuration space

  reg-names:
    items:
      - const: elbi
      - const: cfg
      - const: config

  interrupts:
    maxItems: 1

  clocks:
    items:
      - description: PCIe GEN 100M PLL clock
      - description: PCIe RC clock gate
      - description: PCIe PHY clock

  clock-names:
    items:
      - const: pclk
      - const: port
      - const: general

  phys:
    maxItems: 1

  phy-names:
    const: pcie

  resets:
    items:
      - description: Port Reset
      - description: Shared APB reset

  reset-names:
    items:
      - const: port
      - const: apb

  num-lanes:
    const: 1

  power-domains:
    maxItems: 1

required:
  - compatible
  - reg
  - reg-names
  - interrupts
  - clock
  - clock-names
  - "#address-cells"
  - "#size-cells"
  - "#interrupt-cells"
  - interrupt-map
  - interrupt-map-mask
  - ranges
  - bus-range
  - device_type
  - num-lanes
  - phys
  - phy-names
  - resets
  - reset-names

unevaluatedProperties: false

examples:
  - |
    #include <dt-bindings/interrupt-controller/irq.h>
    #include <dt-bindings/interrupt-controller/arm-gic.h>
    pcie: pcie@f9800000 {
        compatible = "amlogic,axg-pcie", "snps,dw-pcie";
        reg = <0xf9800000 0x400000>, <0xff646000 0x2000>, <0xf9f00000 0x100000>;
        reg-names = "elbi", "cfg", "config";
        interrupts = <GIC_SPI 177 IRQ_TYPE_EDGE_RISING>;
        clocks = <&pclk>, <&clk_port>, <&clk_phy>;
        clock-names = "pclk", "port", "general";
        resets = <&reset_pcie_port>, <&reset_pcie_apb>;
        reset-names = "port", "apb";
        phys = <&pcie_phy>;
        phy-names = "pcie";
        #interrupt-cells = <1>;
        interrupt-map-mask = <0 0 0 0>;
        interrupt-map = <0 0 0 0 &gic GIC_SPI 179 IRQ_TYPE_EDGE_RISING>;
        bus-range = <0x0 0xff>;
        #address-cells = <3>;
        #size-cells = <2>;
        device_type = "pci";
        num-lanes = <1>;
        ranges = <0x82000000 0 0 0xf9c00000 0 0x00300000>;
    };
...
```

## Documentation/devicetree/bindings/pci/amlogic,meson-pcie.txt
```
Amlogic Meson AXG DWC PCIE SoC controller

Amlogic Meson PCIe host controller is based on the Synopsys DesignWare PCI core.
It shares common functions with the PCIe DesignWare core driver and
inherits common properties defined in
Documentation/devicetree/bindings/pci/designware-pcie.txt.

Additional properties are described here:

Required properties:
- compatible:
	should contain :
	- "amlogic,axg-pcie" for AXG SoC Family
	- "amlogic,g12a-pcie" for G12A SoC Family
	to identify the core.
- reg:
	should contain the configuration address space.
- reg-names: Must be
	- "elbi"	External local bus interface registers
	- "cfg"		Meson specific registers
	- "config"	PCIe configuration space
- reset-gpios: The GPIO to generate PCIe PERST# assert and deassert signal.
- clocks: Must contain an entry for each entry in clock-names.
- clock-names: Must include the following entries:
	- "pclk"       PCIe GEN 100M PLL clock
	- "port"       PCIe_x(A or B) RC clock gate
	- "general"    PCIe Phy clock
- resets: phandle to the reset lines.
- reset-names: must contain "port" and "apb"
       - "port"        Port A or B reset
       - "apb"         Share APB reset
- phys: should contain a phandle to the PCIE phy
- phy-names: must contain "pcie"

- device_type:
	should be "pci". As specified in designware-pcie.txt


Example configuration:

	pcie: pcie@f9800000 {
			compatible = "amlogic,axg-pcie", "snps,dw-pcie";
			reg = <0x0 0xf9800000 0x0 0x400000
					0x0 0xff646000 0x0 0x2000
					0x0 0xf9f00000 0x0 0x100000>;
			reg-names = "elbi", "cfg", "config";
			reset-gpios = <&gpio GPIOX_19 GPIO_ACTIVE_HIGH>;
			interrupts = <GIC_SPI 177 IRQ_TYPE_EDGE_RISING>;
			#interrupt-cells = <1>;
			interrupt-map-mask = <0 0 0 0>;
			interrupt-map = <0 0 0 0 &gic GIC_SPI 179 IRQ_TYPE_EDGE_RISING>;
			bus-range = <0x0 0xff>;
			#address-cells = <3>;
			#size-cells = <2>;
			device_type = "pci";
			ranges = <0x82000000 0 0 0x0 0xf9c00000 0 0x00300000>;

			clocks = <&clkc CLKID_USB
					&clkc CLKID_PCIE_A
					&clkc CLKID_PCIE_CML_EN0>;
			clock-names = "general",
					"pclk",
					"port";
			resets = <&reset RESET_PCIE_A>,
				<&reset RESET_PCIE_APB>;
			reset-names = "port",
					"apb";
			phys = <&pcie_phy>;
			phy-names = "pcie";
	};
```

## Documentation/devicetree/bindings/pci/andestech,qilai-pcie.yaml
```yaml
# SPDX-License-Identifier: (GPL-2.0-only OR BSD-2-Clause)
%YAML 1.2
---
$id: http://devicetree.org/schemas/pci/andestech,qilai-pcie.yaml#
$schema: http://devicetree.org/meta-schemas/core.yaml#

title: Andes QiLai PCIe host controller

description:
  Andes QiLai PCIe host controller is based on the Synopsys DesignWare
  PCI core.

maintainers:
  - Randolph Lin <randolph@andestech.com>

allOf:
  - $ref: /schemas/pci/snps,dw-pcie.yaml#

properties:
  compatible:
    const: andestech,qilai-pcie

  reg:
    items:
      - description: Data Bus Interface (DBI) registers.
      - description: APB registers.
      - description: PCIe configuration space region.

  reg-names:
    items:
      - const: dbi
      - const: apb
      - const: config

  dma-coherent: true

  ranges:
    maxItems: 2

  interrupts:
    maxItems: 1

  interrupt-names:
    items:
      - const: msi

required:
  - reg
  - reg-names
  - interrupts
  - interrupt-names

unevaluatedProperties: false

examples:
  - |
    #include <dt-bindings/interrupt-controller/irq.h>

    soc {
      #address-cells = <2>;
      #size-cells = <2>;

      pcie@80000000 {
        compatible = "andestech,qilai-pcie";
        device_type = "pci";
        reg = <0x0 0x80000000 0x0 0x20000000>,
              <0x0 0x04000000 0x0 0x00001000>,
              <0x0 0x00000000 0x0 0x00010000>;
        reg-names = "dbi", "apb", "config";
        dma-coherent;

        linux,pci-domain = <0>;
        #address-cells = <3>;
        #size-cells = <2>;
        ranges = <0x02000000 0x00 0x10000000 0x00 0x10000000 0x00 0xf0000000>,
                 <0x43000000 0x01 0x00000000 0x01 0x00000000 0x02 0x00000000>;

        #interrupt-cells = <1>;
        interrupts = <0xf>;
        interrupt-names = "msi";
        interrupt-parent = <&plic0>;
        interrupt-map-mask = <0 0 0 0>;
        interrupt-map = <0 0 0 1 &plic0 0xf IRQ_TYPE_LEVEL_HIGH>,
                        <0 0 0 2 &plic0 0xf IRQ_TYPE_LEVEL_HIGH>,
                        <0 0 0 3 &plic0 0xf IRQ_TYPE_LEVEL_HIGH>,
                        <0 0 0 4 &plic0 0xf IRQ_TYPE_LEVEL_HIGH>;
      };
    };
...
```

## Documentation/devicetree/bindings/pci/apm,xgene-pcie.yaml
```yaml
# SPDX-License-Identifier: (GPL-2.0-only OR BSD-2-Clause)
%YAML 1.2
---
$id: http://devicetree.org/schemas/pci/apm,xgene-pcie.yaml#
$schema: http://devicetree.org/meta-schemas/core.yaml#

title: AppliedMicro X-Gene PCIe interface

maintainers:
  - Toan Le <toan@os.amperecomputing.com>

allOf:
  - $ref: /schemas/pci/pci-host-bridge.yaml#

properties:
  compatible:
    oneOf:
      - items:
          - const: apm,xgene-storm-pcie
          - const: apm,xgene-pcie
      - items:
          - const: apm,xgene-pcie

  reg:
    items:
      - description: Controller configuration registers
      - description: PCI configuration space registers

  reg-names:
    items:
      - const: csr
      - const: cfg

  clocks:
    maxItems: 1

  clock-names:
    items:
      - const: pcie

  dma-coherent: true

  msi-parent:
    maxItems: 1

required:
  - compatible
  - reg
  - reg-names
  - '#interrupt-cells'
  - interrupt-map-mask
  - interrupt-map
  - clocks

unevaluatedProperties: false

examples:
  - |
    bus {
        #address-cells = <2>;
        #size-cells = <2>;

        pcie@1f2b0000 {
            compatible = "apm,xgene-storm-pcie", "apm,xgene-pcie";
            device_type = "pci";
            #interrupt-cells = <1>;
            #size-cells = <2>;
            #address-cells = <3>;
            reg = <0x00 0x1f2b0000 0x0 0x00010000>, /* Controller registers */
                  <0xe0 0xd0000000 0x0 0x00040000>; /* PCI config space */
            reg-names = "csr", "cfg";
            ranges = <0x01000000 0x00 0x00000000 0xe0 0x10000000 0x00 0x00010000>, /* io */
                    <0x02000000 0x00 0x80000000 0xe1 0x80000000 0x00 0x80000000>; /* mem */
            dma-ranges = <0x42000000 0x80 0x00000000 0x80 0x00000000 0x00 0x80000000>,
                        <0x42000000 0x00 0x00000000 0x00 0x00000000 0x80 0x00000000>;
            interrupt-map-mask = <0x0 0x0 0x0 0x7>;
            interrupt-map = <0x0 0x0 0x0 0x1 &gic 0x0 0xc2 0x1>,
                            <0x0 0x0 0x0 0x2 &gic 0x0 0xc3 0x1>,
                            <0x0 0x0 0x0 0x3 &gic 0x0 0xc4 0x1>,
                            <0x0 0x0 0x0 0x4 &gic 0x0 0xc5 0x1>;
            dma-coherent;
            clocks = <&pcie0clk 0>;
        };
    };
```
