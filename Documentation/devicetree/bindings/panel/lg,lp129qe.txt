## Documentation/devicetree/bindings/panel/lg,lp129qe.txt
```
LG 12.9" (2560x1700 pixels) TFT LCD panel

Required properties:
- compatible: should be "lg,lp129qe"

This binding is compatible with the simple-panel binding, which is specified
in simple-panel.txt in this directory.
```

## Documentation/devicetree/bindings/panel/panasonic,vvx10f004b00.txt
```
Panasonic Corporation 10.1" WUXGA TFT LCD panel

Required properties:
- compatible: should be "panasonic,vvx10f004b00"

This binding is compatible with the simple-panel binding, which is specified
in simple-panel.txt in this directory.
```

## Documentation/devicetree/bindings/pci/83xx-512x-pci.txt
```
* Freescale 83xx and 512x PCI bridges

Freescale 83xx and 512x SOCs include the same PCI bridge core.

83xx/512x specific notes:
- reg: should contain two address length tuples
    The first is for the internal PCI bridge registers
    The second is for the PCI config space access registers

Example (MPC8313ERDB)
	pci0: pci@e0008500 {
		interrupt-map-mask = <0xf800 0x0 0x0 0x7>;
		interrupt-map = <
				/* IDSEL 0x0E -mini PCI */
				 0x7000 0x0 0x0 0x1 &ipic 18 0x8
				 0x7000 0x0 0x0 0x2 &ipic 18 0x8
				 0x7000 0x0 0x0 0x3 &ipic 18 0x8
				 0x7000 0x0 0x0 0x4 &ipic 18 0x8

				/* IDSEL 0x0F - PCI slot */
				 0x7800 0x0 0x0 0x1 &ipic 17 0x8
				 0x7800 0x0 0x0 0x2 &ipic 18 0x8
				 0x7800 0x0 0x0 0x3 &ipic 17 0x8
				 0x7800 0x0 0x0 0x4 &ipic 18 0x8>;
		interrupt-parent = <&ipic>;
		interrupts = <66 0x8>;
		bus-range = <0x0 0x0>;
		ranges = <0x02000000 0x0 0x90000000 0x90000000 0x0 0x10000000
			  0x42000000 0x0 0x80000000 0x80000000 0x0 0x10000000
			  0x01000000 0x0 0x00000000 0xe2000000 0x0 0x00100000>;
		clock-frequency = <66666666>;
		#interrupt-cells = <1>;
		#size-cells = <2>;
		#address-cells = <3>;
		reg = <0xe0008500 0x100		/* internal registers */
		       0xe0008300 0x8>;		/* config space access registers */
		compatible = "fsl,mpc8349-pci";
		device_type = "pci";
	};
```

## Documentation/devicetree/bindings/pci/aardvark-pci.txt
```
Aardvark PCIe controller

This PCIe controller is used on the Marvell Armada 3700 ARM64 SoC.

The Device Tree node describing an Aardvark PCIe controller must
contain the following properties:

 - compatible: Should be "marvell,armada-3700-pcie"
 - reg: range of registers for the PCIe controller
 - interrupts: the interrupt line of the PCIe controller
 - #address-cells: set to <3>
 - #size-cells: set to <2>
 - device_type: set to "pci"
 - ranges: ranges for the PCI memory and I/O regions
 - #interrupt-cells: set to <1>
 - msi-controller: indicates that the PCIe controller can itself
   handle MSI interrupts
 - msi-parent: pointer to the MSI controller to be used
 - interrupt-map-mask and interrupt-map: standard PCI properties to
   define the mapping of the PCIe interface to interrupt numbers.
 - bus-range: PCI bus numbers covered
 - phys: the PCIe PHY handle
 - max-link-speed: see pci.txt
 - reset-gpios: see pci.txt

In addition, the Device Tree describing an Aardvark PCIe controller
must include a sub-node that describes the legacy interrupt controller
built into the PCIe controller. This sub-node must have the following
properties:

 - interrupt-controller
 - #interrupt-cells: set to <1>

Example:

	pcie0: pcie@d0070000 {
		compatible = "marvell,armada-3700-pcie";
		device_type = "pci";
		reg = <0 0xd0070000 0 0x20000>;
		#address-cells = <3>;
		#size-cells = <2>;
		bus-range = <0x00 0xff>;
		interrupts = <GIC_SPI 29 IRQ_TYPE_LEVEL_HIGH>;
		#interrupt-cells = <1>;
		msi-controller;
		msi-parent = <&pcie0>;
		ranges = <0x82000000 0 0xe8000000   0 0xe8000000 0 0x1000000 /* Port 0 MEM */
			  0x81000000 0 0xe9000000   0 0xe9000000 0 0x10000>; /* Port 0 IO*/
		interrupt-map-mask = <0 0 0 7>;
		interrupt-map = <0 0 0 1 &pcie_intc 0>,
				<0 0 0 2 &pcie_intc 1>,
				<0 0 0 3 &pcie_intc 2>,
				<0 0 0 4 &pcie_intc 3>;
		phys = <&comphy1 0>;
		pcie_intc: interrupt-controller {
			interrupt-controller;
			#interrupt-cells = <1>;
		};
	};
```

## Documentation/devicetree/bindings/pci/altera-pcie-msi.txt
```
* Altera PCIe MSI controller

Required properties:
- compatible:	should contain "altr,msi-1.0"
- reg:		specifies the physical base address of the controller and
		the length of the memory mapped region.
- reg-names:	must include the following entries:
		"csr": CSR registers
		"vector_slave": vectors slave port region
- interrupt-parent:	interrupt source phandle.
- interrupts:	specifies the interrupt source of the parent interrupt
		controller. The format of the interrupt specifier depends on the
		parent interrupt controller.
- num-vectors:	number of vectors, range 1 to 32.
- msi-controller:	indicates that this is MSI controller node


Example
msi0: msi@0xFF200000 {
	compatible = "altr,msi-1.0";
	reg = <0xFF200000 0x00000010
		0xFF200010 0x00000080>;
	reg-names = "csr", "vector_slave";
	interrupt-parent = <&hps_0_arm_gic_0>;
	interrupts = <0 42 4>;
	msi-controller;
	num-vectors = <32>;
};
```

## Documentation/devicetree/bindings/pci/altera-pcie.txt
```
* Altera PCIe controller

Required properties:
- compatible :	should contain "altr,pcie-root-port-1.0"
- reg:		a list of physical base address and length for TXS and CRA.
- reg-names:	must include the following entries:
		"Txs": TX slave port region
		"Cra": Control register access region
- interrupt-parent:	interrupt source phandle.
- interrupts:	specifies the interrupt source of the parent interrupt controller.
		The format of the interrupt specifier depends on the parent interrupt
		controller.
- device_type:	must be "pci"
- #address-cells:	set to <3>
- #size-cells:	set to <2>
- #interrupt-cells:	set to <1>
- ranges:		describes the translation of addresses for root ports and standard
		PCI regions.
- interrupt-map-mask and interrupt-map: standard PCI properties to define the
		mapping of the PCIe interface to interrupt numbers.

Optional properties:
- msi-parent:	Link to the hardware entity that serves as the MSI controller for this PCIe
		controller.
- bus-range:	PCI bus numbers covered

Example
	pcie_0: pcie@0xc00000000 {
		compatible = "altr,pcie-root-port-1.0";
		reg = <0xc0000000 0x20000000>,
			<0xff220000 0x00004000>;
		reg-names = "Txs", "Cra";
		interrupt-parent = <&hps_0_arm_gic_0>;
		interrupts = <0 40 4>;
		interrupt-controller;
		#interrupt-cells = <1>;
		bus-range = <0x0 0xFF>;
		device_type = "pci";
		msi-parent = <&msi_to_gic_gen_0>;
		#address-cells = <3>;
		#size-cells = <2>;
		interrupt-map-mask = <0 0 0 7>;
		interrupt-map = <0 0 0 1 &pcie_0 1>,
			            <0 0 0 2 &pcie_0 2>,
			            <0 0 0 3 &pcie_0 3>,
			            <0 0 0 4 &pcie_0 4>;
		ranges = <0x82000000 0x00000000 0x00000000 0xc0000000 0x00000000 0x10000000
			    0x82000000 0x00000000 0x10000000 0xd0000000 0x00000000 0x10000000>;
	};
```

## Documentation/devicetree/bindings/pci/altr,msi-controller.yaml
```yaml
# SPDX-License-Identifier: (GPL-2.0 OR BSD-2-Clause)
# Copyright (C) 2015, 2024, Intel Corporation
%YAML 1.2
---
$id: http://devicetree.org/schemas/altr,msi-controller.yaml#
$schema: http://devicetree.org/meta-schemas/core.yaml#

title: Altera PCIe MSI controller

maintainers:
  - Matthew Gerlach <matthew.gerlach@linux.intel.com>

properties:
  compatible:
    enum:
      - altr,msi-1.0

  reg:
    items:
      - description: CSR registers
      - description: Vectors slave port region

  reg-names:
    items:
      - const: csr
      - const: vector_slave

  interrupts:
    maxItems: 1

  msi-controller: true

  num-vectors:
    description: number of vectors
    $ref: /schemas/types.yaml#/definitions/uint32
    minimum: 1
    maximum: 32

required:
  - compatible
  - reg
  - reg-names
  - interrupts
  - msi-controller
  - num-vectors

allOf:
  - $ref: /schemas/interrupt-controller/msi-controller.yaml#

unevaluatedProperties: false

examples:
  - |
    #include <dt-bindings/interrupt-controller/arm-gic.h>
    #include <dt-bindings/interrupt-controller/irq.h>
    msi@ff200000 {
        compatible = "altr,msi-1.0";
        reg = <0xff200000 0x00000010>,
              <0xff200010 0x00000080>;
        reg-names = "csr", "vector_slave";
        interrupt-parent = <&hps_0_arm_gic_0>;
        interrupts = <GIC_SPI 42 IRQ_TYPE_LEVEL_HIGH>;
        msi-controller;
        num-vectors = <32>;
    };
```

## Documentation/devicetree/bindings/pci/altr,pcie-root-port.yaml
```yaml
# SPDX-License-Identifier: (GPL-2.0 OR BSD-2-Clause)
# Copyright (C) 2015, 2019, 2024, Intel Corporation
%YAML 1.2
---
$id: http://devicetree.org/schemas/altr,pcie-root-port.yaml#
$schema: http://devicetree.org/meta-schemas/core.yaml#

title: Altera PCIe Root Port

maintainers:
  - Matthew Gerlach <matthew.gerlach@linux.intel.com>

properties:
  compatible:
    description: Each family of socfpga has its own implementation of the
      PCI controller. The altr,pcie-root-port-1.0 is used for the Cyclone5
      family of chips. The Stratix10 family of chips is supported by the
      altr,pcie-root-port-2.0. The Agilex family of chips has three,
      non-register compatible, variants of PCIe Hard IP referred to as the
      F-Tile, P-Tile, and R-Tile, depending on the specific chip instance.

    enum:
      - altr,pcie-root-port-1.0
      - altr,pcie-root-port-2.0
      - altr,pcie-root-port-3.0-f-tile
      - altr,pcie-root-port-3.0-p-tile
      - altr,pcie-root-port-3.0-r-tile

  reg:
    items:
      - description: TX slave port region
      - description: Control register access region
      - description: Hard IP region
    minItems: 2

  reg-names:
    items:
      - const: Txs
      - const: Cra
      - const: Hip
    minItems: 2

  interrupts:
    maxItems: 1

  interrupt-controller: true

  interrupt-map-mask:
    items:
      - const: 0
      - const: 0
      - const: 0
      - const: 7

  interrupt-map:
    maxItems: 4

  "#interrupt-cells":
    const: 1

  msi-parent: true

required:
  - compatible
  - reg
  - reg-names
  - interrupts
  - "#interrupt-cells"
  - interrupt-controller
  - interrupt-map
  - interrupt-map-mask

allOf:
  - $ref: /schemas/pci/pci-host-bridge.yaml#
  - if:
      properties:
        compatible:
          enum:
            - altr,pcie-root-port-1.0
    then:
      properties:
        reg:
          maxItems: 2

        reg-names:
          maxItems: 2

    else:
      properties:
        reg:
          minItems: 3

        reg-names:
          minItems: 3


unevaluatedProperties: false

examples:
  - |
    #include <dt-bindings/interrupt-controller/arm-gic.h>
    #include <dt-bindings/interrupt-controller/irq.h>
    pcie_0: pcie@c00000000 {
        compatible = "altr,pcie-root-port-1.0";
        reg = <0xc0000000 0x20000000>,
              <0xff220000 0x00004000>;
        reg-names = "Txs", "Cra";
        interrupt-parent = <&hps_0_arm_gic_0>;
        interrupts = <GIC_SPI 40 IRQ_TYPE_LEVEL_HIGH>;
        interrupt-controller;
        #interrupt-cells = <1>;
        bus-range = <0x0 0xff>;
        device_type = "pci";
        msi-parent = <&msi_to_gic_gen_0>;
        #address-cells = <3>;
        #size-cells = <2>;
        interrupt-map-mask = <0 0 0 7>;
        interrupt-map = <0 0 0 1 &pcie_0 0 0 0 1>,
                        <0 0 0 2 &pcie_0 0 0 0 2>,
                        <0 0 0 3 &pcie_0 0 0 0 3>,
                        <0 0 0 4 &pcie_0 0 0 0 4>;
        ranges = <0x82000000 0x00000000 0x00000000 0xc0000000 0x00000000 0x10000000>,
                 <0x82000000 0x00000000 0x10000000 0xd0000000 0x00000000 0x10000000>;
    };
```

## Documentation/devicetree/bindings/pci/amazon,al-alpine-v3-pcie.yaml
```yaml
# SPDX-License-Identifier: (GPL-2.0-only OR BSD-2-Clause)
%YAML 1.2
---
$id: http://devicetree.org/schemas/pci/amazon,al-alpine-v3-pcie.yaml#
$schema: http://devicetree.org/meta-schemas/core.yaml#

title: Amazon Annapurna Labs Alpine v3 PCIe Host Bridge

maintainers:
  - Jonathan Chocron <jonnyc@amazon.com>

description:
  Amazon's Annapurna Labs PCIe Host Controller is based on the Synopsys
  DesignWare PCI controller.

allOf:
  - $ref: snps,dw-pcie.yaml#

properties:
  compatible:
    enum:
      - amazon,al-alpine-v2-pcie
      - amazon,al-alpine-v3-pcie

  reg:
    items:
      - description: PCIe ECAM space
      - description: AL proprietary registers
      - description: Designware PCIe registers

  reg-names:
    items:
      - const: config
      - const: controller
      - const: dbi

  interrupts:
    maxItems: 1

unevaluatedProperties: false

required:
  - compatible
  - reg
  - reg-names

examples:
  - |
    #include <dt-bindings/interrupt-controller/arm-gic.h>

    bus {
        #address-cells = <2>;
        #size-cells = <2>;

        pcie@fb600000 {
            compatible = "amazon,al-alpine-v3-pcie";
            reg = <0x0 0xfb600000 0x0 0x00100000
                  0x0 0xfd800000 0x0 0x00010000
                  0x0 0xfd810000 0x0 0x00001000>;
            reg-names = "config", "controller", "dbi";
            bus-range = <0 255>;
            device_type = "pci";
            #address-cells = <3>;
            #size-cells = <2>;
            #interrupt-cells = <1>;
            interrupts = <GIC_SPI 49 IRQ_TYPE_LEVEL_HIGH>;
            interrupt-map-mask = <0x00 0 0 7>;
            interrupt-map = <0x0000 0 0 1 &gic GIC_SPI 41 IRQ_TYPE_LEVEL_HIGH>; /* INTa */
            ranges = <0x02000000 0x0 0xc0010000 0x0 0xc0010000 0x0 0x07ff0000>;
        };
    };
```
