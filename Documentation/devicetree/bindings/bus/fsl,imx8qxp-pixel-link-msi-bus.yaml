## Documentation/devicetree/bindings/bus/fsl,imx8qxp-pixel-link-msi-bus.yaml
```yaml
# SPDX-License-Identifier: (GPL-2.0-only OR BSD-2-Clause)
%YAML 1.2
---
$id: http://devicetree.org/schemas/bus/fsl,imx8qxp-pixel-link-msi-bus.yaml#
$schema: http://devicetree.org/meta-schemas/core.yaml#

title: Freescale i.MX8qxp Pixel Link Medium Speed Interconnect (MSI) Bus

maintainers:
  - Liu Ying <victor.liu@nxp.com>

description: |
  i.MX8qxp pixel link MSI bus is used to control settings of PHYs, I/Os
  sitting together with the PHYs.  It is not the same as the MSI bus coming
  from i.MX8 System Controller Unit (SCU) which is used to control power,
  clock and reset through the i.MX8 Distributed Slave System Controller (DSC).

  i.MX8qxp pixel link MSI bus is a simple memory-mapped bus. Two input clocks,
  that is, MSI clock and AHB clock, need to be enabled so that peripherals
  connected to the bus can be accessed. Also, the bus is part of a power
  domain. The power domain needs to be enabled before the peripherals can
  be accessed.

  Peripherals in i.MX8qm/qxp imaging, LVDS, MIPI DSI and HDMI TX subsystems,
  like I2C controller, PWM controller, MIPI DSI controller and Control and
  Status Registers (CSR) module, are accessed through the bus.

  The i.MX System Controller Firmware (SCFW) owns and uses the i.MX8qm/qxp
  pixel link MSI bus controller and does not allow SCFW user to control it.
  So, the controller's registers cannot be accessed by SCFW user. Hence,
  the interrupts generated by the controller don't make any sense from SCFW
  user's point of view.

allOf:
  - $ref: simple-pm-bus.yaml#

# We need a select here so we don't match all nodes with 'simple-pm-bus'.
select:
  properties:
    compatible:
      contains:
        enum:
          - fsl,imx8qxp-display-pixel-link-msi-bus
          - fsl,imx8qm-display-pixel-link-msi-bus
  required:
    - compatible

properties:
  compatible:
    items:
      - enum:
          - fsl,imx8qxp-display-pixel-link-msi-bus
          - fsl,imx8qm-display-pixel-link-msi-bus
      - const: simple-pm-bus

  reg:
    maxItems: 1

  interrupts:
    maxItems: 1

  clocks:
    items:
      - description: master gated clock from system
      - description: AHB clock

  clock-names:
    items:
      - const: msi
      - const: ahb

patternProperties:
  "^.*@[0-9a-f]+$":
    description: Devices attached to the bus
    type: object

    required:
      - reg

required:
  - compatible
  - reg
  - clocks
  - clock-names
  - power-domains

unevaluatedProperties: false

examples:
  - |
    #include <dt-bindings/clock/imx8-lpcg.h>
    #include <dt-bindings/firmware/imx/rsrc.h>
    bus@56200000 {
        compatible = "fsl,imx8qxp-display-pixel-link-msi-bus", "simple-pm-bus";
        reg = <0x56200000 0x20000>;
        #address-cells = <1>;
        #size-cells = <1>;
        interrupt-parent = <&dc0_irqsteer>;
        interrupts = <320>;
        ranges;
        clocks = <&dc0_disp_ctrl_link_mst0_lpcg IMX_LPCG_CLK_4>,
                 <&dc0_disp_ctrl_link_mst0_lpcg IMX_LPCG_CLK_4>;
        clock-names = "msi", "ahb";
        power-domains = <&pd IMX_SC_R_DC_0>;

        syscon@56221000 {
            compatible = "fsl,imx8qxp-mipi-lvds-csr", "syscon", "simple-mfd";
            reg = <0x56221000 0x1000>;
            clocks = <&mipi_lvds_0_di_mipi_lvds_regs_lpcg IMX_LPCG_CLK_4>;
            clock-names = "ipg";

            pxl2dpi {
                compatible = "fsl,imx8qxp-pxl2dpi";
                fsl,sc-resource = <IMX_SC_R_MIPI_0>;
                power-domains = <&pd IMX_SC_R_MIPI_0>;

                ports {
                    #address-cells = <1>;
                    #size-cells = <0>;

                    port@0 {
                        #address-cells = <1>;
                        #size-cells = <0>;
                        reg = <0>;

                        mipi_lvds_0_pxl2dpi_dc0_pixel_link0: endpoint@0 {
                            reg = <0>;
                            remote-endpoint = <&dc0_pixel_link0_mipi_lvds_0_pxl2dpi>;
                        };

                        mipi_lvds_0_pxl2dpi_dc0_pixel_link1: endpoint@1 {
                            reg = <1>;
                            remote-endpoint = <&dc0_pixel_link1_mipi_lvds_0_pxl2dpi>;
                        };
                    };

                    port@1 {
                        #address-cells = <1>;
                        #size-cells = <0>;
                        reg = <1>;

                        mipi_lvds_0_pxl2dpi_mipi_lvds_0_ldb_ch0: endpoint@0 {
                            reg = <0>;
                            remote-endpoint = <&mipi_lvds_0_ldb_ch0_mipi_lvds_0_pxl2dpi>;
                        };

                        mipi_lvds_0_pxl2dpi_mipi_lvds_0_ldb_ch1: endpoint@1 {
                            reg = <1>;
                            remote-endpoint = <&mipi_lvds_0_ldb_ch1_mipi_lvds_0_pxl2dpi>;
                        };
                    };
                };
            };

            ldb {
                #address-cells = <1>;
                #size-cells = <0>;
                compatible = "fsl,imx8qxp-ldb";
                clocks = <&clk IMX_SC_R_LVDS_0 IMX_SC_PM_CLK_MISC2>,
                         <&clk IMX_SC_R_LVDS_0 IMX_SC_PM_CLK_BYPASS>;
                clock-names = "pixel", "bypass";
                power-domains = <&pd IMX_SC_R_LVDS_0>;

                channel@0 {
                    #address-cells = <1>;
                    #size-cells = <0>;
                    reg = <0>;
                    phys = <&mipi_lvds_0_phy>;
                    phy-names = "lvds_phy";

                    port@0 {
                        reg = <0>;

                        mipi_lvds_0_ldb_ch0_mipi_lvds_0_pxl2dpi: endpoint {
                            remote-endpoint = <&mipi_lvds_0_pxl2dpi_mipi_lvds_0_ldb_ch0>;
                        };
                    };

                    port@1 {
                        reg = <1>;

                        /* ... */
                    };
                };

                channel@1 {
                    #address-cells = <1>;
                    #size-cells = <0>;
                    reg = <1>;
                    phys = <&mipi_lvds_0_phy>;
                    phy-names = "lvds_phy";

                    port@0 {
                        reg = <0>;

                        mipi_lvds_0_ldb_ch1_mipi_lvds_0_pxl2dpi: endpoint {
                            remote-endpoint = <&mipi_lvds_0_pxl2dpi_mipi_lvds_0_ldb_ch1>;
                        };
                    };

                    port@1 {
                        reg = <1>;

                        /* ... */
                    };
                };
            };
        };

        clock-controller@56223004 {
            compatible = "fsl,imx8qxp-lpcg";
            reg = <0x56223004 0x4>;
            #clock-cells = <1>;
            clocks = <&mipi_lvds_0_ipg_clk>;
            clock-indices = <IMX_LPCG_CLK_4>;
            clock-output-names = "mipi_lvds_0_di_mipi_lvds_regs_lpcg_ipg_clk";
            power-domains = <&pd IMX_SC_R_MIPI_0>;
        };

        phy@56228300 {
            compatible = "fsl,imx8qxp-mipi-dphy";
            reg = <0x56228300 0x100>;
            clocks = <&clk IMX_SC_R_LVDS_0 IMX_SC_PM_CLK_PHY>;
            clock-names = "phy_ref";
            #phy-cells = <0>;
            fsl,syscon = <&mipi_lvds_0_csr>;
            power-domains = <&pd IMX_SC_R_MIPI_0>;
        };
    };
```

## Documentation/devicetree/bindings/bus/fsl,spba-bus.yaml
```yaml
# SPDX-License-Identifier: (GPL-2.0-only OR BSD-2-Clause)
%YAML 1.2
---
$id: http://devicetree.org/schemas/bus/fsl,spba-bus.yaml#
$schema: http://devicetree.org/meta-schemas/core.yaml#

title: Shared Peripherals Bus Interface

maintainers:
  - Shawn Guo <shawnguo@kernel.org>

description: |
  A simple bus enabling access to shared peripherals.

  The "spba-bus" follows the "simple-bus" set of properties, as
  specified in the Devicetree Specification.  It is an extension of
  "simple-bus" because the SDMA controller uses this compatible flag to
  determine which peripherals are available to it and the range over which
  the SDMA can access.  There are no special clocks for the bus, because
  the SDMA controller itself has its interrupt and clock assignments.

select:
  properties:
    compatible:
      contains:
        const: fsl,spba-bus
  required:
    - compatible

properties:
  $nodename:
    pattern: "^spba-bus(@[0-9a-f]+)?$"

  compatible:
    items:
      - const: fsl,spba-bus
      - const: simple-bus

  '#address-cells':
    enum: [ 1, 2 ]

  '#size-cells':
    enum: [ 1, 2 ]

  reg:
    maxItems: 1

  ranges: true

required:
  - compatible
  - '#address-cells'
  - '#size-cells'
  - reg
  - ranges

additionalProperties:
  type: object

examples:
  - |
    spba-bus@30000000 {
        compatible = "fsl,spba-bus", "simple-bus";
        #address-cells = <1>;
        #size-cells = <1>;
        reg = <0x30000000 0x100000>;
        ranges;
    };
```

## Documentation/devicetree/bindings/bus/imx-weim.txt
```
Device tree bindings for i.MX Wireless External Interface Module (WEIM)

The term "wireless" does not imply that the WEIM is literally an interface
without wires. It simply means that this module was originally designed for
wireless and mobile applications that use low-power technology.

The actual devices are instantiated from the child nodes of a WEIM node.

Required properties:

 - compatible:		Should contain one of the following:
			  "fsl,imx1-weim"
			  "fsl,imx27-weim"
			  "fsl,imx51-weim"
			  "fsl,imx50-weim"
			  "fsl,imx6q-weim"
 - reg:			A resource specifier for the register space
			(see the example below)
 - clocks:		the clock, see the example below.
 - #address-cells:	Must be set to 2 to allow memory address translation
 - #size-cells:		Must be set to 1 to allow CS address passing
 - ranges:		Must be set up to reflect the memory layout with four
			integer values for each chip-select line in use:

			   <cs-number> 0 <physical address of mapping> <size>

Optional properties:

 - fsl,weim-cs-gpr:	For "fsl,imx50-weim" and "fsl,imx6q-weim" type of
			devices, it should be the phandle to the system General
			Purpose Register controller that contains WEIM CS GPR
			register, e.g. IOMUXC_GPR1 on i.MX6Q.  IOMUXC_GPR1[11:0]
			should be set up as one of the following 4 possible
			values depending on the CS space configuration.

			IOMUXC_GPR1[11:0]    CS0    CS1    CS2    CS3
			---------------------------------------------
				05	    128M     0M     0M     0M
				033          64M    64M     0M     0M
				0113         64M    32M    32M     0M
				01111        32M    32M    32M    32M

			In case that the property is absent, the reset value or
			what bootloader sets up in IOMUXC_GPR1[11:0] will be
			used.

Timing property for child nodes. It is mandatory, not optional.

 - fsl,weim-cs-timing:	The timing array, contains timing values for the
			child node. We get the CS indexes from the address
			ranges in the child node's "reg" property.
			The number of registers depends on the selected chip:
			For i.MX1, i.MX21 ("fsl,imx1-weim") there are two
			registers: CSxU, CSxL.
			For i.MX25, i.MX27, i.MX31 and i.MX35 ("fsl,imx27-weim")
			there are three registers: CSCRxU, CSCRxL, CSCRxA.
			For i.MX50, i.MX53 ("fsl,imx50-weim"),
			i.MX51 ("fsl,imx51-weim") and i.MX6Q ("fsl,imx6q-weim")
			there are six registers: CSxGCR1, CSxGCR2, CSxRCR1,
			CSxRCR2, CSxWCR1, CSxWCR2.

Example for an imx6q-sabreauto board, the NOR flash connected to the WEIM:

	weim: weim@21b8000 {
		compatible = "fsl,imx6q-weim";
		reg = <0x021b8000 0x4000>;
		clocks = <&clks 196>;
		#address-cells = <2>;
		#size-cells = <1>;
		ranges = <0 0 0x08000000 0x08000000>;
		fsl,weim-cs-gpr = <&gpr>;

		nor@0,0 {
			compatible = "cfi-flash";
			reg = <0 0 0x02000000>;
			#address-cells = <1>;
			#size-cells = <1>;
			bank-width = <2>;
			fsl,weim-cs-timing = <0x00620081 0x00000001 0x1c022000
					0x0000c000 0x1404a38e 0x00000000>;
		};
	};

Example for an imx6q-based board, a multi-chipselect device connected to WEIM:

In this case, both chip select 0 and 1 will be configured with the same timing
array values.

	weim: weim@21b8000 {
		compatible = "fsl,imx6q-weim";
		reg = <0x021b8000 0x4000>;
		clocks = <&clks 196>;
		#address-cells = <2>;
		#size-cells = <1>;
		ranges = <0 0 0x08000000 0x02000000
			  1 0 0x0a000000 0x02000000
			  2 0 0x0c000000 0x02000000
			  3 0 0x0e000000 0x02000000>;
		fsl,weim-cs-gpr = <&gpr>;

		acme@0 {
			compatible = "acme,whatever";
			reg = <0 0 0x100>, <0 0x400000 0x800>,
				<1 0x400000 0x800>;
			fsl,weim-cs-timing = <0x024400b1 0x00001010 0x20081100
				0x00000000 0xa0000240 0x00000000>;
		};
	};
```
