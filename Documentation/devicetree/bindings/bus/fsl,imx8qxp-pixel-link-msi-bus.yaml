## Documentation/devicetree/bindings/bus/renesas,bsc.yaml
```yaml
%YAML 1.2
---
$id: http://devicetree.org/schemas/bus/renesas,bsc.yaml#
$schema: http://devicetree.org/meta-schemas/core.yaml#

title: Renesas Bus State Controller (BSC)

maintainers:
  - Geert Uytterhoeven <geert+renesas@glider.be>

description: |
  The Renesas Bus State Controller (BSC, sometimes called "LBSC within Bus
  Bridge", or "External Bus Interface") can be found in several Renesas ARM
  SoCs.  It provides an external bus for connecting multiple external
  devices to the SoC, driving several chip select lines, for e.g. NOR
  FLASH, Ethernet and USB.

  While the BSC is a fairly simple memory-mapped bus, it may be part of a
  PM domain, and may have a gateable functional clock.  Before a device
  connected to the BSC can be accessed, the PM domain containing the BSC
  must be powered on, and the functional clock driving the BSC must be
  enabled.

  The bindings for the BSC extend the bindings for "simple-pm-bus".

allOf:
  - $ref: simple-pm-bus.yaml#

properties:
  compatible:
    items:
      - enum:
          - renesas,bsc-r8a73a4  # R-Mobile APE6 (r8a73a4)
          - renesas,bsc-sh73a0   # SH-Mobile AG5 (sh73a0)
      - const: renesas,bsc
      - {} # simple-pm-bus, but not listed here to avoid false select

  reg:
    maxItems: 1

  interrupts:
    maxItems: 1

required:
  - reg

examples:
  - |
    #include <dt-bindings/interrupt-controller/irq.h>

    bsc: bus@fec10000 {
        compatible = "renesas,bsc-sh73a0", "renesas,bsc", "simple-pm-bus";
        #address-cells = <1>;
        #size-cells = <1>;
        ranges = <0 0 0x20000000>;
        reg = <0xfec10000 0x400>;
        interrupts = <0 39 IRQ_TYPE_LEVEL_HIGH>;
        clocks = <&zb_clk>;
        power-domains = <&pd_a4s>;
    };
```

## Documentation/devicetree/bindings/bus/simple-pm-bus.txt
```
Simple Power-Managed Bus
========================

A Simple Power-Managed Bus is a transparent bus that doesn't need a real
driver, as it's typically initialized by the boot loader.

However, its bus controller is part of a PM domain, or under the control of a
functional clock.  Hence, the bus controller's PM domain and/or clock must be
enabled for child devices connected to the bus (either on-SoC or externally)
to function.

While "simple-pm-bus" follows the "simple-bus" set of properties, as specified
in ePAPR, it is not an extension of "simple-bus".


Required properties:
  - compatible: Must contain at least "simple-pm-bus".
		Must not contain "simple-bus".
		It's recommended to let this be preceded by one or more
		vendor-specific compatible values.
  - #address-cells, #size-cells, ranges: Must describe the mapping between
		parent address and child address spaces.

Optional platform-specific properties for clock or PM domain control (at least
one of them is required):
  - clocks: Must contain a reference to the functional clock(s),
  - power-domains: Must contain a reference to the PM domain.
Please refer to the binding documentation for the clock and/or PM domain
providers for more details.


Example:

	bsc: bus@fec10000 {
		compatible = "renesas,bsc-sh73a0", "renesas,bsc",
			     "simple-pm-bus";
		#address-cells = <1>;
		#size-cells = <1>;
		ranges = <0 0 0x20000000>;
		reg = <0xfec10000 0x400>;
		interrupts = <0 39 IRQ_TYPE_LEVEL_HIGH>;
		clocks = <&zb_clk>;
		power-domains = <&pd_a4s>;
	};
```

## Documentation/devicetree/bindings/bus/simple-pm-bus.yaml
```yaml
# SPDX-License-Identifier: GPL-2.0
%YAML 1.2
---
$id: http://devicetree.org/schemas/bus/simple-pm-bus.yaml#
$schema: http://devicetree.org/meta-schemas/core.yaml#

title: Simple Power-Managed Bus

maintainers:
  - Geert Uytterhoeven <geert+renesas@glider.be>

description: |
  A Simple Power-Managed Bus is a transparent bus that doesn't need a real
  driver, as it's typically initialized by the boot loader.

  However, its bus controller is part of a PM domain, or under the control
  of a functional clock.  Hence, the bus controller's PM domain and/or
  clock must be enabled for child devices connected to the bus (either
  on-SoC or externally) to function.

  While "simple-pm-bus" follows the "simple-bus" set of properties, as
  specified in the Devicetree Specification, it is not an extension of
  "simple-bus".

properties:
  $nodename:
    pattern: "^bus(@[0-9a-f]+)?$"

  compatible:
    contains:
      const: simple-pm-bus
    description:
      Shall contain "simple-pm-bus" in addition to a optional bus-specific
      compatible strings defined in individual pm-bus bindings.

  '#address-cells':
    enum: [ 1, 2 ]

  '#size-cells':
    enum: [ 1, 2 ]

  ranges: true

  clocks: true
    # Functional clocks
    # Required if power-domains is absent, optional otherwise

  power-domains:
    # Required if clocks is absent, optional otherwise
    minItems: 1

required:
  - compatible
  - '#address-cells'
  - '#size-cells'
  - ranges

anyOf:
  - required:
      - clocks
  - required:
      - power-domains

additionalProperties: true

examples:
  - |
    #include <dt-bindings/clock/qcom,gcc-msm8996.h>
    #include <dt-bindings/interrupt-controller/irq.h>

    bus {
        power-domains = <&gcc AGGRE0_NOC_GDSC>;
        compatible = "simple-pm-bus";
        #address-cells = <1>;
        #size-cells = <1>;
        ranges;
    };
```

## Documentation/devicetree/bindings/bus/socionext,uniphier-system-bus.yaml
```yaml
# SPDX-License-Identifier: GPL-2.0-only OR BSD-2-Clause
%YAML 1.2
---
$id: http://devicetree.org/schemas/bus/socionext,uniphier-system-bus.yaml#
$schema: http://devicetree.org/meta-schemas/core.yaml#

title: UniPhier System Bus

description: |
  The UniPhier System Bus is an external bus that connects on-board devices to
  the UniPhier SoC. It is a simple (semi-)parallel bus with address, data, and
  some control signals. It supports up to 8 banks (chip selects).

  Before any access to the bus, the bus controller must be configured; the bus
  controller registers provide the control for the translation from the offset
  within each bank to the CPU-viewed address. The needed setup includes the
  base address, the size of each bank. Optionally, some timing parameters can
  be optimized for faster bus access.

maintainers:
  - Masahiro Yamada <yamada.masahiro@socionext.com>

properties:
  compatible:
    const: socionext,uniphier-system-bus

  reg:
    maxItems: 1

  "#address-cells":
    description: |
      The first cell is the bank number (chip select).
      The second cell is the address offset within the bank.
    const: 2

  "#size-cells":
    const: 1

  ranges:
    description: |
      Provide address translation from the System Bus to the parent bus.

      Note:
      The address region(s) that can be assigned for the System Bus is
      implementation defined. Some SoCs can use 0x00000000-0x0fffffff and
      0x40000000-0x4fffffff, while other SoCs only 0x40000000-0x4fffffff.
      There might be additional limitations depending on SoCs and the boot mode.
      The address translation is arbitrary as long as the banks are assigned in
      the supported address space with the required alignment and they do not
      overlap one another.

      For example, it is possible to map:
        bank 0 to 0x42000000-0x43ffffff, bank 5 to 0x46000000-0x46ffffff
      It is also possible to map:
        bank 0 to 0x48000000-0x49ffffff, bank 5 to 0x44000000-0x44ffffff
      There is no reason to stick to a particular translation mapping, but the
      "ranges" property should provide a "reasonable" default that is known to
      work. The software should initialize the bus controller according to it.

patternProperties:
  "^.*@[1-5],[1-9a-f][0-9a-f]+$":
    description: Devices attached to chip selects
    type: object

required:
  - compatible
  - reg
  - "#address-cells"
  - "#size-cells"
  - ranges

additionalProperties: false

examples:
  - |
    // In this example,
    // - the Ethernet device is connected at the offset 0x01f00000 of CS1 and
    //   mapped to 0x43f00000 of the parent bus.
    // - the UART device is connected at the offset 0x00200000 of CS5 and
    //   mapped to 0x46200000 of the parent bus.

    system-bus@58c00000 {
        compatible = "socionext,uniphier-system-bus";
        reg = <0x58c00000 0x400>;
        #address-cells = <2>;
        #size-cells = <1>;
        ranges = <1 0x00000000 0x42000000 0x02000000>,
                 <5 0x00000000 0x46000000 0x01000000>;

        ethernet@1,1f00000 {
            compatible = "smsc,lan9115";
            reg = <1 0x01f00000 0x1000>;
            interrupts = <0 48 4>;
            phy-mode = "mii";
        };

        serial@5,200000 {
            compatible = "ns16550a";
            reg = <5 0x00200000 0x20>;
            interrupts = <0 49 4>;
            clock-frequency = <12288000>;
        };
    };
```

## Documentation/devicetree/bindings/bus/st,stm32-etzpc.yaml
```yaml
# SPDX-License-Identifier: (GPL-2.0-only OR BSD-2-Clause)
%YAML 1.2
---
$id: http://devicetree.org/schemas/bus/st,stm32-etzpc.yaml#
$schema: http://devicetree.org/meta-schemas/core.yaml#

title: STM32 Extended TrustZone protection controller

description: |
  The ETZPC configures TrustZone security in a SoC having bus masters and
  devices with programmable-security attributes (securable resources).

maintainers:
  - Gatien Chevallier <gatien.chevallier@foss.st.com>

select:
  properties:
    compatible:
      contains:
        const: st,stm32-etzpc
  required:
    - compatible

properties:
  compatible:
    items:
      - const: st,stm32-etzpc
      - const: simple-bus

  reg:
    maxItems: 1

  "#address-cells":
    const: 1

  "#size-cells":
    const: 1

  ranges: true

  "#access-controller-cells":
    const: 1
    description:
      Contains the firewall ID associated to the peripheral.

patternProperties:
  "^.*@[0-9a-f]+$":
    description: Peripherals
    type: object

    additionalProperties: true

    required:
      - access-controllers

required:
  - compatible
  - reg
  - "#address-cells"
  - "#size-cells"
  - "#access-controller-cells"
  - ranges

additionalProperties: false

examples:
  - |
    // In this example, the usart2 device refers to rifsc as its access
    // controller.
    // Access rights are verified before creating devices.

    #include <dt-bindings/interrupt-controller/arm-gic.h>
    #include <dt-bindings/clock/stm32mp13-clks.h>
    #include <dt-bindings/reset/stm32mp13-resets.h>

    etzpc: bus@5c007000 {
        compatible = "st,stm32-etzpc", "simple-bus";
        reg = <0x5c007000 0x400>;
        #address-cells = <1>;
        #size-cells = <1>;
        #access-controller-cells = <1>;
        ranges;

        usart2: serial@4c001000 {
            compatible = "st,stm32h7-uart";
            reg = <0x4c001000 0x400>;
            interrupts-extended = <&exti 27 IRQ_TYPE_LEVEL_HIGH>;
            clocks = <&rcc USART2_K>;
            resets = <&rcc USART2_R>;
            wakeup-source;
            dmas = <&dmamux1 43 0x400 0x5>,
                    <&dmamux1 44 0x400 0x1>;
            dma-names = "rx", "tx";
            access-controllers = <&etzpc 17>;
        };
    };
```

## Documentation/devicetree/bindings/bus/st,stm32mp131-dbg-bus.yaml
```yaml
# SPDX-License-Identifier: (GPL-2.0-only OR BSD-2-Clause)
%YAML 1.2
---
$id: http://devicetree.org/schemas/bus/st,stm32mp131-dbg-bus.yaml#
$schema: http://devicetree.org/meta-schemas/core.yaml#

title: STM32 Coresight bus

maintainers:
  - Gatien Chevallier <gatien.chevallier@foss.st.com>

description:
  The STM32 debug bus is in charge of checking the debug configuration
  of the platform before probing the peripheral drivers that rely on the debug
  domain.

properties:
  compatible:
    items:
      - enum:
          - st,stm32mp131-dbg-bus
          - st,stm32mp151-dbg-bus

  "#address-cells":
    const: 1

  "#size-cells":
    const: 1

  ranges:
    minItems: 1
    maxItems: 2

  "#access-controller-cells":
    const: 1
    description:
      Contains the debug profile necessary to access the peripheral.

patternProperties:
  "@[0-9a-f]+$":
    description: Debug related peripherals
    type: object

    additionalProperties: true

    required:
      - access-controllers

required:
  - "#access-controller-cells"
  - "#address-cells"
  - "#size-cells"
  - compatible
  - ranges

additionalProperties: false

examples:
  - |
    #include <dt-bindings/clock/stm32mp1-clks.h>

    dbg_bus: bus@50080000 {
      compatible = "st,stm32mp131-dbg-bus";
      #address-cells = <1>;
      #size-cells = <1>;
      #access-controller-cells = <1>;
      ranges = <0x50080000 0x50080000 0x3f80000>;

      cti@50094000 {
        compatible = "arm,coresight-cti", "arm,primecell";
        reg = <0x50094000 0x1000>;
        clocks = <&rcc CK_DBG>;
        clock-names = "apb_pclk";
        access-controllers = <&dbg_bus 0>;
      };
    };
```

## Documentation/devicetree/bindings/bus/st,stm32mp25-rifsc.yaml
```yaml
# SPDX-License-Identifier: (GPL-2.0-only OR BSD-2-Clause)
%YAML 1.2
---
$id: http://devicetree.org/schemas/bus/st,stm32mp25-rifsc.yaml#
$schema: http://devicetree.org/meta-schemas/core.yaml#

title: STM32 Resource isolation framework security controller

maintainers:
  - Gatien Chevallier <gatien.chevallier@foss.st.com>

description: |
  Resource isolation framework (RIF) is a comprehensive set of hardware blocks
  designed to enforce and manage isolation of STM32 hardware resources like
  memory and peripherals.

  The RIFSC (RIF security controller) is composed of three sets of registers,
  each managing a specific set of hardware resources:
    - RISC registers associated with RISUP logic (resource isolation device unit
      for peripherals), assign all non-RIF aware peripherals to zero, one or
      any security domains (secure, privilege, compartment).
    - RIMC registers: associated with RIMU logic (resource isolation master
      unit), assign all non RIF-aware bus master to one security domain by
      setting secure, privileged and compartment information on the system bus.
      Alternatively, the RISUP logic controlling the device port access to a
      peripheral can assign target bus attributes to this peripheral master port
      (supported attribute: CID).
    - RISC registers associated with RISAL logic (resource isolation device unit
      for address space - Lite version), assign address space subregions to one
      security domains (secure, privilege, compartment).

select:
  properties:
    compatible:
      contains:
        const: st,stm32mp25-rifsc
  required:
    - compatible

properties:
  compatible:
    items:
      - const: st,stm32mp25-rifsc
      - const: simple-bus

  reg:
    maxItems: 1

  "#address-cells":
    const: 1

  "#size-cells":
    const: 1

  ranges: true

  "#access-controller-cells":
    const: 1
    description:
      Contains the firewall ID associated to the peripheral.

patternProperties:
  "^.*@[0-9a-f]+$":
    description: Peripherals
    type: object

    additionalProperties: true

    required:
      - access-controllers

required:
  - compatible
  - reg
  - "#address-cells"
  - "#size-cells"
  - "#access-controller-cells"
  - ranges

additionalProperties: false

examples:
  - |
    // In this example, the usart2 device refers to rifsc as its domain
    // controller.
    // Access rights are verified before creating devices.

    #include <dt-bindings/interrupt-controller/arm-gic.h>

    rifsc: bus@42080000 {
        compatible = "st,stm32mp25-rifsc", "simple-bus";
        reg = <0x42080000 0x1000>;
        #address-cells = <1>;
        #size-cells = <1>;
        #access-controller-cells = <1>;
        ranges;

        usart2: serial@400e0000 {
              compatible = "st,stm32h7-uart";
              reg = <0x400e0000 0x400>;
              interrupts = <GIC_SPI 115 IRQ_TYPE_LEVEL_HIGH>;
              clocks = <&ck_flexgen_08>;
              access-controllers = <&rifsc 32>;
        };
    };
```
