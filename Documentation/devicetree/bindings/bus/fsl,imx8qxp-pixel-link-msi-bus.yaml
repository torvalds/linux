## Documentation/devicetree/bindings/bus/mvebu-mbus.txt
```
* Marvell MBus

Required properties:

- compatible:	 Should be set to one of the following:
		 marvell,armada370-mbus
		 marvell,armadaxp-mbus
		 marvell,armada370-mbus
		 marvell,armadaxp-mbus
		 marvell,kirkwood-mbus
		 marvell,dove-mbus
		 marvell,orion5x-88f5281-mbus
		 marvell,orion5x-88f5182-mbus
		 marvell,orion5x-88f5181-mbus
		 marvell,orion5x-88f6183-mbus
		 marvell,mv78xx0-mbus

- address-cells: Must be '2'. The first cell for the MBus ID encoding,
                 the second cell for the address offset within the window.

- size-cells:    Must be '1'.

- ranges:        Must be set up to provide a proper translation for each child.
	         See the examples below.

- controller:    Contains a single phandle referring to the MBus controller
                 node. This allows to specify the node that contains the
		 registers that control the MBus, which is typically contained
		 within the internal register window (see below).

Optional properties:

- pcie-mem-aperture:	This optional property contains the aperture for
			the memory region of the PCIe driver.
			If it's defined, it must encode the base address and
			size for the address decoding windows allocated for
			the PCIe memory region.

- pcie-io-aperture:	Just as explained for the above property, this
			optional property contains the aperture for the
			I/O region of the PCIe driver.

* Marvell MBus controller

Required properties:

- compatible:	Should be set to "marvell,mbus-controller".

- reg:          Device's register space.
		Two or three entries are expected (see the examples below):
		the first one controls the devices decoding window,
		the second one controls the SDRAM decoding window and
		the third controls the MBus bridge (only with the
		marvell,armada370-mbus and marvell,armadaxp-mbus
		compatible strings)

Example:

	soc {
		compatible = "marvell,armada370-mbus", "simple-bus";
		#address-cells = <2>;
		#size-cells = <1>;
		controller = <&mbusc>;
		pcie-mem-aperture = <0xe0000000 0x8000000>;
		pcie-io-aperture  = <0xe8000000 0x100000>;

		internal-regs {
			compatible = "simple-bus";

			mbusc: mbus-controller@20000 {
				compatible = "marvell,mbus-controller";
				reg = <0x20000 0x100>, <0x20180 0x20>, <0x20250 0x8>;
			};

			/* more children ...*/
		};
	};

** MBus address decoding window specification

The MBus children address space is comprised of two cells: the first one for
the window ID and the second one for the offset within the window.
In order to allow to describe valid and non-valid window entries, the
following encoding is used:

  0xSIAA0000 0x00oooooo

Where:

  S = 0x0 for a MBus valid window
  S = 0xf for a non-valid window (see below)

If S = 0x0, then:

   I = 4-bit window target ID
  AA = windpw attribute

If S = 0xf, then:

   I = don't care
   AA = 1 for internal register

Following the above encoding, for each ranges entry for a MBus valid window
(S = 0x0), an address decoding window is allocated. On the other side,
entries for translation that do not correspond to valid windows (S = 0xf)
are skipped.

	soc {
		compatible = "marvell,armada370-mbus", "simple-bus";
		#address-cells = <2>;
		#size-cells = <1>;
		controller = <&mbusc>;

		ranges = <0xf0010000 0 0 0xd0000000 0x100000
			  0x01e00000 0 0 0xfff00000 0x100000>;

		bootrom {
			compatible = "marvell,bootrom";
			reg = <0x01e00000 0 0x100000>;
		};

		/* other children */
		...

		internal-regs {
			compatible = "simple-bus";
			ranges = <0 0xf0010000 0 0x100000>;

			mbusc: mbus-controller@20000 {
				compatible = "marvell,mbus-controller";
				reg = <0x20000 0x100>, <0x20180 0x20>, <0x20250 0x8>;
			};

			/* more children ...*/
		};
	};

In the shown example, the translation entry in the 'ranges' property is what
makes the MBus driver create a static decoding window for the corresponding
given child device. Note that the binding does not require child nodes to be
present. Of course, child nodes are needed to probe the devices.

Since each window is identified by its target ID and attribute ID there's
a special macro that can be use to simplify the translation entries:

#define MBUS_ID(target,attributes) (((target) << 24) | ((attributes) << 16))

Using this macro, the above example would be:

	soc {
		compatible = "marvell,armada370-mbus", "simple-bus";
		#address-cells = <2>;
		#size-cells = <1>;
		controller = <&mbusc>;

		ranges = < MBUS_ID(0xf0, 0x01) 0 0 0xd0000000 0x100000
			   MBUS_ID(0x01, 0xe0) 0 0 0xfff00000 0x100000>;

		bootrom {
			compatible = "marvell,bootrom";
			reg = <MBUS_ID(0x01, 0xe0) 0 0x100000>;
		};

		/* other children */
		...

		internal-regs {
			compatible = "simple-bus";
			#address-cells = <1>;
			#size-cells = <1>;
			ranges = <0 MBUS_ID(0xf0, 0x01) 0 0x100000>;

			mbusc: mbus-controller@20000 {
				compatible = "marvell,mbus-controller";
				reg = <0x20000 0x100>, <0x20180 0x20>, <0x20250 0x8>;
			};

			/* other children */
			...
		};
	};


** About the window base address

Remember the MBus controller allows a great deal of flexibility for choosing
the decoding window base address. When planning the device tree layout it's
possible to choose any address as the base address, provided of course there's
a region large enough available, and with the required alignment.

Yet in other words: there's nothing preventing us from setting a base address
of 0xf0000000, or 0xd0000000 for the NOR device shown above, if such region is
unused.

** Window allocation policy

The mbus-node ranges property defines a set of mbus windows that are expected
to be set by the operating system and that are guaranteed to be free of overlaps
with one another or with the system memory ranges.

Each entry in the property refers to exactly one window. If the operating system
chooses to use a different set of mbus windows, it must ensure that any address
translations performed from downstream devices are adapted accordingly.

The operating system may insert additional mbus windows that do not conflict
with the ones listed in the ranges, e.g. for mapping PCIe devices.
As a special case, the internal register window must be set up by the boot
loader at the address listed in the ranges property, since access to that region
is needed to set up the other windows.

** Example

See the example below, where a more complete device tree is shown:

	soc {
		compatible = "marvell,armadaxp-mbus", "simple-bus";
		controller = <&mbusc>;

		ranges = <MBUS_ID(0xf0, 0x01) 0 0 0xd0000000 0x100000   /* internal-regs */
			  MBUS_ID(0x01, 0x1d) 0 0 0xfff00000 0x100000
			  MBUS_ID(0x01, 0x2f) 0 0 0xf0000000 0x8000000>;

		bootrom {
			compatible = "marvell,bootrom";
			reg = <MBUS_ID(0x01, 0x1d) 0 0x100000>;
		};

		devbus-bootcs {
			status = "okay";
			ranges = <0 MBUS_ID(0x01, 0x2f) 0 0x8000000>;

			/* NOR */
			nor {
				compatible = "cfi-flash";
				reg = <0 0x8000000>;
				bank-width = <2>;
			};
		};

		pcie-controller {
			compatible = "marvell,armada-xp-pcie";
			status = "okay";
			device_type = "pci";

			#address-cells = <3>;
			#size-cells = <2>;

			ranges =
			       <0x82000000 0 0x40000 MBUS_ID(0xf0, 0x01) 0x40000 0 0x00002000   /* Port 0.0 registers */
				0x82000000 0 0x42000 MBUS_ID(0xf0, 0x01) 0x42000 0 0x00002000   /* Port 2.0 registers */
				0x82000000 0 0x44000 MBUS_ID(0xf0, 0x01) 0x44000 0 0x00002000   /* Port 0.1 registers */
				0x82000000 0 0x48000 MBUS_ID(0xf0, 0x01) 0x48000 0 0x00002000   /* Port 0.2 registers */
				0x82000000 0 0x4c000 MBUS_ID(0xf0, 0x01) 0x4c000 0 0x00002000   /* Port 0.3 registers */
				0x82000800 0 0xe0000000 MBUS_ID(0x04, 0xe8) 0xe0000000 0 0x08000000 /* Port 0.0 MEM */
				0x81000800 0 0          MBUS_ID(0x04, 0xe0) 0xe8000000 0 0x00100000 /* Port 0.0 IO */>;


			pcie@1,0 {
				/* Port 0, Lane 0 */
				status = "okay";
			};
		};

		internal-regs {
			compatible = "simple-bus";
			#address-cells = <1>;
			#size-cells = <1>;
			ranges = <0 MBUS_ID(0xf0, 0x01) 0 0x100000>;

			mbusc: mbus-controller@20000 {
				reg = <0x20000 0x100>, <0x20180 0x20>, <0x20250 0x8>;
			};

			interrupt-controller@20000 {
			      reg = <0x20a00 0x2d0>, <0x21070 0x58>;
			};
		};
	};
```

## Documentation/devicetree/bindings/bus/nvidia,tegra20-gmi.txt
```
Device tree bindings for NVIDIA Tegra Generic Memory Interface bus

The Generic Memory Interface bus enables memory transfers between internal and
external memory. Can be used to attach various high speed devices such as
synchronous/asynchronous NOR, FPGA, UARTS and more.

The actual devices are instantiated from the child nodes of a GMI node.

Required properties:
 - compatible : Should contain one of the following:
        For Tegra20 must contain "nvidia,tegra20-gmi".
        For Tegra30 must contain "nvidia,tegra30-gmi".
 - reg: Should contain GMI controller registers location and length.
 - clocks: Must contain an entry for each entry in clock-names.
 - clock-names: Must include the following entries: "gmi"
 - resets : Must contain an entry for each entry in reset-names.
 - reset-names : Must include the following entries: "gmi"
 - #address-cells: The number of cells used to represent physical base
   addresses in the GMI address space. Should be 2.
 - #size-cells: The number of cells used to represent the size of an address
   range in the GMI address space. Should be 1.
 - ranges: Must be set up to reflect the memory layout with three integer values
   for each chip-select line in use (only one entry is supported, see below
   comments):
   <cs-number> <offset> <physical address of mapping> <size>

Note that the GMI controller does not have any internal chip-select address
decoding, because of that chip-selects either need to be managed via software
or by employing external chip-select decoding logic.

If external chip-select logic is used to support multiple devices it is assumed
that the devices use the same timing and so are probably the same type. It also
assumes that they can fit in the 256MB address range. In this case only one
child device is supported which represents the active chip-select line, see
examples for more insight.

The chip-select number is decoded from the child nodes second address cell of
'ranges' property, if 'ranges' property is not present or empty chip-select will
then be decoded from the first cell of the 'reg' property.

Optional child cs node properties:

 - nvidia,snor-data-width-32bit: Use 32bit data-bus, default is 16bit.
 - nvidia,snor-mux-mode: Enable address/data MUX mode.
 - nvidia,snor-rdy-active-before-data: Assert RDY signal one cycle before data.
   If omitted it will be asserted with data.
 - nvidia,snor-rdy-active-high: RDY signal is active high
 - nvidia,snor-adv-active-high: ADV signal is active high
 - nvidia,snor-oe-active-high: WE/OE signal is active high
 - nvidia,snor-cs-active-high: CS signal is active high

  Note that there is some special handling for the timing values.
  From Tegra TRM:
  Programming 0 means 1 clock cycle: actual cycle = programmed cycle + 1

 - nvidia,snor-muxed-width: Number of cycles MUX address/data asserted on the
   bus. Valid values are 0-15, default is 1
 - nvidia,snor-hold-width: Number of cycles CE stays asserted after the
   de-assertion of WR_N (in case of SLAVE/MASTER Request) or OE_N
   (in case of MASTER Request). Valid values are 0-15, default is 1
 - nvidia,snor-adv-width: Number of cycles during which ADV stays asserted.
   Valid values are 0-15, default is 1.
 - nvidia,snor-ce-width: Number of cycles before CE is asserted.
   Valid values are 0-15, default is 4
 - nvidia,snor-we-width: Number of cycles during which WE stays asserted.
   Valid values are 0-15, default is 1
 - nvidia,snor-oe-width: Number of cycles during which OE stays asserted.
   Valid values are 0-255, default is 1
 - nvidia,snor-wait-width: Number of cycles before READY is asserted.
   Valid values are 0-255, default is 3

Example with two SJA1000 CAN controllers connected to the GMI bus. We wrap the
controllers with a simple-bus node since they are all connected to the same
chip-select (CS4), in this example external address decoding is provided:

gmi@70090000 {
	compatible = "nvidia,tegra20-gmi";
	reg = <0x70009000 0x1000>;
	#address-cells = <2>;
	#size-cells = <1>;
	clocks = <&tegra_car TEGRA20_CLK_NOR>;
	clock-names = "gmi";
	resets = <&tegra_car 42>;
	reset-names = "gmi";
	ranges = <4 0 0xd0000000 0xfffffff>;


	bus@4,0 {
		compatible = "simple-bus";
		#address-cells = <1>;
		#size-cells = <1>;
		ranges = <0 4 0 0x40100>;

		nvidia,snor-mux-mode;
		nvidia,snor-adv-active-high;

		can@0 {
			reg = <0 0x100>;
			...
		};

		can@40000 {
			reg = <0x40000 0x100>;
			...
		};
	};
};

Example with one SJA1000 CAN controller connected to the GMI bus
on CS4:

gmi@70090000 {
	compatible = "nvidia,tegra20-gmi";
	reg = <0x70009000 0x1000>;
	#address-cells = <2>;
	#size-cells = <1>;
	clocks = <&tegra_car TEGRA20_CLK_NOR>;
	clock-names = "gmi";
	resets = <&tegra_car 42>;
	reset-names = "gmi";
	ranges = <4 0 0xd0000000 0xfffffff>;


	can@4,0 {
		reg = <4 0 0x100>;
		nvidia,snor-mux-mode;
		nvidia,snor-adv-active-high;
		...
	};
};
```

## Documentation/devicetree/bindings/bus/nvidia,tegra210-aconnect.txt
```
NVIDIA Tegra ACONNECT Bus

The Tegra ACONNECT bus is an AXI switch which is used to connnect various
components inside the Audio Processing Engine (APE). All CPU accesses to
the APE subsystem go through the ACONNECT via an APB to AXI wrapper.

Required properties:
- compatible: Must be "nvidia,tegra210-aconnect".
- clocks: Must contain the entries for the APE clock (TEGRA210_CLK_APE),
  and APE interface clock (TEGRA210_CLK_APB2APE).
- clock-names: Must contain the names "ape" and "apb2ape" for the corresponding
  'clocks' entries.
- power-domains: Must contain a phandle that points to the audio powergate
  (namely 'aud') for Tegra210.
- #address-cells: The number of cells used to represent physical base addresses
  in the aconnect address space. Should be 1.
- #size-cells: The number of cells used to represent the size of an address
  range in the aconnect address space. Should be 1.
- ranges: Mapping of the aconnect address space to the CPU address space.

All devices accessed via the ACONNNECT are described by child-nodes.

Example:

	aconnect@702c0000 {
		compatible = "nvidia,tegra210-aconnect";
		clocks = <&tegra_car TEGRA210_CLK_APE>,
			 <&tegra_car TEGRA210_CLK_APB2APE>;
		clock-names = "ape", "apb2ape";
		power-domains = <&pd_audio>;

		#address-cells = <1>;
		#size-cells = <1>;
		ranges = <0x702c0000 0x0 0x702c0000 0x00040000>;

		status = "disabled";

		child1 {
			...
		};

		child2 {
			...
		};
	};
```
