## Documentation/devicetree/bindings/bus/ti-sysc.yaml
```yaml
# SPDX-License-Identifier: (GPL-2.0-only OR BSD-2-Clause)
%YAML 1.2
---
$id: http://devicetree.org/schemas/bus/ti-sysc.yaml#
$schema: http://devicetree.org/meta-schemas/core.yaml#

title: Texas Instruments interconnect target module binding

maintainers:
  - Tony Lindgren <tony@atomide.com>

description:
  Texas Instruments SoCs can have a generic interconnect target module
  for devices connected to various interconnects such as L3 interconnect
  using Arteris NoC, and L4 interconnect using Sonics s3220. This module
  is mostly used for interaction between module and Power, Reset and Clock
  Manager PRCM. It participates in the OCP Disconnect Protocol, but other
  than that it is mostly independent of the interconnect.

  Each interconnect target module can have one or more devices connected to
  it. There is a set of control registers for managing the interconnect target
  module clocks, idle modes and interconnect level resets.

  The interconnect target module control registers are sprinkled into the
  unused register address space of the first child device IP block managed by
  the interconnect target module. Typically the register names are REVISION,
  SYSCONFIG and SYSSTATUS.

properties:
  $nodename:
    pattern: "^target-module(@[0-9a-f]+)?$"

  compatible:
    oneOf:
      - items:
          - enum:
              - ti,sysc-omap2
              - ti,sysc-omap4
              - ti,sysc-omap4-simple
              - ti,sysc-omap2-timer
              - ti,sysc-omap4-timer
              - ti,sysc-omap3430-sr
              - ti,sysc-omap3630-sr
              - ti,sysc-omap4-sr
              - ti,sysc-omap3-sham
              - ti,sysc-omap-aes
              - ti,sysc-mcasp
              - ti,sysc-dra7-mcasp
              - ti,sysc-usb-host-fs
              - ti,sysc-dra7-mcan
              - ti,sysc-pruss
          - const: ti,sysc
      - items:
          - const: ti,sysc

  reg:
    description:
      Interconnect target module control registers consisting of
      REVISION, SYSCONFIG and SYSSTATUS registers as defined in the
      Technical Reference Manual for the SoC.
    minItems: 1
    maxItems: 3

  reg-names:
    description:
      Interconnect target module control register names consisting
      of "rev", "sysc" and "syss".
    oneOf:
      - minItems: 1
        items:
          - const: rev
          - const: sysc
          - const: syss
      - items:
          - const: rev
          - const: syss
      - enum: [ sysc, syss ]

  power-domains:
    description: Target module power domain if available.
    maxItems: 1

  clocks:
    description:
      Target module clocks consisting of one functional clock, one
      interface clock, and up to 8 module specific optional clocks.
      Some modules may have only the functional clock, and some have
      no configurable clocks.
    minItems: 1
    maxItems: 4

  clock-names:
    description:
      Target module clock names like "fck", "ick", "optck1", "optck2"
      if the clocks are configurable.
    oneOf:
      - enum: [ ick, fck, sys_clk ]
      - items:
          - const: fck
          - enum: [ ick. dbclk, osc, sys_clk, dss_clk, ahclkx ]
      - items:
          - const: fck
          - const: phy-clk
          - const: phy-clk-div
      - items:
          - const: fck
          - const: hdmi_clk
          - const: sys_clk
          - const: tv_clk
      - items:
          - const: fck
          - const: ahclkx
          - const: ahclkr

  resets:
    description:
      Target module reset bit in the RSTCTRL register if wired for the module.
      Note that the other reset bits should be mapped for the child device
      driver to use.
    maxItems: 1

  reset-names:
    description:
      Target module reset names in the RSTCTRL register, typically named
      "rstctrl" if only one reset bit is wired for the module.
    items:
      - const: rstctrl

  '#address-cells':
    enum: [ 1, 2 ]

  '#size-cells':
    enum: [ 1, 2 ]

  ranges: true

  dma-ranges: true

  ti,sysc-mask:
    description: Mask of supported register bits for the SYSCONFIG register
    $ref: /schemas/types.yaml#/definitions/uint32

  ti,sysc-midle:
    description: List of hardware supported idle modes
    $ref: /schemas/types.yaml#/definitions/uint32-array

  ti,sysc-sidle:
    description: List of hardware supported idle modes
    $ref: /schemas/types.yaml#/definitions/uint32-array

  ti,syss-mask:
    description: Mask of supported register bits for the SYSSTATUS register
    $ref: /schemas/types.yaml#/definitions/uint32

  ti,sysc-delay-us:
    description: Delay needed after OCP softreset before accessing SYCONFIG
    default: 0
    minimum: 0
    maximum: 2

  ti,no-reset-on-init:
    description: Interconnect target module shall not be reset at init
    type: boolean

  ti,no-idle-on-init:
    description: Interconnect target module shall not be idled at init
    type: boolean

  ti,no-idle:
    description: Interconnect target module shall not be idled
    type: boolean

  ti,hwmods:
    description: Interconnect module name to use with legacy hwmod data
    $ref: /schemas/types.yaml#/definitions/string
    deprecated: true

required:
  - compatible
  - '#address-cells'
  - '#size-cells'
  - ranges

additionalProperties:
  type: object

examples:
  - |
    #include <dt-bindings/bus/ti-sysc.h>
    #include <dt-bindings/clock/omap4.h>

    target-module@2b000 {
        compatible = "ti,sysc-omap2", "ti,sysc";
        ti,hwmods = "usb_otg_hs";
        reg = <0x2b400 0x4>,
              <0x2b404 0x4>,
              <0x2b408 0x4>;
        reg-names = "rev", "sysc", "syss";
        clocks = <&l3_init_clkctrl OMAP4_USB_OTG_HS_CLKCTRL 0>;
        clock-names = "fck";
        ti,sysc-mask = <(SYSC_OMAP2_ENAWAKEUP |
                         SYSC_OMAP2_SOFTRESET |
                         SYSC_OMAP2_AUTOIDLE)>;
        ti,sysc-midle = <SYSC_IDLE_FORCE>,
                        <SYSC_IDLE_NO>,
                        <SYSC_IDLE_SMART>;
        ti,sysc-sidle = <SYSC_IDLE_FORCE>,
                        <SYSC_IDLE_NO>,
                        <SYSC_IDLE_SMART>,
                        <SYSC_IDLE_SMART_WKUP>;
        ti,syss-mask = <1>;
        #address-cells = <1>;
        #size-cells = <1>;
        ranges = <0 0x2b000 0x1000>;
    };
```

## Documentation/devicetree/bindings/bus/ts-nbus.txt
```
Technologic Systems NBUS

The NBUS is a bus used to interface with peripherals in the Technologic
Systems FPGA on the TS-4600 SoM.

Required properties :
 - compatible		: "technologic,ts-nbus"
 - #address-cells	: must be 1
 - #size-cells		: must be 0
 - pwms			: The PWM bound to the FPGA
 - ts,data-gpios	: The 8 GPIO pins connected to the data lines on the FPGA
 - ts,csn-gpios		: The GPIO pin connected to the csn line on the FPGA
 - ts,txrx-gpios	: The GPIO pin connected to the txrx line on the FPGA
 - ts,strobe-gpios	: The GPIO pin connected to the stobe line on the FPGA
 - ts,ale-gpios		: The GPIO pin connected to the ale line on the FPGA
 - ts,rdy-gpios		: The GPIO pin connected to the rdy line on the FPGA

Child nodes:

The NBUS node can contain zero or more child nodes representing peripherals
on the bus.

Example:

	nbus {
		compatible = "technologic,ts-nbus";
		pinctrl-0 = <&nbus_pins>;
		#address-cells = <1>;
		#size-cells = <0>;
		pwms = <&pwm 2 83>;
		ts,data-gpios   = <&gpio0 0 GPIO_ACTIVE_HIGH
				   &gpio0 1 GPIO_ACTIVE_HIGH
				   &gpio0 2 GPIO_ACTIVE_HIGH
				   &gpio0 3 GPIO_ACTIVE_HIGH
				   &gpio0 4 GPIO_ACTIVE_HIGH
				   &gpio0 5 GPIO_ACTIVE_HIGH
				   &gpio0 6 GPIO_ACTIVE_HIGH
				   &gpio0 7 GPIO_ACTIVE_HIGH>;
		ts,csn-gpios    = <&gpio0 16 GPIO_ACTIVE_HIGH>;
		ts,txrx-gpios   = <&gpio0 24 GPIO_ACTIVE_HIGH>;
		ts,strobe-gpios = <&gpio0 25 GPIO_ACTIVE_HIGH>;
		ts,ale-gpios    = <&gpio0 26 GPIO_ACTIVE_HIGH>;
		ts,rdy-gpios    = <&gpio0 21 GPIO_ACTIVE_HIGH>;

		watchdog@2a {
			compatible = "...";

			/* ... */
		};
	};
```

## Documentation/devicetree/bindings/bus/uniphier-system-bus.txt
```
UniPhier System Bus

The UniPhier System Bus is an external bus that connects on-board devices to
the UniPhier SoC.  It is a simple (semi-)parallel bus with address, data, and
some control signals.  It supports up to 8 banks (chip selects).

Before any access to the bus, the bus controller must be configured; the bus
controller registers provide the control for the translation from the offset
within each bank to the CPU-viewed address.  The needed setup includes the base
address, the size of each bank.  Optionally, some timing parameters can be
optimized for faster bus access.

Required properties:
- compatible: should be "socionext,uniphier-system-bus".
- reg: offset and length of the register set for the bus controller device.
- #address-cells: should be 2.  The first cell is the bank number (chip select).
  The second cell is the address offset within the bank.
- #size-cells: should be 1.
- ranges: should provide a proper address translation from the System Bus to
  the parent bus.

Note:
The address region(s) that can be assigned for the System Bus is implementation
defined.  Some SoCs can use 0x00000000-0x0fffffff and 0x40000000-0x4fffffff,
while other SoCs can only use 0x40000000-0x4fffffff.  There might be additional
limitations depending on SoCs and the boot mode.  The address translation is
arbitrary as long as the banks are assigned in the supported address space with
the required alignment and they do not overlap one another.
For example, it is possible to map:
  bank 0 to 0x42000000-0x43ffffff, bank 5 to 0x46000000-0x46ffffff
It is also possible to map:
  bank 0 to 0x48000000-0x49ffffff, bank 5 to 0x44000000-0x44ffffff
There is no reason to stick to a particular translation mapping, but the
"ranges" property should provide a "reasonable" default that is known to work.
The software should initialize the bus controller according to it.

Example:

	system-bus {
		compatible = "socionext,uniphier-system-bus";
		reg = <0x58c00000 0x400>;
		#address-cells = <2>;
		#size-cells = <1>;
		ranges = <1 0x00000000 0x42000000 0x02000000
			  5 0x00000000 0x46000000 0x01000000>;

		ethernet@1,01f00000 {
			compatible = "smsc,lan9115";
			reg = <1 0x01f00000 0x1000>;
			interrupts = <0 48 4>
			phy-mode = "mii";
		};

		uart@5,00200000 {
			compatible = "ns16550a";
			reg = <5 0x00200000 0x20>;
			interrupts = <0 49 4>
			clock-frequency = <12288000>;
		};
	};

In this example,
 - the Ethernet device is connected at the offset 0x01f00000 of CS1 and
   mapped to 0x43f00000 of the parent bus.
 - the UART device is connected at the offset 0x00200000 of CS5 and
   mapped to 0x46200000 of the parent bus.
```

## Documentation/devicetree/bindings/bus/xlnx,versal-net-cdx.yaml
```yaml
# SPDX-License-Identifier: (GPL-2.0 OR BSD-2-Clause)
%YAML 1.2
---
$id: http://devicetree.org/schemas/bus/xlnx,versal-net-cdx.yaml#
$schema: http://devicetree.org/meta-schemas/core.yaml#

title: AMD CDX bus controller

description: |
  CDX bus controller for AMD devices is implemented to dynamically
  detect CDX bus and devices using the firmware.
  The CDX bus manages multiple FPGA based hardware devices, which
  can support network, crypto or any other specialized type of
  devices. These FPGA based devices can be added/modified dynamically
  on run-time.

  All devices on the CDX bus will have a unique streamid (for IOMMU)
  and a unique device ID (for MSI) corresponding to a requestor ID
  (one to one associated with the device). The streamid and deviceid
  are used to configure SMMU and GIC-ITS respectively.

  iommu-map property is used to define the set of stream ids
  corresponding to each device and the associated IOMMU.

  The MSI writes are accompanied by sideband data (Device ID).
  The msi-map property is used to associate the devices with the
  device ID as well as the associated ITS controller.

  rproc property (xlnx,rproc) is used to identify the remote processor
  with which APU (Application Processor Unit) interacts to find out
  the bus and device configuration.

maintainers:
  - Nipun Gupta <nipun.gupta@amd.com>
  - Nikhil Agarwal <nikhil.agarwal@amd.com>

properties:
  compatible:
    const: xlnx,versal-net-cdx

  iommu-map: true

  msi-map: true

  xlnx,rproc:
    $ref: /schemas/types.yaml#/definitions/phandle
    description:
      phandle to the remoteproc_r5 rproc node using which APU interacts
      with remote processor.

  ranges: true

  "#address-cells":
    enum: [1, 2]

  "#size-cells":
    enum: [1, 2]

required:
  - compatible
  - iommu-map
  - msi-map
  - xlnx,rproc
  - ranges
  - "#address-cells"
  - "#size-cells"

additionalProperties: false

examples:
  - |
    cdx {
        compatible = "xlnx,versal-net-cdx";
        #address-cells = <1>;
        #size-cells = <1>;
        /* define map for RIDs 250-259 */
        iommu-map = <250 &smmu 250 10>;
        /* define msi map for RIDs 250-259 */
        msi-map = <250 &its 250 10>;
        xlnx,rproc = <&remoteproc_r5>;
        ranges;
    };
```

## Documentation/devicetree/bindings/c6x/clocks.txt
```
C6X PLL Clock Controllers
-------------------------

This is a first-cut support for the SoC clock controllers. This is still
under development and will probably change as the common device tree
clock support is added to the kernel.

Required properties:

- compatible: "ti,c64x+pll"
    May also have SoC-specific value to support SoC-specific initialization
    in the driver. One of:
        "ti,c6455-pll"
        "ti,c6457-pll"
        "ti,c6472-pll"
        "ti,c6474-pll"

- reg: base address and size of register area
- clock-frequency: input clock frequency in hz


Optional properties:

- ti,c64x+pll-bypass-delay: CPU cycles to delay when entering bypass mode

- ti,c64x+pll-reset-delay:  CPU cycles to delay after PLL reset

- ti,c64x+pll-lock-delay:   CPU cycles to delay after PLL frequency change

Example:

	clock-controller@29a0000 {
		compatible = "ti,c6472-pll", "ti,c64x+pll";
		reg = <0x029a0000 0x200>;
		clock-frequency = <25000000>;

		ti,c64x+pll-bypass-delay = <200>;
		ti,c64x+pll-reset-delay = <12000>;
		ti,c64x+pll-lock-delay = <80000>;
	};
```
