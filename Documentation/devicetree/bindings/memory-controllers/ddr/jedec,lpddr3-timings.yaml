## Documentation/devicetree/bindings/memory-controllers/ingenic,nemc-peripherals.yaml
```yaml
# SPDX-License-Identifier: (GPL-2.0-only OR BSD-2-Clause)
%YAML 1.2
---
$id: http://devicetree.org/schemas/memory-controllers/ingenic,nemc-peripherals.yaml#
$schema: http://devicetree.org/meta-schemas/core.yaml#

title: Ingenic SoCs NAND / External Memory Controller (NEMC) devicetree bindings

maintainers:
  - Paul Cercueil <paul@crapouillou.net>

properties:
  reg:
    minItems: 1
    maxItems: 255

  ingenic,nemc-bus-width:
    $ref: /schemas/types.yaml#/definitions/uint32
    enum: [8, 16]
    description: Specifies the bus width in bits.

  ingenic,nemc-tAS:
    $ref: /schemas/types.yaml#/definitions/uint32
    description: Address setup time in nanoseconds.

  ingenic,nemc-tAH:
    $ref: /schemas/types.yaml#/definitions/uint32
    description: Address hold time in nanoseconds.

  ingenic,nemc-tBP:
    $ref: /schemas/types.yaml#/definitions/uint32
    description: Burst pitch time in nanoseconds.

  ingenic,nemc-tAW:
    $ref: /schemas/types.yaml#/definitions/uint32
    description: Address wait time in nanoseconds.

  ingenic,nemc-tSTRV:
    $ref: /schemas/types.yaml#/definitions/uint32
    description: Static memory recovery time in nanoseconds.

required:
  - reg

additionalProperties: true
...
```

## Documentation/devicetree/bindings/memory-controllers/ingenic,nemc.yaml
```yaml
# SPDX-License-Identifier: (GPL-2.0-only OR BSD-2-Clause)
%YAML 1.2
---
$id: http://devicetree.org/schemas/memory-controllers/ingenic,nemc.yaml#
$schema: http://devicetree.org/meta-schemas/core.yaml#

title: Ingenic SoCs NAND / External Memory Controller (NEMC) devicetree bindings

maintainers:
  - Paul Cercueil <paul@crapouillou.net>

properties:
  $nodename:
    pattern: "^memory-controller@[0-9a-f]+$"

  compatible:
    oneOf:
      - enum:
          - ingenic,jz4740-nemc
          - ingenic,jz4780-nemc
      - items:
          - const: ingenic,jz4725b-nemc
          - const: ingenic,jz4740-nemc

  "#address-cells":
    const: 2

  "#size-cells":
    const: 1

  ranges: true

  reg:
    maxItems: 1

  clocks:
    maxItems: 1

patternProperties:
  ".*@[0-9]+$":
    type: object

required:
  - compatible
  - "#address-cells"
  - "#size-cells"
  - ranges
  - reg
  - clocks

additionalProperties: false

examples:
  - |
    #include <dt-bindings/clock/ingenic,jz4780-cgu.h>
    #include <dt-bindings/gpio/gpio.h>
    nemc: memory-controller@13410000 {
      compatible = "ingenic,jz4780-nemc";
      reg = <0x13410000 0x10000>;
      #address-cells = <2>;
      #size-cells = <1>;
      ranges = <1 0 0x1b000000 0x1000000>,
         <2 0 0x1a000000 0x1000000>,
         <3 0 0x19000000 0x1000000>,
         <4 0 0x18000000 0x1000000>,
         <5 0 0x17000000 0x1000000>,
         <6 0 0x16000000 0x1000000>;

      clocks = <&cgu JZ4780_CLK_NEMC>;

      ethernet@6 {
        compatible = "davicom,dm9000";
        davicom,no-eeprom;

        pinctrl-names = "default";
        pinctrl-0 = <&pins_nemc_cs6>;

        reg = <6 0 1>, /* addr */
              <6 2 1>; /* data */

        ingenic,nemc-tAS = <15>;
        ingenic,nemc-tAH = <10>;
        ingenic,nemc-tBP = <20>;
        ingenic,nemc-tAW = <50>;
        ingenic,nemc-tSTRV = <100>;

        reset-gpios = <&gpf 12 GPIO_ACTIVE_HIGH>;
        vcc-supply = <&eth0_power>;

        interrupt-parent = <&gpe>;
        interrupts = <19 4>;
      };
    };
```

## Documentation/devicetree/bindings/memory-controllers/intel,ixp4xx-expansion-peripheral-props.yaml
```yaml
# SPDX-License-Identifier: (GPL-2.0-only OR BSD-2-Clause)
%YAML 1.2
---
$id: http://devicetree.org/schemas/memory-controllers/intel,ixp4xx-expansion-peripheral-props.yaml#
$schema: http://devicetree.org/meta-schemas/core.yaml#

title: Peripheral properties for Intel IXP4xx Expansion Bus

description:
  The IXP4xx expansion bus controller handles access to devices on the
  memory-mapped expansion bus on the Intel IXP4xx family of system on chips,
  including IXP42x, IXP43x, IXP45x and IXP46x.

maintainers:
  - Linus Walleij <linus.walleij@linaro.org>

properties:
  intel,ixp4xx-eb-t1:
    description: Address timing, extend address phase with n cycles.
    $ref: /schemas/types.yaml#/definitions/uint32
    maximum: 3

  intel,ixp4xx-eb-t2:
    description: Setup chip select timing, extend setup phase with n cycles.
    $ref: /schemas/types.yaml#/definitions/uint32
    maximum: 3

  intel,ixp4xx-eb-t3:
    description: Strobe timing, extend strobe phase with n cycles.
    $ref: /schemas/types.yaml#/definitions/uint32
    maximum: 15

  intel,ixp4xx-eb-t4:
    description: Hold timing, extend hold phase with n cycles.
    $ref: /schemas/types.yaml#/definitions/uint32
    maximum: 3

  intel,ixp4xx-eb-t5:
    description: Recovery timing, extend recovery phase with n cycles.
    $ref: /schemas/types.yaml#/definitions/uint32
    maximum: 15

  intel,ixp4xx-eb-cycle-type:
    description: The type of cycles to use on the expansion bus for this
      chip select. 0 = Intel cycles, 1 = Motorola cycles, 2 = HPI cycles.
    $ref: /schemas/types.yaml#/definitions/uint32
    enum: [0, 1, 2]

  intel,ixp4xx-eb-byte-access-on-halfword:
    description: Allow byte read access on half word devices.
    $ref: /schemas/types.yaml#/definitions/uint32
    enum: [0, 1]

  intel,ixp4xx-eb-hpi-hrdy-pol-high:
    description: Set HPI HRDY polarity to active high when using HPI.
    $ref: /schemas/types.yaml#/definitions/uint32
    enum: [0, 1]

  intel,ixp4xx-eb-mux-address-and-data:
    description: Multiplex address and data on the data bus.
    $ref: /schemas/types.yaml#/definitions/uint32
    enum: [0, 1]

  intel,ixp4xx-eb-ahb-split-transfers:
    description: Enable AHB split transfers.
    $ref: /schemas/types.yaml#/definitions/uint32
    enum: [0, 1]

  intel,ixp4xx-eb-write-enable:
    description: Enable write cycles.
    $ref: /schemas/types.yaml#/definitions/uint32
    enum: [0, 1]

  intel,ixp4xx-eb-byte-access:
    description: Expansion bus uses only 8 bits. The default is to use
      16 bits.
    $ref: /schemas/types.yaml#/definitions/uint32
    enum: [0, 1]

additionalProperties: true
```

## Documentation/devicetree/bindings/memory-controllers/marvell,mvebu-sdram-controller.yaml
```yaml
# SPDX-License-Identifier: (GPL-2.0-only OR BSD-2-Clause)
%YAML 1.2
---
$id: http://devicetree.org/schemas/memory-controllers/marvell,mvebu-sdram-controller.yaml#
$schema: http://devicetree.org/meta-schemas/core.yaml#

title: Marvell MVEBU SDRAM controller

maintainers:
  - Jan Luebbe <jlu@pengutronix.de>
  - Krzysztof Kozlowski <krzysztof.kozlowski@canonical.com>

properties:
  compatible:
    const: marvell,armada-xp-sdram-controller

  reg:
    maxItems: 1

required:
  - compatible
  - reg

additionalProperties: false

examples:
  - |
    memory-controller@1400 {
        compatible = "marvell,armada-xp-sdram-controller";
        reg = <0x1400 0x500>;
    };
```

## Documentation/devicetree/bindings/memory-controllers/mc-peripheral-props.yaml
```yaml
# SPDX-License-Identifier: (GPL-2.0 OR BSD-2-Clause)
%YAML 1.2
---
$id: http://devicetree.org/schemas/memory-controllers/mc-peripheral-props.yaml#
$schema: http://devicetree.org/meta-schemas/core.yaml#

title: Peripheral-specific properties for a Memory Controller bus.

description:
  Many Memory Controllers need to add properties to peripheral devices.
  They could be common properties like reg or they could be controller
  specific like delay in clock or data lines, etc. These properties need
  to be defined in the peripheral node because they are per-peripheral
  and there can be multiple peripherals attached to a controller. All
  those properties are listed here. The controller specific properties
  should go in their own separate schema that should be referenced
  from here.

maintainers:
  - Marek Vasut <marex@denx.de>

properties:
  reg:
    description: Bank number, base address and size of the device.

  bank-width:
    $ref: /schemas/types.yaml#/definitions/uint32
    description: Bank width of the device, in bytes.
    enum: [1, 2, 4]

required:
  - reg

# The controller specific properties go here.
allOf:
  - $ref: st,stm32-fmc2-ebi-props.yaml#
  - $ref: ingenic,nemc-peripherals.yaml#
  - $ref: intel,ixp4xx-expansion-peripheral-props.yaml#
  - $ref: ti,gpmc-child.yaml#
  - $ref: fsl/fsl,imx-weim-peripherals.yaml

additionalProperties: true
```
