## Documentation/devicetree/bindings/memory-controllers/ddr/jedec,sdram-props.yaml
```yaml
# SPDX-License-Identifier: (GPL-2.0-only OR BSD-2-Clause)
%YAML 1.2
---
$id: http://devicetree.org/schemas/memory-controllers/ddr/jedec,sdram-props.yaml#
$schema: http://devicetree.org/meta-schemas/core.yaml#

title: Common properties for SDRAM types

description:
  Different SDRAM types generally use the same properties and only differ in the
  range of legal values for each. This file defines the common parts that can be
  reused for each type. Nodes using this schema should generally be nested under
  a SDRAM channel node.

maintainers:
  - Krzysztof Kozlowski <krzk@kernel.org>

properties:
  compatible:
    description: |
      Compatible strings can be either explicit vendor names and part numbers
      (e.g. elpida,ECB240ABACN), or generated strings of the form
      lpddrX-YY,ZZZZ or ddrX-YYYY,AAAA...-ZZ where X, Y, and Z are lowercase
      hexadecimal with leading zeroes, and A is lowercase ASCII.
      For LPDDR and DDR SDRAM, X is the SDRAM version (2, 3, 4, etc.).
      For LPDDR SDRAM:
        - YY is the manufacturer ID (from MR5), 1 byte
        - ZZZZ is the revision ID (from MR6 and MR7), 2 bytes
      For DDR4 SDRAM with SPD, according to JEDEC SPD4.1.2.L-6:
        - YYYY is the manufacturer ID, 2 bytes, from bytes 320 and 321
        - AAAA... is the part number, 20 bytes (20 chars) from bytes 329 to 348
          without trailing spaces
        - ZZ is the revision ID, 1 byte, from byte 349
      The former form is useful when the SDRAM vendor and part number are
      known, for example, when memory is soldered on the board. The latter
      form is useful when SDRAM nodes are created at runtime by boot firmware
      that doesn't have access to static part number information.

  reg:
    description:
      The rank number of this memory rank when used as a subnode to an memory
      channel.
    minimum: 0
    maximum: 3

  revision-id:
    $ref: /schemas/types.yaml#/definitions/uint32-array
    description: |
      SDRAM revision ID:
        - LPDDR SDRAM, decoded from Mode Registers 6 and 7, always 2 bytes.
        - DDR4 SDRAM, decoded from the SPD from byte 349 according to
          JEDEC SPD4.1.2.L-6, always 1 byte.
      One byte per uint32 cell (e.g., <MR6 MR7>).
    maxItems: 2
    items:
      minimum: 0
      maximum: 255

  density:
    $ref: /schemas/types.yaml#/definitions/uint32
    description: |
      Density of the SDRAM chip in megabits:
        - LPDDR SDRAM, decoded from Mode Register 8.
        - DDR4 SDRAM, decoded from the SPD from bits 3-0 of byte 4 according to
          JEDEC SPD4.1.2.L-6.
    enum:
      - 64
      - 128
      - 256
      - 512
      - 1024
      - 2048
      - 3072
      - 4096
      - 6144
      - 8192
      - 12288
      - 16384
      - 24576
      - 32768

  io-width:
    $ref: /schemas/types.yaml#/definitions/uint32
    description: |
      I/O bus width in bits of the SDRAM chip:
        - LPDDR SDRAM, decoded from Mode Register 8.
        - DDR4 SDRAM, decoded from the SPD from bits 2-0 of byte 12 according to
          JEDEC SPD4.1.2.L-6.
    enum:
      - 8
      - 16
      - 32

additionalProperties: true
```

## Documentation/devicetree/bindings/memory-controllers/ddr/lpddr3-timings.txt
```
* AC timing parameters of LPDDR3 memories for a given speed-bin.

The structures are based on LPDDR2 and extended where needed.

Required properties:
- compatible : Should be "jedec,lpddr3-timings"
- min-freq : minimum DDR clock frequency for the speed-bin. Type is <u32>
- reg : maximum DDR clock frequency for the speed-bin. Type is <u32>

Optional properties:

The following properties represent AC timing parameters from the memory
data-sheet of the device for a given speed-bin. All these properties are
of type <u32> and the default unit is ps (pico seconds).
- tRFC
- tRRD
- tRPab
- tRPpb
- tRCD
- tRC
- tRAS
- tWTR
- tWR
- tRTP
- tW2W-C2C
- tR2R-C2C
- tFAW
- tXSR
- tXP
- tCKE
- tCKESR
- tMRD

Example:

timings_samsung_K3QF2F20DB_800mhz: lpddr3-timings@800000000 {
	compatible	= "jedec,lpddr3-timings";
	reg		= <800000000>; /* workaround: it shows max-freq */
	min-freq	= <100000000>;
	tRFC		= <65000>;
	tRRD		= <6000>;
	tRPab		= <12000>;
	tRPpb		= <12000>;
	tRCD		= <10000>;
	tRC		= <33750>;
	tRAS		= <23000>;
	tWTR		= <3750>;
	tWR		= <7500>;
	tRTP		= <3750>;
	tW2W-C2C	= <0>;
	tR2R-C2C	= <0>;
	tFAW		= <25000>;
	tXSR		= <70000>;
	tXP		= <3750>;
	tCKE		= <3750>;
	tCKESR		= <3750>;
	tMRD		= <7000>;
};
```

## Documentation/devicetree/bindings/memory-controllers/ddr/lpddr3.txt
```
* LPDDR3 SDRAM memories compliant to JEDEC JESD209-3C

Required properties:
- compatible : Should be "<vendor>,<type>", and generic value "jedec,lpddr3".
  Example "<vendor>,<type>" values:
    "samsung,K3QF2F20DB"

- density  : <u32> representing density in Mb (Mega bits)
- io-width : <u32> representing bus width. Possible values are 8, 16, 32, 64
- #address-cells: Must be set to 1
- #size-cells: Must be set to 0

Optional properties:

- manufacturer-id : <u32>     Manufacturer ID value read from Mode Register 5
- revision-id     : <u32 u32> Revision IDs read from Mode Registers 6 and 7

The following optional properties represent the minimum value of some AC
timing parameters of the DDR device in terms of number of clock cycles.
These values shall be obtained from the device data-sheet.
- tRFC-min-tck
- tRRD-min-tck
- tRPab-min-tck
- tRPpb-min-tck
- tRCD-min-tck
- tRC-min-tck
- tRAS-min-tck
- tWTR-min-tck
- tWR-min-tck
- tRTP-min-tck
- tW2W-C2C-min-tck
- tR2R-C2C-min-tck
- tWL-min-tck
- tDQSCK-min-tck
- tRL-min-tck
- tFAW-min-tck
- tXSR-min-tck
- tXP-min-tck
- tCKE-min-tck
- tCKESR-min-tck
- tMRD-min-tck

Child nodes:
- The lpddr3 node may have one or more child nodes of type "lpddr3-timings".
  "lpddr3-timings" provides AC timing parameters of the device for
  a given speed-bin. Please see
  Documentation/devicetree/bindings/memory-controllers/ddr/lpddr3-timings.txt
  for more information on "lpddr3-timings"

Example:

samsung_K3QF2F20DB: lpddr3 {
	compatible	= "samsung,K3QF2F20DB", "jedec,lpddr3";
	density		= <16384>;
	io-width	= <32>;
	manufacturer-id = <1>;
	revision-id     = <123 234>;
	#address-cells	= <1>;
	#size-cells	= <0>;

	tRFC-min-tck		= <17>;
	tRRD-min-tck		= <2>;
	tRPab-min-tck		= <2>;
	tRPpb-min-tck		= <2>;
	tRCD-min-tck		= <3>;
	tRC-min-tck		= <6>;
	tRAS-min-tck		= <5>;
	tWTR-min-tck		= <2>;
	tWR-min-tck		= <7>;
	tRTP-min-tck		= <2>;
	tW2W-C2C-min-tck	= <0>;
	tR2R-C2C-min-tck	= <0>;
	tWL-min-tck		= <8>;
	tDQSCK-min-tck		= <5>;
	tRL-min-tck		= <14>;
	tFAW-min-tck		= <5>;
	tXSR-min-tck		= <12>;
	tXP-min-tck		= <2>;
	tCKE-min-tck		= <2>;
	tCKESR-min-tck		= <2>;
	tMRD-min-tck		= <5>;

	timings_samsung_K3QF2F20DB_800mhz: lpddr3-timings@800000000 {
		compatible	= "jedec,lpddr3-timings";
		/* workaround: 'reg' shows max-freq */
		reg		= <800000000>;
		min-freq	= <100000000>;
		tRFC		= <65000>;
		tRRD		= <6000>;
		tRPab		= <12000>;
		tRPpb		= <12000>;
		tRCD		= <10000>;
		tRC		= <33750>;
		tRAS		= <23000>;
		tWTR		= <3750>;
		tWR		= <7500>;
		tRTP		= <3750>;
		tW2W-C2C	= <0>;
		tR2R-C2C	= <0>;
		tFAW		= <25000>;
		tXSR		= <70000>;
		tXP		= <3750>;
		tCKE		= <3750>;
		tCKESR		= <3750>;
		tMRD		= <7000>;
	};
}
```

## Documentation/devicetree/bindings/memory-controllers/exynos-srom.txt
```
SAMSUNG Exynos SoCs SROM Controller driver.

Required properties:
- compatible : Should contain "samsung,exynos4210-srom".

- reg: offset and length of the register set

Optional properties:
The SROM controller can be used to attach external peripherals. In this case
extra properties, describing the bus behind it, should be specified as below:

- #address-cells: Must be set to 2 to allow device address translation.
		  Address is specified as (bank#, offset).

- #size-cells: Must be set to 1 to allow device size passing

- ranges: Must be set up to reflect the memory layout with four integer values
	  per bank:
		<bank-number> 0 <parent address of bank> <size>

Sub-nodes:
The actual device nodes should be added as subnodes to the SROMc node. These
subnodes, in addition to regular device specification, should contain the following
properties, describing configuration of the relevant SROM bank:

Required properties:
- reg: bank number, base address (relative to start of the bank) and size of
       the memory mapped for the device. Note that base address will be
       typically 0 as this is the start of the bank.

- samsung,srom-timing : array of 6 integers, specifying bank timings in the
                        following order: Tacp, Tcah, Tcoh, Tacc, Tcos, Tacs.
                        Each value is specified in cycles and has the following
                        meaning and valid range:
                        Tacp : Page mode access cycle at Page mode (0 - 15)
                        Tcah : Address holding time after CSn (0 - 15)
                        Tcoh : Chip selection hold on OEn (0 - 15)
                        Tacc : Access cycle (0 - 31, the actual time is N + 1)
                        Tcos : Chip selection set-up before OEn (0 - 15)
                        Tacs : Address set-up before CSn (0 - 15)

Optional properties:
- reg-io-width : data width in bytes (1 or 2). If omitted, default of 1 is used.

- samsung,srom-page-mode : if page mode is set, 4 data page mode will be configured,
			   else normal (1 data) page mode will be set.

Example: basic definition, no banks are configured
	memory-controller@12570000 {
		compatible = "samsung,exynos4210-srom";
		reg = <0x12570000 0x14>;
	};

Example: SROMc with SMSC911x ethernet chip on bank 3
	memory-controller@12570000 {
		#address-cells = <2>;
		#size-cells = <1>;
		ranges = <0 0 0x04000000 0x20000   // Bank0
			  1 0 0x05000000 0x20000   // Bank1
			  2 0 0x06000000 0x20000   // Bank2
			  3 0 0x07000000 0x20000>; // Bank3

		compatible = "samsung,exynos4210-srom";
		reg = <0x12570000 0x14>;

		ethernet@3,0 {
			compatible = "smsc,lan9115";
			reg = <3 0 0x10000>;	   // Bank 3, offset = 0
			phy-mode = "mii";
			interrupt-parent = <&gpx0>;
			interrupts = <5 8>;
			reg-io-width = <2>;
			smsc,irq-push-pull;
			smsc,force-internal-phy;

			samsung,srom-page-mode;
			samsung,srom-timing = <9 12 1 9 1 1>;
		};
	};
```

## Documentation/devicetree/bindings/memory-controllers/exynos-srom.yaml
```yaml
# SPDX-License-Identifier: GPL-2.0
%YAML 1.2
---
$id: http://devicetree.org/schemas/memory-controllers/exynos-srom.yaml#
$schema: http://devicetree.org/meta-schemas/core.yaml#

title: Samsung Exynos SoC SROM Controller driver

maintainers:
  - Krzysztof Kozlowski <krzk@kernel.org>

description: |+
  The SROM controller can be used to attach external peripherals. In this case
  extra properties, describing the bus behind it, should be specified.

properties:
  compatible:
    items:
      - const: samsung,exynos4210-srom

  reg:
    maxItems: 1

  "#address-cells":
    const: 2

  "#size-cells":
    const: 1

  ranges:
    minItems: 1
    maxItems: 4
    description: |
      Reflects the memory layout with four integer values per bank. Format:
      <bank-number> 0 <parent address of bank> <size>
      Up to four banks are supported.

patternProperties:
  "^.*@[0-3],[a-f0-9]+$":
    type: object
    $ref: mc-peripheral-props.yaml#
    additionalProperties: true

    properties:
      reg-io-width:
        enum: [1, 2]
        description:
          Data width in bytes (1 or 2). If omitted, default of 1 is used.

    required:
      - samsung,srom-timing

required:
  - compatible
  - reg

additionalProperties: false

examples:
  - |
    // Example: basic definition, no banks are configured
    memory-controller@12560000 {
        compatible = "samsung,exynos4210-srom";
        reg = <0x12560000 0x14>;
    };

  - |
    // Example: SROMc with SMSC911x ethernet chip on bank 3
    memory-controller@12570000 {
        #address-cells = <2>;
        #size-cells = <1>;
        ranges = <0 0 0x04000000 0x20000   // Bank0
                  1 0 0x05000000 0x20000   // Bank1
                  2 0 0x06000000 0x20000   // Bank2
                  3 0 0x07000000 0x20000>; // Bank3

        compatible = "samsung,exynos4210-srom";
        reg = <0x12570000 0x14>;

        ethernet@3,0 {
            compatible = "smsc,lan9115";
            reg = <3 0 0x10000>;     // Bank 3, offset = 0
            phy-mode = "mii";
            interrupt-parent = <&gpx0>;
            interrupts = <5 8>;
            reg-io-width = <2>;
            smsc,irq-push-pull;
            smsc,force-internal-phy;

            samsung,srom-page-mode;
            samsung,srom-timing = <9 12 1 9 1 1>;
        };
    };
```
