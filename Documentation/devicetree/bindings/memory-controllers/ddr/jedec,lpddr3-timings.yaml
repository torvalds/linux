## Documentation/devicetree/bindings/memory-controllers/exynos5422-dmc.txt
```
* Exynos5422 frequency and voltage scaling for Dynamic Memory Controller device

The Samsung Exynos5422 SoC has DMC (Dynamic Memory Controller) to which the DRAM
memory chips are connected. The driver is to monitor the controller in runtime
and switch frequency and voltage. To monitor the usage of the controller in
runtime, the driver uses the PPMU (Platform Performance Monitoring Unit), which
is able to measure the current load of the memory.
When 'userspace' governor is used for the driver, an application is able to
switch the DMC and memory frequency.

Required properties for DMC device for Exynos5422:
- compatible: Should be "samsung,exynos5422-dmc".
- clocks : list of clock specifiers, must contain an entry for each
  required entry in clock-names for CLK_FOUT_SPLL, CLK_MOUT_SCLK_SPLL,
  CLK_FF_DOUT_SPLL2, CLK_FOUT_BPLL, CLK_MOUT_BPLL, CLK_SCLK_BPLL,
  CLK_MOUT_MX_MSPLL_CCORE, CLK_MOUT_MX_MSPLL_CCORE_PHY, CLK_MOUT_MCLK_CDREX,
- clock-names : should include "fout_spll", "mout_sclk_spll", "ff_dout_spll2",
  "fout_bpll", "mout_bpll", "sclk_bpll", "mout_mx_mspll_ccore",
  "mout_mclk_cdrex"  entries
- devfreq-events : phandles for PPMU devices connected to this DMC.
- vdd-supply : phandle for voltage regulator which is connected.
- reg : registers of two CDREX controllers.
- operating-points-v2 : phandle for OPPs described in v2 definition.
- device-handle : phandle of the connected DRAM memory device. For more
	information please refer to documentation file:
	Documentation/devicetree/bindings/ddr/lpddr3.txt
- devfreq-events : phandles of the PPMU events used by the controller.
- samsung,syscon-clk : phandle of the clock register set used by the controller,
	these registers are used for enabling a 'pause' feature and are not
	exposed by clock framework but they must be used in a safe way.
	The register offsets are in the driver code and specyfic for this SoC
	type.

Optional properties for DMC device for Exynos5422:
- interrupt-parent : The parent interrupt controller.
- interrupts : Contains the IRQ line numbers for the DMC internal performance
  event counters in DREX0 and DREX1 channels. Align with specification of the
  interrupt line(s) in the interrupt-parent controller.
- interrupt-names : IRQ names "drex_0" and "drex_1", the order should be the
  same as in the 'interrupts' list above.

Example:

	ppmu_dmc0_0: ppmu@10d00000 {
		compatible = "samsung,exynos-ppmu";
		reg = <0x10d00000 0x2000>;
		clocks = <&clock CLK_PCLK_PPMU_DREX0_0>;
		clock-names = "ppmu";
		events {
			ppmu_event_dmc0_0: ppmu-event3-dmc0_0 {
				event-name = "ppmu-event3-dmc0_0";
			};
		};
	};

	dmc: memory-controller@10c20000 {
		compatible = "samsung,exynos5422-dmc";
		reg = <0x10c20000 0x10000>, <0x10c30000 0x10000>;
		clocks = <&clock CLK_FOUT_SPLL>,
			 <&clock CLK_MOUT_SCLK_SPLL>,
			 <&clock CLK_FF_DOUT_SPLL2>,
			 <&clock CLK_FOUT_BPLL>,
			 <&clock CLK_MOUT_BPLL>,
			 <&clock CLK_SCLK_BPLL>,
			 <&clock CLK_MOUT_MX_MSPLL_CCORE>,
			 <&clock CLK_MOUT_MCLK_CDREX>;
		clock-names = "fout_spll",
			      "mout_sclk_spll",
			      "ff_dout_spll2",
			      "fout_bpll",
			      "mout_bpll",
			      "sclk_bpll",
			      "mout_mx_mspll_ccore",
			      "mout_mclk_cdrex";
		operating-points-v2 = <&dmc_opp_table>;
		devfreq-events = <&ppmu_event3_dmc0_0>,	<&ppmu_event3_dmc0_1>,
				 <&ppmu_event3_dmc1_0>, <&ppmu_event3_dmc1_1>;
		device-handle = <&samsung_K3QF2F20DB>;
		vdd-supply = <&buck1_reg>;
		samsung,syscon-clk = <&clock>;
		interrupt-parent = <&combiner>;
		interrupts = <16 0>, <16 1>;
		interrupt-names = "drex_0", "drex_1";
	};
```

## Documentation/devicetree/bindings/memory-controllers/fsl/ddr.txt
```
Freescale DDR memory controller

Properties:

- compatible	: Should include "fsl,chip-memory-controller" where
		  chip is the processor (bsc9132, mpc8572 etc.), or
		  "fsl,qoriq-memory-controller".
- reg		: Address and size of DDR controller registers
- interrupts	: Error interrupt of DDR controller
- little-endian	: Specifies little-endian access to registers
		  If omitted, big-endian will be used.

Example 1:

	memory-controller@2000 {
		compatible = "fsl,bsc9132-memory-controller";
		reg = <0x2000 0x1000>;
		interrupts = <16 2 1 8>;
	};


Example 2:

	ddr1: memory-controller@8000 {
		compatible = "fsl,qoriq-memory-controller-v4.7",
				"fsl,qoriq-memory-controller";
		reg = <0x8000 0x1000>;
		interrupts = <16 2 1 23>;
	};
```

## Documentation/devicetree/bindings/memory-controllers/fsl/fsl,ddr.yaml
```yaml
# SPDX-License-Identifier: (GPL-2.0-only OR BSD-2-Clause)
%YAML 1.2
---
$id: http://devicetree.org/schemas/memory-controllers/fsl/fsl,ddr.yaml#
$schema: http://devicetree.org/meta-schemas/core.yaml#

title: Freescale DDR memory controller

maintainers:
  - Borislav Petkov <bp@alien8.de>
  - York Sun <york.sun@nxp.com>

properties:
  $nodename:
    pattern: "^memory-controller@[0-9a-f]+$"

  compatible:
    oneOf:
      - items:
          - enum:
              - fsl,qoriq-memory-controller-v4.4
              - fsl,qoriq-memory-controller-v4.5
              - fsl,qoriq-memory-controller-v4.7
              - fsl,qoriq-memory-controller-v5.0
          - const: fsl,qoriq-memory-controller
      - enum:
          - fsl,bsc9132-memory-controller
          - fsl,mpc8536-memory-controller
          - fsl,mpc8540-memory-controller
          - fsl,mpc8541-memory-controller
          - fsl,mpc8544-memory-controller
          - fsl,mpc8548-memory-controller
          - fsl,mpc8555-memory-controller
          - fsl,mpc8560-memory-controller
          - fsl,mpc8568-memory-controller
          - fsl,mpc8569-memory-controller
          - fsl,mpc8572-memory-controller
          - fsl,mpc8349-memory-controller
          - fsl,p1020-memory-controller
          - fsl,p1021-memory-controller
          - fsl,p2020-memory-controller
          - fsl,qoriq-memory-controller

  interrupts:
    maxItems: 1

  little-endian:
    description:
      Specifies little-endian access to registers. If omitted, big-endian will
      be used.
    type: boolean

  reg:
    maxItems: 1

required:
  - compatible
  - interrupts
  - reg

additionalProperties: false

examples:
  - |
    memory-controller@2000 {
        compatible = "fsl,bsc9132-memory-controller";
        reg = <0x2000 0x1000>;
        interrupts = <16 2 1 8>;
    };

  - |
    memory-controller@8000 {
        compatible = "fsl,qoriq-memory-controller-v4.7",
                     "fsl,qoriq-memory-controller";
        reg = <0x8000 0x1000>;
        interrupts = <16 2 1 23>;
    };
```

## Documentation/devicetree/bindings/memory-controllers/fsl/fsl,ifc.yaml
```yaml
# SPDX-License-Identifier: (GPL-2.0-only OR BSD-2-Clause)
%YAML 1.2
---
$id: http://devicetree.org/schemas/memory-controllers/fsl/fsl,ifc.yaml#
$schema: http://devicetree.org/meta-schemas/core.yaml#

title: FSL/NXP Integrated Flash Controller

maintainers:
  - Shawn Guo <shawnguo@kernel.org>

description: |
  NXP's integrated flash controller (IFC) is an advanced version of the
  enhanced local bus controller which includes similar programming and signal
  interfaces with an extended feature set. The IFC provides access to multiple
  external memory types, such as NAND flash (SLC and MLC), NOR flash, EPROM,
  SRAM and other memories where address and data are shared on a bus.

properties:
  $nodename:
    pattern: "^memory-controller@[0-9a-f]+$"

  compatible:
    const: fsl,ifc

  "#address-cells":
    enum: [2, 3]
    description: |
      Should be either two or three.  The first cell is the chipselect
      number, and the remaining cells are the offset into the chipselect.

  "#size-cells":
    enum: [1, 2]
    description: |
      Either one or two, depending on how large each chipselect can be.

  reg:
    maxItems: 1

  interrupts:
    minItems: 1
    maxItems: 2
    description: |
      IFC may have one or two interrupts.  If two interrupt specifiers are
      present, the first is the "common" interrupt (CM_EVTER_STAT), and the
      second is the NAND interrupt (NAND_EVTER_STAT).  If there is only one,
      that interrupt reports both types of event.

  little-endian:
    type: boolean
    description: |
      If this property is absent, the big-endian mode will be in use as default
      for registers.

  ranges:
    description: |
      Each range corresponds to a single chipselect, and covers the entire
      access window as configured.

patternProperties:
  "^.*@[a-f0-9]+(,[a-f0-9]+)+$":
    type: object
    description: |
      Child device nodes describe the devices connected to IFC such as NOR (e.g.
      cfi-flash) and NAND (fsl,ifc-nand). There might be board specific devices
      like FPGAs, CPLDs, etc.

    required:
      - compatible
      - reg

required:
  - compatible
  - reg
  - interrupts

additionalProperties: false

examples:
  - |
    soc {
        #address-cells = <2>;
        #size-cells = <2>;

        memory-controller@ffe1e000 {
            compatible = "fsl,ifc";
            #address-cells = <2>;
            #size-cells = <1>;
            reg = <0x0 0xffe1e000 0 0x2000>;
            interrupts = <16 2 19 2>;
            little-endian;

            /* NOR, NAND Flashes and CPLD on board */
            ranges = <0x0 0x0 0x0 0xee000000 0x02000000>,
                     <0x1 0x0 0x0 0xffa00000 0x00010000>,
                     <0x3 0x0 0x0 0xffb00000 0x00020000>;

            flash@0,0 {
                #address-cells = <1>;
                #size-cells = <1>;
                compatible = "cfi-flash";
                reg = <0x0 0x0 0x2000000>;
                bank-width = <2>;
                device-width = <1>;

                partition@0 {
                    /* 32MB for user data */
                    reg = <0x0 0x02000000>;
                    label = "NOR Data";
                };
            };
        };
    };
```

## Documentation/devicetree/bindings/memory-controllers/fsl/fsl,imx-weim-peripherals.yaml
```yaml
# SPDX-License-Identifier: (GPL-2.0-only OR BSD-2-Clause)
%YAML 1.2
---
$id: http://devicetree.org/schemas/memory-controllers/fsl/fsl,imx-weim-peripherals.yaml#
$schema: http://devicetree.org/meta-schemas/core.yaml#

title: i.MX WEIM Bus Peripheral Nodes

maintainers:
  - Shawn Guo <shawnguo@kernel.org>
  - Sascha Hauer <s.hauer@pengutronix.de>

description:
  This binding is meant for the child nodes of the WEIM node. The node
  represents any device connected to the WEIM bus. It may be a Flash chip,
  RAM chip or Ethernet controller, etc. These properties are meant for
  configuring the WEIM settings/timings and will accompany the bindings
  supported by the respective device.

properties:
  reg: true

  fsl,weim-cs-timing:
    $ref: /schemas/types.yaml#/definitions/uint32-array
    description:
      Timing values for the child node.
    minItems: 2
    maxItems: 6

# the WEIM child will have its own native properties
additionalProperties: true
```
