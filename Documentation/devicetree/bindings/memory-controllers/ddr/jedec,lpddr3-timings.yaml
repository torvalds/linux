## Documentation/devicetree/bindings/memory-controllers/fsl/fsl,imx-weim.yaml
```yaml
# SPDX-License-Identifier: (GPL-2.0-only OR BSD-2-Clause)
%YAML 1.2
---
$id: http://devicetree.org/schemas/memory-controllers/fsl/fsl,imx-weim.yaml#
$schema: http://devicetree.org/meta-schemas/core.yaml#

title: i.MX Wireless External Interface Module (WEIM)

maintainers:
  - Shawn Guo <shawnguo@kernel.org>
  - Sascha Hauer <s.hauer@pengutronix.de>

description:
  The term "wireless" does not imply that the WEIM is literally an interface
  without wires. It simply means that this module was originally designed for
  wireless and mobile applications that use low-power technology. The actual
  devices are instantiated from the child nodes of a WEIM node.

properties:
  $nodename:
    pattern: "^memory-controller@[0-9a-f]+$"

  compatible:
    oneOf:
      - enum:
          - fsl,imx1-weim
          - fsl,imx27-weim
          - fsl,imx50-weim
          - fsl,imx51-weim
          - fsl,imx6q-weim
      - items:
          - enum:
              - fsl,imx31-weim
              - fsl,imx35-weim
          - const: fsl,imx27-weim
      - items:
          - enum:
              - fsl,imx6sx-weim
              - fsl,imx6ul-weim
          - const: fsl,imx6q-weim

  "#address-cells":
    const: 2

  "#size-cells":
    const: 1

  reg:
    maxItems: 1

  clocks:
    maxItems: 1

  interrupts:
    maxItems: 1

  ranges: true

  fsl,weim-cs-gpr:
    $ref: /schemas/types.yaml#/definitions/phandle
    description: |
      Phandle to the system General Purpose Register controller that contains
      WEIM CS GPR register, e.g. IOMUXC_GPR1 on i.MX6Q. IOMUXC_GPR1[11:0]
      should be set up as one of the following 4 possible values depending on
      the CS space configuration.

      IOMUXC_GPR1[11:0]    CS0    CS1    CS2    CS3
      ---------------------------------------------
              05          128M     0M     0M     0M
              033          64M    64M     0M     0M
              0113         64M    32M    32M     0M
              01111        32M    32M    32M    32M

      In case that the property is absent, the reset value or what bootloader
      sets up in IOMUXC_GPR1[11:0] will be used.

  fsl,burst-clk-enable:
    type: boolean
    description:
      The presence of this property indicates that the weim bus should operate
      in Burst Clock Mode.

  fsl,continuous-burst-clk:
    type: boolean
    description:
      Make Burst Clock to output continuous clock. Without this option Burst
      Clock will output clock only when necessary.

patternProperties:
  "^.*@[0-7],[0-9a-f]+$":
    type: object
    description: Devices attached to chip selects are represented as subnodes.
    $ref: fsl,imx-weim-peripherals.yaml
    additionalProperties: true
    required:
      - fsl,weim-cs-timing

required:
  - compatible
  - reg
  - clocks
  - "#address-cells"
  - "#size-cells"
  - ranges

allOf:
  - if:
      properties:
        compatible:
          not:
            contains:
              enum:
                - fsl,imx50-weim
                - fsl,imx6q-weim
    then:
      properties:
        fsl,weim-cs-gpr: false
        fsl,burst-clk-enable: false
  - if:
      not:
        required:
          - fsl,burst-clk-enable
    then:
      properties:
        fsl,continuous-burst-clk: false
  - if:
      properties:
        compatible:
          contains:
            const: fsl,imx1-weim
    then:
      patternProperties:
        "^.*@[0-7],[0-9a-f]+$":
          properties:
            fsl,weim-cs-timing:
              items:
                items:
                  - description: CSxU
                  - description: CSxL
  - if:
      properties:
        compatible:
          contains:
            enum:
              - fsl,imx27-weim
              - fsl,imx31-weim
              - fsl,imx35-weim
    then:
      patternProperties:
        "^.*@[0-7],[0-9a-f]+$":
          properties:
            fsl,weim-cs-timing:
              items:
                items:
                  - description: CSCRxU
                  - description: CSCRxL
                  - description: CSCRxA
  - if:
      properties:
        compatible:
          contains:
            enum:
              - fsl,imx50-weim
              - fsl,imx51-weim
              - fsl,imx6q-weim
              - fsl,imx6sx-weim
              - fsl,imx6ul-weim
    then:
      patternProperties:
        "^.*@[0-7],[0-9a-f]+$":
          properties:
            fsl,weim-cs-timing:
              items:
                items:
                  - description: CSxGCR1
                  - description: CSxGCR2
                  - description: CSxRCR1
                  - description: CSxRCR2
                  - description: CSxWCR1
                  - description: CSxWCR2

additionalProperties: false

examples:
  - |
    memory-controller@21b8000 {
        compatible = "fsl,imx6q-weim";
        reg = <0x021b8000 0x4000>;
        clocks = <&clks 196>;
        #address-cells = <2>;
        #size-cells = <1>;
        ranges = <0 0 0x08000000 0x08000000>;
        fsl,weim-cs-gpr = <&gpr>;

        flash@0,0 {
            compatible = "cfi-flash";
            reg = <0 0 0x02000000>;
            #address-cells = <1>;
            #size-cells = <1>;
            bank-width = <2>;
            fsl,weim-cs-timing = <0x00620081 0x00000001 0x1c022000
                                  0x0000c000 0x1404a38e 0x00000000>;
        };
    };
```

## Documentation/devicetree/bindings/memory-controllers/fsl/ifc.txt
```
Integrated Flash Controller

Properties:
- name : Should be ifc
- compatible : should contain "fsl,ifc". The version of the integrated
               flash controller can be found in the IFC_REV register at
               offset zero.

- #address-cells : Should be either two or three.  The first cell is the
                   chipselect number, and the remaining cells are the
                   offset into the chipselect.
- #size-cells : Either one or two, depending on how large each chipselect
                can be.
- reg : Offset and length of the register set for the device
- interrupts: IFC may have one or two interrupts.  If two interrupt
              specifiers are present, the first is the "common"
              interrupt (CM_EVTER_STAT), and the second is the NAND
              interrupt (NAND_EVTER_STAT).  If there is only one,
              that interrupt reports both types of event.

- little-endian : If this property is absent, the big-endian mode will
                  be in use as default for registers.

- ranges : Each range corresponds to a single chipselect, and covers
           the entire access window as configured.

Child device nodes describe the devices connected to IFC such as NOR (e.g.
cfi-flash) and NAND (fsl,ifc-nand). There might be board specific devices
like FPGAs, CPLDs, etc.

Example:

	ifc@ffe1e000 {
		compatible = "fsl,ifc", "simple-bus";
		#address-cells = <2>;
		#size-cells = <1>;
		reg = <0x0 0xffe1e000 0 0x2000>;
		interrupts = <16 2 19 2>;
		little-endian;

		/* NOR, NAND Flashes and CPLD on board */
		ranges = <0x0 0x0 0x0 0xee000000 0x02000000
			  0x1 0x0 0x0 0xffa00000 0x00010000
			  0x3 0x0 0x0 0xffb00000 0x00020000>;

		flash@0,0 {
			#address-cells = <1>;
			#size-cells = <1>;
			compatible = "cfi-flash";
			reg = <0x0 0x0 0x2000000>;
			bank-width = <2>;
			device-width = <1>;

			partition@0 {
				/* 32MB for user data */
				reg = <0x0 0x02000000>;
				label = "NOR Data";
			};
		};

		flash@1,0 {
			#address-cells = <1>;
			#size-cells = <1>;
			compatible = "fsl,ifc-nand";
			reg = <0x1 0x0 0x10000>;

			partition@0 {
				/* This location must not be altered  */
				/* 1MB for u-boot Bootloader Image */
				reg = <0x0 0x00100000>;
				label = "NAND U-Boot Image";
				read-only;
			};
		};

		cpld@3,0 {
			#address-cells = <1>;
			#size-cells = <1>;
			compatible = "fsl,p1010rdb-cpld";
			reg = <0x3 0x0 0x000001f>;
		};
	};
```

## Documentation/devicetree/bindings/memory-controllers/fsl/imx8m-ddrc.yaml
```yaml
# SPDX-License-Identifier: GPL-2.0
%YAML 1.2
---
$id: http://devicetree.org/schemas/memory-controllers/fsl/imx8m-ddrc.yaml#
$schema: http://devicetree.org/meta-schemas/core.yaml#

title: i.MX8M DDR Controller

maintainers:
  - Peng Fan <peng.fan@nxp.com>

description:
  The DDRC block is integrated in i.MX8M for interfacing with DDR based
  memories.

  It supports switching between different frequencies at runtime but during
  this process RAM itself becomes briefly inaccessible so actual frequency
  switching is implemented by TF-A code which runs from a SRAM area.

  The Linux driver for the DDRC doesn't even map registers (they're included
  for the sake of "describing hardware"), it mostly just exposes firmware
  capabilities through standard Linux mechanism like devfreq and OPP tables.

properties:
  compatible:
    items:
      - enum:
          - fsl,imx8mn-ddrc
          - fsl,imx8mm-ddrc
          - fsl,imx8mq-ddrc
      - const: fsl,imx8m-ddrc

  reg:
    maxItems: 1
    description:
      Base address and size of DDRC CTL area.
      This is not currently mapped by the imx8m-ddrc driver.

  clocks:
    maxItems: 4

  clock-names:
    items:
      - const: core
      - const: pll
      - const: alt
      - const: apb

  operating-points-v2: true
  opp-table:
    type: object

required:
  - reg
  - compatible
  - clocks
  - clock-names

additionalProperties: false

examples:
  - |
    #include <dt-bindings/clock/imx8mm-clock.h>
    ddrc: memory-controller@3d400000 {
        compatible = "fsl,imx8mm-ddrc", "fsl,imx8m-ddrc";
        reg = <0x3d400000 0x400000>;
        clock-names = "core", "pll", "alt", "apb";
        clocks = <&clk IMX8MM_CLK_DRAM_CORE>,
                 <&clk IMX8MM_DRAM_PLL>,
                 <&clk IMX8MM_CLK_DRAM_ALT>,
                 <&clk IMX8MM_CLK_DRAM_APB>;
        operating-points-v2 = <&ddrc_opp_table>;
    };
```

## Documentation/devicetree/bindings/memory-controllers/fsl/mmdc.txt
```
Freescale Multi Mode DDR controller (MMDC)

Required properties :
- compatible : should be one of following:
	for i.MX6Q/i.MX6DL:
	- "fsl,imx6q-mmdc";
	for i.MX6QP:
	- "fsl,imx6qp-mmdc", "fsl,imx6q-mmdc";
	for i.MX6SL:
	- "fsl,imx6sl-mmdc", "fsl,imx6q-mmdc";
	for i.MX6SLL:
	- "fsl,imx6sll-mmdc", "fsl,imx6q-mmdc";
	for i.MX6SX:
	- "fsl,imx6sx-mmdc", "fsl,imx6q-mmdc";
	for i.MX6UL/i.MX6ULL/i.MX6ULZ:
	- "fsl,imx6ul-mmdc", "fsl,imx6q-mmdc";
	for i.MX7ULP:
	- "fsl,imx7ulp-mmdc", "fsl,imx6q-mmdc";
- reg : address and size of MMDC DDR controller registers

Optional properties :
- clocks : the clock provided by the SoC to access the MMDC registers

Example :
	mmdc0: memory-controller@21b0000 { /* MMDC0 */
		compatible = "fsl,imx6q-mmdc";
		reg = <0x021b0000 0x4000>;
		clocks = <&clks IMX6QDL_CLK_MMDC_P0_IPG>;
	};

	mmdc1: memory-controller@21b4000 { /* MMDC1 */
		compatible = "fsl,imx6q-mmdc";
		reg = <0x021b4000 0x4000>;
		status = "disabled";
	};
```

## Documentation/devicetree/bindings/memory-controllers/fsl/mmdc.yaml
```yaml
# SPDX-License-Identifier: (GPL-2.0-only OR BSD-2-Clause)
%YAML 1.2
---
$id: http://devicetree.org/schemas/memory-controllers/fsl/mmdc.yaml#
$schema: http://devicetree.org/meta-schemas/core.yaml#

title: Freescale Multi Mode DDR controller (MMDC)

maintainers:
  - Shawn Guo <shawnguo@kernel.org>
  - Sascha Hauer <s.hauer@pengutronix.de>
  - Fabio Estevam <festevam@gmail.com>

properties:
  compatible:
    oneOf:
      - const: fsl,imx6q-mmdc
      - items:
          - enum:
              - fsl,imx6qp-mmdc
              - fsl,imx6sl-mmdc
              - fsl,imx6sll-mmdc
              - fsl,imx6sx-mmdc
              - fsl,imx6ul-mmdc
              - fsl,imx7ulp-mmdc
          - const: fsl,imx6q-mmdc

  reg:
    maxItems: 1

  clocks:
    maxItems: 1

required:
  - compatible
  - reg

additionalProperties: false

examples:
  - |
    #include <dt-bindings/clock/imx6qdl-clock.h>

    memory-controller@21b0000 {
        compatible = "fsl,imx6q-mmdc";
        reg = <0x021b0000 0x4000>;
        clocks = <&clks IMX6QDL_CLK_MMDC_P0_IPG>;
    };

    memory-controller@21b4000 {
        compatible = "fsl,imx6q-mmdc";
        reg = <0x021b4000 0x4000>;
    };
```

## Documentation/devicetree/bindings/memory-controllers/ingenic,jz4780-nemc.txt
```
* Ingenic JZ4780 NAND/external memory controller (NEMC)

This file documents the device tree bindings for the NEMC external memory
controller in Ingenic JZ4780

Required properties:
- compatible: Should be set to one of:
    "ingenic,jz4740-nemc" (JZ4740)
    "ingenic,jz4780-nemc" (JZ4780)
- reg: Should specify the NEMC controller registers location and length.
- clocks: Clock for the NEMC controller.
- #address-cells: Must be set to 2.
- #size-cells: Must be set to 1.
- ranges: A set of ranges for each bank describing the physical memory layout.
  Each should specify the following 4 integer values:

    <cs number> 0 <physical address of mapping> <size of mapping>

Each child of the NEMC node describes a device connected to the NEMC.

Required child node properties:
- reg: Should contain at least one register specifier, given in the following
  format:

    <cs number> <offset> <size>

  Multiple registers can be specified across multiple banks. This is needed,
  for example, for packaged NAND devices with multiple dies. Such devices
  should be grouped into a single node.

Optional child node properties:
- ingenic,nemc-bus-width: Specifies the bus width in bits. Defaults to 8 bits.
- ingenic,nemc-tAS: Address setup time in nanoseconds.
- ingenic,nemc-tAH: Address hold time in nanoseconds.
- ingenic,nemc-tBP: Burst pitch time in nanoseconds.
- ingenic,nemc-tAW: Access wait time in nanoseconds.
- ingenic,nemc-tSTRV: Static memory recovery time in nanoseconds.

If a child node references multiple banks in its "reg" property, the same value
for all optional parameters will be configured for all banks. If any optional
parameters are omitted, they will be left unchanged from whatever they are
configured to when the NEMC device is probed (which may be the reset value as
given in the hardware reference manual, or a value configured by the boot
loader).

Example (NEMC node with a NAND child device attached at CS1):

nemc: nemc@13410000 {
	compatible = "ingenic,jz4780-nemc";
	reg = <0x13410000 0x10000>;

	#address-cells = <2>;
	#size-cells = <1>;

	ranges = <1 0 0x1b000000 0x1000000
		  2 0 0x1a000000 0x1000000
		  3 0 0x19000000 0x1000000
		  4 0 0x18000000 0x1000000
		  5 0 0x17000000 0x1000000
		  6 0 0x16000000 0x1000000>;

	clocks = <&cgu JZ4780_CLK_NEMC>;

	nand: nand@1 {
		compatible = "ingenic,jz4780-nand";
		reg = <1 0 0x1000000>;

		ingenic,nemc-tAS = <10>;
		ingenic,nemc-tAH = <5>;
		ingenic,nemc-tBP = <10>;
		ingenic,nemc-tAW = <15>;
		ingenic,nemc-tSTRV = <100>;

		...
	};
};
```
