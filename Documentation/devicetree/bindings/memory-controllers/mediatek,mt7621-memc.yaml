## Documentation/devicetree/bindings/memory-controllers/nvidia,tegra20-emc.yaml
```yaml
# SPDX-License-Identifier: (GPL-2.0-only OR BSD-2-Clause)
%YAML 1.2
---
$id: http://devicetree.org/schemas/memory-controllers/nvidia,tegra20-emc.yaml#
$schema: http://devicetree.org/meta-schemas/core.yaml#

title: NVIDIA Tegra20 SoC External Memory Controller

maintainers:
  - Dmitry Osipenko <digetx@gmail.com>
  - Jon Hunter <jonathanh@nvidia.com>
  - Thierry Reding <thierry.reding@gmail.com>

description: |
  The External Memory Controller (EMC) interfaces with the off-chip SDRAM to
  service the request stream sent from Memory Controller. The EMC also has
  various performance-affecting settings beyond the obvious SDRAM configuration
  parameters and initialization settings. Tegra20 EMC supports multiple JEDEC
  standard protocols: DDR1, LPDDR2 and DDR2.

properties:
  compatible:
    const: nvidia,tegra20-emc

  reg:
    maxItems: 1

  clocks:
    maxItems: 1

  interrupts:
    maxItems: 1

  "#address-cells":
    const: 1

  "#size-cells":
    const: 0

  "#interconnect-cells":
    const: 0

  nvidia,memory-controller:
    $ref: /schemas/types.yaml#/definitions/phandle
    description:
      Phandle of the Memory Controller node.

  power-domains:
    maxItems: 1
    description:
      Phandle of the SoC "core" power domain.

  operating-points-v2:
    description:
      Should contain freqs and voltages and opp-supported-hw property, which
      is a bitfield indicating SoC process ID mask.

  nvidia,use-ram-code:
    type: boolean
    description:
      If present, the emc-tables@ sub-nodes will be addressed.

$defs:
  emc-table:
    type: object
    properties:
      compatible:
        const: nvidia,tegra20-emc-table

      clock-frequency:
        description:
          Memory clock rate in kHz.
        minimum: 1000
        maximum: 900000

      reg:
        maxItems: 1
        description:
          Either an opaque enumerator to tell different tables apart, or
          the valid frequency for which the table should be used (in kHz).

      nvidia,emc-registers:
        description:
          EMC timing characterization data. These are the registers
          (see section "15.4.1 EMC Registers" in the TRM) whose values
          need to be specified, according to the board documentation.
        $ref: /schemas/types.yaml#/definitions/uint32-array
        items:
          - description: EMC_RC
          - description: EMC_RFC
          - description: EMC_RAS
          - description: EMC_RP
          - description: EMC_R2W
          - description: EMC_W2R
          - description: EMC_R2P
          - description: EMC_W2P
          - description: EMC_RD_RCD
          - description: EMC_WR_RCD
          - description: EMC_RRD
          - description: EMC_REXT
          - description: EMC_WDV
          - description: EMC_QUSE
          - description: EMC_QRST
          - description: EMC_QSAFE
          - description: EMC_RDV
          - description: EMC_REFRESH
          - description: EMC_BURST_REFRESH_NUM
          - description: EMC_PDEX2WR
          - description: EMC_PDEX2RD
          - description: EMC_PCHG2PDEN
          - description: EMC_ACT2PDEN
          - description: EMC_AR2PDEN
          - description: EMC_RW2PDEN
          - description: EMC_TXSR
          - description: EMC_TCKE
          - description: EMC_TFAW
          - description: EMC_TRPAB
          - description: EMC_TCLKSTABLE
          - description: EMC_TCLKSTOP
          - description: EMC_TREFBW
          - description: EMC_QUSE_EXTRA
          - description: EMC_FBIO_CFG6
          - description: EMC_ODT_WRITE
          - description: EMC_ODT_READ
          - description: EMC_FBIO_CFG5
          - description: EMC_CFG_DIG_DLL
          - description: EMC_DLL_XFORM_DQS
          - description: EMC_DLL_XFORM_QUSE
          - description: EMC_ZCAL_REF_CNT
          - description: EMC_ZCAL_WAIT_CNT
          - description: EMC_AUTO_CAL_INTERVAL
          - description: EMC_CFG_CLKTRIM_0
          - description: EMC_CFG_CLKTRIM_1
          - description: EMC_CFG_CLKTRIM_2

    required:
      - clock-frequency
      - compatible
      - reg
      - nvidia,emc-registers

    additionalProperties: false

patternProperties:
  "^emc-table@[0-9]+$":
    $ref: "#/$defs/emc-table"

  "^emc-tables@[a-z0-9-]+$":
    type: object
    properties:
      reg:
        maxItems: 1
        description:
          An opaque enumerator to tell different tables apart.

      nvidia,ram-code:
        $ref: /schemas/types.yaml#/definitions/uint32
        description:
          Value of RAM_CODE this timing set is used for.

      "#address-cells":
        const: 1

      "#size-cells":
        const: 0

    patternProperties:
      "^emc-table@[0-9]+$":
        $ref: "#/$defs/emc-table"

    required:
      - nvidia,ram-code

    additionalProperties: false

required:
  - compatible
  - reg
  - interrupts
  - clocks
  - nvidia,memory-controller
  - "#interconnect-cells"
  - operating-points-v2

additionalProperties: false

examples:
  - |
    external-memory-controller@7000f400 {
        compatible = "nvidia,tegra20-emc";
        reg = <0x7000f400 0x400>;
        interrupts = <0 78 4>;
        clocks = <&clock_controller 57>;

        nvidia,memory-controller = <&mc>;
        operating-points-v2 = <&dvfs_opp_table>;
        power-domains = <&domain>;

        #interconnect-cells = <0>;
        #address-cells = <1>;
        #size-cells = <0>;

        nvidia,use-ram-code;

        emc-tables@0 {
            nvidia,ram-code = <0>;
            reg = <0>;

            #address-cells = <1>;
            #size-cells = <0>;

            emc-table@333000 {
                reg = <333000>;
                compatible = "nvidia,tegra20-emc-table";
                clock-frequency = <333000>;
                nvidia,emc-registers = <0x00000018 0x00000033
                        0x00000012 0x00000004 0x00000004 0x00000005
                        0x00000003 0x0000000c 0x00000006 0x00000006
                        0x00000003 0x00000001 0x00000004 0x00000005
                        0x00000004 0x00000009 0x0000000d 0x00000bff
                        0x00000000 0x00000003 0x00000003 0x00000006
                        0x00000006 0x00000001 0x00000011 0x000000c8
                        0x00000003 0x0000000e 0x00000007 0x00000008
                        0x00000002 0x00000000 0x00000000 0x00000002
                        0x00000000 0x00000000 0x00000083 0xf0440303
                        0x007fe010 0x00001414 0x00000000 0x00000000
                        0x00000000 0x00000000 0x00000000 0x00000000>;
            };
        };
    };
```

## Documentation/devicetree/bindings/memory-controllers/nvidia,tegra20-mc.txt
```
NVIDIA Tegra20 MC(Memory Controller)

Required properties:
- compatible : "nvidia,tegra20-mc-gart"
- reg : Should contain 2 register ranges: physical base address and length of
  the controller's registers and the GART aperture respectively.
- clocks: Must contain an entry for each entry in clock-names.
  See ../clocks/clock-bindings.txt for details.
- clock-names: Must include the following entries:
  - mc: the module's clock input
- interrupts : Should contain MC General interrupt.
- #reset-cells : Should be 1. This cell represents memory client module ID.
  The assignments may be found in header file <dt-bindings/memory/tegra20-mc.h>
  or in the TRM documentation.
- #iommu-cells: Should be 0. This cell represents the number of cells in an
  IOMMU specifier needed to encode an address. GART supports only a single
  address space that is shared by all devices, therefore no additional
  information needed for the address encoding.
- #interconnect-cells : Should be 1. This cell represents memory client.
  The assignments may be found in header file <dt-bindings/memory/tegra20-mc.h>.

Example:
	mc: memory-controller@7000f000 {
		compatible = "nvidia,tegra20-mc-gart";
		reg = <0x7000f000 0x400		/* controller registers */
		       0x58000000 0x02000000>;	/* GART aperture */
		clocks = <&tegra_car TEGRA20_CLK_MC>;
		clock-names = "mc";
		interrupts = <GIC_SPI 77 0x04>;
		#reset-cells = <1>;
		#iommu-cells = <0>;
		#interconnect-cells = <1>;
	};

	video-codec@6001a000 {
		compatible = "nvidia,tegra20-vde";
		...
		resets = <&mc TEGRA20_MC_RESET_VDE>;
		iommus = <&mc>;
	};
```

## Documentation/devicetree/bindings/memory-controllers/nvidia,tegra20-mc.yaml
```yaml
# SPDX-License-Identifier: (GPL-2.0-only OR BSD-2-Clause)
%YAML 1.2
---
$id: http://devicetree.org/schemas/memory-controllers/nvidia,tegra20-mc.yaml#
$schema: http://devicetree.org/meta-schemas/core.yaml#

title: NVIDIA Tegra20 SoC Memory Controller

maintainers:
  - Dmitry Osipenko <digetx@gmail.com>
  - Jon Hunter <jonathanh@nvidia.com>
  - Thierry Reding <thierry.reding@gmail.com>

description: |
  The Tegra20 Memory Controller merges request streams from various client
  interfaces into request stream(s) for the various memory target devices,
  and returns response data to the various clients. The Memory Controller
  has a configurable arbitration algorithm to allow the user to fine-tune
  performance among the various clients.

  Tegra20 Memory Controller includes the GART (Graphics Address Relocation
  Table) which allows Memory Controller to provide a linear view of a
  fragmented memory pages.

properties:
  compatible:
    const: nvidia,tegra20-mc-gart

  reg:
    items:
      - description: controller registers
      - description: GART registers

  clocks:
    maxItems: 1

  clock-names:
    items:
      - const: mc

  interrupts:
    maxItems: 1

  "#reset-cells":
    const: 1

  "#iommu-cells":
    const: 0

  "#interconnect-cells":
    const: 1

required:
  - compatible
  - reg
  - interrupts
  - clocks
  - clock-names
  - "#reset-cells"
  - "#iommu-cells"
  - "#interconnect-cells"

additionalProperties: false

examples:
  - |
    memory-controller@7000f000 {
        compatible = "nvidia,tegra20-mc-gart";
        reg = <0x7000f000 0x400>,	/* Controller registers */
              <0x58000000 0x02000000>;	/* GART aperture */
        clocks = <&clock_controller 32>;
        clock-names = "mc";

        interrupts = <0 77 4>;

        #iommu-cells = <0>;
        #reset-cells = <1>;
        #interconnect-cells = <1>;
    };
```

## Documentation/devicetree/bindings/memory-controllers/nvidia,tegra210-emc.yaml
```yaml
# SPDX-License-Identifier: (GPL-2.0-only OR BSD-2-Clause)
%YAML 1.2
---
$id: http://devicetree.org/schemas/memory-controllers/nvidia,tegra210-emc.yaml#
$schema: http://devicetree.org/meta-schemas/core.yaml#

title: NVIDIA Tegra210 SoC External Memory Controller

maintainers:
  - Thierry Reding <thierry.reding@gmail.com>
  - Jon Hunter <jonathanh@nvidia.com>

description: |
  The EMC interfaces with the off-chip SDRAM to service the request stream
  sent from the memory controller.

properties:
  compatible:
    const: nvidia,tegra210-emc

  reg:
    maxItems: 3

  clocks:
    items:
      - description: external memory clock

  clock-names:
    items:
      - const: emc

  interrupts:
    items:
      - description: EMC general interrupt

  "#interconnect-cells":
    const: 0

  memory-region:
    maxItems: 1
    description:
      phandle to a reserved memory region describing the table of EMC
      frequencies trained by the firmware

  nvidia,memory-controller:
    $ref: /schemas/types.yaml#/definitions/phandle
    description:
      phandle of the memory controller node

  operating-points-v2:
    description:
      Should contain freqs and voltages and opp-supported-hw property, which
      is a bitfield indicating SoC speedo ID mask.

required:
  - compatible
  - reg
  - clocks
  - clock-names
  - nvidia,memory-controller

additionalProperties: false

examples:
  - |
    #include <dt-bindings/clock/tegra210-car.h>
    #include <dt-bindings/interrupt-controller/arm-gic.h>

    reserved-memory {
        #address-cells = <1>;
        #size-cells = <1>;
        ranges;

        emc_table: emc-table@83400000 {
            compatible = "nvidia,tegra210-emc-table";
            reg = <0x83400000 0x10000>;
        };
    };

    external-memory-controller@7001b000 {
        compatible = "nvidia,tegra210-emc";
        reg = <0x7001b000 0x1000>,
              <0x7001e000 0x1000>,
              <0x7001f000 0x1000>;
        clocks = <&tegra_car TEGRA210_CLK_EMC>;
        clock-names = "emc";
        interrupts = <GIC_SPI 78 IRQ_TYPE_LEVEL_HIGH>;
        memory-region = <&emc_table>;
        nvidia,memory-controller = <&mc>;
        operating-points-v2 = <&dvfs_opp_table>;

        #interconnect-cells = <0>;
    };
```

## Documentation/devicetree/bindings/memory-controllers/nvidia,tegra210-mc.yaml
```yaml
# SPDX-License-Identifier: (GPL-2.0-only OR BSD-2-Clause)
%YAML 1.2
---
$id: http://devicetree.org/schemas/memory-controllers/nvidia,tegra210-mc.yaml#
$schema: http://devicetree.org/meta-schemas/core.yaml#

title: NVIDIA Tegra210 SoC Memory Controller

maintainers:
  - Thierry Reding <thierry.reding@gmail.com>
  - Jon Hunter <jonathanh@nvidia.com>

description: |
  The NVIDIA Tegra210 SoC features a 64 bit memory controller that is split
  into two 32 bit channels to support LPDDR3 and LPDDR4 with x16 subpartitions.
  The MC handles memory requests for 34-bit virtual addresses from internal
  clients and arbitrates among them to allocate memory bandwidth.

  Up to 8 GiB of physical memory can be supported. Security features such as
  encryption of traffic to and from DRAM via general security apertures are
  available for video and other secure applications.

properties:
  $nodename:
    pattern: "^memory-controller@[0-9a-f]+$"

  compatible:
    items:
      - enum:
          - nvidia,tegra210-mc

  reg:
    maxItems: 1

  interrupts:
    maxItems: 1

  clocks:
    items:
      - description: module clock

  clock-names:
    items:
      - const: mc

  "#iommu-cells":
    const: 1

  "#reset-cells":
    const: 1

required:
  - compatible
  - reg
  - interrupts
  - clocks
  - clock-names
  - "#iommu-cells"
  - "#reset-cells"

additionalProperties: false

examples:
  - |
    #include <dt-bindings/clock/tegra210-car.h>
    #include <dt-bindings/interrupt-controller/arm-gic.h>

    memory-controller@70019000 {
        compatible = "nvidia,tegra210-mc";
        reg = <0x70019000 0x1000>;
        interrupts = <GIC_SPI 77 IRQ_TYPE_LEVEL_HIGH>;
        clocks = <&tegra_car TEGRA210_CLK_MC>;
        clock-names = "mc";

        #iommu-cells = <1>;
        #reset-cells = <1>;
    };
```
