## Documentation/devicetree/bindings/mfd/ampere,smpro.yaml
```yaml
# SPDX-License-Identifier: (GPL-2.0-only OR BSD-2-Clause)
%YAML 1.2
---
$id: http://devicetree.org/schemas/mfd/ampere,smpro.yaml#
$schema: http://devicetree.org/meta-schemas/core.yaml#

title: Ampere Altra SMPro firmware driver

maintainers:
  - Quan Nguyen <quan@os.amperecomputing.com>

description: |
  Ampere Altra SMPro firmware may contain different blocks like hardware
  monitoring, error monitoring and other miscellaneous features.

properties:
  compatible:
    enum:
      - ampere,smpro

  reg:
    description:
      I2C device address.
    maxItems: 1

required:
  - compatible
  - reg

additionalProperties: false

examples:
  - |
    i2c {
        #address-cells = <1>;
        #size-cells = <0>;

        smpro@4f {
            compatible = "ampere,smpro";
            reg = <0x4f>;
        };
    };
```

## Documentation/devicetree/bindings/mfd/ams,as3711.yaml
```yaml
# SPDX-License-Identifier: (GPL-2.0-only OR BSD-2-Clause)
%YAML 1.2
---
$id: http://devicetree.org/schemas/mfd/ams,as3711.yaml#
$schema: http://devicetree.org/meta-schemas/core.yaml#

title: Austria MicroSystems AS3711 Quad Buck High Current PMIC with Charger

maintainers:
  - Guennadi Liakhovetski <guennadi.liakhovetski@linux.intel.com>

description:
  AS3711 is an I2C PMIC from Austria MicroSystems with multiple DC/DC and LDO
  power supplies, a battery charger and an RTC.  So far only bindings for the
  two step-up DC/DC converters are defined.

properties:
  compatible:
    const: ams,as3711

  reg:
    maxItems: 1

  backlight:
    description:
      Step-up converter configuration, to be used as a backlight source
    type: object
    additionalProperties: false
    properties:
      compatible:
        const: ams,as3711-bl

      su1-dev:
        description: Framebuffer phandle for the first step-up converter
        $ref: /schemas/types.yaml#/definitions/phandle

      su1-max-uA:
        description: Maximum current for the first step-up converter
        $ref: /schemas/types.yaml#/definitions/uint32

      su2-dev:
        description: Framebuffer phandle for the second step-up converter
        $ref: /schemas/types.yaml#/definitions/phandle

      su2-max-uA:
        description: Maximum current for the second step-up converter
        $ref: /schemas/types.yaml#/definitions/uint32

      su2-feedback-voltage:
        description: Second step-up converter uses voltage feedback
        type: boolean

      su2-feedback-curr1:
        description:
          Second step-up converter uses CURR1 input for current feedback
        type: boolean

      su2-feedback-curr2:
        description:
          Second step-up converter uses CURR2 input for current feedback
        type: boolean

      su2-feedback-curr3:
        description:
          Second step-up converter uses CURR3 input for current feedback
        type: boolean

      su2-feedback-curr-auto:
        description:
          Second step-up converter uses automatic current feedback selection
        type: boolean

      su2-fbprot-lx-sd4:
        description:
          Second step-up converter uses LX_SD4 for over-voltage protection
        type: boolean

      su2-fbprot-gpio2:
        description:
          Second step-up converter uses GPIO2 for over-voltage protection
        type: boolean

      su2-fbprot-gpio3:
        description:
          Second step-up converter uses GPIO3 for over-voltage protection
        type: boolean

      su2-fbprot-gpio4:
        description:
          Second step-up converter uses GPIO4 for over-voltage protection
        type: boolean

      su2-auto-curr1:
        description:
          Second step-up converter uses CURR1 input for automatic current
          feedback
        type: boolean

      su2-auto-curr2:
        description:
          Second step-up converter uses CURR2 input for automatic current
          feedback
        type: boolean

      su2-auto-curr3:
        description:
          Second step-up converter uses CURR3 input for automatic current
          feedback
        type: boolean

    required:
      - compatible

    dependentRequired:
      # To use the SU1 converter as a backlight source the following two
      # properties must be provided:
      su1-dev: [ su1-max-uA ]
      su1-max-uA: [ su1-dev ]

      # To use the SU2 converter as a backlight source the following two
      # properties must be provided:
      su2-dev: [ su2-max-uA ]
      su2-max-uA: [ su2-dev ]

      su2-feedback-voltage: [ su2-dev ]
      su2-feedback-curr1: [ su2-dev ]
      su2-feedback-curr2: [ su2-dev ]
      su2-feedback-curr3: [ su2-dev ]
      su2-feedback-curr-auto: [ su2-dev ]
      su2-fbprot-lx-sd4: [ su2-dev ]
      su2-fbprot-gpio2: [ su2-dev ]
      su2-fbprot-gpio3: [ su2-dev ]
      su2-fbprot-gpio4: [ su2-dev ]
      su2-auto-curr1: [ su2-feedback-curr-auto ]
      su2-auto-curr2: [ su2-feedback-curr-auto ]
      su2-auto-curr3: [ su2-feedback-curr-auto ]

    dependentSchemas:
      su2-dev:
        allOf:
          - oneOf:
              - required:
                  - su2-feedback-voltage
              - required:
                  - su2-feedback-curr1
              - required:
                  - su2-feedback-curr2
              - required:
                  - su2-feedback-curr3
              - required:
                  - su2-feedback-curr-auto
          - oneOf:
              - required:
                  - su2-fbprot-lx-sd4
              - required:
                  - su2-fbprot-gpio2
              - required:
                  - su2-fbprot-gpio3
              - required:
                  - su2-fbprot-gpio4

      su2-feedback-curr-auto:
        anyOf:
          - required:
              - su2-auto-curr1
          - required:
              - su2-auto-curr2
          - required:
              - su2-auto-curr3

  regulators:
    description: Other DC/DC and LDO supplies
    type: object
    unevaluatedProperties: false
    patternProperties:
      "^(sd[1-4]|ldo[1-8])$":
        type: object
        $ref: /schemas/regulator/regulator.yaml#
        unevaluatedProperties: false

required:
  - compatible
  - reg

additionalProperties: false

examples:
  - |
    i2c {
        #address-cells = <1>;
        #size-cells = <0>;

        pmic@40 {
            compatible = "ams,as3711";
            reg = <0x40>;

            regulators {
                sd4 {
                    regulator-name = "1.215V";
                    regulator-min-microvolt = <1215000>;
                    regulator-max-microvolt = <1235000>;
                };
                ldo2 {
                    regulator-name = "2.8V CPU";
                    regulator-min-microvolt = <2800000>;
                    regulator-max-microvolt = <2800000>;
                    regulator-always-on;
                    regulator-boot-on;
                };
            };

            backlight {
                compatible = "ams,as3711-bl";
                su2-dev = <&lcdc>;
                su2-max-uA = <36000>;
                su2-feedback-curr-auto;
                su2-fbprot-gpio4;
                su2-auto-curr1;
                su2-auto-curr2;
                su2-auto-curr3;
            };
        };
    };
```

## Documentation/devicetree/bindings/mfd/apple,smc.yaml
```yaml
# SPDX-License-Identifier: (GPL-2.0-only OR BSD-2-Clause)
%YAML 1.2
---
$id: http://devicetree.org/schemas/mfd/apple,smc.yaml#
$schema: http://devicetree.org/meta-schemas/core.yaml#

title: Apple Mac System Management Controller

maintainers:
  - Sven Peter <sven@kernel.org>

description:
  Apple Mac System Management Controller implements various functions
  such as GPIO, RTC, power, reboot.

properties:
  compatible:
    oneOf:
      - items:
          - const: apple,t6020-smc
          - const: apple,t8103-smc
      - items:
          - enum:
              # Do not add additional SoC to this list.
              - apple,t6000-smc
              - apple,t8103-smc
              - apple,t8112-smc
          - const: apple,smc

  reg:
    items:
      - description: SMC area
      - description: SRAM area

  reg-names:
    items:
      - const: smc
      - const: sram

  mboxes:
    maxItems: 1

  gpio:
    $ref: /schemas/gpio/apple,smc-gpio.yaml

  reboot:
    $ref: /schemas/power/reset/apple,smc-reboot.yaml

  rtc:
    $ref: /schemas/rtc/apple,smc-rtc.yaml

  hwmon:
    $ref: /schemas/hwmon/apple,smc-hwmon.yaml

additionalProperties: false

required:
  - compatible
  - reg
  - reg-names
  - mboxes

examples:
  - |
    soc {
      #address-cells = <2>;
      #size-cells = <2>;

      smc@23e400000 {
        compatible = "apple,t8103-smc", "apple,smc";
        reg = <0x2 0x3e400000 0x0 0x4000>,
               <0x2 0x3fe00000 0x0 0x100000>;
        reg-names = "smc", "sram";
        mboxes = <&smc_mbox>;

        smc_gpio: gpio {
          compatible = "apple,smc-gpio";
          gpio-controller;
          #gpio-cells = <2>;
        };

        reboot {
          compatible = "apple,smc-reboot";
          nvmem-cells = <&shutdown_flag>, <&boot_stage>,
                        <&boot_error_count>, <&panic_count>;
          nvmem-cell-names = "shutdown_flag", "boot_stage",
                             "boot_error_count", "panic_count";
        };

        rtc {
          compatible = "apple,smc-rtc";
          nvmem-cells = <&rtc_offset>;
          nvmem-cell-names = "rtc_offset";
       };

        hwmon {
          compatible = "apple,smc-hwmon";

          current-ID0R {
            apple,key-id = "ID0R";
            label = "AC Input Current";
          };

          fan-F0Ac {
            apple,key-id = "F0Ac";
            apple,fan-minimum = "F0Mn";
            apple,fan-maximum = "F0Mx";
            apple,fan-target = "F0Tg";
            apple,fan-mode = "F0Md";
            label = "Fan 1";
          };

          power-PSTR {
            apple,key-id = "PSTR";
            label = "Total System Power";
          };

          temperature-TW0P {
            apple,key-id = "TW0P";
            label = "WiFi/BT Module Temperature";
          };

          voltage-VD0R {
            apple,key-id = "VD0R";
            label = "AC Input Voltage";
          };
        };
      };
    };
```

## Documentation/devicetree/bindings/mfd/arizona.txt
```
Cirrus Logic/Wolfson Microelectronics Arizona class audio SoCs

These devices are audio SoCs with extensive digital capabilities and a range
of analogue I/O.

Required properties:

  - compatible : One of the following chip-specific strings:
        "cirrus,cs47l24"
        "wlf,wm5102"
        "wlf,wm5110"
        "wlf,wm8280"
        "wlf,wm8997"
        "wlf,wm8998"
        "wlf,wm1814"
        "wlf,wm1831"

  - reg : I2C slave address when connected using I2C, chip select number when
    using SPI.

  - interrupts : The interrupt line the /IRQ signal for the device is
    connected to.
  - interrupt-controller : Arizona class devices contain interrupt controllers
    and may provide interrupt services to other devices.
  - #interrupt-cells: the number of cells to describe an IRQ, this should be 2.
    The first cell is the IRQ number.
    The second cell is the flags, encoded as the trigger masks from
    Documentation/devicetree/bindings/interrupt-controller/interrupts.txt

  - gpio-controller : Indicates this device is a GPIO controller.
  - #gpio-cells : Must be 2. The first cell is the pin number and the
    second cell is used to specify optional parameters, see ../gpio/gpio.txt
    for details.

  - AVDD-supply, DBVDD1-supply, CPVDD-supply : Power supplies for the device,
    as covered in Documentation/devicetree/bindings/regulator/regulator.txt

  - DBVDD2-supply, DBVDD3-supply : Additional databus power supplies (wm5102,
    wm5110, wm8280, wm8998, wm1814)

  - SPKVDDL-supply, SPKVDDR-supply : Speaker driver power supplies (wm5102,
    wm5110, wm8280, wm8998, wm1814)

  - SPKVDD-supply : Speaker driver power supply (wm8997)

  - DCVDD-supply : Main power supply (cs47l24, wm1831)

  - MICVDD-supply : Microphone power supply (cs47l24, wm1831)

Optional properties:

  - reset-gpios : GPIO specifier for the GPIO controlling /RESET

  - clocks: Should reference the clocks supplied on MCLK1 and MCLK2
  - clock-names: Should contains two strings:
      "mclk1" for the clock supplied on MCLK1, recommended to be a high
      quality audio reference clock
      "mclk2" for the clock supplied on MCLK2, recommended to be an always on
      32k clock

  - wlf,gpio-defaults : A list of GPIO configuration register values. Defines
    for the appropriate values can found in <dt-bindings/mfd/arizona.txt>. If
    absent, no configuration of these registers is performed. If any entry has
    a value that is out of range for a 16 bit register then the chip default
    will be used. If present exactly five values must be specified.

  - DCVDD-supply, MICVDD-supply : Power supplies, only need to be specified if
    they are being externally supplied. As covered in
    Documentation/devicetree/bindings/regulator/regulator.txt
    (wm5102, wm5110, wm8280, wm8997, wm8998, wm1814)

Deprecated properties:

  - wlf,reset : GPIO specifier for the GPIO controlling /RESET

Also see child specific device properties:
  Regulator - ../regulator/arizona-regulator.txt
  Extcon    - ../extcon/extcon-arizona.txt
  Sound     - ../sound/wlf,arizona.txt

Example:

codec: wm5102@1a {
	compatible = "wlf,wm5102";
	reg = <0x1a>;
	interrupts = <347>;
	interrupt-controller;
	#interrupt-cells = <2>;
        interrupt-parent = <&gic>;

	gpio-controller;
	#gpio-cells = <2>;

	wlf,gpio-defaults = <
		ARIZONA_GP_FN_TXLRCLK
		ARIZONA_GP_DEFAULT
		ARIZONA_GP_DEFAULT
		ARIZONA_GP_DEFAULT
		ARIZONA_GP_DEFAULT
	>;
};
```

## Documentation/devicetree/bindings/mfd/arm,dev-platforms-syscon.yaml
```yaml
# SPDX-License-Identifier: (GPL-2.0-only OR BSD-2-Clause)
%YAML 1.2
---
$id: http://devicetree.org/schemas/mfd/arm,dev-platforms-syscon.yaml#
$schema: http://devicetree.org/meta-schemas/core.yaml#

title: Arm Ltd Developer Platforms System Controllers

maintainers:
  - Linus Walleij <linus.walleij@linaro.org>

description:
  The Arm Ltd Integrator, Realview, and Versatile families of developer
  platforms are contain various system controller blocks. Often these blocks
  are part of a daughterboard or motherboard module.

properties:
  compatible:
    oneOf:
      - items:
          - enum:
              - arm,integrator-ap-syscon
              - arm,integrator-cp-syscon
              - arm,integrator-sp-syscon
              - arm,im-pd1-syscon
          - const: syscon
      - items:
          - enum:
              - arm,core-module-integrator
              - arm,integrator-ap-syscon
              - arm,integrator-cp-syscon
              - arm,integrator-sp-syscon
              - arm,realview-eb-syscon
              - arm,realview-pb1176-syscon
              - arm,realview-pb11mp-syscon
              - arm,realview-pba8-syscon
              - arm,realview-pbx-syscon
              - arm,versatile-ib2-syscon
          - const: syscon
          - const: simple-mfd
      - items:
          - enum:
              - arm,realview-eb11mp-revb-syscon
              - arm,realview-eb11mp-revc-syscon
          - const: arm,realview-eb-syscon
          - const: syscon
          - const: simple-mfd

  reg:
    maxItems: 1

  ranges: true

  '#address-cells':
    const: 1

  '#size-cells':
    const: 1

required:
  - compatible
  - reg

additionalProperties:
  type: object

...
```
