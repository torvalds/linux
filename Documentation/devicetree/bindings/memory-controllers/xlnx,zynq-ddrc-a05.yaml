## Documentation/devicetree/bindings/memory-controllers/xlnx,zynq-ddrc-a05.yaml
```yaml
# SPDX-License-Identifier: GPL-2.0-only OR BSD-2-Clause
%YAML 1.2
---
$id: http://devicetree.org/schemas/memory-controllers/xlnx,zynq-ddrc-a05.yaml#
$schema: http://devicetree.org/meta-schemas/core.yaml#

title: Zynq A05 DDR Memory Controller

maintainers:
  - Krzysztof Kozlowski <krzk@kernel.org>
  - Michal Simek <michal.simek@amd.com>

description:
  The Zynq DDR ECC controller has an optional ECC support in half-bus width
  (16-bit) configuration. It is cappable of correcting single bit ECC errors
  and detecting double bit ECC errors.

properties:
  compatible:
    const: xlnx,zynq-ddrc-a05

  reg:
    maxItems: 1

required:
  - compatible
  - reg

additionalProperties: false

examples:
  - |
    memory-controller@f8006000 {
      compatible = "xlnx,zynq-ddrc-a05";
      reg = <0xf8006000 0x1000>;
    };
...
```

## Documentation/devicetree/bindings/memory-controllers/xlnx,zynqmp-ocmc-1.0.yaml
```yaml
# SPDX-License-Identifier: (GPL-2.0 OR BSD-2-Clause)
%YAML 1.2
---
$id: http://devicetree.org/schemas/memory-controllers/xlnx,zynqmp-ocmc-1.0.yaml#
$schema: http://devicetree.org/meta-schemas/core.yaml#

title: Xilinx Zynqmp OCM(On-Chip Memory) Controller

maintainers:
  - Shubhrajyoti Datta <shubhrajyoti.datta@amd.com>
  - Sai Krishna Potthuri <sai.krishna.potthuri@amd.com>

description: |
  The OCM supports 64-bit wide ECC functionality to detect multi-bit errors
  and recover from a single-bit memory fault.On a write, if all bytes are
  being written, the ECC is generated and written into the ECC RAM along with
  the write-data that is written into the data RAM. If one or more bytes are
  not written, then the read operation results in an correctable error or
  uncorrectable error.

properties:
  compatible:
    const: xlnx,zynqmp-ocmc-1.0

  reg:
    maxItems: 1

  interrupts:
    maxItems: 1

required:
  - compatible
  - reg
  - interrupts

additionalProperties: false

examples:
  - |
    #include <dt-bindings/interrupt-controller/arm-gic.h>
    memory-controller@ff960000 {
      compatible = "xlnx,zynqmp-ocmc-1.0";
      reg = <0xff960000 0x1000>;
      interrupts = <GIC_SPI 10 IRQ_TYPE_LEVEL_HIGH>;
    };
```

## Documentation/devicetree/bindings/memory.txt
```
* Memory binding

The /memory node provides basic information about the address and size
of the physical memory. This node is usually filled or updated by the
bootloader, depending on the actual memory configuration of the given
hardware.

The memory layout is described by the folllowing node:

memory {
	reg =  <(baseaddr1) (size1)
		(baseaddr2) (size2)
		...
		(baseaddrN) (sizeN)>;
};

baseaddrX:	the base address of the defined memory bank
sizeX:		the size of the defined memory bank

More than one memory bank can be defined.


* Memory regions

In /memory node one can create additional nodes describing particular
memory regions, usually for the special usage by various device drivers.
A good example are contiguous memory allocations or memory sharing with
other operating system on the same hardware board. Those special memory
regions might depend on the board configuration and devices used on the
target system.

Parameters for each memory region can be encoded into the device tree
wit the following convention:

(name): region@(base-address) {
	reg = <(baseaddr) (size)>;
	(linux,contiguous-region);
	(linux,default-contiguous-region);
};

name:		an name given to the defined region.
base-address:	the base address of the defined region.
size:		the size of the memory region.
linux,contiguous-region: property indicating that the defined memory
		region is used for contiguous memory allocations,
		Linux specific (optional)
linux,default-contiguous-region: property indicating that the region
		is the default region for all contiguous memory
		allocations, Linux specific (optional)


* Device nodes

Once the regions in the /memory node are defined, they can be assigned
to device some device nodes for their special use. The following
properties are defined:

linux,contiguous-region = <&phandle>;
	This property indicates that the device driver should use the
	memory region pointed by the given phandle.


* Example:

This example defines a memory consisting of 4 memory banks. 2 contiguous
regions are defined for Linux kernel, one default of all device drivers
(named contig_mem, placed at 0x72000000, 64MiB) and one dedicated to the
framebuffer device (named display_mem, placed at 0x78000000, 16MiB). The
display_mem region is then assigned to fb at 12300000 device for contiguous
memory allocation with Linux kernel drivers.

The reason for creating a separate region for framebuffer device is to
match the framebuffer address of from configuration done by bootloader,
so once Linux kernel drivers starts, no glitches on the displayed boot
logo appears.

/ {
	/* ... */
	memory {
		reg =  <0x40000000 0x10000000
			0x50000000 0x10000000
			0x60000000 0x10000000
			0x70000000 0x10000000>;

		contig_mem: region at 72000000 {
			linux,contiguous-region;
			linux,default-contiguous-region;
			reg = <0x72000000 0x4000000>;
		};

		display_mem: region at 78000000 {
			linux,contiguous-region;
			reg = <0x78000000 0x1000000>;
		};
	};

	fb at 12300000 {
		linux,contiguous-region = <&display_mem>;
		status = "okay";
	};
};
```

## Documentation/devicetree/bindings/metag/meta.txt
```
* Meta Processor Binding

This binding specifies what properties must be available in the device tree
representation of a Meta Processor Core, which is the root node in the tree.

Required properties:

    - compatible: Specifies the compatibility list for the Meta processor.
      The type shall be <string> and the value shall include "img,meta".

Optional properties:

    - clocks: Clock consumer specifiers as described in
      Documentation/devicetree/bindings/clock/clock-bindings.txt

    - clock-names: Clock consumer names as described in
      Documentation/devicetree/bindings/clock/clock-bindings.txt.

Clocks are identified by name. Valid clocks are:

    - "core": The Meta core clock from which the Meta timers are derived.

* Examples

/ {
	compatible = "toumaz,tz1090", "img,meta";

	clocks = <&meta_core_clk>;
	clock-names = "core";
};
```

## Documentation/devicetree/bindings/mfd/88pm860x.txt
```
* Marvell 88PM860x Power Management IC

Required parent device properties:
- compatible : "marvell,88pm860x"
- reg : the I2C slave address for the 88pm860x chip
- interrupts : IRQ line for the 88pm860x chip
- interrupt-controller: describes the 88pm860x as an interrupt controller (has its own domain)
- #interrupt-cells : should be 1.
		- The cell is the 88pm860x local IRQ number

Optional parent device properties:
- marvell,88pm860x-irq-read-clr: inicates whether interrupt status is cleared by read
- marvell,88pm860x-slave-addr: 88pm860x are two chips solution. <reg> stores the I2C address
				of one chip, and this property stores the I2C address of
				another chip.

88pm860x consists of a large and varied group of sub-devices:

Device			 Supply Names	 Description
------			 ------------	 -----------
88pm860x-onkey		:		: On key
88pm860x-rtc		:		: RTC
88pm8607		:		: Regulators
88pm860x-backlight	:		: Backlight
88pm860x-led		:		: Led
88pm860x-touch		:		: Touchscreen

Example:

	pmic: 88pm860x@34 {
		compatible = "marvell,88pm860x";
		reg = <0x34>;
		interrupts = <4>;
		interrupt-parent = <&intc>;
		interrupt-controller;
		#interrupt-cells = <1>;

		marvell,88pm860x-irq-read-clr;
		marvell,88pm860x-slave-addr = <0x11>;

		regulators {
			BUCK1 {
				regulator-min-microvolt = <1000000>;
				regulator-max-microvolt = <1500000>;
				regulator-boot-on;
				regulator-always-on;
			};
			LDO1 {
				regulator-min-microvolt = <1200000>;
				regulator-max-microvolt = <2800000>;
				regulator-boot-on;
				regulator-always-on;
			};
		};
		rtc {
			marvell,88pm860x-vrtc = <1>;
		};
		touch {
			marvell,88pm860x-gpadc-prebias = <1>;
			marvell,88pm860x-gpadc-slot-cycle = <1>;
			marvell,88pm860x-tsi-prebias = <6>;
			marvell,88pm860x-pen-prebias = <16>;
			marvell,88pm860x-pen-prechg = <2>;
			marvell,88pm860x-resistor-X = <300>;
		};
		backlights {
			backlight-0 {
				marvell,88pm860x-iset = <4>;
				marvell,88pm860x-pwm = <3>;
			};
			backlight-2 {
			};
		};
		leds {
			led0-red {
				marvell,88pm860x-iset = <12>;
			};
			led0-green {
				marvell,88pm860x-iset = <12>;
			};
			led0-blue {
				marvell,88pm860x-iset = <12>;
			};
		};
	};
```

## Documentation/devicetree/bindings/mfd/a10sycon.txt
```
* Altera Arria10 System Control IC

Required parent device properties:
- compatible : "altr,a10sycon"
- spi-max-frequency : Maximum SPI frequency.
- reg : the SPI Chip Select address for the Arria10 System Controller chip
- interrupts : IRQ line for the Arria10 System Controller chip
- interrupt-controller: describes the Arria10 System Controller as an
  interrupt controller  (has its own domain)
- interrupt-parent: The GPIO line that is used for key interrupts.
- #interrupt-cells : should be 2.

The A10SyCon consists of this varied group of sub-devices:

Device			 Supply Names	 Description
------			 ------------	 -----------
a10sycon-gpio		:		: GPIO Controller
a10sycon-hwmon		:		: Hardware Monitor
a10sycon-reset		:		: Reset Manager

The input key and LEDs are implemented entirely in the device tree using
the gpio-leds and gpio-keys frameworks.

Example:

        a10_sysctl: a10_sysctl@0 {
		compatible = "altr,a10sycon";
		reg = <0>;
		interrupt-parent = <&gpio1>;
		/* low-level active IRQ at GPIO1_5 */
		interrupts = <5 0x8>;
		interrupt-controller;
		#interrupt-cells = <2>;
		spi-max-frequency = <100000>;

		gpio4: gpio-controller {
			compatible = "altr,a10sycon-gpio";
			gpio-controller;
			#gpio-cells = <2>;
			ngpios = <16>;
		};

		hwmon: a10hwmon {
			compatible = "altr,a10sycon-hwmon";
		};

		a10rst: a10rst {
			compatible = "altr,a10sycon-reset";
			#reset-cells = <1>;
		};
	};
```
