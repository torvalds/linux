## Documentation/devicetree/bindings/memory-controllers/samsung,exynos5422-dmc.yaml
```yaml
# SPDX-License-Identifier: GPL-2.0
%YAML 1.2
---
$id: http://devicetree.org/schemas/memory-controllers/samsung,exynos5422-dmc.yaml#
$schema: http://devicetree.org/meta-schemas/core.yaml#

title: |
  Samsung Exynos5422 SoC frequency and voltage scaling for Dynamic Memory
  Controller device

maintainers:
  - Krzysztof Kozlowski <krzk@kernel.org>
  - Lukasz Luba <lukasz.luba@arm.com>

description: |
  The Samsung Exynos5422 SoC has DMC (Dynamic Memory Controller) to which the
  DRAM memory chips are connected. The driver is to monitor the controller in
  runtime and switch frequency and voltage. To monitor the usage of the
  controller in runtime, the driver uses the PPMU (Platform Performance
  Monitoring Unit), which is able to measure the current load of the memory.
  When 'userspace' governor is used for the driver, an application is able to
  switch the DMC and memory frequency.

properties:
  compatible:
    items:
      - const: samsung,exynos5422-dmc

  clock-names:
    items:
      - const: fout_spll
      - const: mout_sclk_spll
      - const: ff_dout_spll2
      - const: fout_bpll
      - const: mout_bpll
      - const: sclk_bpll
      - const: mout_mx_mspll_ccore
      - const: mout_mclk_cdrex

  clocks:
    minItems: 8
    maxItems: 8

  devfreq-events:
    $ref: '/schemas/types.yaml#/definitions/phandle-array'
    minItems: 1
    maxItems: 16
    items:
      maxItems: 1
    description: phandles of the PPMU events used by the controller.

  device-handle:
    $ref: '/schemas/types.yaml#/definitions/phandle'
    description: |
      phandle of the connected DRAM memory device. For more information please
      refer to jedec,lpddr3.yaml.

  operating-points-v2: true

  interrupts:
    items:
      - description: DMC internal performance event counters in DREX0
      - description: DMC internal performance event counters in DREX1

  interrupt-names:
    items:
      - const: drex_0
      - const: drex_1

  reg:
    items:
      - description: registers of DREX0
      - description: registers of DREX1

  samsung,syscon-clk:
    $ref: '/schemas/types.yaml#/definitions/phandle'
    description: |
      Phandle of the clock register set used by the controller, these registers
      are used for enabling a 'pause' feature and are not exposed by clock
      framework but they must be used in a safe way.  The register offsets are
      in the driver code and specyfic for this SoC type.

  vdd-supply: true

required:
  - compatible
  - clock-names
  - clocks
  - devfreq-events
  - device-handle
  - reg
  - samsung,syscon-clk

additionalProperties: false

examples:
  - |
    #include <dt-bindings/clock/exynos5420.h>
    ppmu_dmc0_0: ppmu@10d00000 {
        compatible = "samsung,exynos-ppmu";
        reg = <0x10d00000 0x2000>;
        clocks = <&clock CLK_PCLK_PPMU_DREX0_0>;
        clock-names = "ppmu";
        events {
            ppmu_event_dmc0_0: ppmu-event3-dmc0-0 {
                event-name = "ppmu-event3-dmc0_0";
            };
        };
    };

    memory-controller@10c20000 {
        compatible = "samsung,exynos5422-dmc";
        reg = <0x10c20000 0x10000>, <0x10c30000 0x10000>;
        clocks = <&clock CLK_FOUT_SPLL>,
                 <&clock CLK_MOUT_SCLK_SPLL>,
                 <&clock CLK_FF_DOUT_SPLL2>,
                 <&clock CLK_FOUT_BPLL>,
                 <&clock CLK_MOUT_BPLL>,
                 <&clock CLK_SCLK_BPLL>,
                 <&clock CLK_MOUT_MX_MSPLL_CCORE>,
                 <&clock CLK_MOUT_MCLK_CDREX>;
        clock-names = "fout_spll",
                      "mout_sclk_spll",
                      "ff_dout_spll2",
                      "fout_bpll",
                      "mout_bpll",
                      "sclk_bpll",
                      "mout_mx_mspll_ccore",
                      "mout_mclk_cdrex";
        operating-points-v2 = <&dmc_opp_table>;
        devfreq-events = <&ppmu_event3_dmc0_0>,	<&ppmu_event3_dmc0_1>,
                         <&ppmu_event3_dmc1_0>, <&ppmu_event3_dmc1_1>;
        device-handle = <&samsung_K3QF2F20DB>;
        vdd-supply = <&buck1_reg>;
        samsung,syscon-clk = <&clock>;
        interrupt-parent = <&combiner>;
        interrupts = <16 0>, <16 1>;
        interrupt-names = "drex_0", "drex_1";
    };
```

## Documentation/devicetree/bindings/memory-controllers/samsung,s5pv210-dmc.yaml
```yaml
# SPDX-License-Identifier: GPL-2.0-only OR BSD-2-Clause
%YAML 1.2
---
$id: http://devicetree.org/schemas/memory-controllers/samsung,s5pv210-dmc.yaml#
$schema: http://devicetree.org/meta-schemas/core.yaml#

title: Samsung S5Pv210 SoC Dynamic Memory Controller

maintainers:
  - Krzysztof Kozlowski <krzk@kernel.org>

description:
  Dynamic Memory Controller interfaces external JEDEC DDR-type SDRAM.

properties:
  compatible:
    const: samsung,s5pv210-dmc

  reg:
    maxItems: 1

required:
  - compatible
  - reg

additionalProperties: false

examples:
  - |
    memory-controller@f0000000 {
        compatible = "samsung,s5pv210-dmc";
        reg = <0xf0000000 0x1000>;
    };
```

## Documentation/devicetree/bindings/memory-controllers/snps,dw-umctl2-ddrc.yaml
```yaml
# SPDX-License-Identifier: GPL-2.0-only
%YAML 1.2
---
$id: http://devicetree.org/schemas/memory-controllers/snps,dw-umctl2-ddrc.yaml#
$schema: http://devicetree.org/meta-schemas/core.yaml#

title: Synopsys DesignWare Universal Multi-Protocol Memory Controller

maintainers:
  - Krzysztof Kozlowski <krzk@kernel.org>
  - Manish Narani <manish.narani@xilinx.com>
  - Michal Simek <michal.simek@xilinx.com>

description: |
  Synopsys DesignWare Enhanced uMCTL2 DDR Memory Controller is capable of
  working with the memory devices supporting up to (LP)DDR4 protocol. It can
  be equipped with SEC/DEC ECC feature if DRAM data bus width is either
  16-bits or 32-bits or 64-bits wide.

  For instance the ZynqMP DDR controller is based on the DW uMCTL2 v2.40a
  controller. It has an optional SEC/DEC ECC support in 64- and 32-bits
  bus width configurations.

properties:
  compatible:
    oneOf:
      - deprecated: true
        description: Synopsys DW uMCTL2 DDR controller v3.80a
        const: snps,ddrc-3.80a
      - description: Synopsys DW uMCTL2 DDR controller
        const: snps,dw-umctl2-ddrc
      - description: Xilinx ZynqMP DDR controller v2.40a
        const: xlnx,zynqmp-ddrc-2.40a

  interrupts:
    description:
      DW uMCTL2 DDRC IP-core provides individual IRQ signal for each event":"
      ECC Corrected Error, ECC Uncorrected Error, ECC Address Protection,
      Scrubber-Done signal, DFI Parity/CRC Error. Some platforms may have the
      signals merged before they reach the IRQ controller or have some of them
      absent in case if the corresponding feature is unavailable/disabled.
    minItems: 1
    maxItems: 5

  interrupt-names:
    minItems: 1
    maxItems: 5
    oneOf:
      - description: Common ECC CE/UE/Scrubber/DFI Errors IRQ
        items:
          - const: ecc
      - description: Individual ECC CE/UE/Scrubber/DFI Errors IRQs
        items:
          enum: [ ecc_ce, ecc_ue, ecc_ap, ecc_sbr, dfi_e ]

  reg:
    maxItems: 1

  clocks:
    description:
      A standard set of the clock sources contains CSRs bus clock, AXI-ports
      reference clock, DDRC core clock, Scrubber standalone clock
      (synchronous to the DDRC clock).
    minItems: 1
    maxItems: 4

  clock-names:
    minItems: 1
    maxItems: 4
    items:
      enum: [ pclk, aclk, core, sbr ]

  resets:
    description:
      Each clock domain can have separate reset signal.
    minItems: 1
    maxItems: 4

  reset-names:
    minItems: 1
    maxItems: 4
    items:
      enum: [ prst, arst, core, sbr ]

required:
  - compatible
  - reg
  - interrupts

additionalProperties: false

examples:
  - |
    #include <dt-bindings/interrupt-controller/arm-gic.h>

    memory-controller@fd070000 {
      compatible = "xlnx,zynqmp-ddrc-2.40a";
      reg = <0xfd070000 0x30000>;

      interrupt-parent = <&gic>;
      interrupts = <GIC_SPI 112 IRQ_TYPE_LEVEL_HIGH>;
      interrupt-names = "ecc";
    };
  - |
    #include <dt-bindings/interrupt-controller/irq.h>

    memory-controller@3d400000 {
      compatible = "snps,dw-umctl2-ddrc";
      reg = <0x3d400000 0x400000>;

      interrupts = <147 IRQ_TYPE_LEVEL_HIGH>, <148 IRQ_TYPE_LEVEL_HIGH>,
                   <149 IRQ_TYPE_LEVEL_HIGH>, <150 IRQ_TYPE_LEVEL_HIGH>;
      interrupt-names = "ecc_ce", "ecc_ue", "ecc_sbr", "dfi_e";

      clocks = <&pclk>, <&aclk>, <&core_clk>, <&sbr_clk>;
      clock-names = "pclk", "aclk", "core", "sbr";
    };
...
```

## Documentation/devicetree/bindings/memory-controllers/st,stm32-fmc2-ebi-props.yaml
```yaml
# SPDX-License-Identifier: (GPL-2.0 OR BSD-2-Clause)
%YAML 1.2
---
$id: http://devicetree.org/schemas/memory-controllers/st,stm32-fmc2-ebi-props.yaml#
$schema: http://devicetree.org/meta-schemas/core.yaml#

title: Peripheral properties for ST FMC2 Controller

maintainers:
  - Christophe Kerello <christophe.kerello@foss.st.com>
  - Marek Vasut <marex@denx.de>

properties:
  st,fmc2-ebi-cs-transaction-type:
    description: |
      Select one of the transactions type supported
      0: Asynchronous mode 1 SRAM/FRAM.
      1: Asynchronous mode 1 PSRAM.
      2: Asynchronous mode A SRAM/FRAM.
      3: Asynchronous mode A PSRAM.
      4: Asynchronous mode 2 NOR.
      5: Asynchronous mode B NOR.
      6: Asynchronous mode C NOR.
      7: Asynchronous mode D NOR.
      8: Synchronous read synchronous write PSRAM.
      9: Synchronous read asynchronous write PSRAM.
      10: Synchronous read synchronous write NOR.
      11: Synchronous read asynchronous write NOR.
    $ref: /schemas/types.yaml#/definitions/uint32
    minimum: 0
    maximum: 11

  st,fmc2-ebi-cs-cclk-enable:
    description: Continuous clock enable (first bank must be configured
      in synchronous mode). The FMC_CLK is generated continuously
      during asynchronous and synchronous access. By default, the
      FMC_CLK is only generated during synchronous access.
    $ref: /schemas/types.yaml#/definitions/flag

  st,fmc2-ebi-cs-mux-enable:
    description: Address/Data multiplexed on databus (valid only with
      NOR and PSRAM transactions type). By default, Address/Data
      are not multiplexed.
    $ref: /schemas/types.yaml#/definitions/flag

  st,fmc2-ebi-cs-buswidth:
    description: Data bus width
    $ref: /schemas/types.yaml#/definitions/uint32
    enum: [ 8, 16 ]
    default: 16

  st,fmc2-ebi-cs-waitpol-high:
    description: Wait signal polarity (NWAIT signal active high).
      By default, NWAIT is active low.
    $ref: /schemas/types.yaml#/definitions/flag

  st,fmc2-ebi-cs-waitcfg-enable:
    description: The NWAIT signal indicates wheither the data from the
      device are valid or if a wait state must be inserted when accessing
      the device in synchronous mode. By default, the NWAIT signal is
      active one data cycle before wait state.
    $ref: /schemas/types.yaml#/definitions/flag

  st,fmc2-ebi-cs-wait-enable:
    description: The NWAIT signal is enabled (its level is taken into
      account after the programmed latency period to insert wait states
      if asserted). By default, the NWAIT signal is disabled.
    $ref: /schemas/types.yaml#/definitions/flag

  st,fmc2-ebi-cs-asyncwait-enable:
    description: The NWAIT signal is taken into account during asynchronous
      transactions. By default, the NWAIT signal is not taken into account
      during asynchronous transactions.
    $ref: /schemas/types.yaml#/definitions/flag

  st,fmc2-ebi-cs-cpsize:
    description: CRAM page size. The controller splits the burst access
      when the memory page is reached. By default, no burst split when
      crossing page boundary.
    $ref: /schemas/types.yaml#/definitions/uint32
    enum: [ 0, 128, 256, 512, 1024 ]
    default: 0

  st,fmc2-ebi-cs-byte-lane-setup-ns:
    description: This property configures the byte lane setup timing
      defined in nanoseconds from NBLx low to Chip Select NEx low.

  st,fmc2-ebi-cs-address-setup-ns:
    description: This property defines the duration of the address setup
      phase in nanoseconds used for asynchronous read/write transactions.

  st,fmc2-ebi-cs-address-hold-ns:
    description: This property defines the duration of the address hold
      phase in nanoseconds used for asynchronous multiplexed read/write
      transactions.

  st,fmc2-ebi-cs-data-setup-ns:
    description: This property defines the duration of the data setup phase
      in nanoseconds used for asynchronous read/write transactions.

  st,fmc2-ebi-cs-bus-turnaround-ns:
    description: This property defines the delay in nanoseconds between the
      end of current read/write transaction and the next transaction.

  st,fmc2-ebi-cs-data-hold-ns:
    description: This property defines the duration of the data hold phase
      in nanoseconds used for asynchronous read/write transactions.

  st,fmc2-ebi-cs-clk-period-ns:
    description: This property defines the FMC_CLK output signal period in
      nanoseconds.

  st,fmc2-ebi-cs-data-latency-ns:
    description: This property defines the data latency before reading or
      writing the first data in nanoseconds.

  st,fmc2-ebi-cs-write-address-setup-ns:
    description: This property defines the duration of the address setup
      phase in nanoseconds used for asynchronous write transactions.

  st,fmc2-ebi-cs-write-address-hold-ns:
    description: This property defines the duration of the address hold
      phase in nanoseconds used for asynchronous multiplexed write
      transactions.

  st,fmc2-ebi-cs-write-data-setup-ns:
    description: This property defines the duration of the data setup
      phase in nanoseconds used for asynchronous write transactions.

  st,fmc2-ebi-cs-write-bus-turnaround-ns:
    description: This property defines the delay between the end of current
      write transaction and the next transaction in nanoseconds.

  st,fmc2-ebi-cs-write-data-hold-ns:
    description: This property defines the duration of the data hold phase
      in nanoseconds used for asynchronous write transactions.

  st,fmc2-ebi-cs-max-low-pulse-ns:
    description: This property defines the maximum chip select low pulse
      duration in nanoseconds for synchronous transactions. When this timing
      reaches 0, the controller splits the current access, toggles NE to
      allow device refresh and restarts a new access.

additionalProperties: true
```
