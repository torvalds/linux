## Documentation/devicetree/bindings/memory-controllers/ti-aemif.txt
```
* Device tree bindings for Texas instruments AEMIF controller

The Async External Memory Interface (EMIF16/AEMIF) controller is intended to
provide a glue-less interface to a variety of asynchronous memory devices like
ASRA M, NOR and NAND memory. A total of 256M bytes of any of these memories
can be accessed at any given time via four chip selects with 64M byte access
per chip select. Synchronous memories such as DDR1 SD RAM, SDR SDRAM
and Mobile SDR are not supported.

Documentation:
Davinci DM646x - http://www.ti.com/lit/ug/sprueq7c/sprueq7c.pdf
OMAP-L138 (DA850) - http://www.ti.com/lit/ug/spruh77a/spruh77a.pdf
Kestone - http://www.ti.com/lit/ug/sprugz3a/sprugz3a.pdf

Required properties:

- compatible:		"ti,davinci-aemif"
			"ti,keystone-aemif"
			"ti,da850-aemif"

- reg:			contains offset/length value for AEMIF control registers
			space.

- #address-cells:	Must be 2. The partition number has to be encoded in the
			first address cell and it may accept values 0..N-1
			(N - total number of partitions). It's recommended to
			assign N-1 number for the control partition. The second
			cell is the offset into the partition.

- #size-cells:		Must be set to 1.

- ranges:		Contains memory regions. There are two types of
			ranges/partitions:
			- CS-specific partition/range. If continuous, must be
			set up to reflect the memory layout for 4 chipselects,
			if not then additional range/partition can be added and
			child device can select the proper one.
			- control partition which is common for all CS
			interfaces.

- clocks:		the clock feeding the controller clock. Required only
			if clock tree data present in device tree.
			See clock-bindings.txt

- clock-names:		clock name. It has to be "aemif". Required only if clock
			tree data present in device tree, in another case don't
			use it.
			See clock-bindings.txt

- clock-ranges:		Empty property indicating that child nodes can inherit
			named clocks. Required only if clock tree data present
			in device tree.
			See clock-bindings.txt


Child chip-select (cs) nodes contain the memory devices nodes connected to
such as NOR (e.g. cfi-flash) and NAND (ti,davinci-nand, see davinci-nand.txt).
There might be board specific devices like FPGAs.

Required child cs node properties:

- #address-cells:	Must be 2.

- #size-cells:		Must be 1.

- ranges:		Empty property indicating that child nodes can inherit
			memory layout.

- clock-ranges:		Empty property indicating that child nodes can inherit
			named clocks. Required only if clock tree data present
			in device tree.

- ti,cs-chipselect:	number of chipselect. Indicates on the aemif driver
			which chipselect is used for accessing the memory. For
			compatibles "ti,davinci-aemif" and "ti,keystone-aemif"
			it can be in range [0-3]. For compatible
			"ti,da850-aemif" range is [2-5].

Optional child cs node properties:

- ti,cs-bus-width:		width of the asynchronous device's data bus
				8 or 16 if not preset 8

- ti,cs-select-strobe-mode:	enable/disable select strobe mode
				In select strobe mode chip select behaves as
				the strobe and is active only during the strobe
				period. If present then enable.

- ti,cs-extended-wait-mode:	enable/disable extended wait mode
				if set, the controller monitors the EMIFWAIT pin
				mapped to that chip select to determine if the
				device wants to extend the strobe period. If
				present then enable.

- ti,cs-min-turnaround-ns:	minimum turn around time, ns
				Time between the end of one asynchronous memory
				access and the start of another asynchronous
				memory access. This delay is not incurred
				between a read followed by read or a write
				followed by a write to same chip select.

- ti,cs-read-setup-ns:		read setup width, ns
				Time between the beginning of a memory cycle
				and the activation of read strobe.
				Minimum value is 1 (0 treated as 1).

- ti,cs-read-strobe-ns:		read strobe width, ns
				Time between the activation and deactivation of
				the read strobe.
				Minimum value is 1 (0 treated as 1).

- ti,cs-read-hold-ns:		read hold width, ns
				Time between the deactivation of the read
				strobe and the end of the cycle (which may be
				either an address change or the deactivation of
				the chip select signal.
				Minimum value is 1 (0 treated as 1).

- ti,cs-write-setup-ns:		write setup width, ns
				Time between the beginning of a memory cycle
				and the activation of write strobe.
				Minimum value is 1 (0 treated as 1).

- ti,cs-write-strobe-ns:	write strobe width, ns
				Time between the activation and deactivation of
				the write strobe.
				Minimum value is 1 (0 treated as 1).

- ti,cs-write-hold-ns:		write hold width, ns
				Time between the deactivation of the write
				strobe and the end of the cycle (which may be
				either an address change or the deactivation of
				the chip select signal.
				Minimum value is 1 (0 treated as 1).

If any of the above parameters are absent, current parameter value will be taken
from the corresponding HW reg.

Example for aemif, davinci nand and nor flash chip select shown below.

memory-controller@21000A00 {
	compatible = "ti,davinci-aemif";
	#address-cells = <2>;
	#size-cells = <1>;
	clocks = <&clkaemif 0>;
	clock-names = "aemif";
	clock-ranges;
	reg = <0x21000A00 0x00000100>;
	ranges = <0 0 0x70000000 0x10000000
		  1 0 0x21000A00 0x00000100>;
		  /*
		   * Partition0: CS-specific memory range which is
		   * implemented as continuous physical memory region
		   * Partition1: control memory range
		   */

	nand:cs2 {
		#address-cells = <2>;
		#size-cells = <1>;
		clock-ranges;
		ranges;

		ti,cs-chipselect = <2>;
		/* all timings in nanoseconds */
		ti,cs-min-turnaround-ns = <0>;
		ti,cs-read-hold-ns = <7>;
		ti,cs-read-strobe-ns = <42>;
		ti,cs-read-setup-ns = <14>;
		ti,cs-write-hold-ns = <7>;
		ti,cs-write-strobe-ns = <42>;
		ti,cs-write-setup-ns = <14>;

		nand@0,0x8000000 {
			compatible = "ti,davinci-nand";
			reg = <0 0x8000000 0x4000000
			       1 0x0000000 0x0000100>;
			/*
			 * Partition0, offset 0x8000000, size 0x4000000
			 * Partition1, offset 0x0000000, size 0x0000100
			 */

			.. see davinci-nand.txt
		};
	};

	nor:cs0 {
		#address-cells = <2>;
		#size-cells = <1>;
		clock-ranges;
		ranges;

		ti,cs-chipselect = <0>;
		/* all timings in nanoseconds */
		ti,cs-min-turnaround-ns = <0>;
		ti,cs-read-hold-ns = <8>;
		ti,cs-read-strobe-ns = <40>;
		ti,cs-read-setup-ns = <14>;
		ti,cs-write-hold-ns = <7>;
		ti,cs-write-strobe-ns = <40>;
		ti,cs-write-setup-ns = <14>;
		ti,cs-bus-width = <16>;

		flash@0,0x0000000 {
			compatible = "cfi-flash";
			reg = <0 0x0000000 0x4000000>;

			...
		};
	};
};
```

## Documentation/devicetree/bindings/memory-controllers/ti-da8xx-ddrctl.txt
```
* Device tree bindings for Texas Instruments da8xx DDR2/mDDR memory controller

The DDR2/mDDR memory controller present on Texas Instruments da8xx SoCs features
a set of registers which allow to tweak the controller's behavior.

Documentation:
OMAP-L138 (DA850) - http://www.ti.com/lit/ug/spruh82c/spruh82c.pdf

Required properties:

- compatible:		"ti,da850-ddr-controller" - for da850 SoC based boards
- reg:			a tuple containing the base address of the memory
			controller and the size of the memory area to map

Example for da850 shown below.

ddrctl {
	compatible = "ti,da850-ddr-controller";
	reg = <0xb0000000 0xe8>;
};
```

## Documentation/devicetree/bindings/memory-controllers/ti/emif.txt
```
* EMIF family of TI SDRAM controllers

EMIF - External Memory Interface - is an SDRAM controller used in
TI SoCs. EMIF supports, based on the IP revision, one or more of
DDR2/DDR3/LPDDR2 protocols. This binding describes a given instance
of the EMIF IP and memory parts attached to it. Certain revisions
of the EMIF controller also contain optional ECC support, which
corrects one bit errors and detects two bit errors.

Required properties:
- compatible	: Should be of the form "ti,emif-<ip-rev>" where <ip-rev>
  is the IP revision of the specific EMIF instance. For newer controllers,
  compatible should be one of the following:
  	     "ti,emif-am3352"
	     "ti,emif-am4372"
	     "ti,emif-dra7xx"
	     "ti,emif-keystone"

- phy-type	: <u32> indicating the DDR phy type. Following are the
  allowed values
  <1>	: Attila PHY
  <2>	: Intelli PHY

- device-handle	: phandle to a "lpddr2" node representing the memory part

- ti,hwmods	: For TI hwmods processing and omap device creation
  the value shall be "emif<n>" where <n> is the number of the EMIF
  instance with base 1.
- interrupts	: interrupt used by the controller

Required only for "ti,emif-am3352" and "ti,emif-am4372":
- sram			: Phandles for generic sram driver nodes,
  first should be type 'protect-exec' for the driver to use to copy
  and run PM functions, second should be regular pool to be used for
  data region for code. See Documentation/devicetree/bindings/sram/sram.yaml
  for more details.

Optional properties:
- cs1-used		: Have this property if CS1 of this EMIF
  instance has a memory part attached to it. If there is a memory
  part attached to CS1, it should be the same type as the one on CS0,
  so there is no need to give the details of this memory part.

- cal-resistor-per-cs	: Have this property if the board has one
  calibration resistor per chip-select.

- hw-caps-read-idle-ctrl: Have this property if the controller
  supports read idle window programming

- hw-caps-dll-calib-ctrl: Have this property if the controller
  supports dll calibration control

- hw-caps-ll-interface	: Have this property if the controller
  has a low latency interface and corresponding interrupt events

- hw-caps-temp-alert	: Have this property if the controller
  has capability for generating SDRAM temperature alerts

-Examples:

emif1: emif@4c000000 {
	compatible	= "ti,emif-4d";
	ti,hwmods	= "emif2";
	phy-type	= <1>;
	device-handle	= <&elpida_ECB240ABACN>;
	cs1-used;
	hw-caps-read-idle-ctrl;
	hw-caps-ll-interface;
	hw-caps-temp-alert;
};

/* From am33xx.dtsi */
emif: emif@4c000000 {
        compatible = "ti,emif-am3352";
        reg =   <0x4C000000 0x1000>;
        sram = <&pm_sram_code
                &pm_sram_data>;
};

emif1: emif@4c000000 {
	compatible = "ti,emif-dra7xx";
	reg = <0x4c000000 0x200>;
	interrupts = <GIC_SPI 105 IRQ_TYPE_LEVEL_HIGH>;
};
```

## Documentation/devicetree/bindings/memory-controllers/xlnx,versal-ddrmc-edac.yaml
```yaml
# SPDX-License-Identifier: (GPL-2.0 OR BSD-2-Clause)
%YAML 1.2
---
$id: http://devicetree.org/schemas/memory-controllers/xlnx,versal-ddrmc-edac.yaml#
$schema: http://devicetree.org/meta-schemas/core.yaml#

title: Xilinx Versal DDRMC (Integrated DDR Memory Controller)

maintainers:
  - Shubhrajyoti Datta <shubhrajyoti.datta@amd.com>
  - Sai Krishna Potthuri <sai.krishna.potthuri@amd.com>

description:
  The integrated DDR Memory Controllers (DDRMCs) support both DDR4 and LPDDR4/
  4X memory interfaces. Versal DDR memory controller has an optional ECC support
  which correct single bit ECC errors and detect double bit ECC errors.

properties:
  compatible:
    const: xlnx,versal-ddrmc

  reg:
    items:
      - description: DDR Memory Controller registers
      - description: NOC registers corresponding to DDR Memory Controller

  reg-names:
    items:
      - const: base
      - const: noc

  interrupts:
    maxItems: 1

required:
  - compatible
  - reg
  - reg-names
  - interrupts

additionalProperties: false

examples:
  - |
    #include <dt-bindings/interrupt-controller/arm-gic.h>

    bus {
      #address-cells = <2>;
      #size-cells = <2>;
      memory-controller@f6150000 {
        compatible = "xlnx,versal-ddrmc";
        reg = <0x0 0xf6150000 0x0 0x2000>, <0x0 0xf6070000 0x0 0x20000>;
        reg-names = "base", "noc";
        interrupt-parent = <&gic>;
        interrupts = <GIC_SPI 147 IRQ_TYPE_LEVEL_HIGH>;
      };
    };
```

## Documentation/devicetree/bindings/memory-controllers/xlnx,versal-net-ddrmc5.yaml
```yaml
# SPDX-License-Identifier: (GPL-2.0 OR BSD-2-Clause)
%YAML 1.2
---
$id: http://devicetree.org/schemas/memory-controllers/xlnx,versal-net-ddrmc5.yaml#
$schema: http://devicetree.org/meta-schemas/core.yaml#

title: Xilinx Versal NET Memory Controller

maintainers:
  - Shubhrajyoti Datta <shubhrajyoti.datta@amd.com>

description:
  The integrated DDR Memory Controllers (DDRMCs) support both DDR5 and LPDDR5
  compact and extended  memory interfaces. Versal NET DDR memory controller
  has an optional ECC support which correct single bit ECC errors and detect
  double bit ECC errors. It also has support for reporting other errors like
  MMCM (Mixed-Mode Clock Manager) errors and General software errors.

properties:
  compatible:
    const: xlnx,versal-net-ddrmc5

  amd,rproc:
    $ref: /schemas/types.yaml#/definitions/phandle
    description:
      phandle to the remoteproc_r5 rproc node using which APU interacts
      with remote processor. APU primarily communicates with the RPU for
      accessing the DDRMC address space and getting error notification.

required:
  - compatible
  - amd,rproc

additionalProperties: false

examples:
  - |
    memory-controller {
        compatible = "xlnx,versal-net-ddrmc5";
        amd,rproc = <&remoteproc_r5>;
    };
```
