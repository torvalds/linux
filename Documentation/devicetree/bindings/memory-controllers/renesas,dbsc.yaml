## Documentation/devicetree/bindings/memory-controllers/st,stm32-fmc2-ebi.yaml
```yaml
# SPDX-License-Identifier: (GPL-2.0-only OR BSD-2-Clause)
%YAML 1.2
---
$id: http://devicetree.org/schemas/memory-controllers/st,stm32-fmc2-ebi.yaml#
$schema: http://devicetree.org/meta-schemas/core.yaml#

title: STMicroelectronics Flexible Memory Controller 2 (FMC2)

description: |
  The FMC2 functional block makes the interface with: synchronous and
  asynchronous static devices (such as PSNOR, PSRAM or other memory-mapped
  peripherals) and NAND flash memories.
  Its main purposes are:
    - to translate AXI transactions into the appropriate external device
      protocol
    - to meet the access time requirements of the external devices
  All external devices share the addresses, data and control signals with the
  controller. Each external device is accessed by means of a unique Chip
  Select. The FMC2 performs only one access at a time to an external device.

maintainers:
  - Christophe Kerello <christophe.kerello@foss.st.com>

properties:
  compatible:
    enum:
      - st,stm32mp1-fmc2-ebi
      - st,stm32mp25-fmc2-ebi

  reg:
    maxItems: 1

  clocks:
    maxItems: 1

  resets:
    maxItems: 1

  power-domains:
    maxItems: 1

  "#address-cells":
    const: 2

  "#size-cells":
    const: 1

  ranges:
    description: |
      Reflects the memory layout with four integer values per bank. Format:
      <bank-number> 0 <address of the bank> <size>

patternProperties:
  "^.*@[0-4],[a-f0-9]+$":
    additionalProperties: true
    type: object
    $ref: mc-peripheral-props.yaml#

required:
  - "#address-cells"
  - "#size-cells"
  - compatible
  - reg
  - clocks
  - ranges

additionalProperties: false

examples:
  - |
    #include <dt-bindings/interrupt-controller/arm-gic.h>
    #include <dt-bindings/clock/stm32mp1-clks.h>
    #include <dt-bindings/reset/stm32mp1-resets.h>
    memory-controller@58002000 {
      #address-cells = <2>;
      #size-cells = <1>;
      compatible = "st,stm32mp1-fmc2-ebi";
      reg = <0x58002000 0x1000>;
      clocks = <&rcc FMC_K>;
      resets = <&rcc FMC_R>;

      ranges = <0 0 0x60000000 0x04000000>, /* EBI CS 1 */
               <1 0 0x64000000 0x04000000>, /* EBI CS 2 */
               <2 0 0x68000000 0x04000000>, /* EBI CS 3 */
               <3 0 0x6c000000 0x04000000>, /* EBI CS 4 */
               <4 0 0x80000000 0x10000000>; /* NAND */

      psram@0,0 {
        compatible = "mtd-ram";
        reg = <0 0x00000000 0x100000>;
        bank-width = <2>;

        st,fmc2-ebi-cs-transaction-type = <1>;
        st,fmc2-ebi-cs-address-setup-ns = <60>;
        st,fmc2-ebi-cs-data-setup-ns = <30>;
        st,fmc2-ebi-cs-bus-turnaround-ns = <5>;
      };

      nand-controller@4,0 {
        #address-cells = <1>;
        #size-cells = <0>;
        compatible = "st,stm32mp1-fmc2-nfc";
        reg = <4 0x00000000 0x1000>,
              <4 0x08010000 0x1000>,
              <4 0x08020000 0x1000>,
              <4 0x01000000 0x1000>,
              <4 0x09010000 0x1000>,
              <4 0x09020000 0x1000>;
        interrupts = <GIC_SPI 48 IRQ_TYPE_LEVEL_HIGH>;
        dmas = <&mdma1 20 0x2 0x12000a02 0x0 0x0>,
               <&mdma1 20 0x2 0x12000a08 0x0 0x0>,
               <&mdma1 21 0x2 0x12000a0a 0x0 0x0>;
        dma-names = "tx", "rx", "ecc";

        nand@0 {
          reg = <0>;
          nand-on-flash-bbt;
          #address-cells = <1>;
          #size-cells = <1>;
        };
      };
    };

...
```

## Documentation/devicetree/bindings/memory-controllers/st,stm32mp25-omm.yaml
```yaml
# SPDX-License-Identifier: (GPL-2.0-only OR BSD-2-Clause)
%YAML 1.2
---
$id: http://devicetree.org/schemas/memory-controllers/st,stm32mp25-omm.yaml#
$schema: http://devicetree.org/meta-schemas/core.yaml#

title: STM32 Octo Memory Manager (OMM)

maintainers:
  - Patrice Chotard <patrice.chotard@foss.st.com>

description: |
  The STM32 Octo Memory Manager is a low-level interface that enables an
  efficient OCTOSPI pin assignment with a full I/O matrix (before alternate
  function map) and multiplex of single/dual/quad/octal SPI interfaces over
  the same bus. It Supports up to:
    - Two single/dual/quad/octal SPI interfaces
    - Two ports for pin assignment

properties:
  compatible:
    const: st,stm32mp25-omm

  "#address-cells":
    const: 2

  "#size-cells":
    const: 1

  ranges:
    description: |
      Reflects the memory layout per OSPI instance.
      Format:
      <chip-select> 0 <registers base address> <size>
    minItems: 2
    maxItems: 2

  reg:
    items:
      - description: OMM registers
      - description: OMM memory map area

  reg-names:
    items:
      - const: regs
      - const: memory_map

  memory-region:
    description:
      Memory region shared between the 2 OCTOSPI instance.
      One or two phandle to a node describing a memory mapped region
      depending of child number.
    minItems: 1
    maxItems: 2

  memory-region-names:
    description:
      Identify to which OSPI instance the memory region belongs to.
    items:
      enum: [ospi1, ospi2]
    minItems: 1
    maxItems: 2

  clocks:
    maxItems: 3

  clock-names:
    items:
      - const: omm
      - const: ospi1
      - const: ospi2

  resets:
    maxItems: 3

  reset-names:
    items:
      - const: omm
      - const: ospi1
      - const: ospi2

  access-controllers:
    maxItems: 1

  power-domains:
    maxItems: 1

  st,syscfg-amcr:
    $ref: /schemas/types.yaml#/definitions/phandle-array
    description: |
      The Address Mapping Control Register (AMCR) is used to split the 256MB
      memory map area shared between the 2 OSPI instance. The Octo Memory
      Manager sets the AMCR depending of the memory-region configuration.
      The memory split bitmask description is:
        - 000: OCTOSPI1 (256 Mbytes), OCTOSPI2 unmapped
        - 001: OCTOSPI1 (192 Mbytes), OCTOSPI2 (64 Mbytes)
        - 010: OCTOSPI1 (128 Mbytes), OCTOSPI2 (128 Mbytes)
        - 011: OCTOSPI1 (64 Mbytes), OCTOSPI2 (192 Mbytes)
        - 1xx: OCTOSPI1 unmapped, OCTOSPI2 (256 Mbytes)
    items:
      - items:
          - description: phandle to syscfg
          - description: register offset within syscfg
          - description: register bitmask for memory split

  st,omm-req2ack-ns:
    description:
      In multiplexed mode (MUXEN = 1), this field defines the time in
      nanoseconds between two transactions.
    default: 0

  st,omm-cssel-ovr:
    $ref: /schemas/types.yaml#/definitions/uint32
    description: |
      Configure the chip select selector override for the 2 OCTOSPIs.
      - 0: OCTOSPI1 chip select send to NCS1 OCTOSPI2 chip select send to NCS1
      - 1: OCTOSPI1 chip select send to NCS2 OCTOSPI2 chip select send to NCS1
      - 2: OCTOSPI1 chip select send to NCS1 OCTOSPI2 chip select send to NCS2
      - 3: OCTOSPI1 chip select send to NCS2 OCTOSPI2 chip select send to NCS2
    minimum: 0
    maximum: 3
    default: 0

  st,omm-mux:
    $ref: /schemas/types.yaml#/definitions/uint32
    description: |
      Configure the muxing between the 2 OCTOSPIs busses and the 2 output ports.
      - 0: direct mode
      - 1: mux OCTOSPI1 and OCTOSPI2 to port 1
      - 2: swapped mode
      - 3: mux OCTOSPI1 and OCTOSPI2 to port 2
    minimum: 0
    maximum: 3
    default: 0

patternProperties:
  ^spi@[0-9]:
    type: object
    $ref: /schemas/spi/st,stm32mp25-ospi.yaml#
    description: Required spi child node

required:
  - compatible
  - reg
  - "#address-cells"
  - "#size-cells"
  - clocks
  - clock-names
  - resets
  - reset-names
  - st,syscfg-amcr
  - ranges

additionalProperties: false

examples:
  - |
    #include <dt-bindings/clock/st,stm32mp25-rcc.h>
    #include <dt-bindings/interrupt-controller/arm-gic.h>
    #include <dt-bindings/reset/st,stm32mp25-rcc.h>
    ommanager@40500000 {
      compatible = "st,stm32mp25-omm";
      reg = <0x40500000 0x400>, <0x60000000 0x10000000>;
      reg-names = "regs", "memory_map";
      ranges = <0 0 0x40430000 0x400>,
               <1 0 0x40440000 0x400>;
      memory-region = <&mm_ospi1>, <&mm_ospi2>;
      memory-region-names = "ospi1", "ospi2";
      pinctrl-0 = <&ospi_port1_clk_pins_a
                   &ospi_port1_io03_pins_a
                   &ospi_port1_cs0_pins_a>;
      pinctrl-1 = <&ospi_port1_clk_sleep_pins_a
                   &ospi_port1_io03_sleep_pins_a
                   &ospi_port1_cs0_sleep_pins_a>;
      pinctrl-names = "default", "sleep";
      clocks = <&rcc CK_BUS_OSPIIOM>,
               <&scmi_clk CK_SCMI_OSPI1>,
               <&scmi_clk CK_SCMI_OSPI2>;
      clock-names = "omm", "ospi1", "ospi2";
      resets = <&rcc OSPIIOM_R>,
               <&scmi_reset RST_SCMI_OSPI1>,
               <&scmi_reset RST_SCMI_OSPI2>;
      reset-names = "omm", "ospi1", "ospi2";
      access-controllers = <&rifsc 111>;
      power-domains = <&CLUSTER_PD>;
      #address-cells = <2>;
      #size-cells = <1>;
      st,syscfg-amcr = <&syscfg 0x2c00 0x7>;
      st,omm-req2ack-ns = <0>;
      st,omm-mux = <0>;
      st,omm-cssel-ovr = <0>;

      spi@0 {
        compatible = "st,stm32mp25-ospi";
        reg = <0 0 0x400>;
        memory-region = <&mm_ospi1>;
        interrupts = <GIC_SPI 163 IRQ_TYPE_LEVEL_HIGH>;
        dmas = <&hpdma 2 0x62 0x00003121 0x0>,
               <&hpdma 2 0x42 0x00003112 0x0>;
        dma-names = "tx", "rx";
        clocks = <&scmi_clk CK_SCMI_OSPI1>;
        resets = <&scmi_reset RST_SCMI_OSPI1>, <&scmi_reset RST_SCMI_OSPI1DLL>;
        access-controllers = <&rifsc 74>;
        power-domains = <&CLUSTER_PD>;
        #address-cells = <1>;
        #size-cells = <0>;
        st,syscfg-dlyb = <&syscfg 0x1000>;
      };

      spi@1 {
        compatible = "st,stm32mp25-ospi";
        reg = <1 0 0x400>;
        memory-region = <&mm_ospi1>;
        interrupts = <GIC_SPI 164 IRQ_TYPE_LEVEL_HIGH>;
        dmas = <&hpdma 3 0x62 0x00003121 0x0>,
               <&hpdma 3 0x42 0x00003112 0x0>;
        dma-names = "tx", "rx";
        clocks = <&scmi_clk CK_KER_OSPI2>;
        resets = <&scmi_reset RST_SCMI_OSPI2>, <&scmi_reset RST_SCMI_OSPI1DLL>;
        access-controllers = <&rifsc 75>;
        power-domains = <&CLUSTER_PD>;
        #address-cells = <1>;
        #size-cells = <0>;
        st,syscfg-dlyb = <&syscfg 0x1000>;
      };
    };
```

## Documentation/devicetree/bindings/memory-controllers/starfive,jh7110-dmc.yaml
```yaml
# SPDX-License-Identifier: (GPL-2.0-only OR BSD-2-Clause)
%YAML 1.2
---
$id: http://devicetree.org/schemas/memory-controllers/starfive,jh7110-dmc.yaml#
$schema: http://devicetree.org/meta-schemas/core.yaml#

title: StarFive JH7110 DMC

maintainers:
  - E Shattow <e@freeshell.de>

description:
  JH7110 DDR external memory interface LPDDR4/DDR4/DDR3/LPDDR3 32-bit at
  2133Mbps (up to 2800Mbps).

properties:
  compatible:
    items:
      - const: starfive,jh7110-dmc

  reg:
    items:
      - description: controller registers
      - description: phy registers

  clocks:
    maxItems: 1

  clock-names:
    items:
      - const: pll

  resets:
    items:
      - description: axi
      - description: osc
      - description: apb

  reset-names:
    items:
      - const: axi
      - const: osc
      - const: apb

required:
  - compatible
  - reg
  - clocks
  - clock-names
  - resets
  - reset-names

additionalProperties: false

examples:
  - |
    #include <dt-bindings/clock/starfive,jh7110-crg.h>
    #include <dt-bindings/reset/starfive,jh7110-crg.h>
    soc {
      #address-cells = <2>;
      #size-cells = <2>;

      memory-controller@15700000 {
        compatible = "starfive,jh7110-dmc";
        reg = <0x0 0x15700000 0x0 0x10000>,
              <0x0 0x13000000 0x0 0x10000>;
        clocks = <&syscrg JH7110_PLLCLK_PLL1_OUT>;
        clock-names = "pll";
        resets = <&syscrg JH7110_SYSRST_DDR_AXI>,
                 <&syscrg JH7110_SYSRST_DDR_OSC>,
                 <&syscrg JH7110_SYSRST_DDR_APB>;
        reset-names = "axi", "osc", "apb";
      };
    };
```

## Documentation/devicetree/bindings/memory-controllers/synopsys,ddrc-ecc.yaml
```yaml
# SPDX-License-Identifier: GPL-2.0-only
%YAML 1.2
---
$id: http://devicetree.org/schemas/memory-controllers/synopsys,ddrc-ecc.yaml#
$schema: http://devicetree.org/meta-schemas/core.yaml#

title: Synopsys DesignWare Universal Multi-Protocol Memory Controller

maintainers:
  - Krzysztof Kozlowski <krzk@kernel.org>
  - Manish Narani <manish.narani@xilinx.com>
  - Michal Simek <michal.simek@xilinx.com>

description: |
  Synopsys DesignWare Enhanced uMCTL2 DDR Memory Controller is capable of
  working with the memory devices supporting up to (LP)DDR4 protocol. It can
  be equipped with SEC/DEC ECC feature if DRAM data bus width is either
  16-bits or 32-bits or 64-bits wide.

  For instance the ZynqMP DDR controller is based on the DW uMCTL2 v2.40a
  controller. It has an optional SEC/DEC ECC support in 64- and 32-bits
  bus width configurations.

properties:
  compatible:
    oneOf:
      - description: Synopsys DW uMCTL2 DDR controller v3.80a
        const: snps,ddrc-3.80a
      - description: Xilinx ZynqMP DDR controller v2.40a
        const: xlnx,zynqmp-ddrc-2.40a

  interrupts:
    maxItems: 1

  reg:
    maxItems: 1

required:
  - compatible
  - reg
  - interrupts

additionalProperties: false

examples:
  - |
    memory-controller@fd070000 {
      compatible = "xlnx,zynqmp-ddrc-2.40a";
      reg = <0xfd070000 0x30000>;
      interrupt-parent = <&gic>;
      interrupts = <0 112 4>;
    };
...
```

## Documentation/devicetree/bindings/memory-controllers/synopsys.txt
```
Binding for Synopsys IntelliDDR Multi Protocol Memory Controller

The ZynqMP DDR ECC controller has an optional ECC support in 64-bit and 32-bit
bus width configurations.

The Zynq DDR ECC controller has an optional ECC support in half-bus width
(16-bit) configuration.

These both ECC controllers correct single bit ECC errors and detect double bit
ECC errors.

Required properties:
 - compatible: One of:
	- 'xlnx,zynq-ddrc-a05' : Zynq DDR ECC controller
	- 'xlnx,zynqmp-ddrc-2.40a' : ZynqMP DDR ECC controller
 - reg: Should contain DDR controller registers location and length.

Required properties for "xlnx,zynqmp-ddrc-2.40a":
 - interrupts: Property with a value describing the interrupt number.

Example:
	memory-controller@f8006000 {
		compatible = "xlnx,zynq-ddrc-a05";
		reg = <0xf8006000 0x1000>;
	};

	mc: memory-controller@fd070000 {
		compatible = "xlnx,zynqmp-ddrc-2.40a";
		reg = <0x0 0xfd070000 0x0 0x30000>;
		interrupt-parent = <&gic>;
		interrupts = <0 112 4>;
	};
```
