## Documentation/devicetree/bindings/memory-controllers/renesas,dbsc.yaml
```yaml
# SPDX-License-Identifier: (GPL-2.0-only OR BSD-2-Clause)
%YAML 1.2
---
$id: "http://devicetree.org/schemas/memory-controllers/renesas,dbsc.yaml#"
$schema: "http://devicetree.org/meta-schemas/core.yaml#"

title: Renesas DDR Bus Controllers

maintainers:
  - Geert Uytterhoeven <geert+renesas@glider.be>

description: |
  Renesas SoCs contain one or more memory controllers.  These memory
  controllers differ from one SoC variant to another, and are called by
  different names, e.g. "DDR Bus Controller (DBSC)", "DDR3 Bus State Controller
  (DBSC3)", or "SDRAM Bus State Controller (SBSC)").

properties:
  compatible:
    enum:
      - renesas,dbsc-r8a73a4  # R-Mobile APE6
      - renesas,dbsc3-r8a7740 # R-Mobile A1
      - renesas,sbsc-sh73a0   # SH-Mobile AG5

  reg:
    maxItems: 1

  interrupts:
    maxItems: 2

  interrupt-names:
    items:
      - const: sec  # secure interrupt
      - const: temp # normal (temperature) interrupt

  power-domains:
    maxItems: 1

required:
  - compatible
  - reg
  - power-domains

additionalProperties: false

examples:
  - |
    #include <dt-bindings/interrupt-controller/arm-gic.h>
    sbsc1: memory-controller@fe400000 {
            compatible = "renesas,sbsc-sh73a0";
            reg = <0xfe400000 0x400>;
            interrupts = <GIC_SPI 35 IRQ_TYPE_LEVEL_HIGH>,
                         <GIC_SPI 36 IRQ_TYPE_LEVEL_HIGH>;
            interrupt-names = "sec", "temp";
            power-domains = <&pd_a4bc0>;
    };
```

## Documentation/devicetree/bindings/memory-controllers/renesas,h8300-bsc.txt
```
* H8/300 bus controller

Required properties:
  - compatible: Must be "renesas,h8300-bsc".
  - reg: Base address and length of BSC registers.

Example.
	bsc: memory-controller@fee01e {
		compatible = "renesas,h8300h-bsc", "renesas,h8300-bsc";
		reg = <0xfee01e 8>;
	};
```

## Documentation/devicetree/bindings/memory-controllers/renesas,h8300-bsc.yaml
```yaml
# SPDX-License-Identifier: (GPL-2.0-only OR BSD-2-Clause)
%YAML 1.2
---
$id: http://devicetree.org/schemas/memory-controllers/renesas,h8300-bsc.yaml#
$schema: http://devicetree.org/meta-schemas/core.yaml#

title: H8/300 bus controller

maintainers:
  - Krzysztof Kozlowski <krzk@kernel.org>
  - Yoshinori Sato <ysato@users.sourceforge.jp>

properties:
  compatible:
    items:
      - enum:
          - renesas,h8300h-bsc
          - renesas,h8s-bsc
      - const: renesas,h8300-bsc

  reg:
    maxItems: 1

required:
  - compatible
  - reg

additionalProperties: false

examples:
  - |
    memory-controller@fee01e {
        compatible = "renesas,h8300h-bsc", "renesas,h8300-bsc";
        reg = <0xfee01e 8>;
    };
```

## Documentation/devicetree/bindings/memory-controllers/renesas,rpc-if.yaml
```yaml
# SPDX-License-Identifier: (GPL-2.0-only OR BSD-2-Clause)
%YAML 1.2
---
$id: http://devicetree.org/schemas/memory-controllers/renesas,rpc-if.yaml#
$schema: http://devicetree.org/meta-schemas/core.yaml#

title: Renesas Reduced Pin Count Interface (RPC-IF)

maintainers:
  - Sergei Shtylyov <sergei.shtylyov@gmail.com>

description: |
  Renesas RPC-IF allows a SPI flash or HyperFlash connected to the SoC to
  be accessed via the external address space read mode or the manual mode.

  The flash chip itself should be represented by a subnode of the RPC-IF node.
  The flash interface is selected based on the "compatible" property of this
  subnode:
  - if it contains "jedec,spi-nor", then SPI is used;
  - if it contains "cfi-flash", then HyperFlash is used.

allOf:
  - $ref: /schemas/spi/spi-controller.yaml#

properties:
  compatible:
    oneOf:
      - items:
          - enum:
              - renesas,r8a774a1-rpc-if       # RZ/G2M
              - renesas,r8a774b1-rpc-if       # RZ/G2N
              - renesas,r8a774c0-rpc-if       # RZ/G2E
              - renesas,r8a774e1-rpc-if       # RZ/G2H
              - renesas,r8a7795-rpc-if        # R-Car H3
              - renesas,r8a7796-rpc-if        # R-Car M3-W
              - renesas,r8a77961-rpc-if       # R-Car M3-W+
              - renesas,r8a77965-rpc-if       # R-Car M3-N
              - renesas,r8a77970-rpc-if       # R-Car V3M
              - renesas,r8a77980-rpc-if       # R-Car V3H
              - renesas,r8a77990-rpc-if       # R-Car E3
              - renesas,r8a77995-rpc-if       # R-Car D3
              - renesas,r8a779a0-rpc-if       # R-Car V3U
          - const: renesas,rcar-gen3-rpc-if   # a generic R-Car gen3 or RZ/G2{E,H,M,N} device

      - items:
          - enum:
              - renesas,r8a779g0-rpc-if       # R-Car V4H
          - const: renesas,rcar-gen4-rpc-if   # a generic R-Car gen4 device

      - items:
          - enum:
              - renesas,r9a07g043-rpc-if      # RZ/G2UL
              - renesas,r9a07g044-rpc-if      # RZ/G2{L,LC}
              - renesas,r9a07g054-rpc-if      # RZ/V2L
          - const: renesas,rzg2l-rpc-if

  reg:
    items:
      - description: RPC-IF registers
      - description: direct mapping read mode area
      - description: write buffer area

  reg-names:
    items:
      - const: regs
      - const: dirmap
      - const: wbuf

  clocks: true

  interrupts:
    maxItems: 1

  power-domains:
    maxItems: 1

  resets:
    maxItems: 1

patternProperties:
  "flash@[0-9a-f]+$":
    type: object
    additionalProperties: true

    properties:
      compatible:
        contains:
          enum:
            - cfi-flash
            - jedec,spi-nor

required:
  - compatible
  - reg
  - reg-names
  - clocks
  - power-domains
  - resets
  - '#address-cells'
  - '#size-cells'

if:
  properties:
    compatible:
      contains:
        enum:
          - renesas,rzg2l-rpc-if
then:
  properties:
    clocks:
      items:
        - description: SPI Multi IO Register access clock (SPI_CLK2)
        - description: SPI Multi IO Main clock (SPI_CLK).

else:
  properties:
    clocks:
      maxItems: 1

unevaluatedProperties: false

examples:
  - |
    #include <dt-bindings/clock/renesas-cpg-mssr.h>
    #include <dt-bindings/power/r8a77995-sysc.h>

    spi@ee200000 {
      compatible = "renesas,r8a77995-rpc-if", "renesas,rcar-gen3-rpc-if";
      reg = <0xee200000 0x200>,
            <0x08000000 0x4000000>,
            <0xee208000 0x100>;
      reg-names = "regs", "dirmap", "wbuf";
      clocks = <&cpg CPG_MOD 917>;
      power-domains = <&sysc R8A77995_PD_ALWAYS_ON>;
      resets = <&cpg 917>;
      #address-cells = <1>;
      #size-cells = <0>;

      flash@0 {
        compatible = "jedec,spi-nor";
        reg = <0>;
        spi-max-frequency = <40000000>;
        spi-tx-bus-width = <1>;
        spi-rx-bus-width = <1>;
      };
    };
```

## Documentation/devicetree/bindings/memory-controllers/renesas,rzg3e-xspi.yaml
```yaml
# SPDX-License-Identifier: (GPL-2.0-only OR BSD-2-Clause)
%YAML 1.2
---
$id: http://devicetree.org/schemas/memory-controllers/renesas,rzg3e-xspi.yaml#
$schema: http://devicetree.org/meta-schemas/core.yaml#

title: Renesas Expanded Serial Peripheral Interface (xSPI)

maintainers:
  - Biju Das <biju.das.jz@bp.renesas.com>

description: |
  Renesas xSPI allows a SPI flash connected to the SoC to be accessed via
  the memory-mapping or the manual command mode.

  The flash chip itself should be represented by a subnode of the XSPI node.
  The flash interface is selected based on the "compatible" property of this
  subnode:
  -  "jedec,spi-nor";

allOf:
  - $ref: /schemas/spi/spi-controller.yaml#

properties:
  compatible:
    oneOf:
      - const: renesas,r9a09g047-xspi  # RZ/G3E

      - items:
          - enum:
              - renesas,r9a09g056-xspi  # RZ/V2N
              - renesas,r9a09g057-xspi  # RZ/V2H(P)
          - const: renesas,r9a09g047-xspi

  reg:
    items:
      - description: xSPI registers
      - description: direct mapping area

  reg-names:
    items:
      - const: regs
      - const: dirmap

  interrupts:
    items:
      - description: Interrupt pulse signal by factors excluding errors
      - description: Interrupt pulse signal by error factors

  interrupt-names:
    items:
      - const: pulse
      - const: err_pulse

  clocks:
    items:
      - description: AHB clock
      - description: AXI clock
      - description: SPI clock
      - description: Double speed SPI clock

  clock-names:
    items:
      - const: ahb
      - const: axi
      - const: spi
      - const: spix2

  power-domains:
    maxItems: 1

  resets:
    items:
      - description: Hardware reset
      - description: AXI reset

  reset-names:
    items:
      - const: hresetn
      - const: aresetn

  renesas,xspi-cs-addr-sys:
    $ref: /schemas/types.yaml#/definitions/phandle
    description: |
      Phandle to the system controller (sys) that allows to configure
      xSPI CS0 and CS1 addresses.

patternProperties:
  "flash@[0-9a-f]+$":
    type: object
    additionalProperties: true

    properties:
      compatible:
        contains:
          const: jedec,spi-nor

required:
  - compatible
  - reg
  - reg-names
  - interrupts
  - interrupt-names
  - clocks
  - clock-names
  - power-domains
  - resets
  - reset-names
  - '#address-cells'
  - '#size-cells'

unevaluatedProperties: false

examples:
  - |
    #include <dt-bindings/interrupt-controller/arm-gic.h>
    #include <dt-bindings/clock/renesas,r9a09g047-cpg.h>

    spi@11030000 {
        compatible = "renesas,r9a09g047-xspi";
        reg = <0x11030000 0x10000>, <0x20000000 0x10000000>;
        reg-names = "regs", "dirmap";
        interrupts = <GIC_SPI 228 IRQ_TYPE_EDGE_RISING>,
                     <GIC_SPI 229 IRQ_TYPE_EDGE_RISING>;
        interrupt-names = "pulse", "err_pulse";
        clocks = <&cpg CPG_MOD 0x9f>, <&cpg CPG_MOD 0xa0>,
                 <&cpg CPG_CORE 9>, <&cpg CPG_MOD 0xa1>;
        clock-names = "ahb", "axi", "spi", "spix2";
        power-domains = <&cpg>;
        resets = <&cpg 0xa3>, <&cpg 0xa4>;
        reset-names = "hresetn", "aresetn";
        #address-cells = <1>;
        #size-cells = <0>;

        flash@0 {
          compatible = "jedec,spi-nor";
          reg = <0>;
          spi-max-frequency = <40000000>;
          spi-tx-bus-width = <1>;
          spi-rx-bus-width = <1>;
        };
    };
```
