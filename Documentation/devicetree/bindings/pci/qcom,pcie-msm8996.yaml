## Documentation/devicetree/bindings/pci/qcom,pcie-msm8996.yaml
```yaml
# SPDX-License-Identifier: (GPL-2.0-only OR BSD-2-Clause)
%YAML 1.2
---
$id: http://devicetree.org/schemas/pci/qcom,pcie-msm8996.yaml#
$schema: http://devicetree.org/meta-schemas/core.yaml#

title: Qualcomm MSM8996 PCI Express Root Complex

maintainers:
  - Bjorn Andersson <andersson@kernel.org>
  - Manivannan Sadhasivam <mani@kernel.org>

properties:
  compatible:
    oneOf:
      - enum:
          - qcom,pcie-msm8996
      - items:
          - const: qcom,pcie-msm8998
          - const: qcom,pcie-msm8996

  reg:
    minItems: 4
    maxItems: 5

  reg-names:
    minItems: 4
    items:
      - const: parf
      - const: dbi
      - const: elbi
      - const: config
      - const: mhi

  clocks:
    maxItems: 5

  clock-names:
    items:
      - const: pipe # Pipe Clock driving internal logic
      - const: aux
      - const: cfg
      - const: bus_master # Master AXI clock
      - const: bus_slave # Slave AXI clock

  interrupts:
    minItems: 8
    maxItems: 9

  interrupt-names:
    minItems: 8
    items:
      - const: msi0
      - const: msi1
      - const: msi2
      - const: msi3
      - const: msi4
      - const: msi5
      - const: msi6
      - const: msi7
      - const: global

  vdda-supply:
    description: A phandle to the core analog power supply

  vddpe-3v3-supply:
    description: A phandle to the PCIe endpoint power supply

required:
  - power-domains

allOf:
  - $ref: qcom,pcie-common.yaml#

unevaluatedProperties: false

examples:
  - |
    #include <dt-bindings/clock/qcom,gcc-msm8996.h>
    #include <dt-bindings/gpio/gpio.h>
    #include <dt-bindings/interrupt-controller/arm-gic.h>

    pcie@600000 {
        compatible = "qcom,pcie-msm8996";
        reg = <0x00600000 0x2000>,
              <0x0c000000 0xf1d>,
              <0x0c000f20 0xa8>,
              <0x0c100000 0x100000>;
        reg-names = "parf", "dbi", "elbi", "config";
        ranges = <0x01000000 0x0 0x00000000 0x0c200000 0x0 0x100000>,
                 <0x02000000 0x0 0x0c300000 0x0c300000 0x0 0xd00000>;

        device_type = "pci";
        bus-range = <0x00 0xff>;
        num-lanes = <1>;
        #address-cells = <3>;
        #size-cells = <2>;
        linux,pci-domain = <0>;

        clocks = <&gcc GCC_PCIE_0_PIPE_CLK>,
                 <&gcc GCC_PCIE_0_AUX_CLK>,
                 <&gcc GCC_PCIE_0_CFG_AHB_CLK>,
                 <&gcc GCC_PCIE_0_MSTR_AXI_CLK>,
                 <&gcc GCC_PCIE_0_SLV_AXI_CLK>;
        clock-names = "pipe",
                     "aux",
                     "cfg",
                     "bus_master",
                     "bus_slave";

        interrupts = <GIC_SPI 405 IRQ_TYPE_LEVEL_HIGH>,
                     <GIC_SPI 406 IRQ_TYPE_LEVEL_HIGH>,
                     <GIC_SPI 407 IRQ_TYPE_LEVEL_HIGH>,
                     <GIC_SPI 408 IRQ_TYPE_LEVEL_HIGH>,
                     <GIC_SPI 409 IRQ_TYPE_LEVEL_HIGH>,
                     <GIC_SPI 410 IRQ_TYPE_LEVEL_HIGH>,
                     <GIC_SPI 411 IRQ_TYPE_LEVEL_HIGH>,
                     <GIC_SPI 412 IRQ_TYPE_LEVEL_HIGH>;
        interrupt-names = "msi0",
                          "msi1",
                          "msi2",
                          "msi3",
                          "msi4",
                          "msi5",
                          "msi6",
                          "msi7";
        #interrupt-cells = <1>;
        interrupt-map-mask = <0 0 0 0x7>;
        interrupt-map = <0 0 0 1 &intc GIC_SPI 244 IRQ_TYPE_LEVEL_HIGH>, /* int_a */
                        <0 0 0 2 &intc GIC_SPI 245 IRQ_TYPE_LEVEL_HIGH>, /* int_b */
                        <0 0 0 3 &intc GIC_SPI 247 IRQ_TYPE_LEVEL_HIGH>, /* int_c */
                        <0 0 0 4 &intc GIC_SPI 248 IRQ_TYPE_LEVEL_HIGH>; /* int_d */

        pinctrl-names = "default", "sleep";
        pinctrl-0 = <&pcie0_state_on>;
        pinctrl-1 = <&pcie0_state_off>;

        phys = <&pciephy_0>;
        phy-names = "pciephy";

        power-domains = <&gcc PCIE0_GDSC>;

        perst-gpios = <&tlmm 35 GPIO_ACTIVE_LOW>;
        vddpe-3v3-supply = <&wlan_en>;
        vdda-supply = <&vreg_l28a_0p925>;

        pcie@0 {
            device_type = "pci";
            reg = <0x0 0x0 0x0 0x0 0x0>;
            bus-range = <0x01 0xff>;

            #address-cells = <3>;
            #size-cells = <2>;
            ranges;
        };
    };
```

## Documentation/devicetree/bindings/pci/qcom,pcie-qcs404.yaml
```yaml
# SPDX-License-Identifier: (GPL-2.0-only OR BSD-2-Clause)
%YAML 1.2
---
$id: http://devicetree.org/schemas/pci/qcom,pcie-qcs404.yaml#
$schema: http://devicetree.org/meta-schemas/core.yaml#

title: Qualcomm QCS404 PCI Express Root Complex

maintainers:
  - Bjorn Andersson <andersson@kernel.org>
  - Manivannan Sadhasivam <mani@kernel.org>

properties:
  compatible:
    enum:
      - qcom,pcie-qcs404

  reg:
    maxItems: 4

  reg-names:
    items:
      - const: dbi
      - const: elbi
      - const: parf
      - const: config

  clocks:
    maxItems: 4

  clock-names:
    items:
      - const: iface # AHB clock
      - const: aux
      - const: master_bus # AXI Master clock
      - const: slave_bus # AXI Slave clock

  interrupts:
    maxItems: 1

  interrupt-names:
    items:
      - const: msi

  resets:
    maxItems: 6

  reset-names:
    items:
      - const: axi_m # AXI Master reset
      - const: axi_s # AXI Slave reset
      - const: axi_m_sticky # AXI Master Sticky reset
      - const: pipe_sticky
      - const: pwr
      - const: ahb

required:
  - resets
  - reset-names

allOf:
  - $ref: qcom,pcie-common.yaml#

unevaluatedProperties: false

examples:
  - |
    #include <dt-bindings/clock/qcom,gcc-qcs404.h>
    #include <dt-bindings/gpio/gpio.h>
    #include <dt-bindings/interrupt-controller/arm-gic.h>

    pcie@10000000 {
        compatible = "qcom,pcie-qcs404";
        reg = <0x10000000 0xf1d>,
              <0x10000f20 0xa8>,
              <0x07780000 0x2000>,
              <0x10001000 0x2000>;
        reg-names = "dbi", "elbi", "parf", "config";
        ranges = <0x81000000 0x0 0x00000000 0x10003000 0x0 0x00010000>, /* I/O */
                 <0x82000000 0x0 0x10013000 0x10013000 0x0 0x007ed000>; /* memory */

        device_type = "pci";
        linux,pci-domain = <0>;
        bus-range = <0x00 0xff>;
        num-lanes = <1>;
        #address-cells = <3>;
        #size-cells = <2>;

        clocks = <&gcc GCC_PCIE_0_CFG_AHB_CLK>,
                 <&gcc GCC_PCIE_0_AUX_CLK>,
                 <&gcc GCC_PCIE_0_MSTR_AXI_CLK>,
                 <&gcc GCC_PCIE_0_SLV_AXI_CLK>;
        clock-names = "iface", "aux", "master_bus", "slave_bus";

        interrupts = <GIC_SPI 266 IRQ_TYPE_LEVEL_HIGH>;
        interrupt-names = "msi";
        #interrupt-cells = <1>;
        interrupt-map-mask = <0 0 0 0x7>;
        interrupt-map = <0 0 0 1 &intc GIC_SPI 68 IRQ_TYPE_LEVEL_HIGH>, /* int_a */
                        <0 0 0 2 &intc GIC_SPI 224 IRQ_TYPE_LEVEL_HIGH>, /* int_b */
                        <0 0 0 3 &intc GIC_SPI 267 IRQ_TYPE_LEVEL_HIGH>, /* int_c */
                        <0 0 0 4 &intc GIC_SPI 268 IRQ_TYPE_LEVEL_HIGH>; /* int_d */

        phys = <&pcie_phy>;
        phy-names = "pciephy";

        perst-gpios = <&tlmm 43 GPIO_ACTIVE_LOW>;

        resets = <&gcc GCC_PCIE_0_AXI_MASTER_ARES>,
                 <&gcc GCC_PCIE_0_AXI_SLAVE_ARES>,
                 <&gcc GCC_PCIE_0_AXI_MASTER_STICKY_ARES>,
                 <&gcc GCC_PCIE_0_CORE_STICKY_ARES>,
                 <&gcc GCC_PCIE_0_BCR>,
                 <&gcc GCC_PCIE_0_AHB_ARES>;
        reset-names = "axi_m",
                      "axi_s",
                      "axi_m_sticky",
                      "pipe_sticky",
                      "pwr",
                      "ahb";

        pcie@0 {
            device_type = "pci";
            reg = <0x0 0x0 0x0 0x0 0x0>;
            bus-range = <0x01 0xff>;

            #address-cells = <3>;
            #size-cells = <2>;
            ranges;
        };
    };
```

## Documentation/devicetree/bindings/pci/qcom,pcie-sa8255p.yaml
```yaml
# SPDX-License-Identifier: (GPL-2.0-only OR BSD-2-Clause)
%YAML 1.2
---
$id: http://devicetree.org/schemas/pci/qcom,pcie-sa8255p.yaml#
$schema: http://devicetree.org/meta-schemas/core.yaml#

title: Qualcomm SA8255p based firmware managed and ECAM compliant PCIe Root Complex

maintainers:
  - Bjorn Andersson <andersson@kernel.org>
  - Manivannan Sadhasivam <manivannan.sadhasivam@linaro.org>

description:
  Qualcomm SA8255p SoC PCIe root complex controller is based on the Synopsys
  DesignWare PCIe IP which is managed by firmware, and configured in ECAM mode.

properties:
  compatible:
    const: qcom,pcie-sa8255p

  reg:
    description:
      The base address and size of the ECAM area for accessing PCI
      Configuration Space, as accessed from the parent bus. The base
      address corresponds to the first bus in the "bus-range" property. If
      no "bus-range" is specified, this will be bus 0 (the default).
    maxItems: 1

  ranges:
    description:
      As described in IEEE Std 1275-1994, but must provide at least a
      definition of non-prefetchable memory. One or both of prefetchable Memory
      may also be provided.
    minItems: 1
    maxItems: 2

  interrupts:
    minItems: 8
    maxItems: 8

  interrupt-names:
    items:
      - const: msi0
      - const: msi1
      - const: msi2
      - const: msi3
      - const: msi4
      - const: msi5
      - const: msi6
      - const: msi7

  power-domains:
    maxItems: 1

  dma-coherent: true
  iommu-map: true

required:
  - compatible
  - reg
  - ranges
  - power-domains
  - interrupts
  - interrupt-names

allOf:
  - $ref: /schemas/pci/pci-host-bridge.yaml#

unevaluatedProperties: false

examples:
  - |
    #include <dt-bindings/interrupt-controller/arm-gic.h>

    soc {
        #address-cells = <2>;
        #size-cells = <2>;

        pci@1c00000 {
            compatible = "qcom,pcie-sa8255p";
            reg = <0x4 0x00000000 0 0x10000000>;
            device_type = "pci";
            #address-cells = <3>;
            #size-cells = <2>;
            ranges = <0x02000000 0x0 0x40100000 0x0 0x40100000 0x0 0x1ff00000>,
                     <0x43000000 0x4 0x10100000 0x4 0x10100000 0x0 0x40000000>;
            bus-range = <0x00 0xff>;
            dma-coherent;
            linux,pci-domain = <0>;
            power-domains = <&scmi5_pd 0>;
            iommu-map = <0x0 &pcie_smmu 0x0000 0x1>,
                        <0x100 &pcie_smmu 0x0001 0x1>;
            interrupt-parent = <&intc>;
            interrupts = <GIC_SPI 307 IRQ_TYPE_LEVEL_HIGH>,
                         <GIC_SPI 308 IRQ_TYPE_LEVEL_HIGH>,
                         <GIC_SPI 309 IRQ_TYPE_LEVEL_HIGH>,
                         <GIC_SPI 312 IRQ_TYPE_LEVEL_HIGH>,
                         <GIC_SPI 313 IRQ_TYPE_LEVEL_HIGH>,
                         <GIC_SPI 314 IRQ_TYPE_LEVEL_HIGH>,
                         <GIC_SPI 374 IRQ_TYPE_LEVEL_HIGH>,
                         <GIC_SPI 375 IRQ_TYPE_LEVEL_HIGH>;
            interrupt-names = "msi0", "msi1", "msi2", "msi3",
                                   "msi4", "msi5", "msi6", "msi7";

            #interrupt-cells = <1>;
            interrupt-map-mask = <0 0 0 0x7>;
            interrupt-map = <0 0 0 1 &intc GIC_SPI 148 IRQ_TYPE_LEVEL_HIGH>,
                            <0 0 0 2 &intc GIC_SPI 149 IRQ_TYPE_LEVEL_HIGH>,
                            <0 0 0 3 &intc GIC_SPI 150 IRQ_TYPE_LEVEL_HIGH>,
                            <0 0 0 4 &intc GIC_SPI 151 IRQ_TYPE_LEVEL_HIGH>;

            pcie@0 {
                device_type = "pci";
                reg = <0x0 0x0 0x0 0x0 0x0>;
                bus-range = <0x01 0xff>;

                #address-cells = <3>;
                #size-cells = <2>;
                ranges;
            };
        };
    };
```
