## Documentation/devicetree/bindings/pci/renesas,r9a08g045-pcie.yaml
```yaml
# SPDX-License-Identifier: (GPL-2.0-only OR BSD-2-Clause)
%YAML 1.2
---
$id: http://devicetree.org/schemas/pci/renesas,r9a08g045-pcie.yaml#
$schema: http://devicetree.org/meta-schemas/core.yaml#

title: Renesas RZ/G3S PCIe host controller

maintainers:
  - Claudiu Beznea <claudiu.beznea.uj@bp.renesas.com>

description:
  Renesas RZ/G3S PCIe host controller complies with PCIe Base Specification
  4.0 and supports up to 5 GT/s (Gen2).

properties:
  compatible:
    const: renesas,r9a08g045-pcie # RZ/G3S

  reg:
    maxItems: 1

  interrupts:
    items:
      - description: System error interrupt
      - description: System error on correctable error interrupt
      - description: System error on non-fatal error interrupt
      - description: System error on fatal error interrupt
      - description: AXI error interrupt
      - description: INTA interrupt
      - description: INTB interrupt
      - description: INTC interrupt
      - description: INTD interrupt
      - description: MSI interrupt
      - description: Link bandwidth interrupt
      - description: PME interrupt
      - description: DMA interrupt
      - description: PCIe event interrupt
      - description: Message interrupt
      - description: All interrupts

  interrupt-names:
    items:
      - description: serr
      - description: ser_cor
      - description: serr_nonfatal
      - description: serr_fatal
      - description: axi_err
      - description: inta
      - description: intb
      - description: intc
      - description: intd
      - description: msi
      - description: link_bandwidth
      - description: pm_pme
      - description: dma
      - description: pcie_evt
      - description: msg
      - description: all

  interrupt-controller: true

  clocks:
    items:
      - description: System clock
      - description: PM control clock

  clock-names:
    items:
      - description: aclk
      - description: pm

  resets:
    items:
      - description: AXI2PCIe Bridge reset
      - description: Data link layer/transaction layer reset
      - description: Transaction layer (ACLK domain) reset
      - description: Transaction layer (PCLK domain) reset
      - description: Physical layer reset
      - description: Configuration register reset
      - description: Configuration register reset

  reset-names:
    items:
      - description: aresetn
      - description: rst_b
      - description: rst_gp_b
      - description: rst_ps_b
      - description: rst_rsm_b
      - description: rst_cfg_b
      - description: rst_load_b

  power-domains:
    maxItems: 1

  dma-ranges:
    description:
      A single range for the inbound memory region.
    maxItems: 1

  renesas,sysc:
    description: |
      System controller registers control and monitor various PCIe
      functionalities.

      Control:
      - transition to L1 state
      - receiver termination settings
      - RST_RSM_B signal

      Monitor:
      - clkl1pm clock request state
      - power off information in L2 state
      - errors (fatal, non-fatal, correctable)
    $ref: /schemas/types.yaml#/definitions/phandle

patternProperties:
  "^pcie@0,[0-0]$":
    type: object
    allOf:
      - $ref: /schemas/pci/pci-pci-bridge.yaml#

    properties:
      reg:
        maxItems: 1

      vendor-id:
        const: 0x1912

      device-id:
        const: 0x0033

      clocks:
        items:
          - description: Reference clock

      clock-names:
        items:
          - const: ref

    required:
      - device_type
      - vendor-id
      - device-id
      - clocks
      - clock-names

    unevaluatedProperties: false

required:
  - compatible
  - reg
  - clocks
  - clock-names
  - resets
  - reset-names
  - interrupts
  - interrupt-names
  - interrupt-map
  - interrupt-map-mask
  - interrupt-controller
  - power-domains
  - "#address-cells"
  - "#size-cells"
  - "#interrupt-cells"
  - renesas,sysc

allOf:
  - $ref: /schemas/pci/pci-host-bridge.yaml#

unevaluatedProperties: false

examples:
  - |
    #include <dt-bindings/clock/r9a08g045-cpg.h>
    #include <dt-bindings/interrupt-controller/arm-gic.h>

    bus {
        #address-cells = <2>;
        #size-cells = <2>;

        pcie@11e40000 {
            compatible = "renesas,r9a08g045-pcie";
            reg = <0 0x11e40000 0 0x10000>;
            ranges = <0x02000000 0 0x30000000 0 0x30000000 0 0x08000000>;
            /* Map all possible DRAM ranges (4 GB). */
            dma-ranges = <0x42000000 0 0x40000000 0 0x40000000 1 0x00000000>;
            bus-range = <0x0 0xff>;
            interrupts = <GIC_SPI 395 IRQ_TYPE_LEVEL_HIGH>,
                         <GIC_SPI 396 IRQ_TYPE_LEVEL_HIGH>,
                         <GIC_SPI 397 IRQ_TYPE_LEVEL_HIGH>,
                         <GIC_SPI 398 IRQ_TYPE_LEVEL_HIGH>,
                         <GIC_SPI 399 IRQ_TYPE_LEVEL_HIGH>,
                         <GIC_SPI 400 IRQ_TYPE_LEVEL_HIGH>,
                         <GIC_SPI 401 IRQ_TYPE_LEVEL_HIGH>,
                         <GIC_SPI 402 IRQ_TYPE_LEVEL_HIGH>,
                         <GIC_SPI 403 IRQ_TYPE_LEVEL_HIGH>,
                         <GIC_SPI 404 IRQ_TYPE_LEVEL_HIGH>,
                         <GIC_SPI 405 IRQ_TYPE_LEVEL_HIGH>,
                         <GIC_SPI 406 IRQ_TYPE_LEVEL_HIGH>,
                         <GIC_SPI 407 IRQ_TYPE_LEVEL_HIGH>,
                         <GIC_SPI 408 IRQ_TYPE_LEVEL_HIGH>,
                         <GIC_SPI 409 IRQ_TYPE_LEVEL_HIGH>,
                         <GIC_SPI 410 IRQ_TYPE_LEVEL_HIGH>;
            interrupt-names = "serr", "serr_cor", "serr_nonfatal",
                              "serr_fatal", "axi_err", "inta",
                              "intb", "intc", "intd", "msi",
                              "link_bandwidth", "pm_pme", "dma",
                              "pcie_evt", "msg", "all";
            #interrupt-cells = <1>;
            interrupt-controller;
            interrupt-map-mask = <0 0 0 7>;
            interrupt-map = <0 0 0 1 &pcie 0 0 0 0>, /* INTA */
                            <0 0 0 2 &pcie 0 0 0 1>, /* INTB */
                            <0 0 0 3 &pcie 0 0 0 2>, /* INTC */
                            <0 0 0 4 &pcie 0 0 0 3>; /* INTD */
            clocks = <&cpg CPG_MOD R9A08G045_PCI_ACLK>,
                     <&cpg CPG_MOD R9A08G045_PCI_CLKL1PM>;
            clock-names = "aclk", "pm";
            resets = <&cpg R9A08G045_PCI_ARESETN>,
                     <&cpg R9A08G045_PCI_RST_B>,
                     <&cpg R9A08G045_PCI_RST_GP_B>,
                     <&cpg R9A08G045_PCI_RST_PS_B>,
                     <&cpg R9A08G045_PCI_RST_RSM_B>,
                     <&cpg R9A08G045_PCI_RST_CFG_B>,
                     <&cpg R9A08G045_PCI_RST_LOAD_B>;
            reset-names = "aresetn", "rst_b", "rst_gp_b", "rst_ps_b",
                          "rst_rsm_b", "rst_cfg_b", "rst_load_b";
            power-domains = <&cpg>;
            device_type = "pci";
            #address-cells = <3>;
            #size-cells = <2>;
            renesas,sysc = <&sysc>;

            pcie@0,0 {
                reg = <0x0 0x0 0x0 0x0 0x0>;
                ranges;
                clocks = <&versa3 5>;
                clock-names = "ref";
                device_type = "pci";
                vendor-id = <0x1912>;
                device-id = <0x0033>;
                #address-cells = <3>;
                #size-cells = <2>;
            };
        };
    };

...
```

## Documentation/devicetree/bindings/pci/rockchip,rk3399-pcie-common.yaml
```yaml
# SPDX-License-Identifier: (GPL-2.0 OR BSD-2-Clause)
%YAML 1.2
---
$id: http://devicetree.org/schemas/pci/rockchip,rk3399-pcie-common.yaml#
$schema: http://devicetree.org/meta-schemas/core.yaml#

title: Rockchip AXI PCIe Bridge Common Properties

maintainers:
  - Shawn Lin <shawn.lin@rock-chips.com>

properties:
  reg:
    maxItems: 2

  clocks:
    maxItems: 4

  clock-names:
    items:
      - const: aclk
      - const: aclk-perf
      - const: hclk
      - const: pm

  num-lanes:
    maximum: 4

  phys:
    oneOf:
      - maxItems: 1
      - maxItems: 4

  phy-names:
    oneOf:
      - const: pcie-phy
      - items:
          - const: pcie-phy-0
          - const: pcie-phy-1
          - const: pcie-phy-2
          - const: pcie-phy-3

  resets:
    maxItems: 7

  reset-names:
    items:
      - const: core
      - const: mgmt
      - const: mgmt-sticky
      - const: pipe
      - const: pm
      - const: pclk
      - const: aclk

required:
  - compatible
  - reg
  - reg-names
  - clocks
  - clock-names
  - phys
  - phy-names
  - resets
  - reset-names

additionalProperties: true

...
```

## Documentation/devicetree/bindings/pci/rockchip,rk3399-pcie-ep.yaml
```yaml
# SPDX-License-Identifier: (GPL-2.0 OR BSD-2-Clause)
%YAML 1.2
---
$id: http://devicetree.org/schemas/pci/rockchip,rk3399-pcie-ep.yaml#
$schema: http://devicetree.org/meta-schemas/core.yaml#

title: Rockchip AXI PCIe Endpoint

maintainers:
  - Shawn Lin <shawn.lin@rock-chips.com>

allOf:
  - $ref: /schemas/pci/pci-ep.yaml#
  - $ref: rockchip,rk3399-pcie-common.yaml#

properties:
  compatible:
    const: rockchip,rk3399-pcie-ep

  reg: true

  reg-names:
    items:
      - const: apb-base
      - const: mem-base

  rockchip,max-outbound-regions:
    description: Maximum number of outbound regions
    $ref: /schemas/types.yaml#/definitions/uint32
    maximum: 32
    default: 32

required:
  - rockchip,max-outbound-regions

unevaluatedProperties: false

examples:
  - |
    #include <dt-bindings/interrupt-controller/arm-gic.h>
    #include <dt-bindings/gpio/gpio.h>
    #include <dt-bindings/clock/rk3399-cru.h>

    bus {
        #address-cells = <2>;
        #size-cells = <2>;

        pcie-ep@f8000000 {
            compatible = "rockchip,rk3399-pcie-ep";
            reg = <0x0 0xfd000000 0x0 0x1000000>, <0x0 0x80000000 0x0 0x20000>;
            reg-names = "apb-base", "mem-base";
            clocks = <&cru ACLK_PCIE>, <&cru ACLK_PERF_PCIE>,
              <&cru PCLK_PCIE>, <&cru SCLK_PCIE_PM>;
            clock-names = "aclk", "aclk-perf",
                    "hclk", "pm";
            max-functions = /bits/ 8 <8>;
            num-lanes = <4>;
            resets = <&cru SRST_PCIE_CORE>, <&cru SRST_PCIE_MGMT>,
              <&cru SRST_PCIE_MGMT_STICKY>, <&cru SRST_PCIE_PIPE> ,
              <&cru SRST_PCIE_PM>, <&cru SRST_P_PCIE>, <&cru SRST_A_PCIE>;
            reset-names = "core", "mgmt", "mgmt-sticky", "pipe",
                    "pm", "pclk", "aclk";
            phys = <&pcie_phy 0>, <&pcie_phy 1>, <&pcie_phy 2>, <&pcie_phy 3>;
            phy-names = "pcie-phy-0", "pcie-phy-1", "pcie-phy-2", "pcie-phy-3";
            rockchip,max-outbound-regions = <16>;
        };
    };
...
```

## Documentation/devicetree/bindings/pci/rockchip,rk3399-pcie.yaml
```yaml
# SPDX-License-Identifier: (GPL-2.0 OR BSD-2-Clause)
%YAML 1.2
---
$id: http://devicetree.org/schemas/pci/rockchip,rk3399-pcie.yaml#
$schema: http://devicetree.org/meta-schemas/core.yaml#

title: Rockchip AXI PCIe Root Port Bridge Host

maintainers:
  - Shawn Lin <shawn.lin@rock-chips.com>

allOf:
  - $ref: /schemas/pci/pci-host-bridge.yaml#
  - $ref: rockchip,rk3399-pcie-common.yaml#

properties:
  compatible:
    const: rockchip,rk3399-pcie

  reg: true

  reg-names:
    items:
      - const: axi-base
      - const: apb-base

  interrupts:
    maxItems: 3

  interrupt-names:
    items:
      - const: sys
      - const: legacy
      - const: client

  aspm-no-l0s:
    description: This property is needed if using 24MHz OSC for RC's PHY.

  ep-gpios:
    maxItems: 1
    description: pre-reset GPIO

  vpcie12v-supply:
    description: The 12v regulator to use for PCIe.

  vpcie3v3-supply:
    description: The 3.3v regulator to use for PCIe.

  vpcie1v8-supply:
    description: The 1.8v regulator to use for PCIe.

  vpcie0v9-supply:
    description: The 0.9v regulator to use for PCIe.

  interrupt-controller:
    type: object
    additionalProperties: false

    properties:
      '#address-cells':
        const: 0

      '#interrupt-cells':
        const: 1

      interrupt-controller: true

required:
  - ranges
  - "#interrupt-cells"
  - interrupts
  - interrupt-controller
  - interrupt-map
  - interrupt-map-mask
  - msi-map

unevaluatedProperties: false

examples:
  - |
    #include <dt-bindings/interrupt-controller/arm-gic.h>
    #include <dt-bindings/gpio/gpio.h>
    #include <dt-bindings/clock/rk3399-cru.h>

    bus {
        #address-cells = <2>;
        #size-cells = <2>;

        pcie@f8000000 {
            compatible = "rockchip,rk3399-pcie";
            device_type = "pci";
            #address-cells = <3>;
            #size-cells = <2>;
            clocks = <&cru ACLK_PCIE>, <&cru ACLK_PERF_PCIE>,
              <&cru PCLK_PCIE>, <&cru SCLK_PCIE_PM>;
            clock-names = "aclk", "aclk-perf",
                    "hclk", "pm";
            interrupts = <GIC_SPI 49 IRQ_TYPE_LEVEL_HIGH 0>,
                  <GIC_SPI 50 IRQ_TYPE_LEVEL_HIGH 0>,
                  <GIC_SPI 51 IRQ_TYPE_LEVEL_HIGH 0>;
            interrupt-names = "sys", "legacy", "client";
            ep-gpios = <&gpio3 13 GPIO_ACTIVE_HIGH>;
            ranges = <0x83000000 0x0 0xfa000000 0x0 0xfa000000 0x0 0x600000
                0x81000000 0x0 0xfa600000 0x0 0xfa600000 0x0 0x100000>;
            num-lanes = <4>;
            msi-map = <0x0 &its 0x0 0x1000>;
            reg = <0x0 0xf8000000 0x0 0x2000000>, <0x0 0xfd000000 0x0 0x1000000>;
            reg-names = "axi-base", "apb-base";
            resets = <&cru SRST_PCIE_CORE>, <&cru SRST_PCIE_MGMT>,
              <&cru SRST_PCIE_MGMT_STICKY>, <&cru SRST_PCIE_PIPE> ,
              <&cru SRST_PCIE_PM>, <&cru SRST_P_PCIE>, <&cru SRST_A_PCIE>;
            reset-names = "core", "mgmt", "mgmt-sticky", "pipe",
                    "pm", "pclk", "aclk";
            /* deprecated legacy PHY model */
            phys = <&pcie_phy>;
            phy-names = "pcie-phy";
            pinctrl-names = "default";
            pinctrl-0 = <&pcie_clkreq>;
            #interrupt-cells = <1>;
            interrupt-map-mask = <0 0 0 7>;
            interrupt-map = <0 0 0 1 &pcie0_intc 0>,
                <0 0 0 2 &pcie0_intc 1>,
                <0 0 0 3 &pcie0_intc 2>,
                <0 0 0 4 &pcie0_intc 3>;

            pcie0_intc: interrupt-controller {
                interrupt-controller;
                #address-cells = <0>;
                #interrupt-cells = <1>;
            };
        };
    };
...
```
