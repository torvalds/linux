## Documentation/devicetree/bindings/pci/qcom,sa8255p-pcie-ep.yaml
```yaml
# SPDX-License-Identifier: (GPL-2.0-only OR BSD-2-Clause)
%YAML 1.2
---
$id: http://devicetree.org/schemas/pci/qcom,sa8255p-pcie-ep.yaml#
$schema: http://devicetree.org/meta-schemas/core.yaml#

title: Qualcomm firmware managed PCIe Endpoint Controller

description:
  Qualcomm SA8255p SoC PCIe endpoint controller is based on the Synopsys
  DesignWare PCIe IP which is managed by firmware.

maintainers:
  - Manivannan Sadhasivam <mani@kernel.org>

properties:
  compatible:
    const: qcom,sa8255p-pcie-ep

  reg:
    items:
      - description: Qualcomm-specific PARF configuration registers
      - description: DesignWare PCIe registers
      - description: External local bus interface registers
      - description: Address Translation Unit (ATU) registers
      - description: Memory region used to map remote RC address space
      - description: BAR memory region
      - description: DMA register space

  reg-names:
    items:
      - const: parf
      - const: dbi
      - const: elbi
      - const: atu
      - const: addr_space
      - const: mmio
      - const: dma

  interrupts:
    items:
      - description: PCIe Global interrupt
      - description: PCIe Doorbell interrupt
      - description: DMA interrupt

  interrupt-names:
    items:
      - const: global
      - const: doorbell
      - const: dma

  iommus:
    maxItems: 1

  reset-gpios:
    description: GPIO used as PERST# input signal
    maxItems: 1

  wake-gpios:
    description: GPIO used as WAKE# output signal
    maxItems: 1

  power-domains:
    maxItems: 1

  dma-coherent: true

  num-lanes:
    default: 2

required:
  - compatible
  - reg
  - reg-names
  - interrupts
  - interrupt-names
  - reset-gpios
  - power-domains

additionalProperties: false

examples:
  - |
    #include <dt-bindings/gpio/gpio.h>
    #include <dt-bindings/interrupt-controller/arm-gic.h>
    soc {
        #address-cells = <2>;
        #size-cells = <2>;
        pcie1_ep: pcie-ep@1c10000 {
            compatible = "qcom,sa8255p-pcie-ep";
            reg = <0x0 0x01c10000 0x0 0x3000>,
                  <0x0 0x60000000 0x0 0xf20>,
                  <0x0 0x60000f20 0x0 0xa8>,
                  <0x0 0x60001000 0x0 0x4000>,
                  <0x0 0x60200000 0x0 0x100000>,
                  <0x0 0x01c13000 0x0 0x1000>,
                  <0x0 0x60005000 0x0 0x2000>;
            reg-names = "parf", "dbi", "elbi", "atu", "addr_space", "mmio", "dma";
            interrupts = <GIC_SPI 518 IRQ_TYPE_LEVEL_HIGH>,
                         <GIC_SPI 152 IRQ_TYPE_LEVEL_HIGH>,
                         <GIC_SPI 474 IRQ_TYPE_LEVEL_HIGH>;
            interrupt-names = "global", "doorbell", "dma";
            reset-gpios = <&tlmm 4 GPIO_ACTIVE_LOW>;
            wake-gpios = <&tlmm 5 GPIO_ACTIVE_LOW>;
            dma-coherent;
            iommus = <&pcie_smmu 0x80 0x7f>;
            power-domains = <&scmi6_pd 1>;
            num-lanes = <4>;
        };
    };
```

## Documentation/devicetree/bindings/pci/ralink,rt3883-pci.txt
```
* Mediatek/Ralink RT3883 PCI controller

1) Main node

   Required properties:

   - compatible: must be "ralink,rt3883-pci"

   - reg: specifies the physical base address of the controller and
     the length of the memory mapped region.

   - #address-cells: specifies the number of cells needed to encode an
     address. The value must be 1.

   - #size-cells: specifies the number of cells used to represent the size
     of an address. The value must be 1.

   - ranges: specifies the translation between child address space and parent
     address space

  Optional properties:

   - status: indicates the operational status of the device.
     Value must be either "disabled" or "okay".

2) Child nodes

   The main node must have two child nodes which describes the built-in
   interrupt controller and the PCI host bridge.

   a) Interrupt controller:

   Required properties:

   - interrupt-controller: identifies the node as an interrupt controller

   - #address-cells: specifies the number of cells needed to encode an
     address. The value must be 0. As such, 'interrupt-map' nodes do not
     have to specify a parent unit address.

   - #interrupt-cells: specifies the number of cells needed to encode an
     interrupt source. The value must be 1.

   - interrupts: specifies the interrupt source of the parent interrupt
     controller. The format of the interrupt specifier depends on the
     parent interrupt controller.

   b) PCI host bridge:

   Required properties:

   - #address-cells: specifies the number of cells needed to encode an
     address. The value must be 0.

   - #size-cells: specifies the number of cells used to represent the size
     of an address. The value must be 2.

   - #interrupt-cells: specifies the number of cells needed to encode an
     interrupt source. The value must be 1.

   - device_type: must be "pci"

   - bus-range: PCI bus numbers covered

   - ranges: specifies the ranges for the PCI memory and I/O regions

   - interrupt-map-mask,
   - interrupt-map: standard PCI properties to define the mapping of the
     PCI interface to interrupt numbers.

   The PCI host bridge node might have additional sub-nodes representing
   the onboard PCI devices/PCI slots. Each such sub-node must have the
   following mandatory properties:

     - reg: used only for interrupt mapping, so only the first four bytes
       are used to refer to the correct bus number and device number.

     - device_type: must be "pci"

   If a given sub-node represents a PCI bridge it must have following
   mandatory properties as well:

     - #address-cells: must be set to <3>

     - #size-cells: must set to <2>

     - #interrupt-cells: must be set to <1>

     - interrupt-map-mask,
     - interrupt-map: standard PCI properties to define the mapping of the
       PCI interface to interrupt numbers.

   Besides the required properties the sub-nodes may have these optional
   properties:

     - status: indicates the operational status of the sub-node.
       Value must be either "disabled" or "okay".

3) Example:

   a) SoC specific dtsi file:

	pci@10140000 {
		compatible = "ralink,rt3883-pci";
		reg = <0x10140000 0x20000>;
		#address-cells = <1>;
		#size-cells = <1>;
		ranges; /* direct mapping */

		status = "disabled";

		pciintc: interrupt-controller {
			interrupt-controller;
			#address-cells = <0>;
			#interrupt-cells = <1>;

			interrupt-parent = <&cpuintc>;
			interrupts = <4>;
		};

		host-bridge {
			#address-cells = <3>;
			#size-cells = <2>;
			#interrupt-cells = <1>;

			device_type = "pci";

			bus-range = <0 255>;
			ranges = <
				0x02000000 0 0x00000000 0x20000000 0 0x10000000 /* pci memory */
				0x01000000 0 0x00000000 0x10160000 0 0x00010000 /* io space */
			>;

			interrupt-map-mask = <0xf800 0 0 7>;
			interrupt-map = <
				/* IDSEL 17 */
				0x8800 0 0 1 &pciintc 18
				0x8800 0 0 2 &pciintc 18
				0x8800 0 0 3 &pciintc 18
				0x8800 0 0 4 &pciintc 18
				/* IDSEL 18 */
				0x9000 0 0 1 &pciintc 19
				0x9000 0 0 2 &pciintc 19
				0x9000 0 0 3 &pciintc 19
				0x9000 0 0 4 &pciintc 19
			>;

			pci-bridge@1 {
				reg = <0x0800 0 0 0 0>;
				device_type = "pci";
				#interrupt-cells = <1>;
				#address-cells = <3>;
				#size-cells = <2>;

				interrupt-map-mask = <0x0 0 0 0>;
				interrupt-map = <0x0 0 0 0 &pciintc 20>;

				status = "disabled";
			};

			pci-slot@17 {
				reg = <0x8800 0 0 0 0>;
				device_type = "pci";

				status = "disabled";
			};

			pci-slot@18 {
				reg = <0x9000 0 0 0 0>;
				device_type = "pci";

				status = "disabled";
			};
		};
	};

   b) Board specific dts file:

	pci@10140000 {
		status = "okay";

		host-bridge {
			pci-bridge@1 {
				status = "okay";
			};
		};
	};
```

## Documentation/devicetree/bindings/pci/rcar-gen4-pci-ep.yaml
```yaml
# SPDX-License-Identifier: (GPL-2.0-only OR BSD-2-Clause)
# Copyright (C) 2022-2023 Renesas Electronics Corp.
%YAML 1.2
---
$id: http://devicetree.org/schemas/pci/rcar-gen4-pci-ep.yaml#
$schema: http://devicetree.org/meta-schemas/core.yaml#

title: Renesas R-Car Gen4 PCIe Endpoint

maintainers:
  - Yoshihiro Shimoda <yoshihiro.shimoda.uh@renesas.com>

allOf:
  - $ref: snps,dw-pcie-ep.yaml#

properties:
  compatible:
    items:
      - enum:
          - renesas,r8a779f0-pcie-ep      # R-Car S4-8
          - renesas,r8a779g0-pcie-ep      # R-Car V4H
      - const: renesas,rcar-gen4-pcie-ep  # R-Car Gen4

  reg:
    maxItems: 7

  reg-names:
    items:
      - const: dbi
      - const: dbi2
      - const: atu
      - const: dma
      - const: app
      - const: phy
      - const: addr_space

  interrupts:
    maxItems: 3

  interrupt-names:
    items:
      - const: dma
      - const: sft_ce
      - const: app

  clocks:
    maxItems: 2

  clock-names:
    items:
      - const: core
      - const: ref

  power-domains:
    maxItems: 1

  resets:
    maxItems: 1

  reset-names:
    items:
      - const: pwr

  max-link-speed:
    maximum: 4

  num-lanes:
    maximum: 4

  max-functions:
    maximum: 2

required:
  - compatible
  - reg
  - reg-names
  - interrupts
  - interrupt-names
  - clocks
  - clock-names
  - power-domains
  - resets
  - reset-names

unevaluatedProperties: false

examples:
  - |
    #include <dt-bindings/clock/r8a779f0-cpg-mssr.h>
    #include <dt-bindings/interrupt-controller/arm-gic.h>
    #include <dt-bindings/power/r8a779f0-sysc.h>

    soc {
        #address-cells = <2>;
        #size-cells = <2>;

        pcie0_ep: pcie-ep@e65d0000 {
            compatible = "renesas,r8a779f0-pcie-ep", "renesas,rcar-gen4-pcie-ep";
            reg = <0 0xe65d0000 0 0x2000>, <0 0xe65d2000 0 0x1000>,
                  <0 0xe65d3000 0 0x2000>, <0 0xe65d5000 0 0x1200>,
                  <0 0xe65d6200 0 0x0e00>, <0 0xe65d7000 0 0x0400>,
                  <0 0xfe000000 0 0x400000>;
            reg-names = "dbi", "dbi2", "atu", "dma", "app", "phy", "addr_space";
            interrupts = <GIC_SPI 417 IRQ_TYPE_LEVEL_HIGH>,
                         <GIC_SPI 418 IRQ_TYPE_LEVEL_HIGH>,
                         <GIC_SPI 422 IRQ_TYPE_LEVEL_HIGH>;
            interrupt-names = "dma", "sft_ce", "app";
            clocks = <&cpg CPG_MOD 624>, <&pcie0_clkref>;
            clock-names = "core", "ref";
            power-domains = <&sysc R8A779F0_PD_ALWAYS_ON>;
            resets = <&cpg 624>;
            reset-names = "pwr";
            max-link-speed = <4>;
            num-lanes = <2>;
            max-functions = /bits/ 8 <2>;
        };
    };
```

## Documentation/devicetree/bindings/pci/rcar-gen4-pci-host.yaml
```yaml
# SPDX-License-Identifier: (GPL-2.0-only OR BSD-2-Clause)
# Copyright (C) 2022-2023 Renesas Electronics Corp.
%YAML 1.2
---
$id: http://devicetree.org/schemas/pci/rcar-gen4-pci-host.yaml#
$schema: http://devicetree.org/meta-schemas/core.yaml#

title: Renesas R-Car Gen4 PCIe Host

maintainers:
  - Yoshihiro Shimoda <yoshihiro.shimoda.uh@renesas.com>

allOf:
  - $ref: snps,dw-pcie.yaml#

properties:
  compatible:
    items:
      - const: renesas,r8a779f0-pcie   # R-Car S4-8
      - const: renesas,rcar-gen4-pcie  # R-Car Gen4

  reg:
    maxItems: 7

  reg-names:
    items:
      - const: dbi
      - const: dbi2
      - const: atu
      - const: dma
      - const: app
      - const: phy
      - const: config

  interrupts:
    maxItems: 4

  interrupt-names:
    items:
      - const: msi
      - const: dma
      - const: sft_ce
      - const: app

  clocks:
    maxItems: 2

  clock-names:
    items:
      - const: core
      - const: ref

  power-domains:
    maxItems: 1

  resets:
    maxItems: 1

  reset-names:
    items:
      - const: pwr

  max-link-speed:
    maximum: 4

  num-lanes:
    maximum: 4

required:
  - compatible
  - reg
  - reg-names
  - interrupts
  - interrupt-names
  - clocks
  - clock-names
  - power-domains
  - resets
  - reset-names

unevaluatedProperties: false

examples:
  - |
    #include <dt-bindings/clock/r8a779f0-cpg-mssr.h>
    #include <dt-bindings/interrupt-controller/arm-gic.h>
    #include <dt-bindings/power/r8a779f0-sysc.h>

    soc {
        #address-cells = <2>;
        #size-cells = <2>;

        pcie: pcie@e65d0000 {
            compatible = "renesas,r8a779f0-pcie", "renesas,rcar-gen4-pcie";
            reg = <0 0xe65d0000 0 0x1000>, <0 0xe65d2000 0 0x0800>,
                  <0 0xe65d3000 0 0x2000>, <0 0xe65d5000 0 0x1200>,
                  <0 0xe65d6200 0 0x0e00>, <0 0xe65d7000 0 0x0400>,
                  <0 0xfe000000 0 0x400000>;
            reg-names = "dbi", "dbi2", "atu", "dma", "app", "phy", "config";
            interrupts = <GIC_SPI 416 IRQ_TYPE_LEVEL_HIGH>,
                         <GIC_SPI 417 IRQ_TYPE_LEVEL_HIGH>,
                         <GIC_SPI 418 IRQ_TYPE_LEVEL_HIGH>,
                         <GIC_SPI 422 IRQ_TYPE_LEVEL_HIGH>;
            interrupt-names = "msi", "dma", "sft_ce", "app";
            clocks = <&cpg CPG_MOD 624>, <&pcie0_clkref>;
            clock-names = "core", "ref";
            power-domains = <&sysc R8A779F0_PD_ALWAYS_ON>;
            resets = <&cpg 624>;
            reset-names = "pwr";
            max-link-speed = <4>;
            num-lanes = <2>;
            #address-cells = <3>;
            #size-cells = <2>;
            bus-range = <0x00 0xff>;
            device_type = "pci";
            ranges = <0x01000000 0 0x00000000 0 0xfe000000 0 0x00400000>,
                     <0x02000000 0 0x30000000 0 0x30000000 0 0x10000000>;
            dma-ranges = <0x42000000 0 0x00000000 0 0x00000000 1 0x00000000>;
            #interrupt-cells = <1>;
            interrupt-map-mask = <0 0 0 7>;
            interrupt-map = <0 0 0 1 &gic GIC_SPI 416 IRQ_TYPE_LEVEL_HIGH>,
                            <0 0 0 2 &gic GIC_SPI 416 IRQ_TYPE_LEVEL_HIGH>,
                            <0 0 0 3 &gic GIC_SPI 416 IRQ_TYPE_LEVEL_HIGH>,
                            <0 0 0 4 &gic GIC_SPI 416 IRQ_TYPE_LEVEL_HIGH>;
            snps,enable-cdm-check;
        };
    };
```
