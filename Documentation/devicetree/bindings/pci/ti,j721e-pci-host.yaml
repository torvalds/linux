## Documentation/devicetree/bindings/pci/ti,j721e-pci-host.yaml
```yaml
# SPDX-License-Identifier: (GPL-2.0-only OR BSD-2-Clause)
# Copyright (C) 2019 Texas Instruments Incorporated - http://www.ti.com/
%YAML 1.2
---
$id: "http://devicetree.org/schemas/pci/ti,j721e-pci-host.yaml#"
$schema: "http://devicetree.org/meta-schemas/core.yaml#"

title: TI J721E PCI Host (PCIe Wrapper)

maintainers:
  - Kishon Vijay Abraham I <kishon@ti.com>

allOf:
  - $ref: "cdns-pcie-host.yaml#"

properties:
  compatible:
    oneOf:
      - const: ti,j721e-pcie-host
      - description: PCIe controller in AM64
        items:
          - const: ti,am64-pcie-host
          - const: ti,j721e-pcie-host
      - description: PCIe controller in J7200
        items:
          - const: ti,j7200-pcie-host
          - const: ti,j721e-pcie-host

  reg:
    maxItems: 4

  reg-names:
    items:
      - const: intd_cfg
      - const: user_cfg
      - const: reg
      - const: cfg

  ti,syscon-pcie-ctrl:
    $ref: /schemas/types.yaml#/definitions/phandle-array
    items:
      - items:
          - description: Phandle to the SYSCON entry
          - description: pcie_ctrl register offset within SYSCON
    description: Specifier for configuring PCIe mode and link speed.

  power-domains:
    maxItems: 1

  clocks:
    minItems: 1
    maxItems: 2
    description: |+
      clock-specifier to represent input to the PCIe for 1 item.
      2nd item if present represents reference clock to the connector.

  clock-names:
    minItems: 1
    items:
      - const: fck
      - const: pcie_refclk

  dma-coherent: true

  vendor-id:
    const: 0x104c

  device-id:
    oneOf:
      - items:
          - const: 0xb00d
      - items:
          - const: 0xb00f
      - items:
          - const: 0xb010

  msi-map: true

required:
  - compatible
  - reg
  - reg-names
  - ti,syscon-pcie-ctrl
  - max-link-speed
  - num-lanes
  - power-domains
  - clocks
  - clock-names
  - vendor-id
  - device-id
  - msi-map
  - dma-ranges
  - ranges
  - reset-gpios
  - phys
  - phy-names

unevaluatedProperties: false

examples:
  - |
    #include <dt-bindings/soc/ti,sci_pm_domain.h>
    #include <dt-bindings/gpio/gpio.h>

    bus {
        #address-cells = <2>;
        #size-cells = <2>;

        pcie0_rc: pcie@2900000 {
            compatible = "ti,j721e-pcie-host";
            reg = <0x00 0x02900000 0x00 0x1000>,
                  <0x00 0x02907000 0x00 0x400>,
                  <0x00 0x0d000000 0x00 0x00800000>,
                  <0x00 0x10000000 0x00 0x00001000>;
            reg-names = "intd_cfg", "user_cfg", "reg", "cfg";
            ti,syscon-pcie-ctrl = <&pcie0_ctrl 0x4070>;
            max-link-speed = <3>;
            num-lanes = <2>;
            power-domains = <&k3_pds 239 TI_SCI_PD_EXCLUSIVE>;
            clocks = <&k3_clks 239 1>;
            clock-names = "fck";
            device_type = "pci";
            #address-cells = <3>;
            #size-cells = <2>;
            bus-range = <0x0 0xf>;
            vendor-id = <0x104c>;
            device-id = <0xb00d>;
            msi-map = <0x0 &gic_its 0x0 0x10000>;
            dma-coherent;
            reset-gpios = <&exp1 6 GPIO_ACTIVE_HIGH>;
            phys = <&serdes0_pcie_link>;
            phy-names = "pcie-phy";
            ranges = <0x01000000 0x0 0x10001000  0x00 0x10001000  0x0 0x0010000>,
                     <0x02000000 0x0 0x10011000  0x00 0x10011000  0x0 0x7fef000>;
            dma-ranges = <0x02000000 0x0 0x0 0x0 0x0 0x10000 0x0>;
        };
    };
```

## Documentation/devicetree/bindings/pci/ti-pci.txt
```
TI PCI Controllers

PCIe DesignWare Controller
 - compatible: Should be "ti,dra7-pcie" for RC (deprecated)
	       Should be "ti,dra7-pcie-ep" for EP (deprecated)
	       Should be "ti,dra746-pcie-rc" for dra74x/dra76 in RC mode
	       Should be "ti,dra746-pcie-ep" for dra74x/dra76 in EP mode
	       Should be "ti,dra726-pcie-rc" for dra72x in RC mode
	       Should be "ti,dra726-pcie-ep" for dra72x in EP mode
 - phys : list of PHY specifiers (used by generic PHY framework)
 - phy-names : must be "pcie-phy0", "pcie-phy1", "pcie-phyN".. based on the
	       number of PHYs as specified in *phys* property.
 - ti,hwmods : Name of the hwmod associated to the pcie, "pcie<X>",
	       where <X> is the instance number of the pcie from the HW spec.
 - num-lanes as specified in ../designware-pcie.txt
 - ti,syscon-lane-sel : phandle/offset pair. Phandle to the system control
			module and the register offset to specify lane
			selection.

HOST MODE
=========
 - reg : Two register ranges as listed in the reg-names property
 - reg-names : The first entry must be "ti-conf" for the TI-specific registers
	       The second entry must be "rc-dbics" for the DesignWare PCIe
	       registers
	       The third entry must be "config" for the PCIe configuration space
 - interrupts : Two interrupt entries must be specified. The first one is for
		main interrupt line and the second for MSI interrupt line.
 - #address-cells,
   #size-cells,
   #interrupt-cells,
   device_type,
   ranges,
   interrupt-map-mask,
   interrupt-map : as specified in ../designware-pcie.txt
 - ti,syscon-unaligned-access: phandle to the syscon DT node. The 1st argument
			       should contain the register offset within syscon
			       and the 2nd argument should contain the bit field
			       for setting the bit to enable unaligned
			       access.

DEVICE MODE
===========
 - reg : Four register ranges as listed in the reg-names property
 - reg-names : "ti-conf" for the TI-specific registers
	       "ep_dbics" for the standard configuration registers as
		they are locally accessed within the DIF CS space
	       "ep_dbics2" for the standard configuration registers as
		they are locally accessed within the DIF CS2 space
	       "addr_space" used to map remote RC address space
 - interrupts : one interrupt entries must be specified for main interrupt.
 - num-ib-windows : number of inbound address translation windows
 - num-ob-windows : number of outbound address translation windows
 - ti,syscon-unaligned-access: phandle to the syscon DT node. The 1st argument
			       should contain the register offset within syscon
			       and the 2nd argument should contain the bit field
			       for setting the bit to enable unaligned
			       access.

Optional Property:
 - gpios : Should be added if a GPIO line is required to drive PERST# line

NOTE: Two DT nodes may be added for each PCI controller; one for host
mode and another for device mode. So in order for PCI to
work in host mode, EP mode DT node should be disabled and in order to PCI to
work in EP mode, host mode DT node should be disabled. Host mode and EP
mode are mutually exclusive.

Example:
axi {
	compatible = "simple-bus";
	#size-cells = <1>;
	#address-cells = <1>;
	ranges = <0x51000000 0x51000000 0x3000
		  0x0	     0x20000000 0x10000000>;
	pcie@51000000 {
		compatible = "ti,dra7-pcie";
		reg = <0x51000000 0x2000>, <0x51002000 0x14c>, <0x1000 0x2000>;
		reg-names = "rc_dbics", "ti_conf", "config";
		interrupts = <0 232 0x4>, <0 233 0x4>;
		#address-cells = <3>;
		#size-cells = <2>;
		device_type = "pci";
		ranges = <0x81000000 0 0          0x03000 0 0x00010000
			  0x82000000 0 0x20013000 0x13000 0 0xffed000>;
		#interrupt-cells = <1>;
		num-lanes = <1>;
		ti,hwmods = "pcie1";
		phys = <&pcie1_phy>;
		phy-names = "pcie-phy0";
		interrupt-map-mask = <0 0 0 7>;
		interrupt-map = <0 0 0 1 &pcie_intc 1>,
				<0 0 0 2 &pcie_intc 2>,
				<0 0 0 3 &pcie_intc 3>,
				<0 0 0 4 &pcie_intc 4>;
		pcie_intc: interrupt-controller {
			interrupt-controller;
			#address-cells = <0>;
			#interrupt-cells = <1>;
		};
	};
};
```

## Documentation/devicetree/bindings/pci/toshiba,tc9563.yaml
```yaml
# SPDX-License-Identifier: (GPL-2.0-only OR BSD-2-Clause)
%YAML 1.2
---
$id: http://devicetree.org/schemas/pci/toshiba,tc9563.yaml#
$schema: http://devicetree.org/meta-schemas/core.yaml#

title: Toshiba TC9563 PCIe switch

maintainers:
  - Krishna Chaitanya Chundru <krishna.chundru@oss.qualcomm.com>

description: |
  Toshiba TC9563 PCIe switch has one upstream and three downstream ports.
  The 3rd downstream port has integrated endpoint device of Ethernet MAC.
  Other two downstream ports are supposed to connect to external device.

  The TC9563 PCIe switch can be configured through I2C interface before
  PCIe link is established to change FTS, ASPM related entry delays,
  tx amplitude etc for better power efficiency and functionality.

properties:
  compatible:
    enum:
      - pci1179,0623

  reg:
    maxItems: 1

  resx-gpios:
    maxItems: 1
    description:
      GPIO controlling the RESX# pin.

  vdd18-supply: true

  vdd09-supply: true

  vddc-supply: true

  vddio1-supply: true

  vddio2-supply: true

  vddio18-supply: true

  i2c-parent:
    $ref: /schemas/types.yaml#/definitions/phandle-array
    description:
      A phandle to the parent I2C node and the slave address of the device
      used to configure tc9563 to change FTS, tx amplitude etc.
    items:
      - description: Phandle to the I2C controller node
      - description: I2C slave address

patternProperties:
  "^pcie@[1-3],0$":
    description:
      child nodes describing the internal downstream ports of
      the tc9563 switch.
    type: object
    allOf:
      - $ref: "#/$defs/tc9563-node"
      - $ref: /schemas/pci/pci-pci-bridge.yaml#
    unevaluatedProperties: false

$defs:
  tc9563-node:
    type: object

    properties:
      toshiba,tx-amplitude-microvolt:
        description:
          Change Tx Margin setting for low power consumption.

      toshiba,no-dfe-support:
        type: boolean
        description:
          Disable DFE (Decision Feedback Equalizer), which mitigates
          intersymbol interference and some reflections caused by
          impedance mismatches.

required:
  - resx-gpios
  - vdd18-supply
  - vdd09-supply
  - vddc-supply
  - vddio1-supply
  - vddio2-supply
  - vddio18-supply
  - i2c-parent

allOf:
  - $ref: "#/$defs/tc9563-node"
  - $ref: /schemas/pci/pci-bus-common.yaml#

unevaluatedProperties: false

examples:
  - |
    #include <dt-bindings/gpio/gpio.h>

    pcie {
        #address-cells = <3>;
        #size-cells = <2>;

        pcie@0 {
            device_type = "pci";
            reg = <0x0 0x0 0x0 0x0 0x0>;

            #address-cells = <3>;
            #size-cells = <2>;
            ranges;
            bus-range = <0x01 0xff>;

            pcie@0,0 {
                compatible = "pci1179,0623";

                reg = <0x10000 0x0 0x0 0x0 0x0>;
                device_type = "pci";
                #address-cells = <3>;
                #size-cells = <2>;
                ranges;
                bus-range = <0x02 0xff>;

                i2c-parent = <&qup_i2c 0x77>;

                vdd18-supply = <&vdd>;
                vdd09-supply = <&vdd>;
                vddc-supply = <&vdd>;
                vddio1-supply = <&vdd>;
                vddio2-supply = <&vdd>;
                vddio18-supply = <&vdd>;

                resx-gpios = <&gpio 1 GPIO_ACTIVE_LOW>;

                pcie@1,0 {
                    compatible = "pciclass,0604";
                    reg = <0x20800 0x0 0x0 0x0 0x0>;
                    #address-cells = <3>;
                    #size-cells = <2>;
                    device_type = "pci";
                    ranges;
                    bus-range = <0x03 0xff>;

                    toshiba,no-dfe-support;
                };

                pcie@2,0 {
                    compatible = "pciclass,0604";
                    reg = <0x21000 0x0 0x0 0x0 0x0>;
                    #address-cells = <3>;
                    #size-cells = <2>;
                    device_type = "pci";
                    ranges;
                    bus-range = <0x04 0xff>;
                };

                pcie@3,0 {
                    compatible = "pciclass,0604";
                    reg = <0x21800 0x0 0x0 0x0 0x0>;
                    #address-cells = <3>;
                    #size-cells = <2>;
                    device_type = "pci";
                    ranges;
                    bus-range = <0x05 0xff>;

                    toshiba,tx-amplitude-microvolt = <10>;

                    ethernet@0,0 {
                        reg = <0x50000 0x0 0x0 0x0 0x0>;
                    };

                    ethernet@0,1 {
                        reg = <0x50100 0x0 0x0 0x0 0x0>;
                    };
                };
            };
        };
    };
```

## Documentation/devicetree/bindings/pci/toshiba,visconti-pcie.yaml
```yaml
# SPDX-License-Identifier: (GPL-2.0-only OR BSD-2-Clause)
%YAML 1.2
---
$id: http://devicetree.org/schemas/pci/toshiba,visconti-pcie.yaml#
$schema: http://devicetree.org/meta-schemas/core.yaml#

title: Toshiba Visconti5 SoC PCIe Host Controller

maintainers:
  - Nobuhiro Iwamatsu <nobuhiro1.iwamatsu@toshiba.co.jp>

description:
  Toshiba Visconti5 SoC PCIe host controller is based on the Synopsys DesignWare PCIe IP.

allOf:
  - $ref: /schemas/pci/snps,dw-pcie.yaml#

properties:
  compatible:
    const: toshiba,visconti-pcie

  reg:
    items:
      - description: Data Bus Interface (DBI) registers.
      - description: PCIe configuration space region.
      - description: Visconti specific additional registers.
      - description: Visconti specific SMU registers
      - description: Visconti specific memory protection unit registers (MPU)

  reg-names:
    items:
      - const: dbi
      - const: config
      - const: ulreg
      - const: smu
      - const: mpu

  interrupts:
    maxItems: 2

  clocks:
    items:
      - description: PCIe reference clock
      - description: PCIe system clock
      - description: Auxiliary clock

  clock-names:
    items:
      - const: ref
      - const: core
      - const: aux

  num-lanes:
    const: 2

required:
  - reg
  - reg-names
  - interrupts
  - "#interrupt-cells"
  - interrupt-map
  - interrupt-map-mask
  - num-lanes
  - clocks
  - clock-names
  - max-link-speed

unevaluatedProperties: false

examples:
  - |
    #include <dt-bindings/interrupt-controller/irq.h>
    #include <dt-bindings/interrupt-controller/arm-gic.h>

    soc {
        #address-cells = <2>;
        #size-cells = <2>;

        pcie: pcie@28400000 {
            compatible = "toshiba,visconti-pcie";
            reg = <0x0 0x28400000 0x0 0x00400000>,
                  <0x0 0x70000000 0x0 0x10000000>,
                  <0x0 0x28050000 0x0 0x00010000>,
                  <0x0 0x24200000 0x0 0x00002000>,
                  <0x0 0x24162000 0x0 0x00001000>;
            reg-names  = "dbi", "config", "ulreg", "smu", "mpu";
            device_type = "pci";
            bus-range = <0x00 0xff>;
            num-lanes = <2>;
            num-viewport = <8>;

            #address-cells = <3>;
            #size-cells = <2>;
            #interrupt-cells = <1>;
            ranges = <0x81000000 0 0x40000000 0 0x40000000 0 0x00010000>,
                     <0x82000000 0 0x50000000 0 0x50000000 0 0x20000000>;
            interrupts = <GIC_SPI 211 IRQ_TYPE_LEVEL_HIGH>,
                         <GIC_SPI 215 IRQ_TYPE_LEVEL_HIGH>;
            interrupt-names = "msi", "intr";
            interrupt-map-mask = <0 0 0 7>;
            interrupt-map =
                <0 0 0 1 &gic GIC_SPI 215 IRQ_TYPE_LEVEL_HIGH
                 0 0 0 2 &gic GIC_SPI 215 IRQ_TYPE_LEVEL_HIGH
                 0 0 0 3 &gic GIC_SPI 215 IRQ_TYPE_LEVEL_HIGH
                 0 0 0 4 &gic GIC_SPI 215 IRQ_TYPE_LEVEL_HIGH>;
            clocks = <&extclk100mhz>, <&clk600mhz>, <&clk25mhz>;
            clock-names = "ref", "core", "aux";
            max-link-speed = <2>;
        };
    };
...
```
