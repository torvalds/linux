## Documentation/devicetree/bindings/pci/versatile.yaml
```yaml
# SPDX-License-Identifier: (GPL-2.0-only OR BSD-2-Clause)
%YAML 1.2
---
$id: http://devicetree.org/schemas/pci/versatile.yaml#
$schema: http://devicetree.org/meta-schemas/core.yaml#

title: ARM Versatile Platform Baseboard PCI interface

maintainers:
  - Rob Herring <robh@kernel.org>

description: |+
  PCI host controller found on the ARM Versatile PB board's FPGA.

allOf:
  - $ref: /schemas/pci/pci-bus.yaml#

properties:
  compatible:
    const: arm,versatile-pci

  reg:
    items:
      - description: Versatile-specific registers
      - description: Self Config space
      - description: Config space

  ranges:
    maxItems: 3

  "#interrupt-cells": true

  interrupt-map:
    maxItems: 16

  interrupt-map-mask:
    items:
      - const: 0x1800
      - const: 0
      - const: 0
      - const: 7

required:
  - compatible
  - reg
  - ranges
  - "#interrupt-cells"
  - interrupt-map
  - interrupt-map-mask

examples:
  - |
    pci@10001000 {
      compatible = "arm,versatile-pci";
      device_type = "pci";
      reg = <0x10001000 0x1000>,
            <0x41000000 0x10000>,
            <0x42000000 0x100000>;
      bus-range = <0 0xff>;
      #address-cells = <3>;
      #size-cells = <2>;
      #interrupt-cells = <1>;

      ranges =
          <0x01000000 0 0x00000000 0x43000000 0 0x00010000>,  /* downstream I/O */
          <0x02000000 0 0x50000000 0x50000000 0 0x10000000>,  /* non-prefetchable memory */
          <0x42000000 0 0x60000000 0x60000000 0 0x10000000>;  /* prefetchable memory */

      interrupt-map-mask = <0x1800 0 0 7>;
      interrupt-map = <0x1800 0 0 1 &sic 28>,
          <0x1800 0 0 2 &sic 29>,
          <0x1800 0 0 3 &sic 30>,
          <0x1800 0 0 4 &sic 27>,

          <0x1000 0 0 1 &sic 27>,
          <0x1000 0 0 2 &sic 28>,
          <0x1000 0 0 3 &sic 29>,
          <0x1000 0 0 4 &sic 30>,

          <0x0800 0 0 1 &sic 30>,
          <0x0800 0 0 2 &sic 27>,
          <0x0800 0 0 3 &sic 28>,
          <0x0800 0 0 4 &sic 29>,

          <0x0000 0 0 1 &sic 29>,
          <0x0000 0 0 2 &sic 30>,
          <0x0000 0 0 3 &sic 27>,
          <0x0000 0 0 4 &sic 28>;
    };


...
```

## Documentation/devicetree/bindings/pci/xgene-pci-msi.txt
```
* AppliedMicro X-Gene v1 PCIe MSI controller

Required properties:

- compatible: should be "apm,xgene1-msi" to identify
	      X-Gene v1 PCIe MSI controller block.
- msi-controller: indicates that this is an X-Gene v1 PCIe MSI controller node
- reg: physical base address (0x79000000) and length (0x900000) for controller
       registers. These registers include the MSI termination address and data
       registers as well as the MSI interrupt status registers.
- reg-names: not required
- interrupts: A list of 16 interrupt outputs of the controller, starting from
	      interrupt number 0x10 to 0x1f.
- interrupt-names: not required

Each PCIe node needs to have property msi-parent that points to an MSI
controller node

Examples:

SoC DTSI:

	+ MSI node:
	msi@79000000 {
		compatible = "apm,xgene1-msi";
		msi-controller;
		reg = <0x00 0x79000000 0x0 0x900000>;
		interrupts = 	<0x0 0x10 0x4>
				<0x0 0x11 0x4>
				<0x0 0x12 0x4>
				<0x0 0x13 0x4>
				<0x0 0x14 0x4>
				<0x0 0x15 0x4>
				<0x0 0x16 0x4>
				<0x0 0x17 0x4>
				<0x0 0x18 0x4>
				<0x0 0x19 0x4>
				<0x0 0x1a 0x4>
				<0x0 0x1b 0x4>
				<0x0 0x1c 0x4>
				<0x0 0x1d 0x4>
				<0x0 0x1e 0x4>
				<0x0 0x1f 0x4>;
	};

	+ PCIe controller node with msi-parent property pointing to MSI node:
	pcie0: pcie@1f2b0000 {
		device_type = "pci";
		compatible = "apm,xgene-storm-pcie", "apm,xgene-pcie";
		#interrupt-cells = <1>;
		#size-cells = <2>;
		#address-cells = <3>;
		reg = < 0x00 0x1f2b0000 0x0 0x00010000   /* Controller registers */
			0xe0 0xd0000000 0x0 0x00040000>; /* PCI config space */
		reg-names = "csr", "cfg";
		ranges = <0x01000000 0x00 0x00000000 0xe0 0x10000000 0x00 0x00010000   /* io */
			  0x02000000 0x00 0x80000000 0xe1 0x80000000 0x00 0x80000000>; /* mem */
		dma-ranges = <0x42000000 0x80 0x00000000 0x80 0x00000000 0x00 0x80000000
			      0x42000000 0x00 0x00000000 0x00 0x00000000 0x80 0x00000000>;
		interrupt-map-mask = <0x0 0x0 0x0 0x7>;
		interrupt-map = <0x0 0x0 0x0 0x1 &gic 0x0 0xc2 0x1
				 0x0 0x0 0x0 0x2 &gic 0x0 0xc3 0x1
				 0x0 0x0 0x0 0x3 &gic 0x0 0xc4 0x1
				 0x0 0x0 0x0 0x4 &gic 0x0 0xc5 0x1>;
		dma-coherent;
		clocks = <&pcie0clk 0>;
		msi-parent= <&msi>;
	};
```

## Documentation/devicetree/bindings/pci/xgene-pci.txt
```
* AppliedMicro X-Gene PCIe interface

Required properties:
- device_type: set to "pci"
- compatible: should contain "apm,xgene-pcie" to identify the core.
- reg: A list of physical base address and length for each set of controller
       registers. Must contain an entry for each entry in the reg-names
       property.
- reg-names: Must include the following entries:
  "csr": controller configuration registers.
  "cfg": PCIe configuration space registers.
- #address-cells: set to <3>
- #size-cells: set to <2>
- ranges: ranges for the outbound memory, I/O regions.
- dma-ranges: ranges for the inbound memory regions.
- #interrupt-cells: set to <1>
- interrupt-map-mask and interrupt-map: standard PCI properties
	to define the mapping of the PCIe interface to interrupt
	numbers.
- clocks: from common clock binding: handle to pci clock.

Optional properties:
- status: Either "ok" or "disabled".
- dma-coherent: Present if DMA operations are coherent

Example:

SoC-specific DT Entry:

	pcie0: pcie@1f2b0000 {
		status = "disabled";
		device_type = "pci";
		compatible = "apm,xgene-storm-pcie", "apm,xgene-pcie";
		#interrupt-cells = <1>;
		#size-cells = <2>;
		#address-cells = <3>;
		reg = < 0x00 0x1f2b0000 0x0 0x00010000   /* Controller registers */
			0xe0 0xd0000000 0x0 0x00040000>; /* PCI config space */
		reg-names = "csr", "cfg";
		ranges = <0x01000000 0x00 0x00000000 0xe0 0x10000000 0x00 0x00010000   /* io */
			  0x02000000 0x00 0x80000000 0xe1 0x80000000 0x00 0x80000000>; /* mem */
		dma-ranges = <0x42000000 0x80 0x00000000 0x80 0x00000000 0x00 0x80000000
			      0x42000000 0x00 0x00000000 0x00 0x00000000 0x80 0x00000000>;
		interrupt-map-mask = <0x0 0x0 0x0 0x7>;
		interrupt-map = <0x0 0x0 0x0 0x1 &gic 0x0 0xc2 0x1
				 0x0 0x0 0x0 0x2 &gic 0x0 0xc3 0x1
				 0x0 0x0 0x0 0x3 &gic 0x0 0xc4 0x1
				 0x0 0x0 0x0 0x4 &gic 0x0 0xc5 0x1>;
		dma-coherent;
		clocks = <&pcie0clk 0>;
	};


Board-specific DT Entry:
	&pcie0 {
		status = "ok";
	};
```

## Documentation/devicetree/bindings/pci/xilinx-nwl-pcie.txt
```
* Xilinx NWL PCIe Root Port Bridge DT description

Required properties:
- compatible: Should contain "xlnx,nwl-pcie-2.11"
- #address-cells: Address representation for root ports, set to <3>
- #size-cells: Size representation for root ports, set to <2>
- #interrupt-cells: specifies the number of cells needed to encode an
	interrupt source. The value must be 1.
- reg: Should contain Bridge, PCIe Controller registers location,
	configuration space, and length
- reg-names: Must include the following entries:
	"breg": bridge registers
	"pcireg": PCIe controller registers
	"cfg": configuration space region
- device_type: must be "pci"
- interrupts: Should contain NWL PCIe interrupt
- interrupt-names: Must include the following entries:
	"msi1, msi0": interrupt asserted when an MSI is received
	"intx": interrupt asserted when a legacy interrupt is received
	"misc": interrupt asserted when miscellaneous interrupt is received
- interrupt-map-mask and interrupt-map: standard PCI properties to define the
	mapping of the PCI interface to interrupt numbers.
- ranges: ranges for the PCI memory regions (I/O space region is not
	supported by hardware)
	Please refer to the standard PCI bus binding document for a more
	detailed explanation
- msi-controller: indicates that this is MSI controller node
- msi-parent:  MSI parent of the root complex itself
- legacy-interrupt-controller: Interrupt controller device node for Legacy
	interrupts
	- interrupt-controller: identifies the node as an interrupt controller
	- #interrupt-cells: should be set to 1
	- #address-cells: specifies the number of cells needed to encode an
		address. The value must be 0.

Optional properties:
- dma-coherent: present if DMA operations are coherent

Example:
++++++++

nwl_pcie: pcie@fd0e0000 {
	#address-cells = <3>;
	#size-cells = <2>;
	compatible = "xlnx,nwl-pcie-2.11";
	#interrupt-cells = <1>;
	msi-controller;
	device_type = "pci";
	interrupt-parent = <&gic>;
	interrupts = <0 114 4>, <0 115 4>, <0 116 4>, <0 117 4>, <0 118 4>;
	interrupt-names = "msi0", "msi1", "intx", "dummy", "misc";
	interrupt-map-mask = <0x0 0x0 0x0 0x7>;
	interrupt-map = <0x0 0x0 0x0 0x1 &pcie_intc 0x1>,
			<0x0 0x0 0x0 0x2 &pcie_intc 0x2>,
			<0x0 0x0 0x0 0x3 &pcie_intc 0x3>,
			<0x0 0x0 0x0 0x4 &pcie_intc 0x4>;

	msi-parent = <&nwl_pcie>;
	reg = <0x0 0xfd0e0000 0x0 0x1000>,
	      <0x0 0xfd480000 0x0 0x1000>,
	      <0x80 0x00000000 0x0 0x1000000>;
	reg-names = "breg", "pcireg", "cfg";
	ranges = <0x02000000 0x00000000 0xe0000000 0x00000000 0xe0000000 0x00000000 0x10000000  /* non-prefetchable memory */
		  0x43000000 0x00000006 0x00000000 0x00000006 0x00000000 0x00000002 0x00000000>;/* prefetchable memory */

	pcie_intc: legacy-interrupt-controller {
		interrupt-controller;
		#address-cells = <0>;
		#interrupt-cells = <1>;
	};

};
```

## Documentation/devicetree/bindings/pci/xilinx-pcie.txt
```
* Xilinx AXI PCIe Root Port Bridge DT description

Required properties:
- #address-cells: Address representation for root ports, set to <3>
- #size-cells: Size representation for root ports, set to <2>
- #interrupt-cells: specifies the number of cells needed to encode an
	interrupt source. The value must be 1.
- compatible: Should contain "xlnx,axi-pcie-host-1.00.a"
- reg: Should contain AXI PCIe registers location and length
- device_type: must be "pci"
- interrupts: Should contain AXI PCIe interrupt
- interrupt-map-mask,
  interrupt-map: standard PCI properties to define the mapping of the
	PCI interface to interrupt numbers.
- ranges: ranges for the PCI memory regions (I/O space region is not
	supported by hardware)
	Please refer to the standard PCI bus binding document for a more
	detailed explanation

Optional properties:
- bus-range: PCI bus numbers covered

Interrupt controller child node
+++++++++++++++++++++++++++++++
Required properties:
- interrupt-controller: identifies the node as an interrupt controller
- #address-cells: specifies the number of cells needed to encode an
	address. The value must be 0.
- #interrupt-cells: specifies the number of cells needed to encode an
	interrupt source. The value must be 1.

NOTE:
The core provides a single interrupt for both INTx/MSI messages. So,
created a interrupt controller node to support 'interrupt-map' DT
functionality.  The driver will create an IRQ domain for this map, decode
the four INTx interrupts in ISR and route them to this domain.


Example:
++++++++

	pci_express: axi-pcie@50000000 {
		#address-cells = <3>;
		#size-cells = <2>;
		#interrupt-cells = <1>;
		compatible = "xlnx,axi-pcie-host-1.00.a";
		reg = < 0x50000000 0x10000000 >;
		device_type = "pci";
		interrupts = < 0 52 4 >;
		interrupt-map-mask = <0 0 0 7>;
		interrupt-map = <0 0 0 1 &pcie_intc 1>,
				<0 0 0 2 &pcie_intc 2>,
				<0 0 0 3 &pcie_intc 3>,
				<0 0 0 4 &pcie_intc 4>;
		ranges = < 0x02000000 0 0x60000000 0x60000000 0 0x10000000 >;

		pcie_intc: interrupt-controller {
			interrupt-controller;
			#address-cells = <0>;
			#interrupt-cells = <1>;
		}
	};
```

## Documentation/devicetree/bindings/pci/xilinx-versal-cpm.yaml
```yaml
# SPDX-License-Identifier: (GPL-2.0-only OR BSD-2-Clause)
%YAML 1.2
---
$id: http://devicetree.org/schemas/pci/xilinx-versal-cpm.yaml#
$schema: http://devicetree.org/meta-schemas/core.yaml#

title: CPM Host Controller device tree for Xilinx Versal SoCs

maintainers:
  - Bharat Kumar Gogada <bharat.kumar.gogada@amd.com>

allOf:
  - $ref: /schemas/pci/pci-host-bridge.yaml#

properties:
  compatible:
    enum:
      - xlnx,versal-cpm-host-1.00
      - xlnx,versal-cpm5-host
      - xlnx,versal-cpm5-host1
      - xlnx,versal-cpm5nc-host

  reg:
    items:
      - description: CPM system level control and status registers.
      - description: Configuration space region and bridge registers.
      - description: CPM5 control and status registers.
    minItems: 2

  reg-names:
    items:
      - const: cpm_slcr
      - const: cfg
      - const: cpm_csr
    minItems: 2

  interrupts:
    maxItems: 1

  msi-map:
    description:
      Maps a Requester ID to an MSI controller and associated MSI sideband data.

  ranges:
    maxItems: 2

  "#interrupt-cells":
    const: 1

  interrupt-controller:
    description: Interrupt controller node for handling legacy PCI interrupts.
    type: object
    additionalProperties: false

    properties:
      "#address-cells":
        const: 0

      "#interrupt-cells":
        const: 1

      interrupt-controller: true

required:
  - reg
  - reg-names
  - "#interrupt-cells"
  - interrupts
  - interrupt-map
  - interrupt-map-mask
  - bus-range
  - msi-map
  - interrupt-controller

unevaluatedProperties: false

examples:
  - |
    versal {
        #address-cells = <2>;
        #size-cells = <2>;
        pcie@fca10000 {
            compatible = "xlnx,versal-cpm-host-1.00";
            device_type = "pci";
            #address-cells = <3>;
            #interrupt-cells = <1>;
            #size-cells = <2>;
            interrupts = <0 72 4>;
            interrupt-parent = <&gic>;
            interrupt-map-mask = <0 0 0 7>;
            interrupt-map = <0 0 0 1 &pcie_intc_0 0>,
                            <0 0 0 2 &pcie_intc_0 1>,
                            <0 0 0 3 &pcie_intc_0 2>,
                            <0 0 0 4 &pcie_intc_0 3>;
            bus-range = <0x00 0xff>;
            ranges = <0x02000000 0x0 0xe0010000 0x0 0xe0010000 0x0 0x10000000>,
                     <0x43000000 0x80 0x00000000 0x80 0x00000000 0x0 0x80000000>;
            msi-map = <0x0 &its_gic 0x0 0x10000>;
            reg = <0x0 0xfca10000 0x0 0x1000>,
                  <0x6 0x00000000 0x0 0x10000000>;
            reg-names = "cpm_slcr", "cfg";
            pcie_intc_0: interrupt-controller {
                    #address-cells = <0>;
                    #interrupt-cells = <1>;
                    interrupt-controller;
            };
        };

        pcie@fcdd0000 {
            compatible = "xlnx,versal-cpm5-host";
            device_type = "pci";
            #address-cells = <3>;
            #interrupt-cells = <1>;
            #size-cells = <2>;
            interrupts = <0 72 4>;
            interrupt-parent = <&gic>;
            interrupt-map-mask = <0 0 0 7>;
            interrupt-map = <0 0 0 1 &pcie_intc_1 0>,
                            <0 0 0 2 &pcie_intc_1 1>,
                            <0 0 0 3 &pcie_intc_1 2>,
                            <0 0 0 4 &pcie_intc_1 3>;
            bus-range = <0x00 0xff>;
            ranges = <0x02000000 0x0 0xe0000000 0x0 0xe0000000 0x0 0x10000000>,
                     <0x43000000 0x80 0x00000000 0x80 0x00000000 0x0 0x80000000>;
            msi-map = <0x0 &its_gic 0x0 0x10000>;
            reg = <0x00 0xfcdd0000 0x00 0x1000>,
                  <0x06 0x00000000 0x00 0x1000000>,
                  <0x00 0xfce20000 0x00 0x1000000>;
            reg-names = "cpm_slcr", "cfg", "cpm_csr";

            pcie_intc_1: interrupt-controller {
                #address-cells = <0>;
                #interrupt-cells = <1>;
                interrupt-controller;
            };
        };
    };
```
