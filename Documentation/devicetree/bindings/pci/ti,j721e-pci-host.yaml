## Documentation/devicetree/bindings/pci/ultrarisc,dp1000-pcie.yaml
```yaml
# SPDX-License-Identifier: (GPL-2.0 OR BSD-2-Clause)
%YAML 1.2
---
$id: http://devicetree.org/schemas/pci/ultrarisc,dp1000-pcie.yaml#
$schema: http://devicetree.org/meta-schemas/core.yaml#

title: UltraRISC DP1000 PCIe Host Controller

description:
  UltraRISC DP1000 SoC PCIe host controller is based on the DesignWare PCIe IP.

maintainers:
  - Xincheng Zhang <zhangxincheng@ultrarisc.com>
  - Jia Wang <wangjia@ultrarisc.com>

allOf:
  - $ref: /schemas/pci/snps,dw-pcie.yaml#

properties:
  compatible:
    const: ultrarisc,dp1000-pcie

  reg:
    items:
      - description: Data Bus Interface (DBI) registers.
      - description: PCIe configuration space region.

  reg-names:
    items:
      - const: dbi
      - const: config

  num-lanes:
    $ref: /schemas/types.yaml#/definitions/uint32
    enum: [4, 16]
    description: Number of lanes to use.

  interrupts:
    items:
      - description: MSI interrupt
      - description: Legacy INTA interrupt
      - description: Legacy INTB interrupt
      - description: Legacy INTC interrupt
      - description: Legacy INTD interrupt

  interrupt-names:
    items:
      - const: msi
      - const: inta
      - const: intb
      - const: intc
      - const: intd

required:
  - compatible
  - reg
  - reg-names
  - interrupts
  - interrupt-names

unevaluatedProperties: false

examples:
  - |
    soc {
      #address-cells = <2>;
      #size-cells = <2>;

      pcie@21000000 {
        compatible = "ultrarisc,dp1000-pcie";
        reg = <0x0 0x21000000 0x0 0x01000000>,
              <0x0 0x4fff0000 0x0 0x00010000>;
        reg-names = "dbi", "config";
        ranges = <0x81000000 0x0 0x4fbf0000 0x0 0x4fbf0000 0x0 0x00400000>,
                 <0x82000000 0x0 0x40000000 0x0 0x40000000 0x0 0x0fbf0000>,
                 <0xc3000000 0x40 0x00000000 0x40 0x00000000 0xd 0x00000000>;
        #address-cells = <3>;
        #size-cells = <2>;
        #interrupt-cells = <1>;
        device_type = "pci";
        dma-coherent;
        bus-range = <0x0 0xff>;
        num-lanes = <16>;
        interrupt-parent = <&plic>;
        interrupts = <43>, <44>, <45>, <46>, <47>;
        interrupt-names = "msi", "inta", "intb", "intc", "intd";
        interrupt-map-mask = <0x0 0x0 0x0 0x7>;
        interrupt-map = <0x0 0x0 0x0 0x1 &plic 44>,
                        <0x0 0x0 0x0 0x2 &plic 45>,
                        <0x0 0x0 0x0 0x3 &plic 46>,
                        <0x0 0x0 0x0 0x4 &plic 47>;
      };
    };
```

## Documentation/devicetree/bindings/pci/uniphier-pcie.txt
```
Socionext UniPhier PCIe host controller bindings

This describes the devicetree bindings for PCIe host controller implemented
on Socionext UniPhier SoCs.

UniPhier PCIe host controller is based on the Synopsys DesignWare PCI core.
It shares common functions with the PCIe DesignWare core driver and inherits
common properties defined in
Documentation/devicetree/bindings/pci/designware-pcie.txt.

Required properties:
- compatible: Should be "socionext,uniphier-pcie".
- reg: Specifies offset and length of the register set for the device.
	According to the reg-names, appropriate register sets are required.
- reg-names: Must include the following entries:
    "dbi"    - controller configuration registers
    "link"   - SoC-specific glue layer registers
    "config" - PCIe configuration space
- clocks: A phandle to the clock gate for PCIe glue layer including
	the host controller.
- resets: A phandle to the reset line for PCIe glue layer including
	the host controller.
- interrupts: A list of interrupt specifiers. According to the
	interrupt-names, appropriate interrupts are required.
- interrupt-names: Must include the following entries:
    "dma" - DMA interrupt
    "msi" - MSI interrupt

Optional properties:
- phys: A phandle to generic PCIe PHY. According to the phy-names, appropriate
	phys are required.
- phy-names: Must be "pcie-phy".

Required sub-node:
- legacy-interrupt-controller: Specifies interrupt controller for legacy PCI
	interrupts.

Required properties for legacy-interrupt-controller:
- interrupt-controller: identifies the node as an interrupt controller.
- #interrupt-cells: specifies the number of cells needed to encode an
	interrupt source. The value must be 1.
- interrupt-parent: Phandle to the parent interrupt controller.
- interrupts: An interrupt specifier for legacy interrupt.

Example:

	pcie: pcie@66000000 {
		compatible = "socionext,uniphier-pcie", "snps,dw-pcie";
		status = "disabled";
		reg-names = "dbi", "link", "config";
		reg = <0x66000000 0x1000>, <0x66010000 0x10000>,
		      <0x2fff0000 0x10000>;
		#address-cells = <3>;
		#size-cells = <2>;
		clocks = <&sys_clk 24>;
		resets = <&sys_rst 24>;
		num-lanes = <1>;
		num-viewport = <1>;
		bus-range = <0x0 0xff>;
		device_type = "pci";
		ranges =
		/* downstream I/O */
			<0x81000000 0 0x00000000  0x2ffe0000  0 0x00010000
		/* non-prefetchable memory */
			 0x82000000 0 0x00000000  0x20000000  0 0x0ffe0000>;
		#interrupt-cells = <1>;
		interrupt-names = "dma", "msi";
		interrupts = <0 224 4>, <0 225 4>;
		interrupt-map-mask = <0 0 0  7>;
		interrupt-map = <0 0 0  1  &pcie_intc 0>,	/* INTA */
				<0 0 0  2  &pcie_intc 1>,	/* INTB */
				<0 0 0  3  &pcie_intc 2>,	/* INTC */
				<0 0 0  4  &pcie_intc 3>;	/* INTD */

		pcie_intc: legacy-interrupt-controller {
			interrupt-controller;
			#interrupt-cells = <1>;
			interrupt-parent = <&gic>;
			interrupts = <0 226 4>;
		};
	};
```

## Documentation/devicetree/bindings/pci/v3,v360epc-pci.yaml
```yaml
# SPDX-License-Identifier: GPL-2.0-only OR BSD-2-Clause
%YAML 1.2
---
$id: http://devicetree.org/schemas/pci/v3,v360epc-pci.yaml#
$schema: http://devicetree.org/meta-schemas/core.yaml#

title: V3 Semiconductor V360 EPC PCI bridge

maintainers:
  - Linus Walleij <linus.walleij@linaro.org>

description:
  This bridge is found in the ARM Integrator/AP (Application Platform)

allOf:
  - $ref: /schemas/pci/pci-host-bridge.yaml#

properties:
  compatible:
    items:
      - const: arm,integrator-ap-pci
      - const: v3,v360epc-pci

  reg:
    items:
      - description: V3 host bridge controller
      - description: Configuration space

  clocks:
    maxItems: 1

  dma-ranges:
    maxItems: 2
    description:
      The inbound ranges must be aligned to a 1MB boundary, and may be 1MB, 2MB,
      4MB, 8MB, 16MB, 32MB, 64MB, 128MB, 256MB, 512MB, 1GB or 2GB in size. The
      memory should be marked as pre-fetchable.

  interrupts:
    description: Bus Error IRQ
    maxItems: 1

  ranges:
    description:
      The non-prefetchable and prefetchable memory windows must each be exactly
      256MB (0x10000000) in size. The prefetchable memory window must be
      immediately adjacent to the non-prefetchable memory window.

required:
  - compatible
  - reg
  - clocks
  - dma-ranges
  - "#interrupt-cells"
  - interrupt-map
  - interrupt-map-mask

unevaluatedProperties: false

examples:
  - |
    pci@62000000 {
        compatible = "arm,integrator-ap-pci", "v3,v360epc-pci";
        #interrupt-cells = <1>;
        #size-cells = <2>;
        #address-cells = <3>;
        reg = <0x62000000 0x10000>, <0x61000000 0x01000000>;
        device_type = "pci";
        interrupt-parent = <&pic>;
        interrupts = <17>; /* Bus error IRQ */
        clocks = <&pciclk>;
        ranges = <0x01000000 0 0x00000000 0x60000000 0 0x01000000>,     /* 16 MiB @ LB 60000000 */
                 <0x02000000 0 0x40000000 0x40000000 0 0x10000000>,     /* 256 MiB @ LB 40000000 1:1 */
                 <0x42000000 0 0x50000000 0x50000000 0 0x10000000>;     /* 256 MiB @ LB 50000000 1:1 */
        dma-ranges = <0x02000000 0 0x20000000 0x20000000 0 0x20000000>, /* EBI: 512 MB @ LB 20000000 1:1 */
                     <0x02000000 0 0x80000000 0x80000000 0 0x40000000>; /* CM alias: 1GB @ LB 80000000 */
        interrupt-map-mask = <0xf800 0 0 0x7>;
        interrupt-map =
            /* IDSEL 9 */
            <0x4800 0 0 1 &pic 13>, /* INT A on slot 9 is irq 13 */
            <0x4800 0 0 2 &pic 14>, /* INT B on slot 9 is irq 14 */
            <0x4800 0 0 3 &pic 15>, /* INT C on slot 9 is irq 15 */
            <0x4800 0 0 4 &pic 16>, /* INT D on slot 9 is irq 16 */
            /* IDSEL 10 */
            <0x5000 0 0 1 &pic 14>, /* INT A on slot 10 is irq 14 */
            <0x5000 0 0 2 &pic 15>, /* INT B on slot 10 is irq 15 */
            <0x5000 0 0 3 &pic 16>, /* INT C on slot 10 is irq 16 */
            <0x5000 0 0 4 &pic 13>, /* INT D on slot 10 is irq 13 */
            /* IDSEL 11 */
            <0x5800 0 0 1 &pic 15>, /* INT A on slot 11 is irq 15 */
            <0x5800 0 0 2 &pic 16>, /* INT B on slot 11 is irq 16 */
            <0x5800 0 0 3 &pic 13>, /* INT C on slot 11 is irq 13 */
            <0x5800 0 0 4 &pic 14>, /* INT D on slot 11 is irq 14 */
            /* IDSEL 12 */
            <0x6000 0 0 1 &pic 16>, /* INT A on slot 12 is irq 16 */
            <0x6000 0 0 2 &pic 13>, /* INT B on slot 12 is irq 13 */
            <0x6000 0 0 3 &pic 14>, /* INT C on slot 12 is irq 14 */
            <0x6000 0 0 4 &pic 15>; /* INT D on slot 12 is irq 15 */
    };
...
```

## Documentation/devicetree/bindings/pci/v3-v360epc-pci.txt
```
V3 Semiconductor V360 EPC PCI bridge

This bridge is found in the ARM Integrator/AP (Application Platform)

Required properties:
- compatible: should be one of:
  "v3,v360epc-pci"
  "arm,integrator-ap-pci", "v3,v360epc-pci"
- reg: should contain two register areas:
  first the base address of the V3 host bridge controller, 64KB
  second the configuration area register space, 16MB
- interrupts: should contain a reference to the V3 error interrupt
  as routed on the system.
- bus-range: see pci.txt
- ranges: this follows the standard PCI bindings in the IEEE Std
  1275-1994 (see pci.txt) with the following restriction:
  - The non-prefetchable and prefetchable memory windows must
    each be exactly 256MB (0x10000000) in size.
  - The prefetchable memory window must be immediately adjacent
    to the non-prefetcable memory window
- dma-ranges: three ranges for the inbound memory region. The ranges must
  be aligned to a 1MB boundary, and may be 1MB, 2MB, 4MB, 8MB, 16MB, 32MB,
  64MB, 128MB, 256MB, 512MB, 1GB or 2GB in size. The memory should be marked
  as pre-fetchable. Two ranges are supported by the hardware.

Integrator-specific required properties:
- syscon: should contain a link to the syscon device node, since
  on the Integrator, some registers in the syscon are required to
  operate the V3 host bridge.

Example:

pci: pciv3@62000000 {
	compatible = "arm,integrator-ap-pci", "v3,v360epc-pci";
	#interrupt-cells = <1>;
	#size-cells = <2>;
	#address-cells = <3>;
	reg = <0x62000000 0x10000>, <0x61000000 0x01000000>;
	interrupt-parent = <&pic>;
	interrupts = <17>; /* Bus error IRQ */
	clocks = <&pciclk>;
	bus-range = <0x00 0xff>;
	ranges = 0x01000000 0 0x00000000 /* I/O space @00000000 */
		0x60000000 0 0x01000000 /* 16 MiB @ LB 60000000 */
		0x02000000 0 0x40000000 /* non-prefectable memory @40000000 */
		0x40000000 0 0x10000000 /* 256 MiB @ LB 40000000 1:1 */
		0x42000000 0 0x50000000 /* prefetchable memory @50000000 */
		0x50000000 0 0x10000000>; /* 256 MiB @ LB 50000000 1:1 */
	dma-ranges = <0x02000000 0 0x20000000 /* EBI memory space */
		0x20000000 0 0x20000000 /* 512 MB @ LB 20000000 1:1 */
		0x02000000 0 0x80000000 /* Core module alias memory */
		0x80000000 0 0x40000000>; /* 1GB @ LB 80000000 */
	interrupt-map-mask = <0xf800 0 0 0x7>;
	interrupt-map = <
	/* IDSEL 9 */
	0x4800 0 0 1 &pic 13 /* INT A on slot 9 is irq 13 */
	0x4800 0 0 2 &pic 14 /* INT B on slot 9 is irq 14 */
	0x4800 0 0 3 &pic 15 /* INT C on slot 9 is irq 15 */
	0x4800 0 0 4 &pic 16 /* INT D on slot 9 is irq 16 */
	/* IDSEL 10 */
	0x5000 0 0 1 &pic 14 /* INT A on slot 10 is irq 14 */
	0x5000 0 0 2 &pic 15 /* INT B on slot 10 is irq 15 */
	0x5000 0 0 3 &pic 16 /* INT C on slot 10 is irq 16 */
	0x5000 0 0 4 &pic 13 /* INT D on slot 10 is irq 13 */
	/* IDSEL 11 */
	0x5800 0 0 1 &pic 15 /* INT A on slot 11 is irq 15 */
	0x5800 0 0 2 &pic 16 /* INT B on slot 11 is irq 16 */
	0x5800 0 0 3 &pic 13 /* INT C on slot 11 is irq 13 */
	0x5800 0 0 4 &pic 14 /* INT D on slot 11 is irq 14 */
	/* IDSEL 12 */
	0x6000 0 0 1 &pic 16 /* INT A on slot 12 is irq 16 */
	0x6000 0 0 2 &pic 13 /* INT B on slot 12 is irq 13 */
	0x6000 0 0 3 &pic 14 /* INT C on slot 12 is irq 14 */
	0x6000 0 0 4 &pic 15 /* INT D on slot 12 is irq 15 */
	>;
};
```

## Documentation/devicetree/bindings/pci/versatile.txt
```
* ARM Versatile Platform Baseboard PCI interface

PCI host controller found on the ARM Versatile PB board's FPGA.

Required properties:
- compatible: should contain "arm,versatile-pci" to identify the Versatile PCI
  controller.
- reg: base addresses and lengths of the pci controller. There must be 3
  entries:
	- Versatile-specific registers
	- Self Config space
	- Config space
- #address-cells: set to <3>
- #size-cells: set to <2>
- device_type: set to "pci"
- bus-range: set to <0 0xff>
- ranges: ranges for the PCI memory and I/O regions
- #interrupt-cells: set to <1>
- interrupt-map-mask and interrupt-map: standard PCI properties to define
	the mapping of the PCI interface to interrupt numbers.

Example:

pci-controller@10001000 {
	compatible = "arm,versatile-pci";
	device_type = "pci";
	reg = <0x10001000 0x1000
	       0x41000000 0x10000
	       0x42000000 0x100000>;
	bus-range = <0 0xff>;
	#address-cells = <3>;
	#size-cells = <2>;
	#interrupt-cells = <1>;

	ranges = <0x01000000 0 0x00000000 0x43000000 0 0x00010000   /* downstream I/O */
		  0x02000000 0 0x50000000 0x50000000 0 0x10000000   /* non-prefetchable memory */
		  0x42000000 0 0x60000000 0x60000000 0 0x10000000>; /* prefetchable memory */

	interrupt-map-mask = <0x1800 0 0 7>;
	interrupt-map = <0x1800 0 0 1 &sic 28
			 0x1800 0 0 2 &sic 29
			 0x1800 0 0 3 &sic 30
			 0x1800 0 0 4 &sic 27

			 0x1000 0 0 1 &sic 27
			 0x1000 0 0 2 &sic 28
			 0x1000 0 0 3 &sic 29
			 0x1000 0 0 4 &sic 30

			 0x0800 0 0 1 &sic 30
			 0x0800 0 0 2 &sic 27
			 0x0800 0 0 3 &sic 28
			 0x0800 0 0 4 &sic 29

			 0x0000 0 0 1 &sic 29
			 0x0000 0 0 2 &sic 30
			 0x0000 0 0 3 &sic 27
			 0x0000 0 0 4 &sic 28>;
};
```
