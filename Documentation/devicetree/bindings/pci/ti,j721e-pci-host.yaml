## Documentation/devicetree/bindings/pci/xlnx,axi-pcie-host.yaml
```yaml
# SPDX-License-Identifier: (GPL-2.0-only OR BSD-2-Clause)
%YAML 1.2
---
$id: http://devicetree.org/schemas/pci/xlnx,axi-pcie-host.yaml#
$schema: http://devicetree.org/meta-schemas/core.yaml#

title: Xilinx AXI PCIe Root Port Bridge

maintainers:
  - Thippeswamy Havalige <thippeswamy.havalige@amd.com>

allOf:
  - $ref: /schemas/pci/pci-host-bridge.yaml#

properties:
  compatible:
    const: xlnx,axi-pcie-host-1.00.a

  reg:
    maxItems: 1

  interrupts:
    maxItems: 1

  ranges:
    items:
      - description: |
          ranges for the PCI memory regions (I/O space region is not
          supported by hardware)

  "#interrupt-cells":
    const: 1

  interrupt-controller:
    description: identifies the node as an interrupt controller
    type: object
    properties:
      interrupt-controller: true

      "#address-cells":
        const: 0

      "#interrupt-cells":
        const: 1

    required:
      - interrupt-controller
      - "#address-cells"
      - "#interrupt-cells"

    additionalProperties: false

required:
  - compatible
  - reg
  - ranges
  - interrupts
  - interrupt-map
  - "#interrupt-cells"
  - interrupt-controller

unevaluatedProperties: false

examples:
  - |
    #include <dt-bindings/interrupt-controller/arm-gic.h>
    #include <dt-bindings/interrupt-controller/irq.h>

    pcie@50000000 {
        compatible = "xlnx,axi-pcie-host-1.00.a";
        reg = <0x50000000 0x1000000>;
        #address-cells = <3>;
        #size-cells = <2>;
        #interrupt-cells = <1>;
        device_type = "pci";
        interrupts = <GIC_SPI 52 IRQ_TYPE_LEVEL_HIGH>;
        interrupt-map-mask = <0 0 0 7>;
        interrupt-map = <0 0 0 1 &pcie_intc 1>,
                        <0 0 0 2 &pcie_intc 2>,
                        <0 0 0 3 &pcie_intc 3>,
                        <0 0 0 4 &pcie_intc 4>;
        ranges = <0x02000000 0 0x60000000 0x60000000 0 0x10000000>;
        pcie_intc: interrupt-controller {
            interrupt-controller;
            #address-cells = <0>;
            #interrupt-cells = <1>;
        };
    };
```

## Documentation/devicetree/bindings/pci/xlnx,nwl-pcie.yaml
```yaml
# SPDX-License-Identifier: (GPL-2.0-only OR BSD-2-Clause)
%YAML 1.2
---
$id: http://devicetree.org/schemas/pci/xlnx,nwl-pcie.yaml#
$schema: http://devicetree.org/meta-schemas/core.yaml#

title: Xilinx NWL PCIe Root Port Bridge

maintainers:
  - Thippeswamy Havalige <thippeswamy.havalige@amd.com>

allOf:
  - $ref: /schemas/pci/pci-bus.yaml#
  - $ref: /schemas/interrupt-controller/msi-controller.yaml#

properties:
  compatible:
    const: xlnx,nwl-pcie-2.11

  reg:
    items:
      - description: PCIe bridge registers location.
      - description: PCIe Controller registers location.
      - description: PCIe Configuration space region.

  reg-names:
    items:
      - const: breg
      - const: pcireg
      - const: cfg

  interrupts:
    items:
      - description: interrupt asserted when miscellaneous interrupt is received
      - description: unused interrupt(dummy)
      - description: interrupt asserted when a legacy interrupt is received
      - description: msi1 interrupt asserted when an MSI is received
      - description: msi0 interrupt asserted when an MSI is received

  interrupt-names:
    items:
      - const: misc
      - const: dummy
      - const: intx
      - const: msi1
      - const: msi0

  interrupt-map-mask:
    items:
      - const: 0
      - const: 0
      - const: 0
      - const: 7

  "#interrupt-cells":
    const: 1

  msi-parent:
    description: MSI controller the device is capable of using.

  interrupt-map:
    maxItems: 4

  power-domains:
    maxItems: 1

  iommus:
    maxItems: 1

  dma-coherent:
    description: optional, only needed if DMA operations are coherent.

  clocks:
    maxItems: 1
    description: optional, input clock specifier.

  legacy-interrupt-controller:
    description: Interrupt controller node for handling legacy PCI interrupts.
    type: object
    properties:
      "#address-cells":
        const: 0

      "#interrupt-cells":
        const: 1

      "interrupt-controller": true

    required:
      - "#address-cells"
      - "#interrupt-cells"
      - interrupt-controller

    additionalProperties: false

required:
  - compatible
  - reg
  - reg-names
  - interrupts
  - "#interrupt-cells"
  - interrupt-map
  - interrupt-map-mask
  - msi-controller
  - power-domains

unevaluatedProperties: false

examples:
  - |
    #include <dt-bindings/interrupt-controller/arm-gic.h>
    #include <dt-bindings/interrupt-controller/irq.h>
    #include <dt-bindings/power/xlnx-zynqmp-power.h>
    soc {
        #address-cells = <2>;
        #size-cells = <2>;
        nwl_pcie: pcie@fd0e0000 {
            compatible = "xlnx,nwl-pcie-2.11";
            reg = <0x0 0xfd0e0000 0x0 0x1000>,
                  <0x0 0xfd480000 0x0 0x1000>,
                  <0x80 0x00000000 0x0 0x10000000>;
            reg-names = "breg", "pcireg", "cfg";
            ranges = <0x02000000 0x0 0xe0000000 0x0 0xe0000000 0x0 0x10000000>,
                     <0x43000000 0x00000006 0x0 0x00000006 0x0 0x00000002 0x0>;
            #address-cells = <3>;
            #size-cells = <2>;
            #interrupt-cells = <1>;
            msi-controller;
            device_type = "pci";
            interrupt-parent = <&gic>;
            interrupts = <GIC_SPI 118 IRQ_TYPE_LEVEL_HIGH>, <GIC_SPI 116 IRQ_TYPE_EDGE_RISING>,
                         <GIC_SPI 116 IRQ_TYPE_LEVEL_HIGH>, <GIC_SPI 115 IRQ_TYPE_EDGE_RISING>,
                         <GIC_SPI 114 IRQ_TYPE_LEVEL_HIGH>;
            interrupt-names = "misc", "dummy", "intx", "msi1", "msi0";
            interrupt-map-mask = <0x0 0x0 0x0 0x7>;
            interrupt-map = <0x0 0x0 0x0 0x1 &pcie_intc 0x1>,
                            <0x0 0x0 0x0 0x2 &pcie_intc 0x2>,
                            <0x0 0x0 0x0 0x3 &pcie_intc 0x3>,
                            <0x0 0x0 0x0 0x4 &pcie_intc 0x4>;
            msi-parent = <&nwl_pcie>;
            power-domains = <&zynqmp_firmware PD_PCIE>;
            iommus = <&smmu 0x4d0>;
            pcie_intc: legacy-interrupt-controller {
                interrupt-controller;
                #address-cells = <0>;
                #interrupt-cells = <1>;
            };
        };
    };
```

## Documentation/devicetree/bindings/pci/xlnx,xdma-host.yaml
```yaml
# SPDX-License-Identifier: (GPL-2.0-only OR BSD-2-Clause)
%YAML 1.2
---
$id: http://devicetree.org/schemas/pci/xlnx,xdma-host.yaml#
$schema: http://devicetree.org/meta-schemas/core.yaml#

title: Xilinx XDMA PL PCIe Root Port Bridge

maintainers:
  - Thippeswamy Havalige <thippeswamy.havalige@amd.com>

allOf:
  - $ref: /schemas/pci/pci-bus.yaml#

properties:
  compatible:
    const: xlnx,xdma-host-3.00

  reg:
    maxItems: 1

  ranges:
    maxItems: 2

  interrupts:
    items:
      - description: interrupt asserted when miscellaneous interrupt is received.
      - description: msi0 interrupt asserted when an MSI is received.
      - description: msi1 interrupt asserted when an MSI is received.

  interrupt-names:
    items:
      - const: misc
      - const: msi0
      - const: msi1

  interrupt-map-mask:
    items:
      - const: 0
      - const: 0
      - const: 0
      - const: 7

  interrupt-map:
    maxItems: 4

  "#interrupt-cells":
    const: 1

  interrupt-controller:
    description: identifies the node as an interrupt controller
    type: object
    properties:
      interrupt-controller: true

      "#address-cells":
        const: 0

      "#interrupt-cells":
        const: 1

    required:
      - interrupt-controller
      - "#address-cells"
      - "#interrupt-cells"

    additionalProperties: false

required:
  - compatible
  - reg
  - ranges
  - interrupts
  - interrupt-map
  - interrupt-map-mask
  - "#interrupt-cells"
  - interrupt-controller

unevaluatedProperties: false

examples:

  - |
    #include <dt-bindings/interrupt-controller/arm-gic.h>
    #include <dt-bindings/interrupt-controller/irq.h>

    soc {
        #address-cells = <2>;
        #size-cells = <2>;
        pcie@a0000000 {
            compatible = "xlnx,xdma-host-3.00";
            reg = <0x0 0xa0000000 0x0 0x10000000>;
            ranges = <0x2000000 0x0 0xb0000000 0x0 0xb0000000 0x0 0x1000000>,
                     <0x43000000 0x5 0x0 0x5 0x0 0x0 0x1000000>;
            #address-cells = <3>;
            #size-cells = <2>;
            #interrupt-cells = <1>;
            device_type = "pci";
            interrupt-parent = <&gic>;
            interrupts = <GIC_SPI 89 IRQ_TYPE_LEVEL_HIGH>, <GIC_SPI 90 IRQ_TYPE_LEVEL_HIGH>,
                         <GIC_SPI 91 IRQ_TYPE_LEVEL_HIGH>;
            interrupt-names = "misc", "msi0", "msi1";
            interrupt-map-mask = <0x0 0x0 0x0 0x7>;
            interrupt-map = <0 0 0 1 &pcie_intc_0 0>,
                            <0 0 0 2 &pcie_intc_0 1>,
                            <0 0 0 3 &pcie_intc_0 2>,
                            <0 0 0 4 &pcie_intc_0 3>;
            pcie_intc_0: interrupt-controller {
                #address-cells = <0>;
                #interrupt-cells = <1>;
                interrupt-controller;
            };
        };
    };
```

## Documentation/devicetree/bindings/peci/nuvoton,npcm-peci.yaml
```yaml
# SPDX-License-Identifier: (GPL-2.0-only OR BSD-2-Clause)
%YAML 1.2
---
$id: http://devicetree.org/schemas/peci/nuvoton,npcm-peci.yaml#
$schema: http://devicetree.org/meta-schemas/core.yaml#

title: Nuvoton PECI Bus

maintainers:
  - Tomer Maimon <tmaimon77@gmail.com>

allOf:
  - $ref: peci-controller.yaml#

properties:
  compatible:
    enum:
      - nuvoton,npcm750-peci
      - nuvoton,npcm845-peci

  reg:
    maxItems: 1

  interrupts:
    maxItems: 1

  clocks:
    description:
      Clock source for PECI controller. Should reference the APB clock.
    maxItems: 1

  cmd-timeout-ms:
    minimum: 1
    maximum: 1000
    default: 1000

required:
  - compatible
  - reg
  - interrupts
  - clocks

additionalProperties: false

examples:
  - |
    #include <dt-bindings/clock/nuvoton,npcm7xx-clock.h>
    #include <dt-bindings/interrupt-controller/arm-gic.h>
    peci-controller@f0100000 {
      compatible = "nuvoton,npcm750-peci";
      reg = <0xf0100000 0x200>;
      interrupts = <GIC_SPI 6 IRQ_TYPE_LEVEL_HIGH>;
      clocks = <&clk NPCM7XX_CLK_APB3>;
      cmd-timeout-ms = <1000>;
    };
...
```

## Documentation/devicetree/bindings/peci/peci-aspeed.yaml
```yaml
# SPDX-License-Identifier: (GPL-2.0-only OR BSD-2-Clause)
%YAML 1.2
---
$id: http://devicetree.org/schemas/peci/peci-aspeed.yaml#
$schema: http://devicetree.org/meta-schemas/core.yaml#

title: Aspeed PECI Bus

maintainers:
  - Iwona Winiarska <iwona.winiarska@intel.com>
  - Jae Hyun Yoo <jae.hyun.yoo@linux.intel.com>

allOf:
  - $ref: peci-controller.yaml#

properties:
  compatible:
    enum:
      - aspeed,ast2400-peci
      - aspeed,ast2500-peci
      - aspeed,ast2600-peci

  reg:
    maxItems: 1

  interrupts:
    maxItems: 1

  clocks:
    description:
      Clock source for PECI controller. Should reference the external
      oscillator clock.
    maxItems: 1

  resets:
    maxItems: 1

  cmd-timeout-ms:
    minimum: 1
    maximum: 1000
    default: 1000

  clock-frequency:
    description:
      The desired operation frequency of PECI controller in Hz.
    minimum: 2000
    maximum: 2000000
    default: 1000000

required:
  - compatible
  - reg
  - interrupts
  - clocks
  - resets

additionalProperties: false

examples:
  - |
    #include <dt-bindings/interrupt-controller/arm-gic.h>
    #include <dt-bindings/clock/ast2600-clock.h>
    peci-controller@1e78b000 {
      compatible = "aspeed,ast2600-peci";
      reg = <0x1e78b000 0x100>;
      interrupts = <GIC_SPI 38 IRQ_TYPE_LEVEL_HIGH>;
      clocks = <&syscon ASPEED_CLK_GATE_REF0CLK>;
      resets = <&syscon ASPEED_RESET_PECI>;
      cmd-timeout-ms = <1000>;
      clock-frequency = <1000000>;
    };
...
```

## Documentation/devicetree/bindings/peci/peci-controller.yaml
```yaml
# SPDX-License-Identifier: (GPL-2.0-only OR BSD-2-Clause)
%YAML 1.2
---
$id: http://devicetree.org/schemas/peci/peci-controller.yaml#
$schema: http://devicetree.org/meta-schemas/core.yaml#

title: Generic Device Tree Bindings for PECI

maintainers:
  - Iwona Winiarska <iwona.winiarska@intel.com>

description:
  PECI (Platform Environment Control Interface) is an interface that provides a
  communication channel from Intel processors and chipset components to external
  monitoring or control devices.

properties:
  $nodename:
    pattern: "^peci-controller(@.*)?$"

  cmd-timeout-ms:
    description:
      Command timeout in units of ms.

additionalProperties: true

examples:
  - |
    peci-controller@1e78b000 {
      reg = <0x1e78b000 0x100>;
      cmd-timeout-ms = <500>;
    };
...
```

## Documentation/devicetree/bindings/perf/amlogic,g12-ddr-pmu.yaml
```yaml
# SPDX-License-Identifier: (GPL-2.0-only OR BSD-2-Clause)
%YAML 1.2
---
$id: http://devicetree.org/schemas/perf/amlogic,g12-ddr-pmu.yaml#
$schema: http://devicetree.org/meta-schemas/core.yaml#

title: Amlogic G12 DDR performance monitor

maintainers:
  - Jiucheng Xu <jiucheng.xu@amlogic.com>

description: |
  Amlogic G12 series SoC integrate DDR bandwidth monitor.
  A timer is inside and can generate interrupt when timeout.
  The bandwidth is counted in the timer ISR. Different platform
  has different subset of event format attribute.

properties:
  compatible:
    enum:
      - amlogic,g12a-ddr-pmu
      - amlogic,g12b-ddr-pmu
      - amlogic,sm1-ddr-pmu

  reg:
    items:
      - description: DMC bandwidth register space.
      - description: DMC PLL register space.

  interrupts:
    items:
      - description: The IRQ of the inside timer timeout.

required:
  - compatible
  - reg
  - interrupts

additionalProperties: false

examples:
  - |
    #include <dt-bindings/interrupt-controller/arm-gic.h>
    pmu {
        #address-cells=<2>;
        #size-cells=<2>;

        pmu@ff638000 {
            compatible = "amlogic,g12a-ddr-pmu";
            reg = <0x0 0xff638000 0x0 0x100>,
                  <0x0 0xff638c00 0x0 0x100>;
            interrupts = <GIC_SPI 52 IRQ_TYPE_EDGE_RISING>;
        };
    };
```
