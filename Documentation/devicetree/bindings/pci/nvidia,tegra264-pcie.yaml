## Documentation/devicetree/bindings/pci/nvidia,tegra264-pcie.yaml
```yaml
# SPDX-License-Identifier: (GPL-2.0-only OR BSD-2-Clause)
%YAML 1.2
---
$id: http://devicetree.org/schemas/pci/nvidia,tegra264-pcie.yaml#
$schema: http://devicetree.org/meta-schemas/core.yaml#

title: NVIDIA Tegra264 PCIe controller

maintainers:
  - Thierry Reding <thierry.reding@gmail.com>
  - Jon Hunter <jonathanh@nvidia.com>

properties:
  compatible:
    const: nvidia,tegra264-pcie

  reg:
    description: |
      Of the six PCIe controllers found on Tegra264, one (C0) is used for the
      internal GPU and the other five (C1-C5) are routed to connectors such as
      PCI or M.2 slots. Therefore the UPHY registers (XPL) exist only for C1
      through C5, but not for C0.
    minItems: 4
    items:
      - description: ECAM-compatible configuration space
      - description: application layer registers
      - description: transaction layer registers
      - description: privileged transaction layer registers
      - description: data link/physical layer registers (not available on C0)

  reg-names:
    minItems: 4
    items:
      - const: ecam
      - const: xal
      - const: xtl
      - const: xtl-pri
      - const: xpl

  interrupts:
    minItems: 1
    maxItems: 4

  dma-coherent: true

  nvidia,bpmp:
    $ref: /schemas/types.yaml#/definitions/phandle-array
    description: |
      Must contain a pair of phandle (to the BPMP controller node) and
      controller ID. The following are the controller IDs for each controller:

      0: C0
      1: C1
      2: C2
      3: C3
      4: C4
      5: C5
    items:
      - items:
          - description: phandle to the BPMP controller node
          - description: PCIe controller ID
            maximum: 5

required:
  - interrupt-map
  - interrupt-map-mask
  - iommu-map
  - msi-map
  - nvidia,bpmp

allOf:
  - $ref: /schemas/pci/pci-host-bridge.yaml#

unevaluatedProperties: false

examples:
  - |
    bus {
      #address-cells = <2>;
      #size-cells = <2>;

      pci@c000000 {
        compatible = "nvidia,tegra264-pcie";
        reg = <0xd0 0xb0000000 0x0 0x10000000>,
              <0x00 0x0c000000 0x0 0x00004000>,
              <0x00 0x0c004000 0x0 0x00001000>,
              <0x00 0x0c005000 0x0 0x00001000>;
        reg-names = "ecam", "xal", "xtl", "xtl-pri";
        #address-cells = <3>;
        #size-cells = <2>;
        device_type = "pci";
        linux,pci-domain = <0x00>;
        #interrupt-cells = <0x1>;

        interrupt-map-mask = <0x0 0x0 0x0 0x7>;
        interrupt-map = <0x0 0x0 0x0 0x1 &gic 0x0 0x0 0x0 155 4>,
                        <0x0 0x0 0x0 0x2 &gic 0x0 0x0 0x0 156 4>,
                        <0x0 0x0 0x0 0x3 &gic 0x0 0x0 0x0 157 4>,
                        <0x0 0x0 0x0 0x4 &gic 0x0 0x0 0x0 158 4>;

        iommu-map = <0x0 &smmu2 0x10000 0x10000>;
        msi-map = <0x0 &its 0x210000 0x10000>;
        dma-coherent;

        ranges = <0x81000000 0x00 0x84000000 0xd0 0x84000000 0x00 0x00200000>,
                 <0x82000000 0x00 0x20000000 0x00 0x20000000 0x00 0x08000000>,
                 <0xc3000000 0xd0 0xc0000000 0xd0 0xc0000000 0x07 0xc0000000>;
        bus-range = <0x0 0xff>;

        nvidia,bpmp = <&bpmp 0>;
      };
    };

  - |
    bus {
      #address-cells = <2>;
      #size-cells = <2>;

      pci@8400000 {
        compatible = "nvidia,tegra264-pcie";
        reg = <0xa8 0xb0000000 0x0 0x10000000>,
              <0x00 0x08400000 0x0 0x00004000>,
              <0x00 0x08404000 0x0 0x00001000>,
              <0x00 0x08405000 0x0 0x00001000>,
              <0x00 0x08410000 0x0 0x00010000>;
        reg-names = "ecam", "xal", "xtl", "xtl-pri", "xpl";
        #address-cells = <3>;
        #size-cells = <2>;
        device_type = "pci";
        linux,pci-domain = <0x01>;
        #interrupt-cells = <1>;
        interrupt-map-mask = <0x0 0x0 0x0 0x7>;
        interrupt-map = <0x0 0x0 0x0 0x1 &gic 0x0 0x0 0x0 908 4>,
                        <0x0 0x0 0x0 0x2 &gic 0x0 0x0 0x0 909 4>,
                        <0x0 0x0 0x0 0x3 &gic 0x0 0x0 0x0 910 4>,
                        <0x0 0x0 0x0 0x4 &gic 0x0 0x0 0x0 911 4>;

        iommu-map = <0x0 &smmu1 0x10000 0x10000>;
        msi-map = <0x0 &its 0x110000 0x10000>;
        dma-coherent;

        ranges = <0x81000000 0x00 0x84000000 0xa8 0x84000000 0x00 0x00200000>,
                 <0x82000000 0x00 0x28000000 0x00 0x28000000 0x00 0x08000000>,
                 <0xc3000000 0xa8 0xc0000000 0xa8 0xc0000000 0x07 0xc0000000>;
        bus-range = <0x00 0xff>;

        nvidia,bpmp = <&bpmp 1>;
      };
    };
```

## Documentation/devicetree/bindings/pci/nxp,s32g-pcie.yaml
```yaml
# SPDX-License-Identifier: (GPL-2.0-only OR BSD-2-Clause)
%YAML 1.2
---
$id: http://devicetree.org/schemas/pci/nxp,s32g-pcie.yaml#
$schema: http://devicetree.org/meta-schemas/core.yaml#

title: NXP S32G2xxx/S32G3xxx PCIe Root Complex controller

maintainers:
  - Bogdan Hamciuc <bogdan.hamciuc@nxp.com>
  - Ionut Vicovan <ionut.vicovan@nxp.com>

description:
  This PCIe controller is based on the Synopsys DesignWare PCIe IP.
  The S32G SoC family has two PCIe controllers, which can be configured as
  either Root Complex or Endpoint.

properties:
  compatible:
    oneOf:
      - enum:
          - nxp,s32g2-pcie
      - items:
          - const: nxp,s32g3-pcie
          - const: nxp,s32g2-pcie

  reg:
    maxItems: 6

  reg-names:
    items:
      - const: dbi
      - const: dbi2
      - const: atu
      - const: dma
      - const: ctrl
      - const: config

  interrupts:
    minItems: 1
    maxItems: 2

  interrupt-names:
    items:
      - const: msi
      - const: dma
    minItems: 1

  pcie@0:
    description:
      Describe the S32G Root Port.
    type: object
    $ref: /schemas/pci/pci-pci-bridge.yaml#

    properties:
      reg:
        maxItems: 1

      phys:
        maxItems: 1

    required:
      - reg
      - phys

    unevaluatedProperties: false

required:
  - compatible
  - reg
  - reg-names
  - interrupts
  - interrupt-names
  - ranges
  - pcie@0

allOf:
  - $ref: /schemas/pci/snps,dw-pcie.yaml#

unevaluatedProperties: false

examples:
  - |
    #include <dt-bindings/interrupt-controller/arm-gic.h>
    #include <dt-bindings/phy/phy.h>

    bus {
        #address-cells = <2>;
        #size-cells = <2>;

        pcie@40400000 {
            compatible = "nxp,s32g3-pcie", "nxp,s32g2-pcie";
            reg = <0x00 0x40400000 0x0 0x00001000>,   /* dbi registers */
                  <0x00 0x40420000 0x0 0x00001000>,   /* dbi2 registers */
                  <0x00 0x40460000 0x0 0x00001000>,   /* atu registers */
                  <0x00 0x40470000 0x0 0x00001000>,   /* dma registers */
                  <0x00 0x40481000 0x0 0x000000f8>,   /* ctrl registers */
                  <0x5f 0xffffe000 0x0 0x00002000>;   /* config space */
            reg-names = "dbi", "dbi2", "atu", "dma", "ctrl", "config";
            dma-coherent;
            #address-cells = <3>;
            #size-cells = <2>;
            device_type = "pci";
            ranges =
                     <0x01000000 0x0 0x00000000 0x5f 0xfffe0000 0x0 0x00010000>,
                     <0x02000000 0x0 0x00000000 0x58 0x00000000 0x0 0x80000000>,
                     <0x02000000 0x1 0x00000000 0x59 0x00000000 0x6 0xfffe0000>;

            bus-range = <0x0 0xff>;
            interrupts = <GIC_SPI 125 IRQ_TYPE_LEVEL_HIGH>,
                         <GIC_SPI 123 IRQ_TYPE_LEVEL_HIGH>;
            interrupt-names = "msi", "dma";
            #interrupt-cells = <1>;
            interrupt-map-mask = <0 0 0 0x7>;
            interrupt-map = <0 0 0 1 &gic 0 0 GIC_SPI 128 IRQ_TYPE_LEVEL_HIGH>,
                            <0 0 0 2 &gic 0 0 GIC_SPI 129 IRQ_TYPE_LEVEL_HIGH>,
                            <0 0 0 3 &gic 0 0 GIC_SPI 130 IRQ_TYPE_LEVEL_HIGH>,
                            <0 0 0 4 &gic 0 0 GIC_SPI 131 IRQ_TYPE_LEVEL_HIGH>;

            pcie@0 {
                reg = <0x0 0x0 0x0 0x0 0x0>;
                #address-cells = <3>;
                #size-cells = <2>;
                ranges;

                device_type = "pci";
                phys = <&serdes0 PHY_TYPE_PCIE 0 0>;
            };
        };
    };
```

## Documentation/devicetree/bindings/pci/pci-armada8k.txt
```
* Marvell Armada 7K/8K PCIe interface

This PCIe host controller is based on the Synopsys DesignWare PCIe IP
and thus inherits all the common properties defined in snps,dw-pcie.yaml.

Required properties:
- compatible: "marvell,armada8k-pcie"
- reg: must contain two register regions
   - the control register region
   - the config space region
- reg-names:
   - "ctrl" for the control register region
   - "config" for the config space region
- interrupts: Interrupt specifier for the PCIe controller
- clocks: reference to the PCIe controller clocks
- clock-names: mandatory if there is a second clock, in this case the
   name must be "core" for the first clock and "reg" for the second
   one

Optional properties:
- phys: phandle(s) to PHY node(s) following the generic PHY bindings.
	Either 1, 2 or 4 PHYs might be needed depending on the number of
	PCIe lanes.
- phy-names: names of the PHYs corresponding to the number of lanes.
	Must be "cp0-pcie0-x4-lane0-phy", "cp0-pcie0-x4-lane1-phy" for
	2 PHYs.

Example:

	pcie@f2600000 {
		compatible = "marvell,armada8k-pcie", "snps,dw-pcie";
		reg = <0 0xf2600000 0 0x10000>, <0 0xf6f00000 0 0x80000>;
		reg-names = "ctrl", "config";
		#address-cells = <3>;
		#size-cells = <2>;
		#interrupt-cells = <1>;
		device_type = "pci";
		dma-coherent;

		bus-range = <0 0xff>;
		ranges = <0x81000000 0 0xf9000000 0  0xf9000000 0 0x10000	/* downstream I/O */
			  0x82000000 0 0xf6000000 0  0xf6000000 0 0xf00000>;	/* non-prefetchable memory */
		interrupt-map-mask = <0 0 0 0>;
		interrupt-map = <0 0 0 0 &gic 0 GIC_SPI 32 IRQ_TYPE_LEVEL_HIGH>;
		interrupts = <GIC_SPI 32 IRQ_TYPE_LEVEL_HIGH>;
		num-lanes = <1>;
		clocks = <&cpm_syscon0 1 13>;
	};
```

## Documentation/devicetree/bindings/pci/pci-ep-bus.yaml
```yaml
# SPDX-License-Identifier: (GPL-2.0-only OR BSD-2-Clause)
%YAML 1.2
---
$id: http://devicetree.org/schemas/pci/pci-ep-bus.yaml#
$schema: http://devicetree.org/meta-schemas/core.yaml#

title: Common Properties for PCI MFD EP with Peripherals Addressable from BARs

maintainers:
  - A. della Porta  <andrea.porta@suse.com>

description:
  Define a generic node representing a PCI endpoint which contains several sub-
  peripherals. The peripherals can be accessed through one or more BARs.
  This common schema is intended to be referenced from device tree bindings and
  does not represent a device tree binding by itself.

properties:
  '#address-cells':
    const: 3

  '#size-cells':
    const: 2

  ranges:
    minItems: 1
    maxItems: 6
    items:
      maxItems: 8
      additionalItems: true
      items:
        - maximum: 5  # The BAR number
        - const: 0
        - const: 0

patternProperties:
  '^pci-ep-bus@[0-5]$':
    type: object
    description:
      One node for each BAR used by peripherals contained in the PCI endpoint.
      Each node represents a bus on which peripherals are connected.
      This allows for some segmentation, e.g., one peripheral is accessible
      through BAR0 and another through BAR1, and you don't want the two
      peripherals to be able to act on the other BAR. Alternatively, when
      different peripherals need to share BARs, you can define only one node
      and use a 'ranges' property to map all the used BARs.

    additionalProperties: true

    properties:
      compatible:
        const: simple-bus

    required:
      - compatible

additionalProperties: true
...
```
