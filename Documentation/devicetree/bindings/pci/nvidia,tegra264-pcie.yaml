## Documentation/devicetree/bindings/pci/plda,xpressrich3-axi-common.yaml
```yaml
# SPDX-License-Identifier: (GPL-2.0-only OR BSD-2-Clause)
%YAML 1.2
---
$id: http://devicetree.org/schemas/pci/plda,xpressrich3-axi-common.yaml#
$schema: http://devicetree.org/meta-schemas/core.yaml#

title: PLDA XpressRICH PCIe host common properties

maintainers:
  - Daire McNamara <daire.mcnamara@microchip.com>
  - Kevin Xie <kevin.xie@starfivetech.com>

description:
  Generic PLDA XpressRICH PCIe host common properties.

allOf:
  - $ref: /schemas/pci/pci-host-bridge.yaml#

properties:
  reg:
    maxItems: 2

  reg-names:
    items:
      - const: cfg
      - const: apb

  interrupts:
    minItems: 1
    items:
      - description: PCIe host controller
      - description: builtin MSI controller

  interrupt-names:
    minItems: 1
    items:
      - const: pcie
      - const: msi

  msi-controller:
    description: Identifies the node as an MSI controller.

  msi-parent:
    description: MSI controller the device is capable of using.

  interrupt-controller:
    type: object
    properties:
      '#address-cells':
        const: 0

      '#interrupt-cells':
        const: 1

      interrupt-controller: true

    required:
      - '#address-cells'
      - '#interrupt-cells'
      - interrupt-controller

    additionalProperties: false

required:
  - reg
  - reg-names
  - interrupts
  - msi-controller
  - "#interrupt-cells"
  - interrupt-map-mask
  - interrupt-map

additionalProperties: true

...
```

## Documentation/devicetree/bindings/pci/plda,xpressrich3-axi.txt
```
* PLDA XpressRICH3-AXI host controller

The PLDA XpressRICH3-AXI host controller can be configured in a manner that
makes it compliant with the SBSA[1] standard published by ARM Ltd. For those
scenarios, the host-generic-pci.txt bindings apply with the following additions
to the compatible property:

Required properties:
 - compatible: should contain "plda,xpressrich3-axi" to identify the IP used.


[1] http://infocenter.arm.com/help/topic/com.arm.doc.den0029a/
```

## Documentation/devicetree/bindings/pci/qcom,hawi-pcie.yaml
```yaml
# SPDX-License-Identifier: (GPL-2.0-only OR BSD-2-Clause)
%YAML 1.2
---
$id: http://devicetree.org/schemas/pci/qcom,hawi-pcie.yaml#
$schema: http://devicetree.org/meta-schemas/core.yaml#

title: Qualcomm Hawi PCI Express Root Complex

maintainers:
  - Bjorn Andersson <andersson@kernel.org>
  - Manivannan Sadhasivam <mani@kernel.org>

description:
  Qualcomm Hawi SoC (and compatible) PCIe root complex controller is based on
  the Synopsys DesignWare PCIe IP.

properties:
  compatible:
    oneOf:
      - const: qcom,hawi-pcie
      - items:
          - enum:
              - qcom,maili-pcie
          - const: qcom,hawi-pcie

  reg:
    items:
      - description: Qualcomm specific registers
      - description: DesignWare PCIe registers
      - description: External local bus interface registers
      - description: ATU address space
      - description: PCIe configuration space
      - description: MHI registers

  reg-names:
    items:
      - const: parf
      - const: dbi
      - const: elbi
      - const: atu
      - const: config
      - const: mhi

  clocks:
    items:
      - description: PCIe Auxiliary clock
      - description: PCIe Configuration clock
      - description: PCIe Master AXI clock
      - description: PCIe Slave AXI clock
      - description: PCIe Slave Q2A AXI clock
      - description: PCIe Aggre NoC AXI clock
      - description: PCIe Config NoC AXI clock

  clock-names:
    items:
      - const: aux
      - const: cfg
      - const: bus_master
      - const: bus_slave
      - const: slave_q2a
      - const: noc_aggr
      - const: cnoc_sf_axi

  interrupts:
    minItems: 9
    maxItems: 9

  interrupt-names:
    items:
      - const: msi0
      - const: msi1
      - const: msi2
      - const: msi3
      - const: msi4
      - const: msi5
      - const: msi6
      - const: msi7
      - const: global

  resets:
    items:
      - description: PCIe core reset
      - description: PCIe link down reset

  reset-names:
    items:
      - const: pci
      - const: link_down

required:
  - power-domains
  - resets
  - reset-names

allOf:
  - $ref: qcom,pcie-common.yaml#

unevaluatedProperties: false

examples:
  - |
    #include <dt-bindings/gpio/gpio.h>
    #include <dt-bindings/interconnect/qcom,icc.h>
    #include <dt-bindings/interrupt-controller/arm-gic.h>

    soc {
        #address-cells = <2>;
        #size-cells = <2>;

        pcie@1c00000 {
            compatible = "qcom,hawi-pcie";
            reg = <0 0x01c00000 0 0x3000>,
                  <0 0x40000000 0 0xf1d>,
                  <0 0x40000f20 0 0xa8>,
                  <0 0x40001000 0 0x1000>,
                  <0 0x40100000 0 0x100000>,
                  <0 0x01c03000 0 0x1000>;
            reg-names = "parf", "dbi", "elbi", "atu", "config", "mhi";
            ranges = <0x01000000 0x0 0x00000000 0x0 0x40200000 0x0 0x100000>,
                     <0x02000000 0x0 0x40300000 0x0 0x40300000 0x0 0x3d00000>;

            bus-range = <0x00 0xff>;
            device_type = "pci";
            linux,pci-domain = <0>;
            num-lanes = <2>;

            #address-cells = <3>;
            #size-cells = <2>;

            clocks = <&gcc_pcie_0_aux_clk>,
                     <&gcc_pcie_0_cfg_ahb_clk>,
                     <&gcc_pcie_0_mstr_axi_clk>,
                     <&gcc_pcie_0_slv_axi_clk>,
                     <&gcc_pcie_0_slv_q2a_axi_clk>,
                     <&gcc_aggre_noc_pcie_axi_clk>,
                     <&gcc_cnoc_pcie_sf_axi_clk>;
            clock-names = "aux",
                          "cfg",
                          "bus_master",
                          "bus_slave",
                          "slave_q2a",
                          "noc_aggr",
                          "cnoc_sf_axi";

            dma-coherent;

            interrupts = <GIC_ESPI 205 IRQ_TYPE_LEVEL_HIGH>,
                         <GIC_ESPI 206 IRQ_TYPE_LEVEL_HIGH>,
                         <GIC_ESPI 207 IRQ_TYPE_LEVEL_HIGH>,
                         <GIC_ESPI 208 IRQ_TYPE_LEVEL_HIGH>,
                         <GIC_ESPI 209 IRQ_TYPE_LEVEL_HIGH>,
                         <GIC_ESPI 210 IRQ_TYPE_LEVEL_HIGH>,
                         <GIC_ESPI 211 IRQ_TYPE_LEVEL_HIGH>,
                         <GIC_ESPI 212 IRQ_TYPE_LEVEL_HIGH>,
                         <GIC_ESPI 204 IRQ_TYPE_LEVEL_HIGH>;
            interrupt-names = "msi0", "msi1", "msi2", "msi3",
                              "msi4", "msi5", "msi6", "msi7", "global";
            #interrupt-cells = <1>;
            interrupt-map-mask = <0 0 0 0x7>;
            interrupt-map = <0 0 0 1 &intc 0 0 GIC_ESPI 213 IRQ_TYPE_LEVEL_HIGH>, /* int_a */
                            <0 0 0 2 &intc 0 0 GIC_ESPI 214 IRQ_TYPE_LEVEL_HIGH>, /* int_b */
                            <0 0 0 3 &intc 0 0 GIC_ESPI 215 IRQ_TYPE_LEVEL_HIGH>, /* int_c */
                            <0 0 0 4 &intc 0 0 GIC_ESPI 216 IRQ_TYPE_LEVEL_HIGH>; /* int_d */

            interconnects = <&pcie_anoc_master_pcie_0 QCOM_ICC_TAG_ALWAYS
                             &mc_virt_slave_ebi1 QCOM_ICC_TAG_ALWAYS>,
                            <&gem_noc_master_appss_proc QCOM_ICC_TAG_ACTIVE_ONLY
                             &cnoc_main_slave_pcie_0 QCOM_ICC_TAG_ACTIVE_ONLY>;
            interconnect-names = "pcie-mem", "cpu-pcie";

            iommu-map = <0x0 &apps_smmu 0x1000 0x1>,
                        <0x100 &apps_smmu 0x1001 0x1>;

            pinctrl-0 = <&pcie0_default_state>;
            pinctrl-names = "default";

            power-domains = <&gcc_pcie_0_phy_gdsc>;

            resets = <&gcc_pcie_0_bcr>,
                     <&gcc_pcie_0_link_down_bcr>;
            reset-names = "pci", "link_down";

            msi-map = <0x0 &gic_its 0x1000 0x1>,
                      <0x100 &gic_its 0x1001 0x1>;
            msi-map-mask = <0xff00>;

            pcie@0 {
                device_type = "pci";
                reg = <0x0 0x0 0x0 0x0 0x0>;
                bus-range = <0x01 0xff>;

                #address-cells = <3>;
                #size-cells = <2>;
                ranges;

                phys = <&pcie0_phy>;
                wake-gpios = <&tlmm 104 GPIO_ACTIVE_HIGH>;
                reset-gpios = <&tlmm 102 GPIO_ACTIVE_LOW>;
            };
        };
    };
```

## Documentation/devicetree/bindings/pci/qcom,pcie-apq8064.yaml
```yaml
# SPDX-License-Identifier: (GPL-2.0-only OR BSD-2-Clause)
%YAML 1.2
---
$id: http://devicetree.org/schemas/pci/qcom,pcie-apq8064.yaml#
$schema: http://devicetree.org/meta-schemas/core.yaml#

title: Qualcomm APQ8064/IPQ8064 PCI Express Root Complex

maintainers:
  - Bjorn Andersson <andersson@kernel.org>
  - Manivannan Sadhasivam <mani@kernel.org>

properties:
  compatible:
    enum:
      - qcom,pcie-apq8064
      - qcom,pcie-ipq8064
      - qcom,pcie-ipq8064-v2

  reg:
    maxItems: 4

  reg-names:
    items:
      - const: dbi
      - const: elbi
      - const: parf
      - const: config

  clocks:
    minItems: 3
    maxItems: 5

  clock-names:
    minItems: 3
    items:
      - const: core # Clocks the pcie hw block
      - const: iface # Configuration AHB clock
      - const: phy
      - const: aux
      - const: ref

  interrupts:
    maxItems: 1

  interrupt-names:
    items:
      - const: msi

  resets:
    minItems: 5
    maxItems: 6

  reset-names:
    minItems: 5
    items:
      - const: axi
      - const: ahb
      - const: por
      - const: pci
      - const: phy
      - const: ext

  vdda-supply:
    description: A phandle to the core analog power supply

  vdda_phy-supply:
    description: A phandle to the core analog power supply for PHY

  vdda_refclk-supply:
    description: A phandle to the core analog power supply for IC which generates reference clock

required:
  - resets
  - reset-names
  - vdda-supply
  - vdda_phy-supply
  - vdda_refclk-supply

allOf:
  - $ref: qcom,pcie-common.yaml#
  - if:
      properties:
        compatible:
          contains:
            enum:
              - qcom,pcie-apq8064
    then:
      properties:
        clocks:
          maxItems: 3
        clock-names:
          maxItems: 3
        resets:
          maxItems: 5
        reset-names:
          maxItems: 5
    else:
      properties:
        clocks:
          minItems: 5
        clock-names:
          minItems: 5
        resets:
          minItems: 6
        reset-names:
          minItems: 6

unevaluatedProperties: false

examples:
  - |
    #include <dt-bindings/clock/qcom,gcc-msm8960.h>
    #include <dt-bindings/gpio/gpio.h>
    #include <dt-bindings/interrupt-controller/arm-gic.h>
    #include <dt-bindings/reset/qcom,gcc-msm8960.h>

    pcie@1b500000 {
        compatible = "qcom,pcie-apq8064";
        reg = <0x1b500000 0x1000>,
              <0x1b502000 0x80>,
              <0x1b600000 0x100>,
              <0x0ff00000 0x100000>;
        reg-names = "dbi", "elbi", "parf", "config";
        ranges = <0x81000000 0x0 0x00000000 0x0fe00000 0x0 0x00100000>, /* I/O */
                 <0x82000000 0x0 0x08000000 0x08000000 0x0 0x07e00000>; /* mem */

        device_type = "pci";
        linux,pci-domain = <0>;
        bus-range = <0x00 0xff>;
        num-lanes = <1>;
        #address-cells = <3>;
        #size-cells = <2>;

        clocks = <&gcc PCIE_A_CLK>,
                 <&gcc PCIE_H_CLK>,
                 <&gcc PCIE_PHY_REF_CLK>;
        clock-names = "core", "iface", "phy";

        interrupts = <GIC_SPI 238 IRQ_TYPE_LEVEL_HIGH>;
        interrupt-names = "msi";
        #interrupt-cells = <1>;
        interrupt-map-mask = <0 0 0 0x7>;
        interrupt-map = <0 0 0 1 &intc GIC_SPI 36 IRQ_TYPE_LEVEL_HIGH>, /* int_a */
                        <0 0 0 2 &intc GIC_SPI 37 IRQ_TYPE_LEVEL_HIGH>, /* int_b */
                        <0 0 0 3 &intc GIC_SPI 38 IRQ_TYPE_LEVEL_HIGH>, /* int_c */
                        <0 0 0 4 &intc GIC_SPI 39 IRQ_TYPE_LEVEL_HIGH>; /* int_d */

        resets = <&gcc PCIE_ACLK_RESET>,
                 <&gcc PCIE_HCLK_RESET>,
                 <&gcc PCIE_POR_RESET>,
                 <&gcc PCIE_PCI_RESET>,
                 <&gcc PCIE_PHY_RESET>;
        reset-names = "axi", "ahb", "por", "pci", "phy";

        perst-gpios = <&tlmm_pinmux 27 GPIO_ACTIVE_LOW>;
        vdda-supply = <&pm8921_s3>;
        vdda_phy-supply = <&pm8921_lvs6>;
        vdda_refclk-supply = <&v3p3_fixed>;

        pcie@0 {
            device_type = "pci";
            reg = <0x0 0x0 0x0 0x0 0x0>;
            bus-range = <0x01 0xff>;

            #address-cells = <3>;
            #size-cells = <2>;
            ranges;
        };
    };
```

## Documentation/devicetree/bindings/pci/qcom,pcie-apq8084.yaml
```yaml
# SPDX-License-Identifier: (GPL-2.0-only OR BSD-2-Clause)
%YAML 1.2
---
$id: http://devicetree.org/schemas/pci/qcom,pcie-apq8084.yaml#
$schema: http://devicetree.org/meta-schemas/core.yaml#

title: Qualcomm APQ8084 PCI Express Root Complex

maintainers:
  - Bjorn Andersson <andersson@kernel.org>
  - Manivannan Sadhasivam <mani@kernel.org>

properties:
  compatible:
    enum:
      - qcom,pcie-apq8084

  reg:
    minItems: 4
    maxItems: 5

  reg-names:
    minItems: 4
    items:
      - const: parf
      - const: dbi
      - const: elbi
      - const: config
      - const: mhi

  clocks:
    maxItems: 4

  clock-names:
    items:
      - const: iface # Configuration AHB clock
      - const: master_bus # Master AXI clock
      - const: slave_bus # Slave AXI clock
      - const: aux

  interrupts:
    maxItems: 1

  interrupt-names:
    items:
      - const: msi

  resets:
    maxItems: 1

  reset-names:
    items:
      - const: core

  vdda-supply:
    description: A phandle to the core analog power supply

required:
  - power-domains
  - resets
  - reset-names

allOf:
  - $ref: qcom,pcie-common.yaml#

unevaluatedProperties: false

examples:
  - |
    #include <dt-bindings/interrupt-controller/arm-gic.h>
    #include <dt-bindings/gpio/gpio.h>
    pcie@fc520000 {
      compatible = "qcom,pcie-apq8084";
      reg = <0xfc520000 0x2000>,
            <0xff000000 0x1000>,
            <0xff001000 0x1000>,
            <0xff002000 0x2000>;
      reg-names = "parf", "dbi", "elbi", "config";
      device_type = "pci";
      linux,pci-domain = <0>;
      bus-range = <0x00 0xff>;
      num-lanes = <1>;
      #address-cells = <3>;
      #size-cells = <2>;
      ranges = <0x81000000 0 0          0xff200000 0 0x00100000>,
               <0x82000000 0 0x00300000 0xff300000 0 0x00d00000>;
      interrupts = <GIC_SPI 243 IRQ_TYPE_LEVEL_HIGH>;
      interrupt-names = "msi";
      #interrupt-cells = <1>;
      interrupt-map-mask = <0 0 0 0x7>;
      interrupt-map = <0 0 0 1 &intc 0 244 IRQ_TYPE_LEVEL_HIGH>,
                      <0 0 0 2 &intc 0 245 IRQ_TYPE_LEVEL_HIGH>,
                      <0 0 0 3 &intc 0 247 IRQ_TYPE_LEVEL_HIGH>,
                      <0 0 0 4 &intc 0 248 IRQ_TYPE_LEVEL_HIGH>;
      clocks = <&gcc 324>,
               <&gcc 325>,
               <&gcc 327>,
               <&gcc 323>;
      clock-names = "iface", "master_bus", "slave_bus", "aux";
      resets = <&gcc 81>;
      reset-names = "core";
      power-domains = <&gcc 1>;
      vdda-supply = <&pma8084_l3>;
      phys = <&pciephy0>;
      phy-names = "pciephy";
      perst-gpios = <&tlmm 70 GPIO_ACTIVE_LOW>;
      pinctrl-0 = <&pcie0_pins_default>;
      pinctrl-names = "default";
    };
```
