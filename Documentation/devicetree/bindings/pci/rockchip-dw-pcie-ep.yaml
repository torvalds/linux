## Documentation/devicetree/bindings/pci/st,stm32-pcie-host.yaml
```yaml
# SPDX-License-Identifier: (GPL-2.0 OR BSD-2-Clause)
%YAML 1.2
---
$id: http://devicetree.org/schemas/pci/st,stm32-pcie-host.yaml#
$schema: http://devicetree.org/meta-schemas/core.yaml#

title: STMicroelectronics STM32MP25 PCIe Root Complex

maintainers:
  - Christian Bruel <christian.bruel@foss.st.com>

description:
  PCIe root complex controller based on the Synopsys DesignWare PCIe core.

allOf:
  - $ref: /schemas/pci/snps,dw-pcie.yaml#
  - $ref: /schemas/pci/st,stm32-pcie-common.yaml#

properties:
  compatible:
    const: st,stm32mp25-pcie-rc

  reg:
    items:
      - description: Data Bus Interface (DBI) registers.
      - description: PCIe configuration registers.

  reg-names:
    items:
      - const: dbi
      - const: config

  msi-parent:
    maxItems: 1

patternProperties:
  '^pcie@[0-2],0$':
    type: object
    $ref: /schemas/pci/pci-pci-bridge.yaml#

    properties:
      reg:
        maxItems: 1

      phys:
        maxItems: 1

      reset-gpios:
        description: GPIO controlled connection to PERST# signal
        maxItems: 1

      wake-gpios:
        description: GPIO used as WAKE# input signal
        maxItems: 1

    required:
      - phys
      - ranges

    unevaluatedProperties: false

required:
  - interrupt-map
  - interrupt-map-mask
  - ranges
  - dma-ranges

unevaluatedProperties: false

examples:
  - |
    #include <dt-bindings/clock/st,stm32mp25-rcc.h>
    #include <dt-bindings/gpio/gpio.h>
    #include <dt-bindings/interrupt-controller/arm-gic.h>
    #include <dt-bindings/phy/phy.h>
    #include <dt-bindings/reset/st,stm32mp25-rcc.h>

    pcie@48400000 {
        compatible = "st,stm32mp25-pcie-rc";
        device_type = "pci";
        reg = <0x48400000 0x400000>,
              <0x10000000 0x10000>;
        reg-names = "dbi", "config";
        #interrupt-cells = <1>;
        interrupt-map-mask = <0 0 0 7>;
        interrupt-map = <0 0 0 1 &intc 0 0 GIC_SPI 264 IRQ_TYPE_LEVEL_HIGH>,
                        <0 0 0 2 &intc 0 0 GIC_SPI 265 IRQ_TYPE_LEVEL_HIGH>,
                        <0 0 0 3 &intc 0 0 GIC_SPI 266 IRQ_TYPE_LEVEL_HIGH>,
                        <0 0 0 4 &intc 0 0 GIC_SPI 267 IRQ_TYPE_LEVEL_HIGH>;
        #address-cells = <3>;
        #size-cells = <2>;
        ranges = <0x01000000 0x0 0x00000000 0x10010000 0x0 0x10000>,
                 <0x02000000 0x0 0x10020000 0x10020000 0x0 0x7fe0000>,
                 <0x42000000 0x0 0x18000000 0x18000000 0x0 0x8000000>;
        dma-ranges = <0x42000000 0x0 0x80000000 0x80000000 0x0 0x80000000>;
        clocks = <&rcc CK_BUS_PCIE>;
        resets = <&rcc PCIE_R>;
        msi-parent = <&v2m0>;
        access-controllers = <&rifsc 68>;
        power-domains = <&CLUSTER_PD>;

        pcie@0,0 {
            device_type = "pci";
            reg = <0x0 0x0 0x0 0x0 0x0>;
            phys = <&combophy PHY_TYPE_PCIE>;
            wake-gpios = <&gpioh 5 (GPIO_ACTIVE_LOW | GPIO_PULL_UP)>;
            reset-gpios = <&gpioj 8 GPIO_ACTIVE_LOW>;
            #address-cells = <3>;
            #size-cells = <2>;
            ranges;
        };
    };
```

## Documentation/devicetree/bindings/pci/starfive,jh7110-pcie.yaml
```yaml
# SPDX-License-Identifier: (GPL-2.0-only OR BSD-2-Clause)
%YAML 1.2
---
$id: http://devicetree.org/schemas/pci/starfive,jh7110-pcie.yaml#
$schema: http://devicetree.org/meta-schemas/core.yaml#

title: StarFive JH7110 PCIe host controller

maintainers:
  - Kevin Xie <kevin.xie@starfivetech.com>

allOf:
  - $ref: plda,xpressrich3-axi-common.yaml#

properties:
  compatible:
    const: starfive,jh7110-pcie


  reg:
    maxItems: 2

  reg-names:
    maxItems: 2

  clocks:
    items:
      - description: NOC bus clock
      - description: Transport layer clock
      - description: AXI MST0 clock
      - description: APB clock

  clock-names:
    items:
      - const: noc
      - const: tl
      - const: axi_mst0
      - const: apb

  resets:
    items:
      - description: AXI MST0 reset
      - description: AXI SLAVE0 reset
      - description: AXI SLAVE reset
      - description: PCIE BRIDGE reset
      - description: PCIE CORE reset
      - description: PCIE APB reset

  reset-names:
    items:
      - const: mst0
      - const: slv0
      - const: slv
      - const: brg
      - const: core
      - const: apb

  starfive,stg-syscon:
    $ref: /schemas/types.yaml#/definitions/phandle-array
    description:
      The phandle to System Register Controller syscon node.

  perst-gpios:
    description: GPIO controlled connection to PERST# signal
    maxItems: 1

  phys:
    description:
      Specified PHY is attached to PCIe controller.
    maxItems: 1

required:
  - clocks
  - resets
  - starfive,stg-syscon

unevaluatedProperties: false

examples:
  - |
    #include <dt-bindings/gpio/gpio.h>
    soc {
        #address-cells = <2>;
        #size-cells = <2>;

        pcie@940000000 {
            compatible = "starfive,jh7110-pcie";
            reg = <0x9 0x40000000 0x0 0x10000000>,
                  <0x0 0x2b000000 0x0 0x1000000>;
            reg-names = "cfg", "apb";
            #address-cells = <3>;
            #size-cells = <2>;
            #interrupt-cells = <1>;
            device_type = "pci";
            ranges = <0x82000000  0x0 0x30000000  0x0 0x30000000 0x0 0x08000000>,
                     <0xc3000000  0x9 0x00000000  0x9 0x00000000 0x0 0x40000000>;
            starfive,stg-syscon = <&stg_syscon>;
            bus-range = <0x0 0xff>;
            interrupt-parent = <&plic>;
            interrupts = <56>;
            interrupt-map-mask = <0x0 0x0 0x0 0x7>;
            interrupt-map = <0x0 0x0 0x0 0x1 &pcie_intc0 0x1>,
                            <0x0 0x0 0x0 0x2 &pcie_intc0 0x2>,
                            <0x0 0x0 0x0 0x3 &pcie_intc0 0x3>,
                            <0x0 0x0 0x0 0x4 &pcie_intc0 0x4>;
            msi-controller;
            clocks = <&syscrg 86>,
                     <&stgcrg 10>,
                     <&stgcrg 8>,
                     <&stgcrg 9>;
            clock-names = "noc", "tl", "axi_mst0", "apb";
            resets = <&stgcrg 11>,
                     <&stgcrg 12>,
                     <&stgcrg 13>,
                     <&stgcrg 14>,
                     <&stgcrg 15>,
                     <&stgcrg 16>;
            perst-gpios = <&gpios 26 GPIO_ACTIVE_LOW>;
            phys = <&pciephy0>;

            pcie_intc0: interrupt-controller {
                #address-cells = <0>;
                #interrupt-cells = <1>;
                interrupt-controller;
            };
        };
    };
```

## Documentation/devicetree/bindings/pci/tango-pcie.txt
```
Sigma Designs Tango PCIe controller

Required properties:

- compatible: "sigma,smp8759-pcie"
- reg: address/size of PCI configuration space, address/size of register area
- bus-range: defined by size of PCI configuration space
- device_type: "pci"
- #size-cells: <2>
- #address-cells: <3>
- msi-controller
- ranges: translation from system to bus addresses
- interrupts: spec for misc interrupts, spec for MSI

Example:

	pcie@2e000 {
		compatible = "sigma,smp8759-pcie";
		reg = <0x50000000 0x400000>, <0x2e000 0x100>;
		bus-range = <0 3>;
		device_type = "pci";
		#size-cells = <2>;
		#address-cells = <3>;
		msi-controller;
		ranges = <0x02000000 0x0 0x00400000  0x50400000  0x0 0x3c00000>;
		interrupts =
			<54 IRQ_TYPE_LEVEL_HIGH>, /* misc interrupts */
			<55 IRQ_TYPE_LEVEL_HIGH>; /* MSI */
	};
```

## Documentation/devicetree/bindings/pci/ti,am65-pci-ep.yaml
```yaml
# SPDX-License-Identifier: (GPL-2.0-only OR BSD-2-Clause)
# Copyright (C) 2021 Texas Instruments Incorporated - http://www.ti.com/
%YAML 1.2
---
$id: http://devicetree.org/schemas/pci/ti,am65-pci-ep.yaml#
$schema: http://devicetree.org/meta-schemas/core.yaml#

title: TI AM65 PCI Endpoint

maintainers:
  - Kishon Vijay Abraham I <kishon@ti.com>

allOf:
  - $ref: pci-ep.yaml#

properties:
  compatible:
    enum:
      - ti,am654-pcie-ep

  reg:
    maxItems: 4

  reg-names:
    items:
      - const: app
      - const: dbics
      - const: addr_space
      - const: atu

  power-domains:
    maxItems: 1

  ti,syscon-pcie-mode:
    $ref: /schemas/types.yaml#/definitions/phandle-array
    items:
      - items:
          - description: Phandle to the SYSCON entry
          - description: pcie_ctrl register offset within SYSCON
    description: Phandle to the SYSCON entry required for configuring PCIe in RC or EP mode.

  interrupts:
    minItems: 1

  dma-coherent: true

required:
  - compatible
  - reg
  - reg-names
  - max-link-speed
  - power-domains
  - ti,syscon-pcie-mode
  - dma-coherent

unevaluatedProperties: false

examples:
  - |
    #include <dt-bindings/interrupt-controller/arm-gic.h>
    #include <dt-bindings/interrupt-controller/irq.h>
    #include <dt-bindings/soc/ti,sci_pm_domain.h>

    pcie0_ep: pcie-ep@5500000 {
        compatible = "ti,am654-pcie-ep";
        reg =  <0x5500000 0x1000>,
               <0x5501000 0x1000>,
               <0x10000000 0x8000000>,
               <0x5506000 0x1000>;
        reg-names = "app", "dbics", "addr_space", "atu";
        power-domains = <&k3_pds 120 TI_SCI_PD_EXCLUSIVE>;
        ti,syscon-pcie-mode = <&scm_conf 0x4060>;
        max-link-speed = <2>;
        dma-coherent;
        interrupts = <GIC_SPI 340 IRQ_TYPE_EDGE_RISING>;
    };
```

## Documentation/devicetree/bindings/pci/ti,am65-pci-host.yaml
```yaml
# SPDX-License-Identifier: (GPL-2.0-only OR BSD-2-Clause)
# Copyright (C) 2021 Texas Instruments Incorporated - http://www.ti.com/
%YAML 1.2
---
$id: http://devicetree.org/schemas/pci/ti,am65-pci-host.yaml#
$schema: http://devicetree.org/meta-schemas/core.yaml#

title: TI AM65 PCI Host

maintainers:
  - Kishon Vijay Abraham I <kishon@ti.com>

allOf:
  - $ref: /schemas/pci/pci-host-bridge.yaml#

properties:
  compatible:
    enum:
      - ti,am654-pcie-rc
      - ti,keystone-pcie

  reg:
    minItems: 4
    maxItems: 6

  reg-names:
    minItems: 4
    items:
      - const: app
      - const: dbics
      - const: config
      - const: atu
      - const: vmap_lp
      - const: vmap_hp

  interrupts:
    maxItems: 1

  power-domains:
    maxItems: 1

  ti,syscon-pcie-id:
    $ref: /schemas/types.yaml#/definitions/phandle-array
    items:
      - items:
          - description: Phandle to the SYSCON entry
          - description: pcie_device_id register offset within SYSCON
    description: Phandle to the SYSCON entry required for getting PCIe device/vendor ID

  ti,syscon-pcie-mode:
    $ref: /schemas/types.yaml#/definitions/phandle-array
    items:
      - items:
          - description: Phandle to the SYSCON entry
          - description: pcie_ctrl register offset within SYSCON
    description: Phandle to the SYSCON entry required for configuring PCIe in RC or EP mode.

  msi-map: true

  dma-coherent: true

  num-viewport:
    $ref: /schemas/types.yaml#/definitions/uint32

  phys:
    description: per-lane PHYs
    minItems: 1
    maxItems: 2

  phy-names:
    minItems: 1
    maxItems: 2
    items:
      pattern: '^pcie-phy[0-1]$'

  memory-region:
    maxItems: 1
    description: |
      phandle to a restricted DMA pool to be used for all devices behind
      this controller. The regions should be defined according to
      reserved-memory/shared-dma-pool.yaml.
      Note that enforcement via the PVU will only be available to
      ti,am654-pcie-rc devices.

required:
  - compatible
  - reg
  - reg-names
  - max-link-speed
  - ti,syscon-pcie-id
  - ti,syscon-pcie-mode
  - ranges

if:
  properties:
    compatible:
      enum:
        - ti,am654-pcie-rc
then:
  required:
    - dma-coherent
    - power-domains
    - msi-map
    - num-viewport
else:
  properties:
    reg:
      maxItems: 4

    reg-names:
      maxItems: 4

unevaluatedProperties: false

examples:
  - |
    #include <dt-bindings/interrupt-controller/arm-gic.h>
    #include <dt-bindings/interrupt-controller/irq.h>
    #include <dt-bindings/phy/phy.h>
    #include <dt-bindings/soc/ti,sci_pm_domain.h>

    pcie0_rc: pcie@5500000 {
        compatible = "ti,am654-pcie-rc";
        reg =  <0x5500000 0x1000>,
               <0x5501000 0x1000>,
               <0x10000000 0x2000>,
               <0x5506000 0x1000>,
               <0x2900000 0x1000>,
               <0x2908000 0x1000>;
        reg-names = "app", "dbics", "config", "atu", "vmap_lp", "vmap_hp";
        power-domains = <&k3_pds 120 TI_SCI_PD_EXCLUSIVE>;
        #address-cells = <3>;
        #size-cells = <2>;
        ranges = <0x81000000 0 0          0x10020000 0 0x00010000>,
                 <0x82000000 0 0x10030000 0x10030000 0 0x07FD0000>;
        ti,syscon-pcie-id = <&scm_conf 0x0210>;
        ti,syscon-pcie-mode = <&scm_conf 0x4060>;
        bus-range = <0x0 0xff>;
        num-viewport = <16>;
        max-link-speed = <2>;
        dma-coherent;
        interrupts = <GIC_SPI 340 IRQ_TYPE_EDGE_RISING>;
        msi-map = <0x0 &gic_its 0x0 0x10000>;
        device_type = "pci";
        num-lanes = <1>;
        phys = <&serdes0 PHY_TYPE_PCIE 0>;
        phy-names = "pcie-phy0";
    };
```

## Documentation/devicetree/bindings/pci/ti,j721e-pci-ep.yaml
```yaml
# SPDX-License-Identifier: (GPL-2.0-only OR BSD-2-Clause)
# Copyright (C) 2020 Texas Instruments Incorporated - http://www.ti.com/
%YAML 1.2
---
$id: "http://devicetree.org/schemas/pci/ti,j721e-pci-ep.yaml#"
$schema: "http://devicetree.org/meta-schemas/core.yaml#"

title: TI J721E PCI EP (PCIe Wrapper)

maintainers:
  - Kishon Vijay Abraham I <kishon@ti.com>

allOf:
  - $ref: "cdns-pcie-ep.yaml#"

properties:
  compatible:
    oneOf:
      - const: ti,j721e-pcie-ep
      - description: PCIe EP controller in AM64
        items:
          - const: ti,am64-pcie-ep
          - const: ti,j721e-pcie-ep
      - description: PCIe EP controller in J7200
        items:
          - const: ti,j7200-pcie-ep
          - const: ti,j721e-pcie-ep

  reg:
    maxItems: 4

  reg-names:
    items:
      - const: intd_cfg
      - const: user_cfg
      - const: reg
      - const: mem

  ti,syscon-pcie-ctrl:
    $ref: /schemas/types.yaml#/definitions/phandle-array
    items:
      - items:
          - description: Phandle to the SYSCON entry
          - description: pcie_ctrl register offset within SYSCON
    description: Specifier for configuring PCIe mode and link speed.

  power-domains:
    maxItems: 1

  clocks:
    maxItems: 1
    description: clock-specifier to represent input to the PCIe

  clock-names:
    items:
      - const: fck

  dma-coherent:
    description: Indicates that the PCIe IP block can ensure the coherency

required:
  - compatible
  - reg
  - reg-names
  - ti,syscon-pcie-ctrl
  - max-link-speed
  - num-lanes
  - power-domains
  - clocks
  - clock-names
  - max-functions
  - phys
  - phy-names

unevaluatedProperties: false

examples:
  - |
    #include <dt-bindings/soc/ti,sci_pm_domain.h>

    bus {
        #address-cells = <2>;
        #size-cells = <2>;

        pcie0_ep: pcie-ep@d000000 {
           compatible = "ti,j721e-pcie-ep";
           reg = <0x00 0x02900000 0x00 0x1000>,
                 <0x00 0x02907000 0x00 0x400>,
                 <0x00 0x0d000000 0x00 0x00800000>,
                 <0x00 0x10000000 0x00 0x08000000>;
           reg-names = "intd_cfg", "user_cfg", "reg", "mem";
           ti,syscon-pcie-ctrl = <&pcie0_ctrl 0x4070>;
           max-link-speed = <3>;
           num-lanes = <2>;
           power-domains = <&k3_pds 239 TI_SCI_PD_EXCLUSIVE>;
           clocks = <&k3_clks 239 1>;
           clock-names = "fck";
           max-functions = /bits/ 8 <6>;
           dma-coherent;
           phys = <&serdes0_pcie_link>;
           phy-names = "pcie-phy";
       };
    };
```
