## Documentation/devicetree/bindings/pci/sophgo,sg2042-pcie-host.yaml
```yaml
# SPDX-License-Identifier: (GPL-2.0 OR BSD-2-Clause)
%YAML 1.2
---
$id: http://devicetree.org/schemas/pci/sophgo,sg2042-pcie-host.yaml#
$schema: http://devicetree.org/meta-schemas/core.yaml#

title: Sophgo SG2042 PCIe Host (Cadence PCIe Wrapper)

description:
  Sophgo SG2042 PCIe host controller is based on the Cadence PCIe core.

maintainers:
  - Chen Wang <unicorn_wang@outlook.com>

properties:
  compatible:
    const: sophgo,sg2042-pcie-host

  reg:
    maxItems: 2

  reg-names:
    items:
      - const: reg
      - const: cfg

  vendor-id:
    const: 0x1f1c

  device-id:
    const: 0x2042

  msi-parent: true

allOf:
  - $ref: cdns-pcie-host.yaml#

required:
  - compatible
  - reg
  - reg-names

unevaluatedProperties: false

examples:
  - |
    #include <dt-bindings/interrupt-controller/irq.h>

    pcie@62000000 {
      compatible = "sophgo,sg2042-pcie-host";
      device_type = "pci";
      reg = <0x62000000  0x00800000>,
            <0x48000000  0x00001000>;
      reg-names = "reg", "cfg";
      #address-cells = <3>;
      #size-cells = <2>;
      ranges = <0x81000000 0 0x00000000 0xde000000 0 0x00010000>,
               <0x82000000 0 0xd0400000 0xd0400000 0 0x0d000000>;
      bus-range = <0x00 0xff>;
      vendor-id = <0x1f1c>;
      device-id = <0x2042>;
      cdns,no-bar-match-nbits = <48>;
      msi-parent = <&msi>;
    };
```

## Documentation/devicetree/bindings/pci/sophgo,sg2044-pcie.yaml
```yaml
# SPDX-License-Identifier: (GPL-2.0-only OR BSD-2-Clause)
%YAML 1.2
---
$id: http://devicetree.org/schemas/pci/sophgo,sg2044-pcie.yaml#
$schema: http://devicetree.org/meta-schemas/core.yaml#

title: DesignWare based PCIe Root Complex controller on Sophgo SoCs

maintainers:
  - Inochi Amaoto <inochiama@gmail.com>

description:
  SG2044 SoC PCIe Root Complex controller is based on the Synopsys DesignWare
  PCIe IP and thus inherits all the common properties defined in
  snps,dw-pcie.yaml.

allOf:
  - $ref: /schemas/pci/pci-host-bridge.yaml#
  - $ref: /schemas/pci/snps,dw-pcie.yaml#

properties:
  compatible:
    const: sophgo,sg2044-pcie

  reg:
    items:
      - description: Data Bus Interface (DBI) registers
      - description: iATU registers
      - description: Config registers
      - description: Sophgo designed configuration registers

  reg-names:
    items:
      - const: dbi
      - const: atu
      - const: config
      - const: app

  clocks:
    items:
      - description: core clk

  clock-names:
    items:
      - const: core

  interrupt-controller:
    description: Interrupt controller node for handling legacy PCI interrupts.
    type: object

    properties:
      "#address-cells":
        const: 0

      "#interrupt-cells":
        const: 1

      interrupt-controller: true

      interrupts:
        items:
          - description: combined legacy interrupt

    required:
      - "#address-cells"
      - "#interrupt-cells"
      - interrupt-controller
      - interrupts

    additionalProperties: false

  msi-parent: true

  ranges:
    maxItems: 5

required:
  - compatible
  - reg
  - clocks

unevaluatedProperties: false

examples:
  - |
    #include <dt-bindings/interrupt-controller/irq.h>

    soc {
      #address-cells = <2>;
      #size-cells = <2>;

      pcie@6c00400000 {
        compatible = "sophgo,sg2044-pcie";
        reg = <0x6c 0x00400000 0x0 0x00001000>,
              <0x6c 0x00700000 0x0 0x00004000>,
              <0x40 0x00000000 0x0 0x00001000>,
              <0x6c 0x00780c00 0x0 0x00000400>;
        reg-names = "dbi", "atu", "config", "app";
        #address-cells = <3>;
        #size-cells = <2>;
        bus-range = <0x00 0xff>;
        clocks = <&clk 0>;
        clock-names = "core";
        device_type = "pci";
        linux,pci-domain = <0>;
        msi-parent = <&msi>;
        ranges = <0x01000000 0x0  0x00000000  0x40 0x10000000  0x0 0x00200000>,
                 <0x42000000 0x0  0x00000000  0x0  0x00000000  0x0 0x04000000>,
                 <0x02000000 0x0  0x04000000  0x0  0x04000000  0x0 0x04000000>,
                 <0x43000000 0x42 0x00000000  0x42 0x00000000  0x2 0x00000000>,
                 <0x03000000 0x41 0x00000000  0x41 0x00000000  0x1 0x00000000>;

        interrupt-controller {
          #address-cells = <0>;
          #interrupt-cells = <1>;
          interrupt-controller;
          interrupt-parent = <&intc>;
          interrupts = <64 IRQ_TYPE_LEVEL_HIGH>;
        };
      };
    };
...
```

## Documentation/devicetree/bindings/pci/spacemit,k1-pcie-host.yaml
```yaml
# SPDX-License-Identifier: (GPL-2.0-only OR BSD-2-Clause)
%YAML 1.2
---
$id: http://devicetree.org/schemas/pci/spacemit,k1-pcie-host.yaml#
$schema: http://devicetree.org/meta-schemas/core.yaml#

title: SpacemiT K1 PCI Express Host Controller

maintainers:
  - Alex Elder <elder@riscstar.com>

description: >
  The SpacemiT K1 SoC PCIe host controller is based on the Synopsys DesignWare
  PCIe IP.  The controller uses the DesignWare built-in MSI interrupt
  controller, and supports 256 MSIs.

allOf:
  - $ref: /schemas/pci/snps,dw-pcie.yaml#

properties:
  compatible:
    const: spacemit,k1-pcie

  reg:
    items:
      - description: DesignWare PCIe registers
      - description: ATU address space
      - description: PCIe configuration space
      - description: Link control registers

  reg-names:
    items:
      - const: dbi
      - const: atu
      - const: config
      - const: link

  clocks:
    items:
      - description: DWC PCIe Data Bus Interface (DBI) clock
      - description: DWC PCIe application AXI-bus master interface clock
      - description: DWC PCIe application AXI-bus slave interface clock

  clock-names:
    items:
      - const: dbi
      - const: mstr
      - const: slv

  resets:
    items:
      - description: DWC PCIe Data Bus Interface (DBI) reset
      - description: DWC PCIe application AXI-bus master interface reset
      - description: DWC PCIe application AXI-bus slave interface reset

  reset-names:
    items:
      - const: dbi
      - const: mstr
      - const: slv

  interrupts:
    items:
      - description: Interrupt used for MSIs

  interrupt-names:
    const: msi

  spacemit,apmu:
    $ref: /schemas/types.yaml#/definitions/phandle-array
    description:
      A phandle that refers to the APMU system controller, whose regmap is
      used in managing resets and link state, along with and offset of its
      reset control register.
    items:
      - items:
          - description: phandle to APMU system controller
          - description: register offset

patternProperties:
  '^pcie@':
    type: object
    $ref: /schemas/pci/pci-pci-bridge.yaml#

    properties:
      phys:
        maxItems: 1

      vpcie3v3-supply:
        description:
          A phandle for 3.3v regulator to use for PCIe

    required:
      - phys
      - vpcie3v3-supply

    unevaluatedProperties: false

required:
  - clocks
  - clock-names
  - resets
  - reset-names
  - interrupts
  - interrupt-names
  - spacemit,apmu

unevaluatedProperties: false

examples:
  - |
    #include <dt-bindings/clock/spacemit,k1-syscon.h>
    pcie@ca400000 {
        device_type = "pci";
        compatible = "spacemit,k1-pcie";
        reg = <0xca400000 0x00001000>,
              <0xca700000 0x0001ff24>,
              <0x9f000000 0x00002000>,
              <0xc0c20000 0x00001000>;
        reg-names = "dbi",
                    "atu",
                    "config",
                    "link";
        #address-cells = <3>;
        #size-cells = <2>;
        ranges = <0x01000000 0x0 0x00000000 0x9f002000 0x0 0x00100000>,
                 <0x02000000 0x0 0x90000000 0x90000000 0x0 0x0f000000>;
        interrupts = <142>;
        interrupt-names = "msi";
        clocks = <&syscon_apmu CLK_PCIE1_DBI>,
                 <&syscon_apmu CLK_PCIE1_MASTER>,
                 <&syscon_apmu CLK_PCIE1_SLAVE>;
        clock-names = "dbi",
                      "mstr",
                      "slv";
        resets = <&syscon_apmu RESET_PCIE1_DBI>,
                 <&syscon_apmu RESET_PCIE1_MASTER>,
                 <&syscon_apmu RESET_PCIE1_SLAVE>;
        reset-names = "dbi",
                      "mstr",
                      "slv";
        pinctrl-names = "default";
        pinctrl-0 = <&pcie1_3_cfg>;
        spacemit,apmu = <&syscon_apmu 0x3d4>;

        pcie@0 {
          device_type = "pci";
          compatible = "pciclass,0604";
          reg = <0x0 0x0 0x0 0x0 0x0>;
          bus-range = <0x01 0xff>;
          #address-cells = <3>;
          #size-cells = <2>;
          ranges;
          phys = <&pcie1_phy>;
          vpcie3v3-supply = <&pcie_vcc_3v3>;
        };
    };
```

## Documentation/devicetree/bindings/pci/spear13xx-pcie.txt
```
SPEAr13XX PCIe DT detail:
================================

SPEAr13XX uses the Synopsys DesignWare PCIe controller and ST MiPHY as PHY
controller.

Required properties:
- compatible	    : should be "st,spear1340-pcie", "snps,dw-pcie".
- phys		    : phandle to PHY node associated with PCIe controller
- phy-names	    : must be "pcie-phy"
- All other definitions as per generic PCI bindings

 Optional properties:
- st,pcie-is-gen1 indicates that forced gen1 initialization is needed.
```

## Documentation/devicetree/bindings/pci/st,spear1340-pcie.yaml
```yaml
# SPDX-License-Identifier: (GPL-2.0-only OR BSD-2-Clause)
%YAML 1.2
---
$id: http://devicetree.org/schemas/pci/st,spear1340-pcie.yaml#
$schema: http://devicetree.org/meta-schemas/core.yaml#

title: ST SPEAr1340 PCIe controller

maintainers:
  - Pratyush Anand <pratyush.anand@gmail.com>

description:
  SPEAr13XX uses the Synopsys DesignWare PCIe controller and ST MiPHY as PHY
  controller.

select:
  properties:
    compatible:
      contains:
        const: st,spear1340-pcie
  required:
    - compatible

properties:
  compatible:
    items:
      - const: st,spear1340-pcie
      - const: snps,dw-pcie

  phys:
    maxItems: 1

  st,pcie-is-gen1:
    type: boolean
    description: Indicates forced gen1 initialization is needed.

required:
  - compatible
  - phys
  - phy-names

allOf:
  - $ref: snps,dw-pcie.yaml#

unevaluatedProperties: false
```

## Documentation/devicetree/bindings/pci/st,stm32-pcie-common.yaml
```yaml
# SPDX-License-Identifier: (GPL-2.0 OR BSD-2-Clause)
%YAML 1.2
---
$id: http://devicetree.org/schemas/pci/st,stm32-pcie-common.yaml#
$schema: http://devicetree.org/meta-schemas/core.yaml#

title: STM32MP25 PCIe RC/EP controller

maintainers:
  - Christian Bruel <christian.bruel@foss.st.com>

description:
  STM32MP25 PCIe RC/EP common properties

properties:
  clocks:
    maxItems: 1
    description: PCIe system clock

  resets:
    maxItems: 1

  power-domains:
    maxItems: 1

  access-controllers:
    maxItems: 1

required:
  - clocks
  - resets

additionalProperties: true
```

## Documentation/devicetree/bindings/pci/st,stm32-pcie-ep.yaml
```yaml
# SPDX-License-Identifier: (GPL-2.0 OR BSD-2-Clause)
%YAML 1.2
---
$id: http://devicetree.org/schemas/pci/st,stm32-pcie-ep.yaml#
$schema: http://devicetree.org/meta-schemas/core.yaml#

title: STMicroelectronics STM32MP25 PCIe Endpoint

maintainers:
  - Christian Bruel <christian.bruel@foss.st.com>

description:
  PCIe endpoint controller based on the Synopsys DesignWare PCIe core.

allOf:
  - $ref: /schemas/pci/snps,dw-pcie-ep.yaml#
  - $ref: /schemas/pci/st,stm32-pcie-common.yaml#

properties:
  compatible:
    const: st,stm32mp25-pcie-ep

  reg:
    items:
      - description: Data Bus Interface (DBI) registers.
      - description: Data Bus Interface (DBI) shadow registers.
      - description: Internal Address Translation Unit (iATU) registers.
      - description: PCIe configuration registers.

  reg-names:
    items:
      - const: dbi
      - const: dbi2
      - const: atu
      - const: addr_space

  reset-gpios:
    description: GPIO controlled connection to PERST# signal
    maxItems: 1

  phys:
    maxItems: 1

required:
  - phys
  - reset-gpios

unevaluatedProperties: false

examples:
  - |
    #include <dt-bindings/clock/st,stm32mp25-rcc.h>
    #include <dt-bindings/gpio/gpio.h>
    #include <dt-bindings/phy/phy.h>
    #include <dt-bindings/reset/st,stm32mp25-rcc.h>

    pcie-ep@48400000 {
        compatible = "st,stm32mp25-pcie-ep";
        reg = <0x48400000 0x400000>,
              <0x48500000 0x100000>,
              <0x48700000 0x80000>,
              <0x10000000 0x10000000>;
        reg-names = "dbi", "dbi2", "atu", "addr_space";
        clocks = <&rcc CK_BUS_PCIE>;
        phys = <&combophy PHY_TYPE_PCIE>;
        resets = <&rcc PCIE_R>;
        pinctrl-names = "default", "init";
        pinctrl-0 = <&pcie_pins_a>;
        pinctrl-1 = <&pcie_init_pins_a>;
        reset-gpios = <&gpioj 8 GPIO_ACTIVE_LOW>;
        access-controllers = <&rifsc 68>;
        power-domains = <&CLUSTER_PD>;
    };
```
