## Documentation/devicetree/bindings/pci/fsl,pci.txt
```
* Bus Enumeration by Freescale PCI-X Agent

Typically any Freescale PCI-X bridge hardware strapped into Agent mode
is prevented from enumerating the bus. The PrPMC form-factor requires
all mezzanines to be PCI-X Agents, but one per system may still
enumerate the bus.

The property defined below will allow a PCI-X bridge to be used for bus
enumeration despite being strapped into Agent mode.

Required properties:
- fsl,pci-agent-force-enum : There is no value associated with this
  property. The property itself is treated as a boolean.

Example:

	/* PCI-X bridge known to be PrPMC Monarch */
	pci0: pci@ef008000 {
		fsl,pci-agent-force-enum;
		#interrupt-cells = <1>;
		#size-cells = <2>;
		#address-cells = <3>;
		compatible = "fsl,mpc8540-pcix", "fsl,mpc8540-pci";
		device_type = "pci";
		...
		...
	};
```

## Documentation/devicetree/bindings/pci/hisilicon,kirin-pcie.yaml
```yaml
# SPDX-License-Identifier: GPL-2.0
%YAML 1.2
---
$id: http://devicetree.org/schemas/pci/hisilicon,kirin-pcie.yaml#
$schema: http://devicetree.org/meta-schemas/core.yaml#

title: HiSilicon Kirin SoCs PCIe host DT description

maintainers:
  - Xiaowei Song <songxiaowei@hisilicon.com>
  - Binghui Wang <wangbinghui@hisilicon.com>

description: |
  Kirin PCIe host controller is based on the Synopsys DesignWare PCI core.
  It shares common functions with the PCIe DesignWare core driver and
  inherits common properties defined in
  Documentation/devicetree/bindings/pci/snps,dw-pcie.yaml.

allOf:
  - $ref: /schemas/pci/snps,dw-pcie.yaml#

properties:
  compatible:
    contains:
      enum:
        - hisilicon,kirin960-pcie
        - hisilicon,kirin970-pcie

  reg:
    description: |
      Should contain dbi, apb, config registers location and length.
      For hisilicon,kirin960-pcie, it should also contain phy.
    minItems: 3
    maxItems: 4

  reg-names:
    minItems: 3
    maxItems: 4

  clocks:
    maxItems: 5

  clock-names:
    items:
      - const: pcie_phy_ref
      - const: pcie_aux
      - const: pcie_apb_phy
      - const: pcie_apb_sys
      - const: pcie_aclk

  phys:
    maxItems: 1

  hisilicon,clken-gpios:
    description: |
      Clock input enablement GPIOs from PCI devices like Ethernet, M.2 and
      mini-PCIe slots.

required:
  - compatible
  - reg
  - reg-names

unevaluatedProperties: false

examples:
  - |
    #include <dt-bindings/interrupt-controller/arm-gic.h>
    #include <dt-bindings/clock/hi3660-clock.h>
    #include <dt-bindings/clock/hi3670-clock.h>

    soc {
      #address-cells = <2>;
      #size-cells = <2>;

      pcie@f4000000 {
        compatible = "hisilicon,kirin960-pcie";
        reg = <0x0 0xf4000000 0x0 0x1000>,
              <0x0 0xff3fe000 0x0 0x1000>,
              <0x0 0xf3f20000 0x0 0x40000>,
              <0x0 0xf5000000 0x0 0x2000>;
        reg-names = "dbi", "apb", "phy", "config";
        bus-range = <0x0  0xff>;
        #address-cells = <3>;
        #size-cells = <2>;
        device_type = "pci";
        ranges = <0x02000000 0x0 0x00000000
                  0x0 0xf6000000
                  0x0 0x02000000>;
        num-lanes = <1>;
        #interrupt-cells = <1>;
        interrupts = <0 283 4>;
        interrupt-names = "msi";
        interrupt-map-mask = <0xf800 0 0 7>;
        interrupt-map = <0x0 0 0 1 &gic GIC_SPI 282 IRQ_TYPE_LEVEL_HIGH>,
                        <0x0 0 0 2 &gic GIC_SPI 283 IRQ_TYPE_LEVEL_HIGH>,
                        <0x0 0 0 3 &gic GIC_SPI 284 IRQ_TYPE_LEVEL_HIGH>,
                        <0x0 0 0 4 &gic GIC_SPI 285 IRQ_TYPE_LEVEL_HIGH>;
        clocks = <&crg_ctrl HI3660_PCIEPHY_REF>,
                 <&crg_ctrl HI3660_CLK_GATE_PCIEAUX>,
                 <&crg_ctrl HI3660_PCLK_GATE_PCIE_PHY>,
                 <&crg_ctrl HI3660_PCLK_GATE_PCIE_SYS>,
                 <&crg_ctrl HI3660_ACLK_GATE_PCIE>;
        clock-names = "pcie_phy_ref", "pcie_aux", "pcie_apb_phy",
                      "pcie_apb_sys", "pcie_aclk";
      };

      pcie@f5000000 {
        compatible = "hisilicon,kirin970-pcie";
        reg = <0x0 0xf4000000 0x0 0x1000000>,
              <0x0 0xfc180000 0x0 0x1000>,
              <0x0 0xf5000000 0x0 0x2000>;
        reg-names = "dbi", "apb", "config";
        bus-range = <0x0  0xff>;
        #address-cells = <3>;
        #size-cells = <2>;
        device_type = "pci";
        phys = <&pcie_phy>;
        ranges = <0x02000000 0x0 0x00000000
                  0x0 0xf6000000
                  0x0 0x02000000>;
        num-lanes = <1>;
        #interrupt-cells = <1>;
        interrupts = <GIC_SPI 283 IRQ_TYPE_LEVEL_HIGH>;
        interrupt-names = "msi";
        interrupt-map-mask = <0 0 0 7>;
        interrupt-map = <0x0 0 0 1 &gic GIC_SPI 282 IRQ_TYPE_LEVEL_HIGH>,
                        <0x0 0 0 2 &gic GIC_SPI 283 IRQ_TYPE_LEVEL_HIGH>,
                        <0x0 0 0 3 &gic GIC_SPI 284 IRQ_TYPE_LEVEL_HIGH>,
                        <0x0 0 0 4 &gic GIC_SPI 285 IRQ_TYPE_LEVEL_HIGH>;
        reset-gpios = <&gpio7 0 0>;
        hisilicon,clken-gpios = <&gpio27 3 0>, <&gpio17 0 0>, <&gpio20 6 0>;
        pcie@0,0 { // Lane 0: PCIe switch: Bus 1, Device 0
          reg = <0 0 0 0 0>;
          compatible = "pciclass,0604";
          device_type = "pci";
          #address-cells = <3>;
          #size-cells = <2>;
          ranges;

          pcie@0,0 { // Lane 0: upstream
            reg = <0 0 0 0 0>;
            compatible = "pciclass,0604";
            device_type = "pci";
            #address-cells = <3>;
            #size-cells = <2>;
            ranges;

            pcie@1,0 { // Lane 4: M.2
              reg = <0x0800 0 0 0 0>;
              compatible = "pciclass,0604";
              device_type = "pci";
              reset-gpios = <&gpio3 1 0>;
              #address-cells = <3>;
              #size-cells = <2>;
              ranges;
            };

            pcie@5,0 { // Lane 5: Mini PCIe
              reg = <0x2800 0 0 0 0>;
              compatible = "pciclass,0604";
              device_type = "pci";
              reset-gpios = <&gpio27 4 0 >;
              #address-cells = <3>;
              #size-cells = <2>;
              ranges;
            };

            pcie@7,0 { // Lane 6: Ethernet
              reg = <0x03800 0 0 0 0>;
              compatible = "pciclass,0604";
              device_type = "pci";
              reset-gpios = <&gpio25 2 0 >;
              #address-cells = <3>;
              #size-cells = <2>;
              ranges;
            };
          };
        };
      };
    };
```

## Documentation/devicetree/bindings/pci/hisilicon-histb-pcie.txt
```
HiSilicon STB PCIe host bridge DT description

The HiSilicon STB PCIe host controller is based on the DesignWare PCIe core.
It shares common functions with the DesignWare PCIe core driver and inherits
common properties defined in
Documentation/devicetree/bindings/pci/designware-pcie.txt.

Additional properties are described here:

Required properties
- compatible: Should be one of the following strings:
		"hisilicon,hi3798cv200-pcie"
- reg: Should contain sysctl, rc_dbi, config registers location and length.
- reg-names: Must include the following entries:
  "control": control registers of PCIe controller;
  "rc-dbi": configuration space of PCIe controller;
  "config": configuration transaction space of PCIe controller.
- bus-range: PCI bus numbers covered.
- interrupts: MSI interrupt.
- interrupt-names: Must include "msi" entries.
- clocks: List of phandle and clock specifier pairs as listed in clock-names
  property.
- clock-name: Must include the following entries:
  "aux": auxiliary gate clock;
  "pipe": pipe gate clock;
  "sys": sys gate clock;
  "bus": bus gate clock.
- resets: List of phandle and reset specifier pairs as listed in reset-names
  property.
- reset-names: Must include the following entries:
  "soft": soft reset;
  "sys": sys reset;
  "bus": bus reset.

Optional properties:
- reset-gpios: The gpio to generate PCIe PERST# assert and deassert signal.
- vpcie-supply: The regulator in charge of PCIe port power.
- phys: List of phandle and phy mode specifier, should be 0.
- phy-names: Must be "phy".

Example:
	pcie@f9860000 {
		compatible = "hisilicon,hi3798cv200-pcie";
		reg = <0xf9860000 0x1000>,
		      <0xf0000000 0x2000>,
		      <0xf2000000 0x01000000>;
		reg-names = "control", "rc-dbi", "config";
		#address-cells = <3>;
		#size-cells = <2>;
		device_type = "pci";
		bus-range = <0 15>;
		num-lanes = <1>;
		ranges=<0x81000000 0 0 0xf4000000 0 0x00010000
			0x82000000 0 0xf3000000 0xf3000000 0 0x01000000>;
		interrupts = <GIC_SPI 128 IRQ_TYPE_LEVEL_HIGH>;
		interrupt-names = "msi";
		#interrupt-cells = <1>;
		interrupt-map-mask = <0 0 0 0>;
		interrupt-map = <0 0 0 0 &gic GIC_SPI 131 IRQ_TYPE_LEVEL_HIGH>;
		clocks = <&crg PCIE_AUX_CLK>,
			 <&crg PCIE_PIPE_CLK>,
			 <&crg PCIE_SYS_CLK>,
			 <&crg PCIE_BUS_CLK>;
		clock-names = "aux", "pipe", "sys", "bus";
		resets = <&crg 0x18c 6>, <&crg 0x18c 5>, <&crg 0x18c 4>;
		reset-names = "soft", "sys", "bus";
		phys = <&combphy1 PHY_TYPE_PCIE>;
		phy-names = "phy";
	};
```

## Documentation/devicetree/bindings/pci/hisilicon-pcie.txt
```
HiSilicon Hip05 and Hip06 PCIe host bridge DT description

HiSilicon PCIe host controller is based on the Synopsys DesignWare PCI core.
It shares common functions with the PCIe DesignWare core driver and inherits
common properties defined in
Documentation/devicetree/bindings/pci/designware-pcie.txt.

Additional properties are described here:

Required properties
- compatible: Should contain "hisilicon,hip05-pcie" or "hisilicon,hip06-pcie".
- reg: Should contain rc_dbi, config registers location and length.
- reg-names: Must include the following entries:
  "rc_dbi": controller configuration registers;
  "config": PCIe configuration space registers.
- msi-parent: Should be its_pcie which is an ITS receiving MSI interrupts.
- port-id: Should be 0, 1, 2 or 3.

Optional properties:
- status: Either "ok" or "disabled".
- dma-coherent: Present if DMA operations are coherent.

Hip05 Example (note that Hip06 is the same except compatible):
	pcie@b0080000 {
		compatible = "hisilicon,hip05-pcie", "snps,dw-pcie";
		reg = <0 0xb0080000 0 0x10000>, <0x220 0x00000000 0 0x2000>;
		reg-names = "rc_dbi", "config";
		bus-range = <0  15>;
		msi-parent = <&its_pcie>;
		#address-cells = <3>;
		#size-cells = <2>;
		device_type = "pci";
		dma-coherent;
		ranges = <0x82000000 0 0x00000000 0x220 0x00000000 0 0x10000000>;
		num-lanes = <8>;
		port-id = <1>;
		#interrupt-cells = <1>;
		interrupt-map-mask = <0xf800 0 0 7>;
		interrupt-map = <0x0 0 0 1 &mbigen_pcie 1 10
				 0x0 0 0 2 &mbigen_pcie 2 11
				 0x0 0 0 3 &mbigen_pcie 3 12
				 0x0 0 0 4 &mbigen_pcie 4 13>;
	};
```

## Documentation/devicetree/bindings/pci/host-generic-pci.txt
```
* Generic PCI host controller

Firmware-initialised PCI host controllers and PCI emulations, such as the
virtio-pci implementations found in kvmtool and other para-virtualised
systems, do not require driver support for complexities such as regulator
and clock management. In fact, the controller may not even require the
configuration of a control interface by the operating system, instead
presenting a set of fixed windows describing a subset of IO, Memory and
Configuration Spaces.

Such a controller can be described purely in terms of the standardized device
tree bindings communicated in pci.txt:


Properties of the host controller node:

- compatible     : Must be "pci-host-cam-generic" or "pci-host-ecam-generic"
                   depending on the layout of configuration space (CAM vs
                   ECAM respectively).

- device_type    : Must be "pci".

- ranges         : As described in IEEE Std 1275-1994, but must provide
                   at least a definition of non-prefetchable memory. One
                   or both of prefetchable Memory and IO Space may also
                   be provided.

- bus-range      : Optional property (also described in IEEE Std 1275-1994)
                   to indicate the range of bus numbers for this controller.
                   If absent, defaults to <0 255> (i.e. all buses).

- #address-cells : Must be 3.

- #size-cells    : Must be 2.

- reg            : The Configuration Space base address and size, as accessed
                   from the parent bus.  The base address corresponds to
                   the first bus in the "bus-range" property.  If no
                   "bus-range" is specified, this will be bus 0 (the default).

Properties of the /chosen node:

- linux,pci-probe-only
                 : Optional property which takes a single-cell argument.
                   If '0', then Linux will assign devices in its usual manner,
                   otherwise it will not try to assign devices and instead use
                   them as they are configured already.

Configuration Space is assumed to be memory-mapped (as opposed to being
accessed via an ioport) and laid out with a direct correspondence to the
geography of a PCI bus address by concatenating the various components to
form an offset.

For CAM, this 24-bit offset is:

        cfg_offset(bus, device, function, register) =
                   bus << 16 | device << 11 | function << 8 | register

While ECAM extends this by 4 bits to accommodate 4k of function space:

        cfg_offset(bus, device, function, register) =
                   bus << 20 | device << 15 | function << 12 | register

Interrupt mapping is exactly as described in `Open Firmware Recommended
Practice: Interrupt Mapping' and requires the following properties:

- #interrupt-cells   : Must be 1

- interrupt-map      : <see aforementioned specification>

- interrupt-map-mask : <see aforementioned specification>


Example:

pci {
    compatible = "pci-host-cam-generic"
    device_type = "pci";
    #address-cells = <3>;
    #size-cells = <2>;
    bus-range = <0x0 0x1>;

    // CPU_PHYSICAL(2)  SIZE(2)
    reg = <0x0 0x40000000  0x0 0x1000000>;

    // BUS_ADDRESS(3)  CPU_PHYSICAL(2)  SIZE(2)
    ranges = <0x01000000 0x0 0x01000000  0x0 0x01000000  0x0 0x00010000>,
             <0x02000000 0x0 0x41000000  0x0 0x41000000  0x0 0x3f000000>;


    #interrupt-cells = <0x1>;

    // PCI_DEVICE(3)  INT#(1)  CONTROLLER(PHANDLE)  CONTROLLER_DATA(3)
    interrupt-map = <  0x0 0x0 0x0  0x1  &gic  0x0 0x4 0x1
                     0x800 0x0 0x0  0x1  &gic  0x0 0x5 0x1
                    0x1000 0x0 0x0  0x1  &gic  0x0 0x6 0x1
                    0x1800 0x0 0x0  0x1  &gic  0x0 0x7 0x1>;

    // PCI_DEVICE(3)  INT#(1)
    interrupt-map-mask = <0xf800 0x0 0x0  0x7>;
}
```
