## Documentation/devicetree/bindings/pci/fsl,imx6q-pcie-common.yaml
```yaml
# SPDX-License-Identifier: (GPL-2.0-only OR BSD-2-Clause)
%YAML 1.2
---
$id: http://devicetree.org/schemas/pci/fsl,imx6q-pcie-common.yaml#
$schema: http://devicetree.org/meta-schemas/core.yaml#

title: Freescale i.MX6 PCIe RC/EP controller

maintainers:
  - Lucas Stach <l.stach@pengutronix.de>
  - Richard Zhu <hongxing.zhu@nxp.com>

description:
  Generic Freescale i.MX PCIe Root Port and Endpoint controller
  properties.

properties:
  clocks:
    minItems: 3
    maxItems: 4

  clock-names:
    minItems: 3
    maxItems: 4

  num-lanes:
    const: 1

  fsl,imx7d-pcie-phy:
    $ref: /schemas/types.yaml#/definitions/phandle
    description: A phandle to an fsl,imx7d-pcie-phy node. Additional
      required properties for imx7d-pcie, imx7d-pcie-ep, imx8mq-pcie,
      and imx8mq-pcie-ep.

  power-domains:
    minItems: 1
    items:
      - description: The phandle pointing to the DISPLAY domain for
          imx6sx-pcie, imx6sx-pcie-ep, to PCIE_PHY power domain for
          imx7d-pcie, imx7d-pcie-ep, imx8mq-pcie and imx8mq-pcie-ep.
      - description: The phandle pointing to the PCIE_PHY power domains
          for imx6sx-pcie and imx6sx-pcie-ep.

  power-domain-names:
    minItems: 1
    items:
      - const: pcie
      - const: pcie_phy

  resets:
    minItems: 2
    maxItems: 3
    description: Phandles to PCIe-related reset lines exposed by SRC
      IP block. Additional required by imx7d-pcie, imx7d-pcie-ep,
      imx8mq-pcie, and imx8mq-pcie-ep.

  reset-names:
    minItems: 2
    maxItems: 3

  fsl,tx-deemph-gen1:
    description: Gen1 De-emphasis value (optional required).
    $ref: /schemas/types.yaml#/definitions/uint32
    default: 0

  fsl,tx-deemph-gen2-3p5db:
    description: Gen2 (3.5db) De-emphasis value (optional required).
    $ref: /schemas/types.yaml#/definitions/uint32
    default: 0

  fsl,tx-deemph-gen2-6db:
    description: Gen2 (6db) De-emphasis value (optional required).
    $ref: /schemas/types.yaml#/definitions/uint32
    default: 20

  fsl,tx-swing-full:
    description: Gen2 TX SWING FULL value (optional required).
    $ref: /schemas/types.yaml#/definitions/uint32
    default: 127

  fsl,tx-swing-low:
    description: TX launch amplitude swing_low value (optional required).
    $ref: /schemas/types.yaml#/definitions/uint32
    default: 127

  fsl,max-link-speed:
    description: Specify PCI Gen for link capability (optional required).
      Note that the IMX6 LVDS clock outputs do not meet gen2 jitter
      requirements and thus for gen2 capability a gen2 compliant clock
      generator should be used and configured.
    $ref: /schemas/types.yaml#/definitions/uint32
    enum: [1, 2, 3, 4]
    default: 1

  phys:
    maxItems: 1

  phy-names:
    const: pcie-phy

  vpcie-supply:
    description: Should specify the regulator in charge of PCIe port power.
      The regulator will be enabled when initializing the PCIe host and
      disabled either as part of the init process or when shutting down
      the host (optional required).

  vph-supply:
    description: Should specify the regulator in charge of VPH one of
      the three PCIe PHY powers. This regulator can be supplied by both
      1.8v and 3.3v voltage supplies (optional required).

required:
  - clocks
  - clock-names
  - num-lanes

allOf:
  - if:
      properties:
        compatible:
          contains:
            enum:
              - fsl,imx6sx-pcie
              - fsl,imx6sx-pcie-ep
    then:
      properties:
        clock-names:
          items:
            - {}
            - {}
            - const: pcie_phy
            - const: pcie_inbound_axi
        power-domains:
          minItems: 2
        power-domain-names:
          minItems: 2

  - if:
      properties:
        compatible:
          contains:
            enum:
              - fsl,imx8mq-pcie
              - fsl,imx8mq-pcie-ep
    then:
      properties:
        clock-names:
          items:
            - {}
            - {}
            - const: pcie_phy
            - const: pcie_aux
  - if:
      properties:
        compatible:
          not:
            contains:
              enum:
                - fsl,imx6sx-pcie
                - fsl,imx8mq-pcie
                - fsl,imx6sx-pcie-ep
                - fsl,imx8mq-pcie-ep
    then:
      properties:
        clocks:
          maxItems: 3
        clock-names:
          maxItems: 3

  - if:
      properties:
        compatible:
          contains:
            enum:
              - fsl,imx6q-pcie
              - fsl,imx6qp-pcie
              - fsl,imx7d-pcie
              - fsl,imx6q-pcie-ep
              - fsl,imx6qp-pcie-ep
              - fsl,imx7d-pcie-ep
    then:
      properties:
        clock-names:
          maxItems: 3
          contains:
            const: pcie_phy

  - if:
      properties:
        compatible:
          contains:
            enum:
              - fsl,imx8mm-pcie
              - fsl,imx8mp-pcie
              - fsl,imx8mm-pcie-ep
              - fsl,imx8mp-pcie-ep
    then:
      properties:
        clock-names:
          maxItems: 3
          contains:
            const: pcie_aux
  - if:
      properties:
        compatible:
          contains:
            enum:
              - fsl,imx6q-pcie
              - fsl,imx6qp-pcie
              - fsl,imx6q-pcie-ep
              - fsl,imx6qp-pcie-ep
    then:
      properties:
        power-domains: false
        power-domain-names: false

  - if:
      not:
        properties:
          compatible:
            contains:
              enum:
                - fsl,imx6sx-pcie
                - fsl,imx6q-pcie
                - fsl,imx6qp-pcie
                - fsl,imx6sx-pcie-ep
                - fsl,imx6q-pcie-ep
                - fsl,imx6qp-pcie-ep
    then:
      properties:
        power-domains:
          maxItems: 1
        power-domain-names: false

  - if:
      properties:
        compatible:
          contains:
            enum:
              - fsl,imx6q-pcie
              - fsl,imx6sx-pcie
              - fsl,imx6qp-pcie
              - fsl,imx7d-pcie
              - fsl,imx8mq-pcie
              - fsl,imx6q-pcie-ep
              - fsl,imx6sx-pcie-ep
              - fsl,imx6qp-pcie-ep
              - fsl,imx7d-pcie-ep
              - fsl,imx8mq-pcie-ep
    then:
      properties:
        resets:
          minItems: 3
        reset-names:
          items:
            - const: pciephy
            - const: apps
            - const: turnoff
    else:
      properties:
        resets:
          maxItems: 2
        reset-names:
          items:
            - const: apps
            - const: turnoff

additionalProperties: true

...
```

## Documentation/devicetree/bindings/pci/fsl,imx6q-pcie-ep.yaml
```yaml
# SPDX-License-Identifier: (GPL-2.0-only OR BSD-2-Clause)
%YAML 1.2
---
$id: http://devicetree.org/schemas/pci/fsl,imx6q-pcie-ep.yaml#
$schema: http://devicetree.org/meta-schemas/core.yaml#

title: Freescale i.MX6 PCIe Endpoint controller

maintainers:
  - Lucas Stach <l.stach@pengutronix.de>
  - Richard Zhu <hongxing.zhu@nxp.com>

description: |+
  This PCIe controller is based on the Synopsys DesignWare PCIe IP and
  thus inherits all the common properties defined in snps,dw-pcie-ep.yaml.
  The controller instances are dual mode where in they can work either in
  Root Port mode or Endpoint mode but one at a time.

properties:
  compatible:
    enum:
      - fsl,imx8mm-pcie-ep
      - fsl,imx8mq-pcie-ep
      - fsl,imx8mp-pcie-ep
      - fsl,imx8q-pcie-ep
      - fsl,imx95-pcie-ep

  clocks:
    minItems: 3
    items:
      - description: PCIe bridge clock.
      - description: PCIe bus clock.
      - description: PCIe PHY clock.
      - description: Additional required clock entry for imx6sx-pcie,
           imx6sx-pcie-ep, imx8mq-pcie, imx8mq-pcie-ep.

  clock-names:
    minItems: 3
    maxItems: 4

  interrupts:
    items:
      - description: builtin eDMA interrupter.

  interrupt-names:
    items:
      - const: dma

required:
  - compatible
  - reg
  - reg-names
  - interrupts
  - interrupt-names

allOf:
  - $ref: /schemas/pci/snps,dw-pcie-ep.yaml#
  - $ref: /schemas/pci/fsl,imx6q-pcie-common.yaml#
  - if:
      properties:
        compatible:
          enum:
            - fsl,imx8mm-pcie-ep
            - fsl,imx8mq-pcie-ep
            - fsl,imx8mp-pcie-ep
    then:
      properties:
        reg:
          minItems: 4
          maxItems: 4
        reg-names:
          items:
            - const: dbi
            - const: addr_space
            - const: dbi2
            - const: atu

  - if:
      properties:
        compatible:
          enum:
            - fsl,imx8q-pcie-ep
    then:
      properties:
        reg:
          maxItems: 2
        reg-names:
          items:
            - const: dbi
            - const: addr_space

  - if:
      properties:
        compatible:
          enum:
            - fsl,imx95-pcie-ep
    then:
      properties:
        reg:
          minItems: 6
          maxItems: 6
        reg-names:
          items:
            - const: dbi
            - const: atu
            - const: dbi2
            - const: app
            - const: dma
            - const: addr_space

  - if:
      properties:
        compatible:
          enum:
            - fsl,imx8mq-pcie-ep
            - fsl,imx95-pcie-ep
    then:
      properties:
        clocks:
          minItems: 4
          maxItems: 4
        clock-names:
          items:
            - const: pcie
            - const: pcie_bus
            - const: pcie_phy
            - const: pcie_aux

  - if:
      properties:
        compatible:
          enum:
            - fsl,imx8mm-pcie-ep
            - fsl,imx8mp-pcie-ep
    then:
      properties:
        clocks:
          maxItems: 3
        clock-names:
          items:
            - const: pcie
            - const: pcie_bus
            - const: pcie_aux

  - if:
      properties:
        compatible:
          enum:
            - fsl,imxq-pcie-ep
    then:
      properties:
        clocks:
          maxItems: 3
        clock-names:
          items:
            - const: dbi
            - const: mstr
            - const: slv

unevaluatedProperties: false

examples:
  - |
    #include <dt-bindings/clock/imx8mp-clock.h>
    #include <dt-bindings/power/imx8mp-power.h>
    #include <dt-bindings/reset/imx8mp-reset.h>
    #include <dt-bindings/interrupt-controller/arm-gic.h>

    pcie_ep: pcie-ep@33800000 {
      compatible = "fsl,imx8mp-pcie-ep";
      reg = <0x33800000 0x100000>,
            <0x18000000 0x8000000>,
            <0x33900000 0x100000>,
            <0x33b00000 0x100000>;
      reg-names = "dbi", "addr_space", "dbi2", "atu";
      clocks = <&clk IMX8MP_CLK_HSIO_ROOT>,
               <&clk IMX8MP_CLK_HSIO_AXI>,
               <&clk IMX8MP_CLK_PCIE_ROOT>;
      clock-names = "pcie", "pcie_bus", "pcie_aux";
      assigned-clocks = <&clk IMX8MP_CLK_PCIE_AUX>;
      assigned-clock-rates = <10000000>;
      assigned-clock-parents = <&clk IMX8MP_SYS_PLL2_50M>;
      num-lanes = <1>;
      interrupts = <GIC_SPI 127 IRQ_TYPE_LEVEL_HIGH>; /* eDMA */
      interrupt-names = "dma";
      fsl,max-link-speed = <3>;
      power-domains = <&hsio_blk_ctrl IMX8MP_HSIOBLK_PD_PCIE>;
      resets = <&src IMX8MP_RESET_PCIE_CTRL_APPS_EN>,
               <&src IMX8MP_RESET_PCIE_CTRL_APPS_TURNOFF>;
      reset-names = "apps", "turnoff";
      phys = <&pcie_phy>;
      phy-names = "pcie-phy";
      num-ib-windows = <4>;
      num-ob-windows = <4>;
    };
```

## Documentation/devicetree/bindings/pci/fsl,imx6q-pcie.txt
```
* Freescale i.MX6 PCIe interface

This PCIe host controller is based on the Synopsys DesignWare PCIe IP
and thus inherits all the common properties defined in snps,dw-pcie.yaml.

Required properties:
- compatible:
	- "fsl,imx6q-pcie"
	- "fsl,imx6sx-pcie",
	- "fsl,imx6qp-pcie"
	- "fsl,imx7d-pcie"
	- "fsl,imx8mq-pcie"
- reg: base address and length of the PCIe controller
- interrupts: A list of interrupt outputs of the controller. Must contain an
  entry for each entry in the interrupt-names property.
- interrupt-names: Must include the following entries:
	- "msi": The interrupt that is asserted when an MSI is received
- clock-names: Must include the following additional entries:
	- "pcie_phy"

Optional properties:
- fsl,tx-deemph-gen1: Gen1 De-emphasis value. Default: 0
- fsl,tx-deemph-gen2-3p5db: Gen2 (3.5db) De-emphasis value. Default: 0
- fsl,tx-deemph-gen2-6db: Gen2 (6db) De-emphasis value. Default: 20
- fsl,tx-swing-full: Gen2 TX SWING FULL value. Default: 127
- fsl,tx-swing-low: TX launch amplitude swing_low value. Default: 127
- fsl,max-link-speed: Specify PCI gen for link capability. Must be '2' for
  gen2, otherwise will default to gen1. Note that the IMX6 LVDS clock outputs
  do not meet gen2 jitter requirements and thus for gen2 capability a gen2
  compliant clock generator should be used and configured.
- reset-gpio: Should specify the GPIO for controlling the PCI bus device reset
  signal. It's not polarity aware and defaults to active-low reset sequence
  (L=reset state, H=operation state).
- reset-gpio-active-high: If present then the reset sequence using the GPIO
  specified in the "reset-gpio" property is reversed (H=reset state,
  L=operation state).
- vpcie-supply: Should specify the regulator in charge of PCIe port power.
  The regulator will be enabled when initializing the PCIe host and
  disabled either as part of the init process or when shutting down the
  host.
- vph-supply: Should specify the regulator in charge of VPH one of the three
  PCIe PHY powers. This regulator can be supplied by both 1.8v and 3.3v voltage
  supplies.

Additional required properties for imx6sx-pcie:
- clock names: Must include the following additional entries:
	- "pcie_inbound_axi"
- power-domains: Must be set to phandles pointing to the DISPLAY and
  PCIE_PHY power domains
- power-domain-names: Must be "pcie", "pcie_phy"

Additional required properties for imx7d-pcie and imx8mq-pcie:
- power-domains: Must be set to a phandle pointing to PCIE_PHY power domain
- resets: Must contain phandles to PCIe-related reset lines exposed by SRC
  IP block
- reset-names: Must contain the following entries:
	       - "pciephy"
	       - "apps"
	       - "turnoff"
- fsl,imx7d-pcie-phy: A phandle to an fsl,imx7d-pcie-phy node.

Additional required properties for imx8mq-pcie:
- clock-names: Must include the following additional entries:
	- "pcie_aux"

Example:

	pcie@01000000 {
		compatible = "fsl,imx6q-pcie", "snps,dw-pcie";
		reg = <0x01ffc000 0x04000>,
		      <0x01f00000 0x80000>;
		reg-names = "dbi", "config";
		#address-cells = <3>;
		#size-cells = <2>;
		device_type = "pci";
		ranges = <0x00000800 0 0x01f00000 0x01f00000 0 0x00080000
			  0x81000000 0 0          0x01f80000 0 0x00010000
			  0x82000000 0 0x01000000 0x01000000 0 0x00f00000>;
		num-lanes = <1>;
		interrupts = <GIC_SPI 120 IRQ_TYPE_LEVEL_HIGH>;
		interrupt-names = "msi";
		#interrupt-cells = <1>;
		interrupt-map-mask = <0 0 0 0x7>;
		interrupt-map = <0 0 0 1 &intc GIC_SPI 123 IRQ_TYPE_LEVEL_HIGH>,
		                <0 0 0 2 &intc GIC_SPI 122 IRQ_TYPE_LEVEL_HIGH>,
		                <0 0 0 3 &intc GIC_SPI 121 IRQ_TYPE_LEVEL_HIGH>,
		                <0 0 0 4 &intc GIC_SPI 120 IRQ_TYPE_LEVEL_HIGH>;
		clocks = <&clks 144>, <&clks 206>, <&clks 189>;
		clock-names = "pcie", "pcie_bus", "pcie_phy";
	};

* Freescale i.MX7d PCIe PHY

This is the PHY associated with the IMX7d PCIe controller.  It's used by the
PCI-e controller via the fsl,imx7d-pcie-phy phandle.

Required properties:
- compatible:
	- "fsl,imx7d-pcie-phy"
- reg: base address and length of the PCIe PHY controller
```
