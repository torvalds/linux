## Documentation/devicetree/bindings/pci/fsl,imx6q-pcie.yaml
```yaml
# SPDX-License-Identifier: (GPL-2.0-only OR BSD-2-Clause)
%YAML 1.2
---
$id: http://devicetree.org/schemas/pci/fsl,imx6q-pcie.yaml#
$schema: http://devicetree.org/meta-schemas/core.yaml#

title: Freescale i.MX6 PCIe host controller

maintainers:
  - Lucas Stach <l.stach@pengutronix.de>
  - Richard Zhu <hongxing.zhu@nxp.com>

description: |+
  This PCIe host controller is based on the Synopsys DesignWare PCIe IP
  and thus inherits all the common properties defined in snps,dw-pcie.yaml.
  The controller instances are dual mode where in they can work either in
  Root Port mode or Endpoint mode but one at a time.

  See fsl,imx6q-pcie-ep.yaml for details on the Endpoint mode device tree
  bindings.

properties:
  compatible:
    enum:
      - fsl,imx6q-pcie
      - fsl,imx6sx-pcie
      - fsl,imx6qp-pcie
      - fsl,imx7d-pcie
      - fsl,imx8mq-pcie
      - fsl,imx8mm-pcie
      - fsl,imx8mp-pcie

  reg:
    items:
      - description: Data Bus Interface (DBI) registers.
      - description: PCIe configuration space region.

  reg-names:
    items:
      - const: dbi
      - const: config

  clocks:
    minItems: 3
    items:
      - description: PCIe bridge clock.
      - description: PCIe bus clock.
      - description: PCIe PHY clock.
      - description: Additional required clock entry for imx6sx-pcie,
           imx6sx-pcie-ep, imx8mq-pcie, imx8mq-pcie-ep.

  clock-names:
    minItems: 3
    maxItems: 4

  interrupts:
    items:
      - description: builtin MSI controller.

  interrupt-names:
    items:
      - const: msi

  reset-gpio:
    description: Should specify the GPIO for controlling the PCI bus device
      reset signal. It's not polarity aware and defaults to active-low reset
      sequence (L=reset state, H=operation state) (optional required).

  reset-gpio-active-high:
    description: If present then the reset sequence using the GPIO
      specified in the "reset-gpio" property is reversed (H=reset state,
      L=operation state) (optional required).
    type: boolean

required:
  - compatible
  - reg
  - reg-names
  - "#address-cells"
  - "#size-cells"
  - device_type
  - bus-range
  - ranges
  - interrupts
  - interrupt-names
  - "#interrupt-cells"
  - interrupt-map-mask
  - interrupt-map

allOf:
  - $ref: /schemas/pci/snps,dw-pcie.yaml#
  - $ref: /schemas/pci/fsl,imx6q-pcie-common.yaml#
  - if:
      properties:
        compatible:
          enum:
            - fsl,imx6sx-pcie
    then:
      properties:
        clocks:
          minItems: 4
        clock-names:
          items:
            - const: pcie
            - const: pcie_bus
            - const: pcie_phy
            - const: pcie_inbound_axi

  - if:
      properties:
        compatible:
          enum:
            - fsl,imx8mq-pcie
    then:
      properties:
        clocks:
          minItems: 4
        clock-names:
          items:
            - const: pcie
            - const: pcie_bus
            - const: pcie_phy
            - const: pcie_aux

  - if:
      properties:
        compatible:
          enum:
            - fsl,imx6q-pcie
            - fsl,imx6qp-pcie
            - fsl,imx7d-pcie
    then:
      properties:
        clocks:
          maxItems: 3
        clock-names:
          items:
            - const: pcie
            - const: pcie_bus
            - const: pcie_phy

  - if:
      properties:
        compatible:
          enum:
            - fsl,imx8mm-pcie
            - fsl,imx8mp-pcie
    then:
      properties:
        clocks:
          maxItems: 3
        clock-names:
          items:
            - const: pcie
            - const: pcie_bus
            - const: pcie_aux

unevaluatedProperties: false

examples:
  - |
    #include <dt-bindings/clock/imx6qdl-clock.h>
    #include <dt-bindings/interrupt-controller/arm-gic.h>

    pcie: pcie@1ffc000 {
        compatible = "fsl,imx6q-pcie";
        reg = <0x01ffc000 0x04000>,
              <0x01f00000 0x80000>;
        reg-names = "dbi", "config";
        #address-cells = <3>;
        #size-cells = <2>;
        device_type = "pci";
        bus-range = <0x00 0xff>;
        ranges = <0x81000000 0 0          0x01f80000 0 0x00010000>,
                 <0x82000000 0 0x01000000 0x01000000 0 0x00f00000>;
        num-lanes = <1>;
        interrupts = <GIC_SPI 120 IRQ_TYPE_LEVEL_HIGH>;
        interrupt-names = "msi";
        #interrupt-cells = <1>;
        interrupt-map-mask = <0 0 0 0x7>;
        interrupt-map = <0 0 0 1 &gpc GIC_SPI 123 IRQ_TYPE_LEVEL_HIGH>,
                        <0 0 0 2 &gpc GIC_SPI 122 IRQ_TYPE_LEVEL_HIGH>,
                        <0 0 0 3 &gpc GIC_SPI 121 IRQ_TYPE_LEVEL_HIGH>,
                        <0 0 0 4 &gpc GIC_SPI 120 IRQ_TYPE_LEVEL_HIGH>;
        clocks = <&clks IMX6QDL_CLK_PCIE_AXI>,
                <&clks IMX6QDL_CLK_LVDS1_GATE>,
                <&clks IMX6QDL_CLK_PCIE_REF_125M>;
        clock-names = "pcie", "pcie_bus", "pcie_phy";
    };
...
```

## Documentation/devicetree/bindings/pci/fsl,layerscape-pcie-ep.yaml
```yaml
# SPDX-License-Identifier: (GPL-2.0-only OR BSD-2-Clause)
%YAML 1.2
---
$id: http://devicetree.org/schemas/pci/fsl,layerscape-pcie-ep.yaml#
$schema: http://devicetree.org/meta-schemas/core.yaml#

title: Freescale Layerscape PCIe Endpoint(EP) controller

maintainers:
  - Frank Li <Frank.Li@nxp.com>

description:
  This PCIe EP controller is based on the Synopsys DesignWare PCIe IP.

  This controller derives its clocks from the Reset Configuration Word (RCW)
  which is used to describe the PLL settings at the time of chip-reset.

  Also as per the available Reference Manuals, there is no specific 'version'
  register available in the Freescale PCIe controller register set,
  which can allow determining the underlying DesignWare PCIe controller version
  information.

properties:
  compatible:
    enum:
      - fsl,ls2088a-pcie-ep
      - fsl,ls1088a-pcie-ep
      - fsl,ls1046a-pcie-ep
      - fsl,ls1028a-pcie-ep
      - fsl,lx2160ar2-pcie-ep

  reg:
    maxItems: 2

  reg-names:
    items:
      - const: regs
      - const: addr_space

  fsl,pcie-scfg:
    $ref: /schemas/types.yaml#/definitions/phandle
    description: A phandle to the SCFG device node. The second entry is the
      physical PCIe controller index starting from '0'. This is used to get
      SCFG PEXN registers.

  big-endian:
    $ref: /schemas/types.yaml#/definitions/flag
    description: If the PEX_LUT and PF register block is in big-endian, specify
      this property.

  dma-coherent: true

  interrupts:
    minItems: 1
    maxItems: 2

  interrupt-names:
    minItems: 1
    maxItems: 2

required:
  - compatible
  - reg
  - reg-names

allOf:
  - if:
      properties:
        compatible:
          enum:
            - fsl,ls1028a-pcie-ep
            - fsl,ls1046a-pcie-ep
            - fsl,ls1088a-pcie-ep
    then:
      properties:
        interrupt-names:
          items:
            - const: pme

unevaluatedProperties: false

examples:
  - |
    #include <dt-bindings/interrupt-controller/arm-gic.h>

    soc {
      #address-cells = <2>;
      #size-cells = <2>;

      pcie_ep1: pcie-ep@3400000 {
        compatible = "fsl,ls1028a-pcie-ep";
        reg = <0x00 0x03400000 0x0 0x00100000
              0x80 0x00000000 0x8 0x00000000>;
        reg-names = "regs", "addr_space";
        interrupts = <GIC_SPI 108 IRQ_TYPE_LEVEL_HIGH>; /* PME interrupt */
        interrupt-names = "pme";
        num-ib-windows = <6>;
        num-ob-windows = <8>;
        status = "disabled";
      };
    };
...
```

## Documentation/devicetree/bindings/pci/fsl,layerscape-pcie.yaml
```yaml
# SPDX-License-Identifier: (GPL-2.0-only OR BSD-2-Clause)
%YAML 1.2
---
$id: http://devicetree.org/schemas/pci/fsl,layerscape-pcie.yaml#
$schema: http://devicetree.org/meta-schemas/core.yaml#

title: Freescale Layerscape PCIe Root Complex(RC) controller

maintainers:
  - Frank Li <Frank.Li@nxp.com>

description:
  This PCIe RC controller is based on the Synopsys DesignWare PCIe IP

  This controller derives its clocks from the Reset Configuration Word (RCW)
  which is used to describe the PLL settings at the time of chip-reset.

  Also as per the available Reference Manuals, there is no specific 'version'
  register available in the Freescale PCIe controller register set,
  which can allow determining the underlying DesignWare PCIe controller version
  information.

properties:
  compatible:
    enum:
      - fsl,ls1021a-pcie
      - fsl,ls2080a-pcie
      - fsl,ls2085a-pcie
      - fsl,ls2088a-pcie
      - fsl,ls1088a-pcie
      - fsl,ls1046a-pcie
      - fsl,ls1043a-pcie
      - fsl,ls1012a-pcie
      - fsl,ls1028a-pcie
      - fsl,lx2160a-pcie

  reg:
    maxItems: 2

  reg-names:
    items:
      - const: regs
      - const: config

  fsl,pcie-scfg:
    $ref: /schemas/types.yaml#/definitions/phandle
    description: A phandle to the SCFG device node. The second entry is the
      physical PCIe controller index starting from '0'. This is used to get
      SCFG PEXN registers.

  big-endian:
    $ref: /schemas/types.yaml#/definitions/flag
    description: If the PEX_LUT and PF register block is in big-endian, specify
      this property.

  dma-coherent: true

  msi-parent: true

  iommu-map: true

  interrupts:
    minItems: 1
    maxItems: 2

  interrupt-names:
    minItems: 1
    maxItems: 2

required:
  - compatible
  - reg
  - reg-names
  - "#address-cells"
  - "#size-cells"
  - device_type
  - bus-range
  - ranges
  - interrupts
  - interrupt-names
  - "#interrupt-cells"
  - interrupt-map-mask
  - interrupt-map

allOf:
  - $ref: /schemas/pci/pci-bus.yaml#

  - if:
      properties:
        compatible:
          enum:
            - fsl,ls1028a-pcie
            - fsl,ls1046a-pcie
            - fsl,ls1043a-pcie
            - fsl,ls1012a-pcie
    then:
      properties:
        interrupts:
          maxItems: 2
        interrupt-names:
          items:
            - const: pme
            - const: aer

  - if:
      properties:
        compatible:
          enum:
            - fsl,ls2080a-pcie
            - fsl,ls2085a-pcie
            - fsl,ls2088a-pcie
    then:
      properties:
        interrupts:
          maxItems: 1
        interrupt-names:
          items:
            - const: intr

  - if:
      properties:
        compatible:
          enum:
            - fsl,ls1088a-pcie
    then:
      properties:
        interrupts:
          maxItems: 1
        interrupt-names:
          items:
            - const: aer

unevaluatedProperties: false

examples:
  - |
    #include <dt-bindings/interrupt-controller/arm-gic.h>

    soc {
      #address-cells = <2>;
      #size-cells = <2>;

      pcie@3400000 {
        compatible = "fsl,ls1088a-pcie";
        reg = <0x00 0x03400000 0x0 0x00100000>, /* controller registers */
            <0x20 0x00000000 0x0 0x00002000>; /* configuration space */
        reg-names = "regs", "config";
        interrupts = <0 108 IRQ_TYPE_LEVEL_HIGH>; /* aer interrupt */
        interrupt-names = "aer";
        #address-cells = <3>;
        #size-cells = <2>;
        dma-coherent;
        device_type = "pci";
        bus-range = <0x0 0xff>;
        ranges = <0x81000000 0x0 0x00000000 0x20 0x00010000 0x0 0x00010000   /* downstream I/O */
                 0x82000000 0x0 0x40000000 0x20 0x40000000 0x0 0x40000000>; /* non-prefetchable memory */
        msi-parent = <&its>;
        #interrupt-cells = <1>;
        interrupt-map-mask = <0 0 0 7>;
        interrupt-map = <0000 0 0 1 &gic 0 0 0 109 IRQ_TYPE_LEVEL_HIGH>,
                        <0000 0 0 2 &gic 0 0 0 110 IRQ_TYPE_LEVEL_HIGH>,
                        <0000 0 0 3 &gic 0 0 0 111 IRQ_TYPE_LEVEL_HIGH>,
                        <0000 0 0 4 &gic 0 0 0 112 IRQ_TYPE_LEVEL_HIGH>;
        iommu-map = <0 &smmu 0 1>; /* Fixed-up by bootloader */
      };
    };
...
```

## Documentation/devicetree/bindings/pci/fsl,mpc8xxx-pci.yaml
```yaml
# SPDX-License-Identifier: (GPL-2.0-only OR BSD-2-Clause)
%YAML 1.2
---

$id: http://devicetree.org/schemas/pci/fsl,mpc8xxx-pci.yaml#
$schema: http://devicetree.org/meta-schemas/core.yaml#

title: Freescale MPC83xx PCI/PCI-X/PCIe controllers

description:
  Binding for the PCI/PCI-X/PCIe host bridges on MPC8xxx SoCs

maintainers:
  - J. Neuschäfer <j.neuschaefer@gmx.net>

allOf:
  - $ref: /schemas/pci/pci-host-bridge.yaml#

properties:
  compatible:
    oneOf:
      - enum:
          - fsl,mpc8314-pcie
          - fsl,mpc8349-pci
          - fsl,mpc8540-pci
          - fsl,mpc8548-pcie
          - fsl,mpc8641-pcie
      - items:
          - enum:
              - fsl,mpc8308-pcie
              - fsl,mpc8315-pcie
              - fsl,mpc8377-pcie
              - fsl,mpc8378-pcie
          - const: fsl,mpc8314-pcie
      - items:
          - const: fsl,mpc8360-pci
          - const: fsl,mpc8349-pci
      - items:
          - const: fsl,mpc8540-pcix
          - const: fsl,mpc8540-pci

  reg:
    minItems: 1
    items:
      - description: internal registers
      - description: config space access registers

  clock-frequency: true

  interrupts:
    items:
      - description: Consolidated PCI interrupt

  fsl,pci-agent-force-enum:
    type: boolean
    description:
      Typically any Freescale PCI-X bridge hardware strapped into Agent mode is
      prevented from enumerating the bus. The PrPMC form-factor requires all
      mezzanines to be PCI-X Agents, but one per system may still enumerate the
      bus.

      This property allows a PCI-X bridge to be used for bus enumeration
      despite being strapped into Agent mode.

required:
  - reg
  - compatible

unevaluatedProperties: false

examples:
  - |
    #include <dt-bindings/interrupt-controller/irq.h>

    pcie@e0009000 {
        compatible = "fsl,mpc8315-pcie", "fsl,mpc8314-pcie";
        reg = <0xe0009000 0x00001000>;
        ranges = <0x02000000 0 0xa0000000 0xa0000000 0 0x10000000
                  0x01000000 0 0x00000000 0xb1000000 0 0x00800000>;
        #address-cells = <3>;
        #size-cells = <2>;
        #interrupt-cells = <1>;
        device_type = "pci";
        bus-range = <0 255>;
        interrupt-map-mask = <0xf800 0 0 7>;
        interrupt-map = <0 0 0 1 &ipic 1 IRQ_TYPE_LEVEL_LOW
                         0 0 0 2 &ipic 1 IRQ_TYPE_LEVEL_LOW
                         0 0 0 3 &ipic 1 IRQ_TYPE_LEVEL_LOW
                         0 0 0 4 &ipic 1 IRQ_TYPE_LEVEL_LOW>;
        clock-frequency = <0>;
    };

  - |
    pci@ef008000 {
        compatible = "fsl,mpc8540-pcix", "fsl,mpc8540-pci";
        reg = <0xef008000 0x1000>;
        ranges = <0x02000000 0 0x80000000 0x80000000 0 0x20000000
                  0x01000000 0 0x00000000 0xd0000000 0 0x01000000>;
        #interrupt-cells = <1>;
        #size-cells = <2>;
        #address-cells = <3>;
        device_type = "pci";
        clock-frequency = <33333333>;
        interrupt-map-mask = <0xf800 0x0 0x0 0x7>;
        interrupt-map = </* IDSEL */
                         0xe000 0 0 1 &mpic 2 1
                         0xe000 0 0 2 &mpic 3 1>;
        interrupts-extended = <&mpic 24 2>;
        bus-range = <0 0>;
        fsl,pci-agent-force-enum;
    };

...
```
