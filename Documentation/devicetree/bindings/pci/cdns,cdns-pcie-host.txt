## Documentation/devicetree/bindings/pci/cdns,cdns-pcie-host.txt
```
* Cadence PCIe host controller

This PCIe controller inherits the base properties defined in
host-generic-pci.txt.

Required properties:
- compatible: Should contain "cdns,cdns-pcie-host" to identify the IP used.
- reg: Should contain the controller register base address, PCIe configuration
  window base address, and AXI interface region base address respectively.
- reg-names: Must be "reg", "cfg" and "mem" respectively.
- #address-cells: Set to <3>
- #size-cells: Set to <2>
- device_type: Set to "pci"
- ranges: Ranges for the PCI memory and I/O regions
- #interrupt-cells: Set to <1>
- interrupt-map-mask and interrupt-map: Standard PCI properties to define the
  mapping of the PCIe interface to interrupt numbers.

Optional properties:
- cdns,max-outbound-regions: Set to maximum number of outbound regions
  (default 32)
- cdns,no-bar-match-nbits: Set into the no BAR match register to configure the
  number of least significant bits kept during inbound (PCIe -> AXI) address
  translations (default 32)
- vendor-id: The PCI vendor ID (16 bits, default is design dependent)
- device-id: The PCI device ID (16 bits, default is design dependent)

Example:

pcie@fb000000 {
	compatible = "cdns,cdns-pcie-host";
	device_type = "pci";
	#address-cells = <3>;
	#size-cells = <2>;
	bus-range = <0x0 0xff>;
	linux,pci-domain = <0>;
	cdns,max-outbound-regions = <16>;
	cdns,no-bar-match-nbits = <32>;
	vendor-id = /bits/ 16 <0x17cd>;
	device-id = /bits/ 16 <0x0200>;

	reg = <0x0 0xfb000000  0x0 0x01000000>,
	      <0x0 0x41000000  0x0 0x00001000>,
	      <0x0 0x40000000  0x0 0x04000000>;
	reg-names = "reg", "cfg", "mem";

	ranges = <0x02000000 0x0 0x42000000  0x0 0x42000000  0x0 0x1000000>,
		 <0x01000000 0x0 0x43000000  0x0 0x43000000  0x0 0x0010000>;

	#interrupt-cells = <0x1>;

	interrupt-map = <0x0 0x0 0x0  0x1  &gic  0x0 0x0 0x0 14 0x1
			 0x0 0x0 0x0  0x2  &gic  0x0 0x0 0x0 15 0x1
			 0x0 0x0 0x0  0x3  &gic  0x0 0x0 0x0 16 0x1
			 0x0 0x0 0x0  0x4  &gic  0x0 0x0 0x0 17 0x1>;

	interrupt-map-mask = <0x0 0x0 0x0  0x7>;

	msi-parent = <&its_pci>;
};
```

## Documentation/devicetree/bindings/pci/cdns,cdns-pcie-host.yaml
```yaml
# SPDX-License-Identifier: GPL-2.0-only
%YAML 1.2
---
$id: http://devicetree.org/schemas/pci/cdns,cdns-pcie-host.yaml#
$schema: http://devicetree.org/meta-schemas/core.yaml#

title: Cadence PCIe host controller

maintainers:
  - Tom Joseph <tjoseph@cadence.com>

allOf:
  - $ref: /schemas/pci/pci-bus.yaml#
  - $ref: "cdns-pcie-host.yaml#"

properties:
  compatible:
    const: cdns,cdns-pcie-host

  reg:
    maxItems: 2

  reg-names:
    items:
      - const: reg
      - const: cfg

  msi-parent: true

required:
  - reg
  - reg-names

examples:
  - |
    bus {
        #address-cells = <2>;
        #size-cells = <2>;

        pcie@fb000000 {
            compatible = "cdns,cdns-pcie-host";
            device_type = "pci";
            #address-cells = <3>;
            #size-cells = <2>;
            bus-range = <0x0 0xff>;
            linux,pci-domain = <0>;
            vendor-id = <0x17cd>;
            device-id = <0x0200>;

            reg = <0x0 0xfb000000  0x0 0x01000000>,
                  <0x0 0x41000000  0x0 0x00001000>;
            reg-names = "reg", "cfg";

            ranges = <0x02000000 0x0 0x42000000  0x0 0x42000000  0x0 0x1000000>,
                     <0x01000000 0x0 0x43000000  0x0 0x43000000  0x0 0x0010000>;
            dma-ranges = <0x02000000 0x0 0x0 0x0 0x0 0x1 0x00000000>;

            #interrupt-cells = <0x1>;

            interrupt-map = <0x0 0x0 0x0  0x1  &gic  0x0 0x0 0x0 14 0x1>,
                 <0x0 0x0 0x0  0x2  &gic  0x0 0x0 0x0 15 0x1>,
                 <0x0 0x0 0x0  0x3  &gic  0x0 0x0 0x0 16 0x1>,
                 <0x0 0x0 0x0  0x4  &gic  0x0 0x0 0x0 17 0x1>;

            interrupt-map-mask = <0x0 0x0 0x0  0x7>;

            msi-parent = <&its_pci>;

            phys = <&pcie_phy0>;
            phy-names = "pcie-phy";
        };
    };
...
```

## Documentation/devicetree/bindings/pci/cdns-pcie-ep.yaml
```yaml
# SPDX-License-Identifier: (GPL-2.0-only OR BSD-2-Clause)
%YAML 1.2
---
$id: "http://devicetree.org/schemas/pci/cdns-pcie-ep.yaml#"
$schema: "http://devicetree.org/meta-schemas/core.yaml#"

title: Cadence PCIe Device

maintainers:
  - Tom Joseph <tjoseph@cadence.com>

allOf:
  - $ref: "cdns-pcie.yaml#"
  - $ref: "pci-ep.yaml#"

properties:
  cdns,max-outbound-regions:
    description: maximum number of outbound regions
    $ref: /schemas/types.yaml#/definitions/uint32
    minimum: 1
    maximum: 32
    default: 32

additionalProperties: true
```

## Documentation/devicetree/bindings/pci/cdns-pcie-host.yaml
```yaml
# SPDX-License-Identifier: (GPL-2.0-only OR BSD-2-Clause)
%YAML 1.2
---
$id: "http://devicetree.org/schemas/pci/cdns-pcie-host.yaml#"
$schema: "http://devicetree.org/meta-schemas/core.yaml#"

title: Cadence PCIe Host

maintainers:
  - Tom Joseph <tjoseph@cadence.com>

allOf:
  - $ref: "/schemas/pci/pci-bus.yaml#"
  - $ref: "cdns-pcie.yaml#"

properties:
  cdns,max-outbound-regions:
    description: maximum number of outbound regions
    $ref: /schemas/types.yaml#/definitions/uint32
    minimum: 1
    maximum: 32
    default: 32
    deprecated: true

  cdns,no-bar-match-nbits:
    description:
      Set into the no BAR match register to configure the number of least
      significant bits kept during inbound (PCIe -> AXI) address translations
    $ref: /schemas/types.yaml#/definitions/uint32
    minimum: 0
    maximum: 64
    default: 32
    deprecated: true

  msi-parent: true
```

## Documentation/devicetree/bindings/pci/cdns-pcie.yaml
```yaml
# SPDX-License-Identifier: (GPL-2.0-only OR BSD-2-Clause)
%YAML 1.2
---
$id: http://devicetree.org/schemas/pci/cdns-pcie.yaml#
$schema: http://devicetree.org/meta-schemas/core.yaml#

title: Cadence PCIe Core

maintainers:
  - Tom Joseph <tjoseph@cadence.com>

properties:
  phys:
    description:
      One per lane if more than one in the list. If only one PHY listed it must
      manage all lanes.
    minItems: 1
    maxItems: 16

  phy-names:
    items:
      - const: pcie-phy
    # FIXME: names when more than 1

additionalProperties: true
```

## Documentation/devicetree/bindings/pci/cix,sky1-pcie-host.yaml
```yaml
# SPDX-License-Identifier: (GPL-2.0 OR BSD-2-Clause)
%YAML 1.2
---
$id: http://devicetree.org/schemas/pci/cix,sky1-pcie-host.yaml#
$schema: http://devicetree.org/meta-schemas/core.yaml#

title: CIX Sky1 PCIe Root Complex

maintainers:
  - Hans Zhang <hans.zhang@cixtech.com>

description:
  PCIe root complex controller based on the Cadence PCIe core.

allOf:
  - $ref: /schemas/pci/pci-host-bridge.yaml#

properties:
  compatible:
    const: cix,sky1-pcie-host

  reg:
    items:
      - description: PCIe controller registers.
      - description: ECAM registers.
      - description: Remote CIX System Unit strap registers.
      - description: Remote CIX System Unit status registers.
      - description: Region for sending messages registers.

  reg-names:
    items:
      - const: reg
      - const: cfg
      - const: rcsu_strap
      - const: rcsu_status
      - const: msg

  ranges:
    maxItems: 3

required:
  - compatible
  - ranges
  - bus-range
  - device_type
  - interrupt-map
  - interrupt-map-mask
  - msi-map

unevaluatedProperties: false

examples:
  - |
    #include <dt-bindings/interrupt-controller/arm-gic.h>

    soc {
        #address-cells = <2>;
        #size-cells = <2>;

        pcie@a010000 {
            compatible = "cix,sky1-pcie-host";
            reg = <0x00 0x0a010000 0x00 0x10000>,
                  <0x00 0x2c000000 0x00 0x4000000>,
                  <0x00 0x0a000300 0x00 0x100>,
                  <0x00 0x0a000400 0x00 0x100>,
                  <0x00 0x60000000 0x00 0x00100000>;
            reg-names = "reg", "cfg", "rcsu_strap", "rcsu_status", "msg";
            ranges = <0x01000000 0x00 0x60100000 0x00 0x60100000 0x00 0x00100000>,
                     <0x02000000 0x00 0x60200000 0x00 0x60200000 0x00 0x1fe00000>,
                     <0x43000000 0x18 0x00000000 0x18 0x00000000 0x04 0x00000000>;
            #address-cells = <3>;
            #size-cells = <2>;
            bus-range = <0xc0 0xff>;
            device_type = "pci";
            #interrupt-cells = <1>;
            interrupt-map-mask = <0 0 0 0x7>;
            interrupt-map = <0 0 0 1 &gic 0 0 GIC_SPI 407 IRQ_TYPE_LEVEL_HIGH 0>,
                            <0 0 0 2 &gic 0 0 GIC_SPI 408 IRQ_TYPE_LEVEL_HIGH 0>,
                            <0 0 0 3 &gic 0 0 GIC_SPI 409 IRQ_TYPE_LEVEL_HIGH 0>,
                            <0 0 0 4 &gic 0 0 GIC_SPI 410 IRQ_TYPE_LEVEL_HIGH 0>;
            msi-map = <0xc000 &gic_its 0xc000 0x4000>;
        };
    };
```

## Documentation/devicetree/bindings/pci/designware-pcie-ecam.txt
```
* Synopsys DesignWare PCIe root complex in ECAM shift mode

In some cases, firmware may already have configured the Synopsys DesignWare
PCIe controller in RC mode with static ATU window mappings that cover all
config, MMIO and I/O spaces in a [mostly] ECAM compatible fashion.
In this case, there is no need for the OS to perform any low level setup
of clocks, PHYs or device registers, nor is there any reason for the driver
to reconfigure ATU windows for config and/or IO space accesses at runtime.

In cases where the IP was synthesized with a minimum ATU window size of
64 KB, it cannot be supported by the generic ECAM driver, because it
requires special config space accessors that filter accesses to device #1
and beyond on the first bus.

Required properties:
- compatible: "marvell,armada8k-pcie-ecam" or
              "socionext,synquacer-pcie-ecam" or
              "snps,dw-pcie-ecam" (must be preceded by a more specific match)

Please refer to the binding document of "pci-host-ecam-generic" in the
file host-generic-pci.txt for a description of the remaining required
and optional properties.

Example:

    pcie1: pcie@7f000000 {
        compatible = "socionext,synquacer-pcie-ecam", "snps,dw-pcie-ecam";
        device_type = "pci";
        reg = <0x0 0x7f000000 0x0 0xf00000>;
        bus-range = <0x0 0xe>;
        #address-cells = <3>;
        #size-cells = <2>;
        ranges = <0x1000000 0x00 0x00010000 0x00 0x7ff00000 0x0 0x00010000>,
                 <0x2000000 0x00 0x70000000 0x00 0x70000000 0x0 0x0f000000>,
                 <0x3000000 0x3f 0x00000000 0x3f 0x00000000 0x1 0x00000000>;

        #interrupt-cells = <0x1>;
        interrupt-map-mask = <0x0 0x0 0x0 0x0>;
        interrupt-map = <0x0 0x0 0x0 0x0 &gic 0x0 0x0 0x0 182 0x4>;
        msi-map = <0x0 &its 0x0 0x10000>;
        dma-coherent;
    };
```

## Documentation/devicetree/bindings/pci/designware-pcie.txt
```
* Synopsys DesignWare PCIe interface

Required properties:
- compatible:
	"snps,dw-pcie" for RC mode;
	"snps,dw-pcie-ep" for EP mode;
- reg: Should contain the configuration address space.
- reg-names: Must be "config" for the PCIe configuration space.
    (The old way of getting the configuration address space from "ranges"
    is deprecated and should be avoided.)
- num-lanes: number of lanes to use
RC mode:
- #address-cells: set to <3>
- #size-cells: set to <2>
- device_type: set to "pci"
- ranges: ranges for the PCI memory and I/O regions
- #interrupt-cells: set to <1>
- interrupt-map-mask and interrupt-map: standard PCI
	properties to define the mapping of the PCIe interface to interrupt
	numbers.
EP mode:
- num-ib-windows: number of inbound address translation windows
- num-ob-windows: number of outbound address translation windows

Optional properties:
- num-lanes: number of lanes to use (this property should be specified unless
  the link is brought already up in BIOS)
- reset-gpio: GPIO pin number of power good signal
- clocks: Must contain an entry for each entry in clock-names.
	See ../clocks/clock-bindings.txt for details.
- clock-names: Must include the following entries:
	- "pcie"
	- "pcie_bus"
RC mode:
- num-viewport: number of view ports configured in hardware. If a platform
  does not specify it, the driver assumes 2.
- bus-range: PCI bus numbers covered (it is recommended for new devicetrees
  to specify this property, to keep backwards compatibility a range of
  0x00-0xff is assumed if not present)

EP mode:
- max-functions: maximum number of functions that can be configured

Example configuration:

	pcie: pcie@dfc00000 {
		compatible = "snps,dw-pcie";
		reg = <0xdfc00000 0x0001000>, /* IP registers */
		      <0xd0000000 0x0002000>; /* Configuration space */
		reg-names = "dbi", "config";
		#address-cells = <3>;
		#size-cells = <2>;
		device_type = "pci";
		ranges = <0x81000000 0 0x00000000 0xde000000 0 0x00010000
			  0x82000000 0 0xd0400000 0xd0400000 0 0x0d000000>;
		interrupts = <25>, <24>;
		#interrupt-cells = <1>;
		num-lanes = <1>;
	};
or
	pcie: pcie@dfc00000 {
		compatible = "snps,dw-pcie-ep";
		reg = <0xdfc00000 0x0001000>, /* IP registers 1 */
		      <0xdfc01000 0x0001000>, /* IP registers 2 */
		      <0xd0000000 0x2000000>; /* Configuration space */
		reg-names = "dbi", "dbi2", "addr_space";
		num-ib-windows = <6>;
		num-ob-windows = <2>;
		num-lanes = <1>;
	};
```
