## Documentation/devicetree/bindings/pci/intel,keembay-pcie-ep.yaml
```yaml
# SPDX-License-Identifier: (GPL-2.0 OR BSD-2-Clause)
%YAML 1.2
---
$id: http://devicetree.org/schemas/pci/intel,keembay-pcie-ep.yaml#
$schema: http://devicetree.org/meta-schemas/core.yaml#

title: Intel Keem Bay PCIe controller Endpoint mode

maintainers:
  - Wan Ahmad Zainie <wan.ahmad.zainie.wan.mohamad@intel.com>
  - Srikanth Thokala <srikanth.thokala@intel.com>

properties:
  compatible:
    const: intel,keembay-pcie-ep

  reg:
    maxItems: 5

  reg-names:
    items:
      - const: dbi
      - const: dbi2
      - const: atu
      - const: addr_space
      - const: apb

  interrupts:
    maxItems: 4

  interrupt-names:
    items:
      - const: pcie
      - const: pcie_ev
      - const: pcie_err
      - const: pcie_mem_access

  num-lanes:
    description: Number of lanes to use.
    enum: [ 1, 2 ]

required:
  - compatible
  - reg
  - reg-names
  - interrupts
  - interrupt-names

additionalProperties: false

examples:
  - |
    #include <dt-bindings/interrupt-controller/arm-gic.h>
    #include <dt-bindings/interrupt-controller/irq.h>
    pcie-ep@37000000 {
        compatible = "intel,keembay-pcie-ep";
        reg = <0x37000000 0x00001000>,
              <0x37100000 0x00001000>,
              <0x37300000 0x00001000>,
              <0x36000000 0x01000000>,
              <0x37800000 0x00000200>;
        reg-names = "dbi", "dbi2", "atu", "addr_space", "apb";
        interrupts = <GIC_SPI 107 IRQ_TYPE_LEVEL_HIGH>,
                     <GIC_SPI 108 IRQ_TYPE_EDGE_RISING>,
                     <GIC_SPI 109 IRQ_TYPE_LEVEL_HIGH>,
                     <GIC_SPI 110 IRQ_TYPE_LEVEL_HIGH>;
        interrupt-names = "pcie", "pcie_ev", "pcie_err", "pcie_mem_access";
        num-lanes = <2>;
    };
```

## Documentation/devicetree/bindings/pci/intel,keembay-pcie.yaml
```yaml
# SPDX-License-Identifier: (GPL-2.0 OR BSD-2-Clause)
%YAML 1.2
---
$id: "http://devicetree.org/schemas/pci/intel,keembay-pcie.yaml#"
$schema: "http://devicetree.org/meta-schemas/core.yaml#"

title: Intel Keem Bay PCIe controller Root Complex mode

maintainers:
  - Wan Ahmad Zainie <wan.ahmad.zainie.wan.mohamad@intel.com>
  - Srikanth Thokala <srikanth.thokala@intel.com>

allOf:
  - $ref: /schemas/pci/pci-bus.yaml#

properties:
  compatible:
    const: intel,keembay-pcie

  ranges:
    maxItems: 1

  reset-gpios:
    maxItems: 1

  reg:
    maxItems: 4

  reg-names:
    items:
      - const: dbi
      - const: atu
      - const: config
      - const: apb

  clocks:
    maxItems: 2

  clock-names:
    items:
      - const: master
      - const: aux

  interrupts:
    maxItems: 3

  interrupt-names:
    items:
      - const: pcie
      - const: pcie_ev
      - const: pcie_err

  num-lanes:
    description: Number of lanes to use.
    enum: [ 1, 2 ]

required:
  - compatible
  - reg
  - reg-names
  - ranges
  - clocks
  - clock-names
  - interrupts
  - interrupt-names
  - reset-gpios

unevaluatedProperties: false

examples:
  - |
    #include <dt-bindings/interrupt-controller/arm-gic.h>
    #include <dt-bindings/interrupt-controller/irq.h>
    #include <dt-bindings/gpio/gpio.h>
    #define KEEM_BAY_A53_PCIE
    #define KEEM_BAY_A53_AUX_PCIE
    pcie@37000000 {
          compatible = "intel,keembay-pcie";
          reg = <0x37000000 0x00001000>,
                <0x37300000 0x00001000>,
                <0x36e00000 0x00200000>,
                <0x37800000 0x00000200>;
          reg-names = "dbi", "atu", "config", "apb";
          #address-cells = <3>;
          #size-cells = <2>;
          device_type = "pci";
          ranges = <0x02000000 0 0x36000000 0x36000000 0 0x00e00000>;
          interrupts = <GIC_SPI 107 IRQ_TYPE_LEVEL_HIGH>,
                       <GIC_SPI 108 IRQ_TYPE_LEVEL_HIGH>,
                       <GIC_SPI 109 IRQ_TYPE_LEVEL_HIGH>;
          interrupt-names = "pcie", "pcie_ev", "pcie_err";
          clocks = <&scmi_clk KEEM_BAY_A53_PCIE>,
                   <&scmi_clk KEEM_BAY_A53_AUX_PCIE>;
          clock-names = "master", "aux";
          reset-gpios = <&pca2 9 GPIO_ACTIVE_LOW>;
          num-lanes = <2>;
    };
```

## Documentation/devicetree/bindings/pci/intel-gw-pcie.yaml
```yaml
# SPDX-License-Identifier: (GPL-2.0 OR BSD-2-Clause)
%YAML 1.2
---
$id: http://devicetree.org/schemas/pci/intel-gw-pcie.yaml#
$schema: http://devicetree.org/meta-schemas/core.yaml#

title: PCIe RC controller on Intel Gateway SoCs

maintainers:
  - Rahul Tanwar <rtanwar@maxlinear.com>

select:
  properties:
    compatible:
      contains:
        const: intel,lgm-pcie
  required:
    - compatible

allOf:
  - $ref: /schemas/pci/snps,dw-pcie.yaml#

properties:
  compatible:
    items:
      - const: intel,lgm-pcie
      - const: snps,dw-pcie

  reg:
    items:
      - description: Controller control and status registers.
      - description: PCIe configuration registers.
      - description: Controller application registers.

  reg-names:
    items:
      - const: dbi
      - const: config
      - const: app

  ranges:
    maxItems: 1

  resets:
    maxItems: 1

  clocks:
    maxItems: 1

  phys:
    maxItems: 1

  phy-names:
    const: pcie

  reset-gpios:
    maxItems: 1

  num-lanes:
    maximum: 2

  max-link-speed:
    enum: [1, 2, 3, 4]
    default: 1

  reset-assert-ms:
    description: |
      Delay after asserting reset to the PCIe device.
    maximum: 500
    default: 100

required:
  - compatible
  - reg
  - reg-names
  - ranges
  - resets
  - clocks
  - phys
  - phy-names
  - reset-gpios
  - '#interrupt-cells'
  - interrupt-map
  - interrupt-map-mask

unevaluatedProperties: false

examples:
  - |
    #include <dt-bindings/gpio/gpio.h>
    pcie10: pcie@d0e00000 {
      compatible = "intel,lgm-pcie", "snps,dw-pcie";
      device_type = "pci";
      #address-cells = <3>;
      #size-cells = <2>;
      reg = <0xd0e00000 0x1000>,
            <0xd2000000 0x800000>,
            <0xd0a41000 0x1000>;
      reg-names = "dbi", "config", "app";
      linux,pci-domain = <0>;
      max-link-speed = <4>;
      bus-range = <0x00 0x08>;
      #interrupt-cells = <1>;
      interrupt-map-mask = <0 0 0 0x7>;
      interrupt-map = <0 0 0 1 &ioapic1 27 1>,
                      <0 0 0 2 &ioapic1 28 1>,
                      <0 0 0 3 &ioapic1 29 1>,
                      <0 0 0 4 &ioapic1 30 1>;
      ranges = <0x02000000 0 0xd4000000 0xd4000000 0 0x04000000>;
      resets = <&rcu0 0x50 0>;
      clocks = <&cgu0 120>;
      phys = <&cb0phy0>;
      phy-names = "pcie";
      reset-assert-ms = <500>;
      reset-gpios = <&gpio0 3 GPIO_ACTIVE_LOW>;
      num-lanes = <2>;
    };
```

## Documentation/devicetree/bindings/pci/kirin-pcie.txt
```
HiSilicon Kirin SoCs PCIe host DT description

Kirin PCIe host controller is based on Designware PCI core.
It shares common functions with PCIe Designware core driver
and inherits common properties defined in
Documentation/devicetree/bindings/pci/designware-pci.txt.

Additional properties are described here:

Required properties
- compatible:
	"hisilicon,kirin960-pcie" for PCIe of Kirin960 SoC
- reg: Should contain rc_dbi, apb, phy, config registers location and length.
- reg-names: Must include the following entries:
  "dbi": controller configuration registers;
  "apb": apb Ctrl register defined by Kirin;
  "phy": apb PHY register defined by Kirin;
  "config": PCIe configuration space registers.
- reset-gpios: The gpio to generate PCIe perst assert and deassert signal.

Optional properties:

Example based on kirin960:

	pcie@f4000000 {
		compatible = "hisilicon,kirin-pcie";
		reg = <0x0 0xf4000000 0x0 0x1000>, <0x0 0xff3fe000 0x0 0x1000>,
		      <0x0 0xf3f20000 0x0 0x40000>, <0x0 0xF4000000 0 0x2000>;
		reg-names = "dbi","apb","phy", "config";
		bus-range = <0x0  0x1>;
		#address-cells = <3>;
		#size-cells = <2>;
		device_type = "pci";
		ranges = <0x02000000 0x0 0x00000000 0x0 0xf5000000 0x0 0x2000000>;
		num-lanes = <1>;
		#interrupt-cells = <1>;
		interrupt-map-mask = <0xf800 0 0 7>;
		interrupt-map = <0x0 0 0 1 &gic 0 0 0  282 4>,
				<0x0 0 0 2 &gic 0 0 0  283 4>,
				<0x0 0 0 3 &gic 0 0 0  284 4>,
				<0x0 0 0 4 &gic 0 0 0  285 4>;
		clocks = <&crg_ctrl HI3660_PCIEPHY_REF>,
			 <&crg_ctrl HI3660_CLK_GATE_PCIEAUX>,
			 <&crg_ctrl HI3660_PCLK_GATE_PCIE_PHY>,
			 <&crg_ctrl HI3660_PCLK_GATE_PCIE_SYS>,
			 <&crg_ctrl HI3660_ACLK_GATE_PCIE>;
		clock-names = "pcie_phy_ref", "pcie_aux",
			      "pcie_apb_phy", "pcie_apb_sys", "pcie_aclk";
		reset-gpios = <&gpio11 1 0 >;
	};
```

## Documentation/devicetree/bindings/pci/layerscape-pci.txt
```
Freescale Layerscape PCIe controller

This PCIe host controller is based on the Synopsys DesignWare PCIe IP
and thus inherits all the common properties defined in snps,dw-pcie.yaml.

This controller derives its clocks from the Reset Configuration Word (RCW)
which is used to describe the PLL settings at the time of chip-reset.

Also as per the available Reference Manuals, there is no specific 'version'
register available in the Freescale PCIe controller register set,
which can allow determining the underlying DesignWare PCIe controller version
information.

Required properties:
- compatible: should contain the platform identifier such as:
  RC mode:
        "fsl,ls1021a-pcie"
        "fsl,ls2080a-pcie", "fsl,ls2085a-pcie"
        "fsl,ls2088a-pcie"
        "fsl,ls1088a-pcie"
        "fsl,ls1046a-pcie"
        "fsl,ls1043a-pcie"
        "fsl,ls1012a-pcie"
        "fsl,ls1028a-pcie"
  EP mode:
	"fsl,ls1028a-pcie-ep", "fsl,ls-pcie-ep"
	"fsl,ls1046a-pcie-ep", "fsl,ls-pcie-ep"
	"fsl,ls1088a-pcie-ep", "fsl,ls-pcie-ep"
	"fsl,ls2088a-pcie-ep", "fsl,ls-pcie-ep"
	"fsl,lx2160ar2-pcie-ep", "fsl,ls-pcie-ep"
- reg: base addresses and lengths of the PCIe controller register blocks.
- interrupts: A list of interrupt outputs of the controller. Must contain an
  entry for each entry in the interrupt-names property.
- interrupt-names: It could include the following entries:
  "aer": Used for interrupt line which reports AER events when
	 non MSI/MSI-X/INTx mode is used
  "pme": Used for interrupt line which reports PME events when
	 non MSI/MSI-X/INTx mode is used
  "intr": Used for SoCs(like ls2080a, lx2160a, ls2080a, ls2088a, ls1088a)
	  which has a single interrupt line for miscellaneous controller
	  events(could include AER and PME events).
- fsl,pcie-scfg: Must include two entries.
  The first entry must be a link to the SCFG device node
  The second entry is the physical PCIe controller index starting from '0'.
  This is used to get SCFG PEXN registers
- dma-coherent: Indicates that the hardware IP block can ensure the coherency
  of the data transferred from/to the IP block. This can avoid the software
  cache flush/invalid actions, and improve the performance significantly.

Optional properties:
- big-endian: If the PEX_LUT and PF register block is in big-endian, specify
  this property.

Example:

        pcie@3400000 {
                compatible = "fsl,ls1088a-pcie";
                reg = <0x00 0x03400000 0x0 0x00100000>, /* controller registers */
                      <0x20 0x00000000 0x0 0x00002000>; /* configuration space */
                reg-names = "regs", "config";
                interrupts = <0 108 IRQ_TYPE_LEVEL_HIGH>; /* aer interrupt */
                interrupt-names = "aer";
                #address-cells = <3>;
                #size-cells = <2>;
                device_type = "pci";
                dma-coherent;
                num-viewport = <256>;
                bus-range = <0x0 0xff>;
                ranges = <0x81000000 0x0 0x00000000 0x20 0x00010000 0x0 0x00010000   /* downstream I/O */
                          0x82000000 0x0 0x40000000 0x20 0x40000000 0x0 0x40000000>; /* non-prefetchable memory */
                msi-parent = <&its>;
                #interrupt-cells = <1>;
                interrupt-map-mask = <0 0 0 7>;
                interrupt-map = <0000 0 0 1 &gic 0 0 0 109 IRQ_TYPE_LEVEL_HIGH>,
                                <0000 0 0 2 &gic 0 0 0 110 IRQ_TYPE_LEVEL_HIGH>,
                                <0000 0 0 3 &gic 0 0 0 111 IRQ_TYPE_LEVEL_HIGH>,
                                <0000 0 0 4 &gic 0 0 0 112 IRQ_TYPE_LEVEL_HIGH>;
                iommu-map = <0 &smmu 0 1>; /* Fixed-up by bootloader */
        };
```

## Documentation/devicetree/bindings/pci/layerscape-pcie-gen4.txt
```
NXP Layerscape PCIe Gen4 controller

This PCIe controller is based on the Mobiveil PCIe IP and thus inherits all
the common properties defined in mobiveil-pcie.txt.

Required properties:
- compatible: should contain the platform identifier such as:
  "fsl,lx2160a-pcie"
- reg: base addresses and lengths of the PCIe controller register blocks.
  "csr_axi_slave": Bridge config registers
  "config_axi_slave": PCIe controller registers
- interrupts: A list of interrupt outputs of the controller. Must contain an
  entry for each entry in the interrupt-names property.
- interrupt-names: It could include the following entries:
  "intr": The interrupt that is asserted for controller interrupts
  "aer": Asserted for aer interrupt when chip support the aer interrupt with
	 none MSI/MSI-X/INTx mode,but there is interrupt line for aer.
  "pme": Asserted for pme interrupt when chip support the pme interrupt with
	 none MSI/MSI-X/INTx mode,but there is interrupt line for pme.
- dma-coherent: Indicates that the hardware IP block can ensure the coherency
  of the data transferred from/to the IP block. This can avoid the software
  cache flush/invalid actions, and improve the performance significantly.
- msi-parent : See the generic MSI binding described in
  Documentation/devicetree/bindings/interrupt-controller/msi.txt.

Example:

	pcie@3400000 {
		compatible = "fsl,lx2160a-pcie";
		reg = <0x00 0x03400000 0x0 0x00100000   /* controller registers */
		       0x80 0x00000000 0x0 0x00001000>; /* configuration space */
		reg-names = "csr_axi_slave", "config_axi_slave";
		interrupts = <GIC_SPI 108 IRQ_TYPE_LEVEL_HIGH>, /* AER interrupt */
			     <GIC_SPI 108 IRQ_TYPE_LEVEL_HIGH>, /* PME interrupt */
			     <GIC_SPI 108 IRQ_TYPE_LEVEL_HIGH>; /* controller interrupt */
		interrupt-names = "aer", "pme", "intr";
		#address-cells = <3>;
		#size-cells = <2>;
		device_type = "pci";
		apio-wins = <8>;
		ppio-wins = <8>;
		dma-coherent;
		bus-range = <0x0 0xff>;
		msi-parent = <&its>;
		ranges = <0x82000000 0x0 0x40000000 0x80 0x40000000 0x0 0x40000000>;
		#interrupt-cells = <1>;
		interrupt-map-mask = <0 0 0 7>;
		interrupt-map = <0000 0 0 1 &gic 0 0 GIC_SPI 109 IRQ_TYPE_LEVEL_HIGH>,
				<0000 0 0 2 &gic 0 0 GIC_SPI 110 IRQ_TYPE_LEVEL_HIGH>,
				<0000 0 0 3 &gic 0 0 GIC_SPI 111 IRQ_TYPE_LEVEL_HIGH>,
				<0000 0 0 4 &gic 0 0 GIC_SPI 112 IRQ_TYPE_LEVEL_HIGH>;
	};
```
