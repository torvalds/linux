## Documentation/devicetree/bindings/pci/loongson.yaml
```yaml
# SPDX-License-Identifier: (GPL-2.0-only OR BSD-2-Clause)
%YAML 1.2
---
$id: http://devicetree.org/schemas/pci/loongson.yaml#
$schema: http://devicetree.org/meta-schemas/core.yaml#

title: Loongson PCI Host Controller

maintainers:
  - Jiaxun Yang <jiaxun.yang@flygoat.com>

description: |+
  PCI host controller found on Loongson PCHs and SoCs.

allOf:
  - $ref: /schemas/pci/pci-host-bridge.yaml#

properties:
  compatible:
    enum:
      - loongson,ls2k-pci
      - loongson,ls7a-pci
      - loongson,rs780e-pci

  reg:
    minItems: 1
    items:
      - description: CFG0 standard config space register
      - description: CFG1 extended config space register

  ranges:
    minItems: 1
    maxItems: 3


required:
  - compatible
  - reg
  - ranges

unevaluatedProperties: false

examples:
  - |

    bus {
        #address-cells = <2>;
        #size-cells = <2>;
        pcie@1a000000 {
            compatible = "loongson,rs780e-pci";
            device_type = "pci";
            #address-cells = <3>;
            #size-cells = <2>;

            // CPU_PHYSICAL(2)  SIZE(2)
            reg = <0x0 0x1a000000  0x0 0x2000000>;

            // BUS_ADDRESS(3)  CPU_PHYSICAL(2)  SIZE(2)
            ranges = <0x01000000 0x0 0x00004000  0x0 0x00004000  0x0 0x00004000>,
                     <0x02000000 0x0 0x40000000  0x0 0x40000000  0x0 0x40000000>;
        };
    };
...
```

## Documentation/devicetree/bindings/pci/marvell,armada-3700-pcie.yaml
```yaml
# SPDX-License-Identifier: (GPL-2.0-only OR BSD-2-Clause)
%YAML 1.2
---
$id: http://devicetree.org/schemas/pci/marvell,armada-3700-pcie.yaml#
$schema: http://devicetree.org/meta-schemas/core.yaml#

title: Marvell Armada 3700 (Aardvark) PCIe Controller

maintainers:
  - Thomas Petazzoni <thomas.petazzoni@bootlin.com>
  - Pali Rohár <pali@kernel.org>

allOf:
  - $ref: /schemas/pci/pci-host-bridge.yaml#

properties:
  compatible:
    const: marvell,armada-3700-pcie

  reg:
    maxItems: 1

  clocks:
    maxItems: 1

  interrupts:
    maxItems: 1

  msi-controller: true

  msi-parent:
    maxItems: 1

  phys:
    maxItems: 1

  reset-gpios:
    description: PCIe reset GPIO signals.

  interrupt-controller:
    type: object
    additionalProperties: false

    properties:
      '#address-cells':
        const: 0

      interrupt-controller: true

      '#interrupt-cells':
        const: 1

    required:
      - interrupt-controller
      - '#interrupt-cells'

required:
  - compatible
  - reg
  - interrupts
  - '#interrupt-cells'

unevaluatedProperties: false

examples:
  - |
    #include <dt-bindings/interrupt-controller/arm-gic.h>
    #include <dt-bindings/gpio/gpio.h>

    bus {
        #address-cells = <2>;
        #size-cells = <2>;

        pcie@d0070000 {
            compatible = "marvell,armada-3700-pcie";
            device_type = "pci";
            reg = <0 0xd0070000 0 0x20000>;
            #address-cells = <3>;
            #size-cells = <2>;
            bus-range = <0x00 0xff>;
            interrupts = <GIC_SPI 29 IRQ_TYPE_LEVEL_HIGH>;
            msi-controller;
            msi-parent = <&pcie0>;
            ranges = <0x82000000 0 0xe8000000 0 0xe8000000 0 0x1000000>,
                    <0x81000000 0 0xe9000000 0 0xe9000000 0 0x10000>;

            #interrupt-cells = <1>;
            interrupt-map-mask = <0 0 0 7>;
            interrupt-map = <0 0 0 1 &pcie_intc 0>,
                            <0 0 0 2 &pcie_intc 1>,
                            <0 0 0 3 &pcie_intc 2>,
                            <0 0 0 4 &pcie_intc 3>;
            phys = <&comphy1 0>;
            max-link-speed = <2>;
            reset-gpios = <&gpio1 15 GPIO_ACTIVE_LOW>;

            pcie_intc: interrupt-controller {
                #address-cells = <0>;
                interrupt-controller;
                #interrupt-cells = <1>;
            };
        };
    };
```

## Documentation/devicetree/bindings/pci/marvell,armada8k-pcie.yaml
```yaml
# SPDX-License-Identifier: GPL-2.0
%YAML 1.2
---
$id: http://devicetree.org/schemas/pci/marvell,armada8k-pcie.yaml#
$schema: http://devicetree.org/meta-schemas/core.yaml#

title: Marvell Armada 7K/8K PCIe interface

maintainers:
  - Thomas Petazzoni <thomas.petazzoni@bootlin.com>

description:
  This PCIe host controller is based on the Synopsys DesignWare PCIe IP.

select:
  properties:
    compatible:
      contains:
        enum:
          - marvell,armada8k-pcie
  required:
    - compatible

allOf:
  - $ref: snps,dw-pcie.yaml#

properties:
  compatible:
    items:
      - enum:
          - marvell,armada8k-pcie
      - const: snps,dw-pcie

  reg:
    maxItems: 2

  reg-names:
    items:
      - const: ctrl
      - const: config

  clocks:
    minItems: 1
    maxItems: 2

  clock-names:
    items:
      - const: core
      - const: reg

  interrupts:
    maxItems: 1

  msi-parent:
    maxItems: 1

  phys:
    minItems: 1
    maxItems: 4

  phy-names:
    minItems: 1
    maxItems: 4

  marvell,reset-gpio:
    maxItems: 1
    deprecated: true

required:
  - interrupt-map
  - clocks
  - msi-parent

unevaluatedProperties: false

examples:
  - |
    #include <dt-bindings/interrupt-controller/arm-gic.h>
    #include <dt-bindings/interrupt-controller/irq.h>

    pcie@f2600000 {
        compatible = "marvell,armada8k-pcie", "snps,dw-pcie";
        reg = <0xf2600000 0x10000>, <0xf6f00000 0x80000>;
        reg-names = "ctrl", "config";
        #address-cells = <3>;
        #size-cells = <2>;
        #interrupt-cells = <1>;
        device_type = "pci";
        dma-coherent;
        msi-parent = <&gic_v2m0>;

        ranges = <0x81000000 0 0xf9000000 0xf9000000 0 0x10000>,  /* downstream I/O */
                 <0x82000000 0 0xf6000000 0xf6000000 0 0xf00000>;  /* non-prefetchable memory */
        interrupt-map-mask = <0 0 0 0>;
        interrupt-map = <0 0 0 0 &gic 0 GIC_SPI 32 IRQ_TYPE_LEVEL_HIGH>;
        interrupts = <GIC_SPI 32 IRQ_TYPE_LEVEL_HIGH>;
        num-lanes = <1>;
        clocks = <&cpm_syscon0 1 13>;
    };
...
```
