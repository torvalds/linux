## Documentation/devicetree/bindings/nvmem/renesas,rcar-efuse.yaml
```yaml
# SPDX-License-Identifier: (GPL-2.0-only OR BSD-2-Clause)
%YAML 1.2
---
$id: http://devicetree.org/schemas/nvmem/renesas,rcar-efuse.yaml#
$schema: http://devicetree.org/meta-schemas/core.yaml#

title: R-Car E-FUSE connected to PFC

maintainers:
  - Geert Uytterhoeven <geert+renesas@glider.be>

description:
  The E-FUSE is a type of non-volatile memory, which is accessible through the
  Pin Function Controller (PFC) on some R-Car Gen4 SoCs.

allOf:
  - $ref: nvmem.yaml#

properties:
  compatible:
    enum:
      - renesas,r8a779a0-efuse # R-Car V3U
      - renesas,r8a779f0-efuse # R-Car S4-8

  reg:
    maxItems: 1
    description: PFC System Group Fuse Control and Monitor register block

  clocks:
    maxItems: 1

  power-domains:
    maxItems: 1

  resets:
    maxItems: 1

required:
  - compatible
  - reg
  - clocks
  - power-domains
  - resets

unevaluatedProperties: false

examples:
  - |
    #include <dt-bindings/clock/r8a779f0-cpg-mssr.h>
    #include <dt-bindings/power/r8a779f0-sysc.h>

    fuse@e6078800 {
        compatible = "renesas,r8a779f0-efuse";
        reg = <0xe6078800 0x200>;
        clocks = <&cpg CPG_MOD 915>;
        power-domains = <&sysc R8A779F0_PD_ALWAYS_ON>;
        resets = <&cpg 915>;

        nvmem-layout {
            compatible = "fixed-layout";
            #address-cells = <1>;
            #size-cells = <1>;

            calib@144 {
                reg = <0x144 0x08>;
            };
        };
    };
```
