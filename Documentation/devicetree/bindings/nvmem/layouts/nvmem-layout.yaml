## Documentation/devicetree/bindings/nvmem/mxs-ocotp.txt
```
On-Chip OTP Memory for Freescale i.MX23/i.MX28

Required properties :
- compatible :
  - "fsl,imx23-ocotp" for i.MX23
  - "fsl,imx28-ocotp" for i.MX28
- #address-cells : Should be 1
- #size-cells : Should be 1
- reg : Address and length of OTP controller registers
- clocks : Should contain a reference to the hbus clock

= Data cells =
Are child nodes of mxs-ocotp, bindings of which as described in
bindings/nvmem/nvmem.txt

Example for i.MX28:

	ocotp: ocotp@8002c000 {
		compatible = "fsl,imx28-ocotp", "fsl,ocotp";
		#address-cells = <1>;
		#size-cells = <1>;
		reg = <0x8002c000 0x2000>;
		clocks = <&clks 25>;
		status = "okay";
	};
```

## Documentation/devicetree/bindings/nvmem/mxs-ocotp.yaml
```yaml
# SPDX-License-Identifier: (GPL-2.0 OR BSD-2-Clause)
%YAML 1.2
---
$id: http://devicetree.org/schemas/nvmem/mxs-ocotp.yaml#
$schema: http://devicetree.org/meta-schemas/core.yaml#

title: On-Chip OTP Memory for Freescale i.MX23/i.MX28

maintainers:
  - Anson Huang <Anson.Huang@nxp.com>

allOf:
  - $ref: nvmem.yaml#

properties:
  compatible:
    enum:
      - fsl,imx23-ocotp
      - fsl,imx28-ocotp

  reg:
    maxItems: 1

  clocks:
    maxItems: 1

required:
  - compatible
  - reg
  - clocks

unevaluatedProperties: false

examples:
  - |
    ocotp: efuse@8002c000 {
        compatible = "fsl,imx28-ocotp";
        #address-cells = <1>;
        #size-cells = <1>;
        reg = <0x8002c000 0x2000>;
        clocks = <&clks 25>;
    };

...
```

## Documentation/devicetree/bindings/nvmem/nintendo-otp.yaml
```yaml
# SPDX-License-Identifier: GPL-2.0-only OR BSD-2-Clause
%YAML 1.2
---
$id: http://devicetree.org/schemas/nvmem/nintendo-otp.yaml#
$schema: http://devicetree.org/meta-schemas/core.yaml#

title: Nintendo Wii and Wii U OTP

description: |
  This binding represents the OTP memory as found on a Nintendo Wii or Wii U,
  which contains common and per-console keys, signatures and related data
  required to access peripherals.

  See https://wiiubrew.org/wiki/Hardware/OTP

maintainers:
  - Emmanuel Gil Peyrot <linkmauve@linkmauve.fr>

allOf:
  - $ref: "nvmem.yaml#"

properties:
  compatible:
    enum:
      - nintendo,hollywood-otp
      - nintendo,latte-otp

  reg:
    maxItems: 1

required:
  - compatible
  - reg

unevaluatedProperties: false

examples:
  - |
    otp@d8001ec {
        compatible = "nintendo,latte-otp";
        reg = <0x0d8001ec 0x8>;
    };

...
```

## Documentation/devicetree/bindings/nvmem/nvmem-consumer.yaml
```yaml
# SPDX-License-Identifier: (GPL-2.0 OR BSD-2-Clause)
%YAML 1.2
---
$id: http://devicetree.org/schemas/nvmem/nvmem-consumer.yaml#
$schema: http://devicetree.org/meta-schemas/base.yaml#

title: NVMEM (Non Volatile Memory) Consumer

maintainers:
  - Srinivas Kandagatla <srinivas.kandagatla@linaro.org>

select: true

properties:
  nvmem:
    $ref: /schemas/types.yaml#/definitions/phandle-array
    description:
      List of phandle to the nvmem providers.

  nvmem-cells:
    $ref: /schemas/types.yaml#/definitions/phandle-array
    description:
      List of phandle to the nvmem data cells.

  nvmem-names:
    description:
      Names for the each nvmem provider.

  nvmem-cell-names:
    description:
      Names for each nvmem-cells specified.

dependencies:
  nvmem-names: [ nvmem ]
  nvmem-cell-names: [ nvmem-cells ]

additionalProperties: true

examples:
  - |
    tsens {
        /* ... */
        nvmem-cells = <&tsens_calibration>;
        nvmem-cell-names = "calibration";
    };
```

## Documentation/devicetree/bindings/nvmem/nvmem-deprecated-cells.yaml
```yaml
# SPDX-License-Identifier: (GPL-2.0 OR BSD-2-Clause)
%YAML 1.2
---
$id: http://devicetree.org/schemas/nvmem/nvmem-deprecated-cells.yaml#
$schema: http://devicetree.org/meta-schemas/core.yaml#

title: NVMEM old syntax for fixed cells

maintainers:
  - Srinivas Kandagatla <srinivas.kandagatla@linaro.org>

description: |
  Before introducing NVMEM layouts all NVMEM (fixed) cells were defined
  as direct device subnodes. That syntax was replaced by "fixed-layout"
  and is deprecated now. No new bindings should use it.

patternProperties:
  "@[0-9a-f]+(,[0-7])?$":
    type: object
    allOf:
      - $ref: layouts/fixed-cell.yaml
      - properties:
          compatible: false
    deprecated: true

additionalProperties: true

...
```

## Documentation/devicetree/bindings/nvmem/nvmem-provider.yaml
```yaml
# SPDX-License-Identifier: (GPL-2.0 OR BSD-2-Clause)
%YAML 1.2
---
$id: http://devicetree.org/schemas/nvmem/nvmem-provider.yaml#
$schema: http://devicetree.org/meta-schemas/base.yaml#

title: NVMEM (Non Volatile Memory) Provider

maintainers:
  - Srinivas Kandagatla <srinivas.kandagatla@linaro.org>

select: true

properties:
  '#nvmem-cell-cells':
    enum: [0, 1]

additionalProperties: true
```

## Documentation/devicetree/bindings/nvmem/nvmem.yaml
```yaml
# SPDX-License-Identifier: (GPL-2.0 OR BSD-2-Clause)
%YAML 1.2
---
$id: http://devicetree.org/schemas/nvmem/nvmem.yaml#
$schema: http://devicetree.org/meta-schemas/core.yaml#

title: NVMEM (Non Volatile Memory)

maintainers:
  - Srinivas Kandagatla <srinivas.kandagatla@linaro.org>

description: |
  This binding is intended to represent the location of hardware
  configuration data stored in NVMEMs like eeprom, efuses and so on.

  On a significant proportion of boards, the manufacturer has stored
  some data on NVMEM, for the OS to be able to retrieve these
  information and act upon it. Obviously, the OS has to know about
  where to retrieve these data from, and where they are stored on the
  storage device.

properties:
  "#address-cells":
    const: 1

  "#size-cells":
    const: 1

  read-only:
    $ref: /schemas/types.yaml#/definitions/flag
    description:
      Mark the provider as read only.

  wp-gpios:
    description:
      GPIO to which the write-protect pin of the chip is connected.
      The write-protect GPIO is asserted, when it's driven high
      (logical '1') to block the write operation. It's deasserted,
      when it's driven low (logical '0') to allow writing.
    maxItems: 1

  nvmem-layout:
    $ref: /schemas/nvmem/layouts/nvmem-layout.yaml
    description:
      Alternative to the statically defined nvmem cells, this
      container may reference more advanced (dynamic) layout
      parsers.

patternProperties:
  "@[0-9a-f]+(,[0-7])?$":
    type: object
    allOf:
      - $ref: layouts/fixed-cell.yaml
      - properties:
          compatible: false
    deprecated: true

additionalProperties: true

examples:
  - |
      #include <dt-bindings/gpio/gpio.h>

      qfprom: eeprom@700000 {
          compatible = "qcom,msm8974-qfprom", "qcom,qfprom";
          #address-cells = <1>;
          #size-cells = <1>;
          reg = <0x00700000 0x100000>;

          wp-gpios = <&gpio1 3 GPIO_ACTIVE_HIGH>;

          /* ... */

          nvmem-layout {
              compatible = "fixed-layout";
              #address-cells = <1>;
              #size-cells = <1>;

              /* Data cells */
              tsens_calibration: calib@404 {
                  reg = <0x404 0x10>;
              };

              tsens_calibration_bckp: calib_bckp@504 {
                  reg = <0x504 0x11>;
                  bits = <6 128>;
              };

              pvs_version: pvs-version@6 {
                  reg = <0x6 0x2>;
                  bits = <7 2>;
              };

              speed_bin: speed-bin@c{
                  reg = <0xc 0x1>;
                  bits = <2 3>;
              };
          };
      };

...
```

## Documentation/devicetree/bindings/nvmem/nxp,lpc1857-eeprom.yaml
```yaml
# SPDX-License-Identifier: (GPL-2.0-only OR BSD-2-Clause)
%YAML 1.2
---
$id: http://devicetree.org/schemas/nvmem/nxp,lpc1857-eeprom.yaml#
$schema: http://devicetree.org/meta-schemas/core.yaml#

title: NXP LPC18xx EEPROM memory

maintainers:
  - Frank Li <Frank.Li@nxp.com>

properties:
  compatible:
    const: nxp,lpc1857-eeprom

  reg:
    maxItems: 2

  reg-names:
    items:
      - const: reg
      - const: mem

  clocks:
    maxItems: 1

  clock-names:
    items:
      - const: eeprom

  interrupts:
    maxItems: 1

  resets:
    maxItems: 1

required:
  - compatible
  - reg
  - reg-names
  - clocks
  - clock-names
  - interrupts
  - resets

additionalProperties: false

examples:
  - |
    #include <dt-bindings/clock/lpc18xx-ccu.h>

    eeprom@4000e000 {
        compatible = "nxp,lpc1857-eeprom";
        reg = <0x4000e000 0x1000>,
              <0x20040000 0x4000>;
        reg-names = "reg", "mem";
        clocks = <&ccu1 CLK_CPU_EEPROM>;
        clock-names = "eeprom";
        resets = <&rgu 27>;
        interrupts = <4>;
    };
```

## Documentation/devicetree/bindings/nvmem/nxp,s32g-ocotp-nvmem.yaml
```yaml
# SPDX-License-Identifier: (GPL-2.0 OR BSD-2-Clause)
%YAML 1.2
---
$id: http://devicetree.org/schemas/nvmem/nxp,s32g-ocotp-nvmem.yaml#
$schema: http://devicetree.org/meta-schemas/core.yaml#

title: NXP S32G OCOTP NVMEM driver

maintainers:
  - Ciprian Costea <ciprianmarian.costea@nxp.com>

description:
  The drivers provides an interface to access One Time
  Programmable memory pages, such as TMU fuse values.

properties:
  compatible:
    oneOf:
      - enum:
          - nxp,s32g2-ocotp
      - items:
          - enum:
              - nxp,s32g3-ocotp
              - nxp,s32r45-ocotp
          - const: nxp,s32g2-ocotp
  reg:
    maxItems: 1

required:
  - compatible
  - reg

unevaluatedProperties: false

allOf:
  - $ref: nvmem.yaml#

examples:
  - |
    nvmem@400a4000 {
      compatible = "nxp,s32g2-ocotp";
      reg = <0x400a4000 0x400>;
      #address-cells = <1>;
      #size-cells = <1>;
    };
```

## Documentation/devicetree/bindings/nvmem/qcom,qfprom.yaml
```yaml
# SPDX-License-Identifier: (GPL-2.0-only OR BSD-2-Clause)
%YAML 1.2
---
$id: http://devicetree.org/schemas/nvmem/qcom,qfprom.yaml#
$schema: http://devicetree.org/meta-schemas/core.yaml#

title: Qualcomm Technologies Inc, QFPROM Efuse

maintainers:
  - Srinivas Kandagatla <srinivas.kandagatla@linaro.org>

allOf:
  - $ref: "nvmem.yaml#"

properties:
  compatible:
    items:
      - enum:
          - qcom,apq8064-qfprom
          - qcom,apq8084-qfprom
          - qcom,ipq8064-qfprom
          - qcom,ipq8074-qfprom
          - qcom,msm8916-qfprom
          - qcom,msm8974-qfprom
          - qcom,msm8976-qfprom
          - qcom,msm8996-qfprom
          - qcom,msm8998-qfprom
          - qcom,qcs404-qfprom
          - qcom,sc7180-qfprom
          - qcom,sc7280-qfprom
          - qcom,sdm630-qfprom
          - qcom,sdm670-qfprom
          - qcom,sdm845-qfprom
          - qcom,sm6115-qfprom
          - qcom,sm8150-qfprom
          - qcom,sm8250-qfprom
      - const: qcom,qfprom

  reg:
    # If the QFPROM is read-only OS image then only the corrected region
    # needs to be provided.  If the QFPROM is writable then all 4 regions
    # must be provided.
    oneOf:
      - items:
          - description: The corrected region.
      - items:
          - description: The corrected region.
          - description: The raw region.
          - description: The config region.
          - description: The security control region.

  # Clock must be provided if QFPROM is writable from the OS image.
  clocks:
    maxItems: 1
  clock-names:
    const: core

  # Supply reference must be provided if QFPROM is writable from the OS image.
  vcc-supply:
    description: Our power supply.

  power-domains:
    maxItems: 1

  # Needed if any child nodes are present.
  "#address-cells":
    const: 1
  "#size-cells":
    const: 1

required:
  - compatible
  - reg

unevaluatedProperties: false

examples:
  - |
    #include <dt-bindings/clock/qcom,gcc-sc7180.h>

    soc {
      #address-cells = <2>;
      #size-cells = <2>;

      efuse@784000 {
        compatible = "qcom,sc7180-qfprom", "qcom,qfprom";
        reg = <0 0x00784000 0 0x8ff>,
              <0 0x00780000 0 0x7a0>,
              <0 0x00782000 0 0x100>,
              <0 0x00786000 0 0x1fff>;
        clocks = <&gcc GCC_SEC_CTRL_CLK_SRC>;
        clock-names = "core";
        #address-cells = <1>;
        #size-cells = <1>;

        vcc-supply = <&vreg_l11a_1p8>;

        hstx-trim-primary@25b {
          reg = <0x25b 0x1>;
          bits = <1 3>;
        };
      };
    };

  - |
    soc {
      #address-cells = <2>;
      #size-cells = <2>;

      efuse@784000 {
        compatible = "qcom,sdm845-qfprom", "qcom,qfprom";
        reg = <0 0x00784000 0 0x8ff>;
        #address-cells = <1>;
        #size-cells = <1>;

        hstx-trim-primary@1eb {
          reg = <0x1eb 0x1>;
          bits = <1 4>;
        };
      };
    };
```

## Documentation/devicetree/bindings/nvmem/qcom,sec-qfprom.yaml
```yaml
# SPDX-License-Identifier: (GPL-2.0-only OR BSD-2-Clause)
%YAML 1.2
---
$id: http://devicetree.org/schemas/nvmem/qcom,sec-qfprom.yaml#
$schema: http://devicetree.org/meta-schemas/core.yaml#

title: Qualcomm Technologies Inc, Secure QFPROM Efuse

maintainers:
  - Komal Bajaj <quic_kbajaj@quicinc.com>

description:
  For some of the Qualcomm SoC's, it is possible that the qfprom region is
  protected from non-secure access. In such situations, the OS have to use
  secure calls to read the region.

allOf:
  - $ref: nvmem.yaml#
  - $ref: nvmem-deprecated-cells.yaml#

properties:
  compatible:
    items:
      - enum:
          - qcom,qdu1000-sec-qfprom
      - const: qcom,sec-qfprom

  reg:
    items:
      - description: The secure qfprom corrected region.

required:
  - compatible
  - reg

unevaluatedProperties: false

examples:
  - |
    soc {
      #address-cells = <2>;
      #size-cells = <2>;

      efuse@221c8000 {
        compatible = "qcom,qdu1000-sec-qfprom", "qcom,sec-qfprom";
        reg = <0 0x221c8000 0 0x1000>;
        #address-cells = <1>;
        #size-cells = <1>;

        multi_chan_ddr: multi-chan-ddr@12b {
          reg = <0x12b 0x1>;
          bits = <0 2>;
        };
      };
    };
```

## Documentation/devicetree/bindings/nvmem/qcom,spmi-sdam.yaml
```yaml
# SPDX-License-Identifier: (GPL-2.0-only OR BSD-2-Clause)
%YAML 1.2
---
$id: http://devicetree.org/schemas/nvmem/qcom,spmi-sdam.yaml#
$schema: http://devicetree.org/meta-schemas/core.yaml#

title: Qualcomm Technologies, Inc. SPMI SDAM

maintainers:
  - Shyam Kumar Thella <sthella@codeaurora.org>

description: |
  The SDAM provides scratch register space for the PMIC clients. This
  memory can be used by software to store information or communicate
  to/from the PBUS.

allOf:
  - $ref: nvmem.yaml#
  - $ref: nvmem-deprecated-cells.yaml#

properties:
  compatible:
    enum:
      - qcom,spmi-sdam

  reg:
    maxItems: 1

  ranges: true

required:
  - compatible
  - reg
  - ranges

unevaluatedProperties: false

examples:
  - |
    pmic {
        #address-cells = <1>;
        #size-cells = <0>;

        sdam_1: nvram@b000 {
            compatible = "qcom,spmi-sdam";
            reg = <0xb000>;
            #address-cells = <1>;
            #size-cells = <1>;
            ranges = <0 0xb000 0x100>;

            /* Data cells */
            restart_reason: restart@50 {
                reg = <0x50 0x1>;
                bits = <6 2>;
            };
        };
    };
...
```

## Documentation/devicetree/bindings/nvmem/qfprom.txt
```
= Qualcomm QFPROM device tree bindings =

This binding is intended to represent QFPROM which is found in most QCOM SOCs.

Required properties:
- compatible: should be "qcom,qfprom"
- reg: Should contain registers location and length

= Data cells =
Are child nodes of qfprom, bindings of which as described in
bindings/nvmem/nvmem.txt

Example:

	qfprom: qfprom@00700000 {
		compatible 	= "qcom,qfprom";
		reg		= <0x00700000 0x8000>;
		...
		/* Data cells */
		tsens_calibration: calib@404 {
			reg = <0x4404 0x10>;
		};
	};


= Data consumers =
Are device nodes which consume nvmem data cells.

For example:

	tsens {
		...
		nvmem-cells = <&tsens_calibration>;
		nvmem-cell-names = "calibration";
	};
```
