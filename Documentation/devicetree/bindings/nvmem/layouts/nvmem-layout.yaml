## Documentation/devicetree/bindings/nvmem/layouts/nvmem-layout.yaml
```yaml
# SPDX-License-Identifier: (GPL-2.0 OR BSD-2-Clause)
%YAML 1.2
---
$id: http://devicetree.org/schemas/nvmem/layouts/nvmem-layout.yaml#
$schema: http://devicetree.org/meta-schemas/core.yaml#

title: NVMEM (Non Volatile Memory) layouts

maintainers:
  - Srinivas Kandagatla <srinivas.kandagatla@linaro.org>
  - Michael Walle <michael@walle.cc>
  - Miquel Raynal <miquel.raynal@bootlin.com>

description: |
  Most NVMEM layouts are static and thus do not require additional description
  besides the bytes/bits offset and length. Other layouts can be less statically
  define and might require dynamic reading of the NVMEM device in order to
  perform their parsing. The nvmem-layout container is here to describe these.

oneOf:
  - $ref: fixed-layout.yaml
  - $ref: kontron,sl28-vpd.yaml
  - $ref: onie,tlv-layout.yaml

properties:
  compatible: true

required:
  - compatible

unevaluatedProperties: false
```

## Documentation/devicetree/bindings/nvmem/layouts/onie,tlv-layout.yaml
```yaml
# SPDX-License-Identifier: (GPL-2.0 OR BSD-2-Clause)
%YAML 1.2
---
$id: http://devicetree.org/schemas/nvmem/layouts/onie,tlv-layout.yaml#
$schema: http://devicetree.org/meta-schemas/core.yaml#

title: NVMEM layout of the ONIE tlv table

maintainers:
  - Miquel Raynal <miquel.raynal@bootlin.com>

description:
  Modern networking hardware implementing the Open Compute Project ONIE
  infrastructure shall provide a non-volatile memory with a table whose the
  content is well specified and gives many information about the manufacturer
  (name, country of manufacture, etc) as well as device caracteristics (serial
  number, hardware version, mac addresses, etc). The underlaying device type
  (flash, EEPROM,...) is not specified. The exact location of each value is also
  dynamic and should be discovered at run time because it depends on the
  parameters the manufacturer decided to embed.

select: false

properties:
  compatible:
    const: onie,tlv-layout

  product-name:
    type: object
    additionalProperties: false

  part-number:
    type: object
    additionalProperties: false

  serial-number:
    type: object
    additionalProperties: false

  mac-address:
    type: object
    description:
      Base MAC address for all on-module network interfaces. The first
      argument of the phandle will be treated as an offset.

    properties:
      "#nvmem-cell-cells":
        const: 1

    additionalProperties: false

  manufacture-date:
    type: object
    additionalProperties: false

  device-version:
    type: object
    additionalProperties: false

  label-revision:
    type: object
    additionalProperties: false

  platforn-name:
    type: object
    additionalProperties: false

  onie-version:
    type: object
    additionalProperties: false

  num-macs:
    type: object
    additionalProperties: false

  manufacturer:
    type: object
    additionalProperties: false

  country-code:
    type: object
    additionalProperties: false

  vendor:
    type: object
    additionalProperties: false

  diag-version:
    type: object
    additionalProperties: false

  service-tag:
    type: object
    additionalProperties: false

  vendor-extension:
    type: object
    additionalProperties: false

required:
  - compatible

additionalProperties: false

examples:
  - |
    spi {
        #address-cells = <1>;
        #size-cells = <0>;

        eeprom@56 {
            compatible = "atmel,24c64";
            read-only;
            reg = <0x56>;

            nvmem-layout {
                compatible = "onie,tlv-layout";

                serial-number {
                };
            };
        };
    };

  - |
    spi {
        #address-cells = <1>;
        #size-cells = <0>;

        flash@0 {
            compatible = "m25p80", "jedec,spi-nor";
            reg = <0>;

            otp {
                compatible = "user-otp";

                nvmem-layout {
                    compatible = "onie,tlv-layout";

                    mac-address {
                        #nvmem-cell-cells = <1>;
                    };
                };
            };
        };
    };
...
```

## Documentation/devicetree/bindings/nvmem/layouts/u-boot,env.yaml
```yaml
# SPDX-License-Identifier: GPL-2.0-only OR BSD-2-Clause
%YAML 1.2
---
$id: http://devicetree.org/schemas/nvmem/layouts/u-boot,env.yaml#
$schema: http://devicetree.org/meta-schemas/core.yaml#

title: U-Boot environment variables layout

description: |
  U-Boot uses environment variables to store device parameters and
  configuration. They may be used for booting process, setup or keeping end user
  info.

  Data is stored using U-Boot specific formats (variant specific header and NUL
  separated key-value pairs).

  Environment data can be stored on various storage entities, e.g.:
  1. Raw flash partition
  2. UBI volume

  This binding allows marking storage device (as containing env data) and
  specifying used format.

  Variables can be defined as NVMEM device subnodes.

maintainers:
  - Rafał Miłecki <rafal@milecki.pl>

properties:
  compatible:
    oneOf:
      - description: A standalone env data block
        const: u-boot,env
      - description: Two redundant blocks with active one flagged
        const: u-boot,env-redundant-bool
      - description: Two redundant blocks with active having higher counter
        const: u-boot,env-redundant-count
      - description: Broadcom's variant with custom header
        const: brcm,env

  reg:
    description: Partition offset and size for env on top of MTD
    maxItems: 1

  bootcmd:
    type: object
    description: Command to use for automatic booting

  ethaddr:
    type: object
    description: Ethernet interfaces base MAC address.
    additionalProperties: false

    properties:
      "#nvmem-cell-cells":
        description: The first argument is a MAC address offset.
        const: 1

allOf:
  - if:
      properties:
        $nodename:
          not:
            contains:
              pattern: "^partition@[0-9a-f]+$"
    then:
      properties:
        reg: false

additionalProperties: false

examples:
  - |
    partitions {
        compatible = "fixed-partitions";
        #address-cells = <1>;
        #size-cells = <1>;

        partition@0 {
            reg = <0x0 0x40000>;
            label = "u-boot";
            read-only;
        };

        env: partition@40000 {
            compatible = "u-boot,env";
            reg = <0x40000 0x10000>;

            mac: ethaddr {
                #nvmem-cell-cells = <1>;
            };
        };
    };
  - |
    partitions {
        compatible = "fixed-partitions";
        #address-cells = <1>;
        #size-cells = <1>;

        partition@0 {
            reg = <0x0 0x100000>;
            compatible = "brcm,u-boot";
            label = "u-boot";

            partition-u-boot-env {
                compatible = "brcm,env";

                ethaddr {
                };
            };
        };
    };
  - |
    partition@0 {
        reg = <0x0 0x100000>;
        label = "ubi";
        compatible = "linux,ubi";

        volumes {
            ubi-volume-u-boot-env {
                volname = "env";

                nvmem-layout {
                    compatible = "u-boot,env";

                    ethaddr {
                        #nvmem-cell-cells = <1>;
                    };
                };
            };
        };
    };
```

## Documentation/devicetree/bindings/nvmem/lpc1850-otp.txt
```
* NXP LPC18xx OTP memory

Internal OTP (One Time Programmable) memory for NXP LPC18xx/43xx devices.

Required properties:
  - compatible: Should be "nxp,lpc1850-otp"
  - reg: Must contain an entry with the physical base address and length
    for each entry in reg-names.
  - address-cells: must be set to 1.
  - size-cells: must be set to 1.

See nvmem.txt for more information.

Example:
  otp: otp@40045000 {
    compatible = "nxp,lpc1850-otp";
    reg = <0x40045000 0x1000>;
    #address-cells = <1>;
    #size-cells = <1>;
  };
```

## Documentation/devicetree/bindings/nvmem/lpc1857-eeprom.txt
```
* NXP LPC18xx EEPROM memory NVMEM driver

Required properties:
  - compatible: Should be "nxp,lpc1857-eeprom"
  - reg: Must contain an entry with the physical base address and length
    for each entry in reg-names.
  - reg-names: Must include the following entries.
    - reg: EEPROM registers.
    - mem: EEPROM address space.
  - clocks: Must contain an entry for each entry in clock-names.
  - clock-names: Must include the following entries.
    - eeprom: EEPROM operating clock.
  - resets: Should contain a reference to the reset controller asserting
    the EEPROM in reset.
  - interrupts: Should contain EEPROM interrupt.

Example:

  eeprom: eeprom@4000e000 {
    compatible = "nxp,lpc1857-eeprom";
    reg = <0x4000e000 0x1000>,
          <0x20040000 0x4000>;
    reg-names = "reg", "mem";
    clocks = <&ccu1 CLK_CPU_EEPROM>;
    clock-names = "eeprom";
    resets = <&rgu 27>;
    interrupts = <4>;
  };
```

## Documentation/devicetree/bindings/nvmem/maxim,max77759-nvmem.yaml
```yaml
# SPDX-License-Identifier: (GPL-2.0-only OR BSD-2-Clause)
%YAML 1.2
---
$id: http://devicetree.org/schemas/nvmem/maxim,max77759-nvmem.yaml#
$schema: http://devicetree.org/meta-schemas/core.yaml#

title: Maxim Integrated MAX77759 Non Volatile Memory

maintainers:
  - André Draszik <andre.draszik@linaro.org>

description: |
  This module is part of the MAX77759 PMIC. For additional information, see
  Documentation/devicetree/bindings/mfd/maxim,max77759.yaml.

  The MAX77759 is a PMIC integrating, amongst others, Non Volatile Memory
  (NVMEM) with 30 bytes of storage which can be used by software to store
  information or communicate with a boot loader.

properties:
  compatible:
    const: maxim,max77759-nvmem

  wp-gpios: false

required:
  - compatible

allOf:
  - $ref: nvmem.yaml#

unevaluatedProperties: false
```

## Documentation/devicetree/bindings/nvmem/mediatek,efuse.yaml
```yaml
# SPDX-License-Identifier: (GPL-2.0-only OR BSD-2-Clause)
%YAML 1.2
---
$id: http://devicetree.org/schemas/nvmem/mediatek,efuse.yaml#
$schema: http://devicetree.org/meta-schemas/core.yaml#

title: MediaTek efuse

description: |
  MediaTek's efuse is used for storing calibration data, it can be accessed
  on ARM devices usiong I/O mapped memory.

maintainers:
  - Andrew-CT Chen <andrew-ct.chen@mediatek.com>
  - Lala Lin <lala.lin@mediatek.com>

allOf:
  - $ref: nvmem.yaml#

properties:
  $nodename:
    pattern: "^efuse@[0-9a-f]+$"

  compatible:
    oneOf:
      - items:
          - enum:
              - mediatek,mt7622-efuse
              - mediatek,mt7623-efuse
              - mediatek,mt8173-efuse
              - mediatek,mt8183-efuse
              - mediatek,mt8186-efuse
              - mediatek,mt8188-efuse
              - mediatek,mt8192-efuse
              - mediatek,mt8195-efuse
              - mediatek,mt8516-efuse
          - const: mediatek,efuse
      - const: mediatek,mt8173-efuse
        deprecated: true

  reg:
    maxItems: 1

required:
  - compatible
  - reg

unevaluatedProperties: false

examples:
  - |
    efuse@11c10000 {
        compatible = "mediatek,mt8195-efuse", "mediatek,efuse";
        reg = <0x11c10000 0x1000>;
        #address-cells = <1>;
        #size-cells = <1>;

        u3_tx_imp_p0: usb3-tx-imp@184,1 {
            reg = <0x184 0x1>;
            bits = <0 5>;
        };
        u3_rx_imp_p0: usb3-rx-imp@184,2 {
            reg = <0x184 0x2>;
            bits = <5 5>;
        };
        u3_intr_p0: usb3-intr@185 {
            reg = <0x185 0x1>;
            bits = <2 6>;
        };
        comb_tx_imp_p1: usb3-tx-imp@186,1 {
            reg = <0x186 0x1>;
            bits = <0 5>;
        };
        comb_rx_imp_p1: usb3-rx-imp@186,2 {
            reg = <0x186 0x2>;
            bits = <5 5>;
        };
        comb_intr_p1: usb3-intr@187 {
            reg = <0x187 0x1>;
            bits = <2 6>;
        };
        u2_intr_p0: usb2-intr-p0@188,1 {
            reg = <0x188 0x1>;
            bits = <0 5>;
        };
        u2_intr_p1: usb2-intr-p1@188,2 {
            reg = <0x188 0x2>;
            bits = <5 5>;
        };
    };
```

## Documentation/devicetree/bindings/nvmem/microchip,lan9662-otpc.yaml
```yaml
# SPDX-License-Identifier: (GPL-2.0 OR BSD-2-Clause)
%YAML 1.2
---
$id: http://devicetree.org/schemas/nvmem/microchip,lan9662-otpc.yaml#
$schema: http://devicetree.org/meta-schemas/core.yaml#

title: Microchip LAN9662 OTP Controller (OTPC)

maintainers:
  - Horatiu Vultur <horatiu.vultur@microchip.com>

description: |
  OTP controller drives a NVMEM memory where system specific data
  (e.g. hardware configuration settings, chip identifiers) or
  user specific data could be stored.

allOf:
  - $ref: nvmem.yaml#

properties:
  compatible:
    oneOf:
      - items:
          - const: microchip,lan9668-otpc
          - const: microchip,lan9662-otpc
      - enum:
          - microchip,lan9662-otpc

  reg:
    maxItems: 1

required:
  - compatible
  - reg

unevaluatedProperties: false

examples:
  - |
    otpc: otp@e0021000 {
        compatible = "microchip,lan9662-otpc";
        reg = <0xe0021000 0x300>;
    };

...
```

## Documentation/devicetree/bindings/nvmem/microchip,sama7g5-otpc.yaml
```yaml
# SPDX-License-Identifier: (GPL-2.0 OR BSD-2-Clause)
%YAML 1.2
---
$id: http://devicetree.org/schemas/nvmem/microchip,sama7g5-otpc.yaml#
$schema: http://devicetree.org/meta-schemas/core.yaml#

title: Microchip SAMA7G5 OTP Controller (OTPC)

maintainers:
  - Claudiu Beznea <claudiu.beznea@microchip.com>

description: |
  OTP controller drives a NVMEM memory where system specific data
  (e.g. calibration data for analog cells, hardware configuration
  settings, chip identifiers) or user specific data could be stored.

allOf:
  - $ref: nvmem.yaml#
  - $ref: nvmem-deprecated-cells.yaml#

properties:
  compatible:
    items:
      - const: microchip,sama7g5-otpc
      - const: syscon

  reg:
    maxItems: 1

required:
  - compatible
  - reg

unevaluatedProperties: false

examples:
  - |
    #include <dt-bindings/nvmem/microchip,sama7g5-otpc.h>

    otpc: efuse@e8c00000 {
        compatible = "microchip,sama7g5-otpc", "syscon";
        reg = <0xe8c00000 0xec>;
        #address-cells = <1>;
        #size-cells = <1>;

        temperature_calib: calib@1 {
            reg = <OTP_PKT(1) 76>;
        };
    };

...
```

## Documentation/devicetree/bindings/nvmem/mtk-efuse.txt
```
= Mediatek MTK-EFUSE device tree bindings =

This binding is intended to represent MTK-EFUSE which is found in most Mediatek SOCs.

Required properties:
- compatible: should be
	      "mediatek,mt7622-efuse", "mediatek,efuse": for MT7622
	      "mediatek,mt7623-efuse", "mediatek,efuse": for MT7623
	      "mediatek,mt8173-efuse" or "mediatek,efuse": for MT8173
	      "mediatek,mt8192-efuse", "mediatek,efuse": for MT8192
	      "mediatek,mt8516-efuse", "mediatek,efuse": for MT8516
	      "mediatek,mt8192-efuse", "mediatek,efuse": for MT8192
- reg: Should contain registers location and length

= Data cells =
Are child nodes of MTK-EFUSE, bindings of which as described in
bindings/nvmem/nvmem.txt

Example:

	efuse: efuse@10206000 {
		compatible = "mediatek,mt8173-efuse";
		reg	   = <0 0x10206000 0 0x1000>;
		#address-cells = <1>;
		#size-cells = <1>;

		/* Data cells */
		thermal_calibration: calib@528 {
			reg = <0x528 0xc>;
		};
	};

= Data consumers =
Are device nodes which consume nvmem data cells.

For example:

	thermal {
		...
		nvmem-cells = <&thermal_calibration>;
		nvmem-cell-names = "calibration";
	};
```
