## Documentation/devicetree/bindings/nvmem/fsl,t1023-sfp.yaml
```yaml
# SPDX-License-Identifier: (GPL-2.0-only OR BSD-2-Clause)
%YAML 1.2
---
$id: http://devicetree.org/schemas/nvmem/fsl,t1023-sfp.yaml#
$schema: http://devicetree.org/meta-schemas/core.yaml#

title: NXP QorIQ eFuse support

maintainers:
  - Richard Alpe <richard@bit42.se>

description:
  Read support for the eFuses (SFP) on NXP QorIQ series SoC's.

allOf:
  - $ref: nvmem.yaml#

properties:
  compatible:
    const: fsl,t1023-sfp

  reg:
    maxItems: 1

required:
  - compatible
  - reg

unevaluatedProperties: false

examples:
  - |
    efuse@e8000 {
        compatible = "fsl,t1023-sfp";
        reg = <0xe8000 0x1000>;
    };
...
```

## Documentation/devicetree/bindings/nvmem/fsl,vf610-ocotp.yaml
```yaml
# SPDX-License-Identifier: (GPL-2.0-only OR BSD-2-Clause)
%YAML 1.2
---
$id: http://devicetree.org/schemas/nvmem/fsl,vf610-ocotp.yaml#
$schema: http://devicetree.org/meta-schemas/core.yaml#

title: On-Chip OTP Memory for Freescale Vybrid

maintainers:
  - Frank Li <Frank.Li@nxp.com>

allOf:
  - $ref: nvmem.yaml#
  - $ref: nvmem-deprecated-cells.yaml

properties:
  compatible:
    items:
      - enum:
          - fsl,vf610-ocotp
      - const: syscon

  reg:
    maxItems: 1

  clocks:
    items:
      - description: ipg clock we associate with the OCOTP peripheral

required:
  - compatible
  - reg
  - clocks

unevaluatedProperties: false

examples:
  - |
    #include <dt-bindings/clock/vf610-clock.h>

    ocotp@400a5000 {
        compatible = "fsl,vf610-ocotp", "syscon";
        reg = <0x400a5000 0xcf0>;
        #address-cells = <1>;
        #size-cells = <1>;
        clocks = <&clks VF610_CLK_OCOTP>;
    };
```

## Documentation/devicetree/bindings/nvmem/google,gs101-otp.yaml
```yaml
# SPDX-License-Identifier: (GPL-2.0-only OR BSD-2-Clause)
%YAML 1.2
---
$id: http://devicetree.org/schemas/nvmem/google,gs101-otp.yaml#
$schema: http://devicetree.org/meta-schemas/core.yaml#

title: Google GS101 OTP Controller

maintainers:
  - Tudor Ambarus <tudor.ambarus@linaro.org>

description: |
  OTP controller drives a NVMEM memory where system or user specific data
  can be stored. The OTP controller register space is of interest as well
  because it contains dedicated registers where it stores the Product ID
  and the Chip ID (apart other things like TMU or ASV info).

allOf:
  - $ref: nvmem.yaml#

properties:
  compatible:
    items:
      - const: google,gs101-otp

  clocks:
    maxItems: 1

  clock-names:
    const: pclk

  interrupts:
    maxItems: 1

  reg:
    maxItems: 1

  power-domains:
    maxItems: 1

required:
  - compatible
  - reg
  - clocks
  - clock-names
  - interrupts

unevaluatedProperties: false

examples:
  - |
    #include <dt-bindings/clock/google,gs101.h>
    #include <dt-bindings/interrupt-controller/arm-gic.h>

    efuse@10000000 {
        compatible = "google,gs101-otp";
        reg = <0x10000000 0xf084>;
        clocks = <&cmu_misc CLK_GOUT_MISC_OTP_CON_TOP_PCLK>;
        clock-names = "pclk";
        interrupts = <GIC_SPI 752 IRQ_TYPE_LEVEL_HIGH>;
    };
```

## Documentation/devicetree/bindings/nvmem/imx-iim.txt
```
Freescale i.MX IC Identification Module (IIM) device tree bindings

This binding represents the IC Identification Module (IIM) found on
i.MX25, i.MX27, i.MX31, i.MX35, i.MX51 and i.MX53 SoCs.

Required properties:
- compatible: should be one of
	"fsl,imx25-iim", "fsl,imx27-iim",
	"fsl,imx31-iim", "fsl,imx35-iim",
	"fsl,imx51-iim", "fsl,imx53-iim",
- reg: Should contain the register base and length.
- interrupts: Should contain the interrupt for the IIM
- clocks: Should contain a phandle pointing to the gated peripheral clock.

Example:

	iim: iim@63f98000 {
		compatible = "fsl,imx53-iim", "fsl,imx27-iim";
		reg = <0x63f98000 0x4000>;
		interrupts = <69>;
                clocks = <&clks IMX5_CLK_IIM_GATE>;
	};
```

## Documentation/devicetree/bindings/nvmem/imx-iim.yaml
```yaml
# SPDX-License-Identifier: (GPL-2.0 OR BSD-2-Clause)
%YAML 1.2
---
$id: http://devicetree.org/schemas/nvmem/imx-iim.yaml#
$schema: http://devicetree.org/meta-schemas/core.yaml#

title: Freescale i.MX IC Identification Module (IIM)

maintainers:
  - Anson Huang <Anson.Huang@nxp.com>

description: |
  This binding represents the IC Identification Module (IIM) found on
  i.MX25, i.MX27, i.MX31, i.MX35, i.MX51 and i.MX53 SoCs.

allOf:
  - $ref: nvmem.yaml#

properties:
  compatible:
    enum:
      - fsl,imx25-iim
      - fsl,imx27-iim
      - fsl,imx31-iim
      - fsl,imx35-iim
      - fsl,imx51-iim
      - fsl,imx53-iim

  reg:
    maxItems: 1

  interrupts:
    maxItems: 1

  clocks:
    maxItems: 1

required:
  - compatible
  - reg
  - interrupts
  - clocks

additionalProperties: false

examples:
  - |
    #include <dt-bindings/clock/imx5-clock.h>

    iim: efuse@63f98000 {
        compatible = "fsl,imx53-iim";
        reg = <0x63f98000 0x4000>;
        interrupts = <69>;
        clocks = <&clks IMX5_CLK_IIM_GATE>;
    };

...
```

## Documentation/devicetree/bindings/nvmem/imx-ocotp.txt
```
Freescale i.MX6 On-Chip OTP Controller (OCOTP) device tree bindings

This binding represents the on-chip eFuse OTP controller found on
i.MX6Q/D, i.MX6DL/S, i.MX6SL, i.MX6SX, i.MX6UL, i.MX6ULL/ULZ, i.MX6SLL,
i.MX7D/S, i.MX7ULP and i.MX8MQ SoCs.

Required properties:
- compatible: should be one of
	"fsl,imx6q-ocotp" (i.MX6Q/D/DL/S),
	"fsl,imx6sl-ocotp" (i.MX6SL), or
	"fsl,imx6sx-ocotp" (i.MX6SX),
	"fsl,imx6ul-ocotp" (i.MX6UL),
	"fsl,imx6ull-ocotp" (i.MX6ULL/ULZ),
	"fsl,imx7d-ocotp" (i.MX7D/S),
	"fsl,imx6sll-ocotp" (i.MX6SLL),
	"fsl,imx7ulp-ocotp" (i.MX7ULP),
	"fsl,imx8mq-ocotp" (i.MX8MQ),
	"fsl,imx8mm-ocotp" (i.MX8MM),
	followed by "syscon".
- #address-cells : Should be 1
- #size-cells : Should be 1
- reg: Should contain the register base and length.
- clocks: Should contain a phandle pointing to the gated peripheral clock.

Optional properties:
- read-only: disable write access

Optional Child nodes:

- Data cells of ocotp:
  Detailed bindings are described in bindings/nvmem/nvmem.txt

Example:
	ocotp: ocotp@21bc000 {
		#address-cells = <1>;
		#size-cells = <1>;
		compatible = "fsl,imx6sx-ocotp", "syscon";
		reg = <0x021bc000 0x4000>;
		clocks = <&clks IMX6SX_CLK_OCOTP>;

		tempmon_calib: calib@38 {
			reg = <0x38 4>;
		};

		tempmon_temp_grade: temp-grade@20 {
			reg = <0x20 4>;
		};
	};
```

## Documentation/devicetree/bindings/nvmem/imx-ocotp.yaml
```yaml
# SPDX-License-Identifier: (GPL-2.0 OR BSD-2-Clause)
%YAML 1.2
---
$id: http://devicetree.org/schemas/nvmem/imx-ocotp.yaml#
$schema: http://devicetree.org/meta-schemas/core.yaml#

title: Freescale i.MX On-Chip OTP Controller (OCOTP)

maintainers:
  - Anson Huang <Anson.Huang@nxp.com>

description: |
  This binding represents the on-chip eFuse OTP controller found on
  i.MX6Q/D, i.MX6DL/S, i.MX6SL, i.MX6SX, i.MX6UL, i.MX6ULL/ULZ, i.MX6SLL,
  i.MX7D/S, i.MX7ULP, i.MX8MQ, i.MX8MM, i.MX8MN i.MX8MP and i.MX93 SoCs.

allOf:
  - $ref: nvmem.yaml#

properties:
  compatible:
    oneOf:
      - items:
          - enum:
              - fsl,imx6q-ocotp
              - fsl,imx6sl-ocotp
              - fsl,imx6sx-ocotp
              - fsl,imx6ul-ocotp
              - fsl,imx6ull-ocotp
              - fsl,imx7d-ocotp
              - fsl,imx6sll-ocotp
              - fsl,imx7ulp-ocotp
              - fsl,imx8mq-ocotp
              - fsl,imx8mm-ocotp
              - fsl,imx93-ocotp
          - const: syscon
      - items:
          - enum:
              - fsl,imx8mn-ocotp
              # i.MX8MP not really compatible with fsl,imx8mm-ocotp, however
              # the code for getting SoC revision depends on fsl,imx8mm-ocotp
              # compatible.
              - fsl,imx8mp-ocotp
          - const: fsl,imx8mm-ocotp
          - const: syscon

  reg:
    maxItems: 1

  clocks:
    maxItems: 1

required:
  - "#address-cells"
  - "#size-cells"
  - compatible
  - reg

unevaluatedProperties: false

examples:
  - |
    #include <dt-bindings/clock/imx6sx-clock.h>

    ocotp: efuse@21bc000 {
        #address-cells = <1>;
        #size-cells = <1>;
        compatible = "fsl,imx6sx-ocotp", "syscon";
        reg = <0x021bc000 0x4000>;
        clocks = <&clks IMX6SX_CLK_OCOTP>;

        cpu_speed_grade: speed-grade@10 {
            reg = <0x10 4>;
        };

        tempmon_calib: calib@38 {
            reg = <0x38 4>;
        };

        tempmon_temp_grade: temp-grade@20 {
            reg = <0x20 4>;
        };
    };

...
```

## Documentation/devicetree/bindings/nvmem/ingenic,jz4780-efuse.yaml
```yaml
# SPDX-License-Identifier: GPL-2.0-only OR BSD-2-Clause
%YAML 1.2
---
$id: http://devicetree.org/schemas/nvmem/ingenic,jz4780-efuse.yaml#
$schema: http://devicetree.org/meta-schemas/core.yaml#

title: Ingenic JZ EFUSE driver bindings

maintainers:
  - PrasannaKumar Muralidharan <prasannatsmkumar@gmail.com>

allOf:
  - $ref: "nvmem.yaml#"

properties:
  compatible:
    enum:
      - ingenic,jz4780-efuse

  reg:
    maxItems: 1

  clocks:
    # Handle for the ahb for the efuse.
    maxItems: 1

required:
  - compatible
  - reg
  - clocks

unevaluatedProperties: false

examples:
  - |
    #include <dt-bindings/clock/ingenic,jz4780-cgu.h>

    efuse@134100d0 {
        compatible = "ingenic,jz4780-efuse";
        reg = <0x134100d0 0x2c>;

        clocks = <&cgu JZ4780_CLK_AHB2>;
    };

...
```

## Documentation/devicetree/bindings/nvmem/layouts/fixed-cell.yaml
```yaml
# SPDX-License-Identifier: (GPL-2.0-only OR BSD-2-Clause)
%YAML 1.2
---
$id: http://devicetree.org/schemas/nvmem/layouts/fixed-cell.yaml#
$schema: http://devicetree.org/meta-schemas/core.yaml#

title: Fixed offset & size NVMEM cell

maintainers:
  - Rafał Miłecki <rafal@milecki.pl>
  - Srinivas Kandagatla <srinivas.kandagatla@linaro.org>

properties:
  reg:
    maxItems: 1

  bits:
    $ref: /schemas/types.yaml#/definitions/uint32-array
    items:
      - minimum: 0
        maximum: 7
        description:
          Offset in bit within the address range specified by reg.
      - minimum: 1
        description:
          Size in bit within the address range specified by reg.

required:
  - reg

additionalProperties: true
```

## Documentation/devicetree/bindings/nvmem/layouts/fixed-layout.yaml
```yaml
# SPDX-License-Identifier: (GPL-2.0-only OR BSD-2-Clause)
%YAML 1.2
---
$id: http://devicetree.org/schemas/nvmem/layouts/fixed-layout.yaml#
$schema: http://devicetree.org/meta-schemas/core.yaml#

title: NVMEM layout for fixed NVMEM cells

description:
  Many NVMEM devices have hardcoded cells layout (offset and size of defined
  NVMEM content doesn't change).

  This binding allows defining such NVMEM layout with its cells. It can be used
  on top of any NVMEM device.

maintainers:
  - Rafał Miłecki <rafal@milecki.pl>

properties:
  compatible:
    const: fixed-layout

  "#address-cells":
    const: 1

  "#size-cells":
    const: 1

patternProperties:
  "@[a-f0-9]+$":
    type: object
    $ref: fixed-cell.yaml
    unevaluatedProperties: false

required:
  - compatible

additionalProperties: false

examples:
  - |
    nvmem-layout {
        compatible = "fixed-layout";
        #address-cells = <1>;
        #size-cells = <1>;

        mac@100 {
            compatible = "mac-base";
            reg = <0x100 0x6>;
            #nvmem-cell-cells = <1>;
        };

        mac@110 {
            compatible = "mac-base";
            reg = <0x110 0x11>;
            #nvmem-cell-cells = <1>;
        };

        calibration@4000 {
            reg = <0x4000 0x100>;
        };
    };
```

## Documentation/devicetree/bindings/nvmem/layouts/kontron,sl28-vpd.yaml
```yaml
# SPDX-License-Identifier: (GPL-2.0 OR BSD-2-Clause)
%YAML 1.2
---
$id: http://devicetree.org/schemas/nvmem/layouts/kontron,sl28-vpd.yaml#
$schema: http://devicetree.org/meta-schemas/core.yaml#

title: NVMEM layout of the Kontron SMARC-sAL28 vital product data

maintainers:
  - Michael Walle <michael@walle.cc>

description:
  The vital product data (VPD) of the sl28 boards contains a serial
  number and a base MAC address. The actual MAC addresses for the
  on-board ethernet devices are derived from this base MAC address by
  adding an offset.

select: false

properties:
  compatible:
    const: kontron,sl28-vpd

  serial-number:
    type: object
    description: The board's serial number

    additionalProperties: false

  base-mac-address:
    type: object
    description:
      Base MAC address for all on-module network interfaces. The first
      argument of the phandle will be treated as an offset.

    properties:
      "#nvmem-cell-cells":
        const: 1

    additionalProperties: false

required:
  - compatible

additionalProperties: false

examples:
  - |
      otp-1 {
          compatible = "user-otp";

          nvmem-layout {
              compatible = "kontron,sl28-vpd";

              serial_number: serial-number {
              };

              base_mac_address: base-mac-address {
                  #nvmem-cell-cells = <1>;
              };
          };
      };

...
```
