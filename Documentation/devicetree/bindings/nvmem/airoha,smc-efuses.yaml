## Documentation/devicetree/bindings/nvmem/airoha,smc-efuses.yaml
```yaml
# SPDX-License-Identifier: GPL-2.0-only OR BSD-2-Clause
%YAML 1.2
---
$id: http://devicetree.org/schemas/nvmem/airoha,smc-efuses.yaml#
$schema: http://devicetree.org/meta-schemas/core.yaml#

title: Airoha SMC eFuses

description: |
  Airoha new SoC AN7581 expose banks of eFuse accessible
  via specific SMC commands.

  2 different bank of eFuse or 64 cells of 32 bit are exposed
  read-only used to give information on HW Revision, PHY Calibration,
  Device Model, Private Key...

maintainers:
  - Christian Marangi <ansuelsmth@gmail.com>

properties:
  compatible:
    enum:
      - airoha,an7581-efuses

  "#address-cells":
    const: 1

  "#size-cells":
    const: 0

patternProperties:
  '^efuse-bank@[0-1]$':
    type: object

    allOf:
      - $ref: nvmem.yaml#

    properties:
      reg:
        description: Identify the eFuse bank.
        enum: [0, 1]

    required:
      - reg

    unevaluatedProperties: false

required:
  - compatible
  - '#address-cells'
  - '#size-cells'

additionalProperties: false

examples:
  - |
    efuse {
        compatible = "airoha,an7581-efuses";
        #address-cells = <1>;
        #size-cells = <0>;

        efuse-bank@0 {
           reg = <0>;
        };
    };

...
```

## Documentation/devicetree/bindings/nvmem/allwinner,sun4i-a10-sid.yaml
```yaml
# SPDX-License-Identifier: GPL-2.0
%YAML 1.2
---
$id: http://devicetree.org/schemas/nvmem/allwinner,sun4i-a10-sid.yaml#
$schema: http://devicetree.org/meta-schemas/core.yaml#

title: Allwinner A10 Security ID

maintainers:
  - Chen-Yu Tsai <wens@csie.org>
  - Maxime Ripard <mripard@kernel.org>

allOf:
  - $ref: "nvmem.yaml#"

properties:
  compatible:
    oneOf:
      - const: allwinner,sun4i-a10-sid
      - const: allwinner,sun7i-a20-sid
      - const: allwinner,sun8i-a83t-sid
      - const: allwinner,sun8i-h3-sid
      - const: allwinner,sun20i-d1-sid
      - const: allwinner,sun50i-a64-sid
      - items:
          - const: allwinner,sun50i-a100-sid
          - const: allwinner,sun50i-a64-sid
      - const: allwinner,sun50i-h5-sid
      - const: allwinner,sun50i-h6-sid

  reg:
    maxItems: 1

required:
  - compatible
  - reg

unevaluatedProperties: false

examples:
  - |
    efuse@1c23800 {
        compatible = "allwinner,sun4i-a10-sid";
        reg = <0x01c23800 0x10>;
    };

  - |
    efuse@1c23800 {
        compatible = "allwinner,sun7i-a20-sid";
        reg = <0x01c23800 0x200>;
    };

...
```

## Documentation/devicetree/bindings/nvmem/allwinner,sunxi-sid.txt
```
Allwinner sunxi-sid

Required properties:
- compatible: Should be one of the following:
  "allwinner,sun4i-a10-sid"
  "allwinner,sun7i-a20-sid"
  "allwinner,sun8i-a83t-sid"
  "allwinner,sun8i-h3-sid"
  "allwinner,sun50i-a64-sid"
  "allwinner,sun50i-h5-sid"

- reg: Should contain registers location and length

= Data cells =
Are child nodes of qfprom, bindings of which as described in
bindings/nvmem/nvmem.txt

Example for sun4i:
	sid@1c23800 {
		compatible = "allwinner,sun4i-a10-sid";
		reg = <0x01c23800 0x10>
	};

Example for sun7i:
	sid@1c23800 {
		compatible = "allwinner,sun7i-a20-sid";
		reg = <0x01c23800 0x200>
	};
```

## Documentation/devicetree/bindings/nvmem/amlogic,meson-gxbb-efuse.yaml
```yaml
# SPDX-License-Identifier: (GPL-2.0-only OR BSD-2-Clause)
%YAML 1.2
---
$id: http://devicetree.org/schemas/nvmem/amlogic,meson-gxbb-efuse.yaml#
$schema: http://devicetree.org/meta-schemas/core.yaml#

title: Amlogic Meson GX eFuse

maintainers:
  - Neil Armstrong <neil.armstrong@linaro.org>

allOf:
  - $ref: nvmem.yaml#
  - $ref: nvmem-deprecated-cells.yaml#

properties:
  compatible:
    oneOf:
      - const: amlogic,meson-gxbb-efuse
      - items:
          - const: amlogic,meson-gx-efuse
          - const: amlogic,meson-gxbb-efuse

  clocks:
    maxItems: 1

  secure-monitor:
    description: phandle to the secure-monitor node
    $ref: /schemas/types.yaml#/definitions/phandle

required:
  - compatible
  - clocks
  - secure-monitor

unevaluatedProperties: false

examples:
  - |
    efuse: efuse {
        compatible = "amlogic,meson-gxbb-efuse";
        clocks = <&clk_efuse>;
        #address-cells = <1>;
        #size-cells = <1>;
        secure-monitor = <&sm>;

        sn: sn@14 {
            reg = <0x14 0x10>;
        };

        eth_mac: mac@34 {
            reg = <0x34 0x10>;
        };

        bid: bid@46 {
            reg = <0x46 0x30>;
        };
    };
```

## Documentation/devicetree/bindings/nvmem/amlogic,meson6-efuse.yaml
```yaml
# SPDX-License-Identifier: (GPL-2.0-only OR BSD-2-Clause)
%YAML 1.2
---
$id: http://devicetree.org/schemas/nvmem/amlogic,meson6-efuse.yaml#
$schema: http://devicetree.org/meta-schemas/core.yaml#

title: Amlogic Meson6 eFuse

maintainers:
  - Neil Armstrong <neil.armstrong@linaro.org>
  - Martin Blumenstingl <martin.blumenstingl@googlemail.com>

allOf:
  - $ref: nvmem.yaml#
  - $ref: nvmem-deprecated-cells.yaml#

properties:
  compatible:
    enum:
      - amlogic,meson6-efuse
      - amlogic,meson8-efuse
      - amlogic,meson8b-efuse

  reg:
    maxItems: 1

  clocks:
    maxItems: 1

  clock-names:
    const: core

required:
  - compatible
  - reg
  - clocks
  - clock-names

unevaluatedProperties: false

examples:
  - |
    efuse: efuse@0 {
        compatible = "amlogic,meson6-efuse";
        reg = <0x0 0x2000>;
        clocks = <&clk_efuse>;
        clock-names = "core";
        #address-cells = <1>;
        #size-cells = <1>;

        ethernet_mac_address: mac@1b4 {
            reg = <0x1b4 0x6>;
        };

        temperature_calib: calib@1f4 {
             reg = <0x1f4 0x4>;
        };
    };
```

## Documentation/devicetree/bindings/nvmem/amlogic-efuse.txt
```
= Amlogic Meson GX eFuse device tree bindings =

Required properties:
- compatible: should be "amlogic,meson-gxbb-efuse"
- clocks: phandle to the efuse peripheral clock provided by the
	  clock controller.
- secure-monitor: phandle to the secure-monitor node

= Data cells =
Are child nodes of eFuse, bindings of which as described in
bindings/nvmem/nvmem.txt

Example:

	efuse: efuse {
		compatible = "amlogic,meson-gxbb-efuse";
		clocks = <&clkc CLKID_EFUSE>;
		#address-cells = <1>;
		#size-cells = <1>;
		secure-monitor = <&sm>;

		sn: sn@14 {
			reg = <0x14 0x10>;
		};

		eth_mac: eth_mac@34 {
			reg = <0x34 0x10>;
		};

		bid: bid@46 {
			reg = <0x46 0x30>;
		};
	};

	sm: secure-monitor {
		compatible = "amlogic,meson-gxbb-sm";
	};

= Data consumers =
Are device nodes which consume nvmem data cells.

For example:

	eth_mac {
		...
		nvmem-cells = <&eth_mac>;
		nvmem-cell-names = "eth_mac";
	};
```

## Documentation/devicetree/bindings/nvmem/amlogic-meson-mx-efuse.txt
```
Amlogic Meson6/Meson8/Meson8b efuse

Required Properties:
- compatible: depending on the SoC this should be one of:
	- "amlogic,meson6-efuse"
	- "amlogic,meson8-efuse"
	- "amlogic,meson8b-efuse"
- reg: base address and size of the efuse registers
- clocks: a reference to the efuse core gate clock
- clock-names: must be "core"

All properties and sub-nodes as well as the consumer bindings
defined in nvmem.txt in this directory are also supported.


Example:
	efuse: nvmem@0 {
		compatible = "amlogic,meson8-efuse";
		reg = <0x0 0x2000>;
		clocks = <&clkc CLKID_EFUSE>;
		clock-names = "core";
	};
```

## Documentation/devicetree/bindings/nvmem/apple,efuses.yaml
```yaml
# SPDX-License-Identifier: GPL-2.0-only OR BSD-2-Clause
%YAML 1.2
---
$id: http://devicetree.org/schemas/nvmem/apple,efuses.yaml#
$schema: http://devicetree.org/meta-schemas/core.yaml#

title: Apple SoC eFuse-based NVMEM

description: |
  Apple SoCs such as the M1 contain factory-programmed eFuses used to e.g. store
  calibration data for the PCIe and the Type-C PHY or unique chip identifiers
  such as the ECID.

maintainers:
  - Sven Peter <sven@svenpeter.dev>

allOf:
  - $ref: "nvmem.yaml#"

properties:
  compatible:
    items:
      - enum:
          - apple,t8103-efuses
          - apple,t6000-efuses
      - const: apple,efuses

  reg:
    maxItems: 1

required:
  - compatible
  - reg

unevaluatedProperties: false

examples:
  - |
    efuse@3d2bc000 {
        compatible = "apple,t8103-efuses", "apple,efuses";
        reg = <0x3d2bc000 0x1000>;
        #address-cells = <1>;
        #size-cells = <1>;

        ecid: efuse@500 {
            reg = <0x500 0x8>;
        };
    };

...
```

## Documentation/devicetree/bindings/nvmem/apple,spmi-nvmem.yaml
```yaml
# SPDX-License-Identifier: GPL-2.0-only OR BSD-2-Clause
%YAML 1.2
---
$id: http://devicetree.org/schemas/nvmem/apple,spmi-nvmem.yaml#
$schema: http://devicetree.org/meta-schemas/core.yaml#

title: Apple SPMI NVMEM

description: Exports a series of SPMI registers as NVMEM cells

maintainers:
  - Sasha Finkelstein <fnkl.kernel@gmail.com>

allOf:
  - $ref: nvmem.yaml#

properties:
  compatible:
    items:
      - enum:
          - apple,maverick-pmic
          - apple,sera-pmic
          - apple,stowe-pmic
      - const: apple,spmi-nvmem

  reg:
    maxItems: 1

required:
  - compatible
  - reg

unevaluatedProperties: false

examples:
  - |
    #include <dt-bindings/spmi/spmi.h>

    pmic@f {
        compatible = "apple,maverick-pmic", "apple,spmi-nvmem";
        reg = <0xf SPMI_USID>;

        nvmem-layout {
            compatible = "fixed-layout";
            #address-cells = <1>;
            #size-cells = <1>;

            boot_stage: boot-stage@6001 {
                reg = <0x6001 0x1>;
            };
        };
    };

...
```

## Documentation/devicetree/bindings/nvmem/brcm,nvram.yaml
```yaml
# SPDX-License-Identifier: (GPL-2.0-only OR BSD-2-Clause)
%YAML 1.2
---
$id: http://devicetree.org/schemas/nvmem/brcm,nvram.yaml#
$schema: http://devicetree.org/meta-schemas/core.yaml#

title: Broadcom's NVRAM

description: |
  Broadcom's NVRAM is a structure containing device specific environment
  variables. It is used for storing device configuration, booting parameters
  and calibration data.

  NVRAM can be accessed on Broadcom BCM47xx MIPS and Northstar ARM Cortex-A9
  devices usiong I/O mapped memory.

  NVRAM variables can be defined as NVMEM device subnodes.

maintainers:
  - Rafał Miłecki <rafal@milecki.pl>

allOf:
  - $ref: nvmem.yaml#

properties:
  compatible:
    const: brcm,nvram

  reg:
    maxItems: 1

  board_id:
    type: object
    description: Board identification name

  et0macaddr:
    type: object
    description: First Ethernet interface's MAC address
    properties:
      "#nvmem-cell-cells":
        description: The first argument is a MAC address offset.
        const: 1
    additionalProperties: false

  et1macaddr:
    type: object
    description: Second Ethernet interface's MAC address
    properties:
      "#nvmem-cell-cells":
        description: The first argument is a MAC address offset.
        const: 1
    additionalProperties: false

  et2macaddr:
    type: object
    description: Third Ethernet interface's MAC address
    properties:
      "#nvmem-cell-cells":
        description: The first argument is a MAC address offset.
        const: 1
    additionalProperties: false

unevaluatedProperties: false

examples:
  - |
    nvram@1eff0000 {
        compatible = "brcm,nvram";
        reg = <0x1eff0000 0x10000>;

        mac: et0macaddr {
        };
    };
```

## Documentation/devicetree/bindings/nvmem/brcm,ocotp.txt
```
Broadcom OTP memory controller

Required Properties:
- compatible: "brcm,ocotp" for the first generation Broadcom OTPC which is used
  in Cygnus and supports 32 bit read/write. Use "brcm,ocotp-v2" for the second
  generation Broadcom OTPC which is used in SoC's such as Stingray and supports
  64-bit read/write.
- reg: Base address of the OTP controller.
- brcm,ocotp-size: Amount of memory available, in 32 bit words

Example:

otp: otp@0301c800 {
	compatible = "brcm,ocotp";
	reg = <0x0301c800 0x2c>;
	brcm,ocotp-size = <2048>;
};
```

## Documentation/devicetree/bindings/nvmem/brcm,ocotp.yaml
```yaml
# SPDX-License-Identifier: (GPL-2.0-only OR BSD-2-Clause)
%YAML 1.2
---
$id: http://devicetree.org/schemas/nvmem/brcm,ocotp.yaml#
$schema: http://devicetree.org/meta-schemas/core.yaml#

title: Broadcom OTP memory controller

maintainers:
  - Ray Jui <rjui@broadcom.com>
  - Scott Branden <sbranden@broadcom.com>

properties:
  compatible:
    enum:
      - brcm,ocotp
      - brcm,ocotp-v2

  reg:
    maxItems: 1

  brcm,ocotp-size:
    description: Amount of memory available, in 32-bit words
    $ref: /schemas/types.yaml#/definitions/uint32

required:
  - compatible
  - reg
  - brcm,ocotp-size

additionalProperties: false

examples:
  - |
    otp@301c800 {
        compatible = "brcm,ocotp";
        reg = <0x0301c800 0x2c>;
        brcm,ocotp-size = <2048>;
    };
```

## Documentation/devicetree/bindings/nvmem/fsl,layerscape-sfp.yaml
```yaml
# SPDX-License-Identifier: (GPL-2.0-only OR BSD-2-Clause)
%YAML 1.2
---
$id: http://devicetree.org/schemas/nvmem/fsl,layerscape-sfp.yaml#
$schema: http://devicetree.org/meta-schemas/core.yaml#

title: Freescale Layerscape Security Fuse Processor

maintainers:
  - Michael Walle <michael@walle.cc>

description: |
  SFP is the security fuse processor which among other things provides a
  unique identifier per part.

allOf:
  - $ref: "nvmem.yaml#"

properties:
  compatible:
    oneOf:
      - description: Trust architecture 2.1 SFP
        items:
          - const: fsl,ls1021a-sfp
      - description: Trust architecture 3.0 SFP
        items:
          - const: fsl,ls1028a-sfp

  reg:
    maxItems: 1

  clocks:
    maxItems: 1
    description:
      The SFP clock. Typically, this is the platform clock divided by 4.

  clock-names:
    const: sfp

  ta-prog-sfp-supply:
    description:
      The regulator for the TA_PROG_SFP pin. It will be enabled for programming
      and disabled for reading.

required:
  - compatible
  - reg
  - clock-names
  - clocks

unevaluatedProperties: false

examples:
  - |
    #include <dt-bindings/clock/fsl,qoriq-clockgen.h>
    efuse@1e80000 {
        compatible = "fsl,ls1028a-sfp";
        reg = <0x1e80000 0x8000>;
        clocks = <&clockgen QORIQ_CLK_PLATFORM_PLL
                            QORIQ_CLK_PLL_DIV(4)>;
        clock-names = "sfp";
    };
```

## Documentation/devicetree/bindings/nvmem/fsl,scu-ocotp.yaml
```yaml
# SPDX-License-Identifier: (GPL-2.0-only OR BSD-2-Clause)
%YAML 1.2
---
$id: http://devicetree.org/schemas/nvmem/fsl,scu-ocotp.yaml#
$schema: http://devicetree.org/meta-schemas/core.yaml#

title: i.MX SCU Client Device Node - OCOTP Based on SCU Message Protocol

maintainers:
  - Dong Aisheng <aisheng.dong@nxp.com>

description: i.MX SCU Client Device Node
  Client nodes are maintained as children of the relevant IMX-SCU device node.

allOf:
  - $ref: nvmem.yaml#

properties:
  compatible:
    enum:
      - fsl,imx8qm-scu-ocotp
      - fsl,imx8qxp-scu-ocotp

patternProperties:
  '^mac@[0-9a-f]*$':
    type: object
    description:
      MAC address.

    properties:
      reg:
        description:
          Byte offset within OCOTP where the MAC address is stored
        maxItems: 1

    required:
      - reg

    additionalProperties: false

required:
  - compatible

unevaluatedProperties: false

examples:
  - |
    ocotp {
        compatible = "fsl,imx8qxp-scu-ocotp";
        #address-cells = <1>;
        #size-cells = <1>;

        fec_mac0: mac@2c4 {
            reg = <0x2c4 6>;
        };
    };
```
