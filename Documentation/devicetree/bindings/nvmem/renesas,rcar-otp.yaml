## Documentation/devicetree/bindings/nvmem/renesas,rcar-otp.yaml
```yaml
# SPDX-License-Identifier: (GPL-2.0-only OR BSD-2-Clause)
%YAML 1.2
---
$id: http://devicetree.org/schemas/nvmem/renesas,rcar-otp.yaml#
$schema: http://devicetree.org/meta-schemas/core.yaml#

title: R-Car E-FUSE connected to OTP_MEM

maintainers:
  - Geert Uytterhoeven <geert+renesas@glider.be>

description:
  The E-FUSE is a type of non-volatile memory, which is accessible through the
  One-Time Programmable Memory (OTP_MEM) module on some R-Car Gen4 SoCs.

allOf:
  - $ref: nvmem.yaml#

properties:
  compatible:
    enum:
      - renesas,r8a779g0-otp # R-CarV4H
      - renesas,r8a779h0-otp # R-CarV4M

  reg:
    items:
      - description: OTP_MEM_0
      - description: OTP_MEM_1.
          The addresses of cells defined under the optional nvmem-layout
          subnode are relative to this register bank.

required:
  - compatible
  - reg

unevaluatedProperties: false

examples:
  - |
    otp@e61be000 {
        compatible = "renesas,r8a779g0-otp";
        reg = <0xe61be000 0x1000>, <0xe61bf000 0x1000>;
    };
```

## Documentation/devicetree/bindings/nvmem/rmem.yaml
```yaml
# SPDX-License-Identifier: (GPL-2.0-only OR BSD-2-Clause)
%YAML 1.2
---
$id: http://devicetree.org/schemas/nvmem/rmem.yaml#
$schema: http://devicetree.org/meta-schemas/core.yaml#

title: Reserved Memory Based nvmem Device

maintainers:
  - Nicolas Saenz Julienne <nsaenzjulienne@suse.de>

allOf:
  - $ref: nvmem.yaml#

properties:
  compatible:
    items:
      - enum:
          - mobileye,eyeq5-bootloader-config
          - raspberrypi,bootloader-config
          - raspberrypi,bootloader-public-key
      - const: nvmem-rmem

  reg:
    maxItems: 1

  no-map:
    $ref: /schemas/types.yaml#/definitions/flag
    description:
      Avoid creating a virtual mapping of the region as part of the OS'
      standard mapping of system memory.

required:
  - compatible
  - no-map

unevaluatedProperties: false

examples:
  - |
        reserved-memory {
                #address-cells = <1>;
                #size-cells = <1>;

                blconfig: nvram@10000000 {
                        compatible = "raspberrypi,bootloader-config", "nvmem-rmem";
                        #address-cells = <1>;
                        #size-cells = <1>;
                        reg = <0x10000000 0x1000>;
                        no-map;
                };
        };

...
```

## Documentation/devicetree/bindings/nvmem/rockchip,otp.yaml
```yaml
# SPDX-License-Identifier: (GPL-2.0 OR BSD-2-Clause)
%YAML 1.2
---
$id: http://devicetree.org/schemas/nvmem/rockchip,otp.yaml#
$schema: http://devicetree.org/meta-schemas/core.yaml#

title: Rockchip internal OTP (One Time Programmable) memory

maintainers:
  - Heiko Stuebner <heiko@sntech.de>

properties:
  compatible:
    enum:
      - rockchip,px30-otp
      - rockchip,rk3308-otp
      - rockchip,rk3588-otp

  reg:
    maxItems: 1

  clocks:
    minItems: 3
    maxItems: 4

  clock-names:
    minItems: 3
    items:
      - const: otp
      - const: apb_pclk
      - const: phy
      - const: arb

  resets:
    minItems: 1
    maxItems: 3

  reset-names:
    minItems: 1
    maxItems: 3

required:
  - compatible
  - reg
  - clocks
  - clock-names
  - resets
  - reset-names

allOf:
  - $ref: nvmem.yaml#

  - if:
      properties:
        compatible:
          contains:
            enum:
              - rockchip,px30-otp
              - rockchip,rk3308-otp
    then:
      properties:
        clocks:
          maxItems: 3
        resets:
          maxItems: 1
        reset-names:
          items:
            - const: phy

  - if:
      properties:
        compatible:
          contains:
            enum:
              - rockchip,rk3588-otp
    then:
      properties:
        clocks:
          minItems: 4
        resets:
          minItems: 3
        reset-names:
          items:
            - const: otp
            - const: apb
            - const: arb

unevaluatedProperties: false

examples:
  - |
    #include <dt-bindings/clock/px30-cru.h>

    soc {
        #address-cells = <2>;
        #size-cells = <2>;

        otp: efuse@ff290000 {
            compatible = "rockchip,px30-otp";
            reg = <0x0 0xff290000 0x0 0x4000>;
            clocks = <&cru SCLK_OTP_USR>, <&cru PCLK_OTP_NS>,
                     <&cru PCLK_OTP_PHY>;
            clock-names = "otp", "apb_pclk", "phy";
            resets = <&cru SRST_OTP_PHY>;
            reset-names = "phy";
            #address-cells = <1>;
            #size-cells = <1>;

            cpu_id: id@7 {
                reg = <0x07 0x10>;
            };

            cpu_leakage: cpu-leakage@17 {
                reg = <0x17 0x1>;
            };

            performance: performance@1e {
                reg = <0x1e 0x1>;
                bits = <4 3>;
            };
        };
    };
```

## Documentation/devicetree/bindings/nvmem/rockchip-efuse.txt
```
= Rockchip eFuse device tree bindings =

Required properties:
- compatible: Should be one of the following.
  - "rockchip,rk3066a-efuse" - for RK3066a SoCs.
  - "rockchip,rk3188-efuse" - for RK3188 SoCs.
  - "rockchip,rk3228-efuse" - for RK3228 SoCs.
  - "rockchip,rk3288-efuse" - for RK3288 SoCs.
  - "rockchip,rk3328-efuse" - for RK3328 SoCs.
  - "rockchip,rk3368-efuse" - for RK3368 SoCs.
  - "rockchip,rk3399-efuse" - for RK3399 SoCs.
- reg: Should contain the registers location and exact eFuse size
- clocks: Should be the clock id of eFuse
- clock-names: Should be "pclk_efuse"

Optional properties:
- rockchip,efuse-size: Should be exact eFuse size in byte, the eFuse
  size in property <reg> will be invalid if define this property.

Deprecated properties:
- compatible: "rockchip,rockchip-efuse"
  Old efuse compatible value compatible to rk3066a, rk3188 and rk3288
  efuses

= Data cells =
Are child nodes of eFuse, bindings of which as described in
bindings/nvmem/nvmem.txt

Example:

	efuse: efuse@ffb40000 {
		compatible = "rockchip,rk3288-efuse";
		reg = <0xffb40000 0x20>;
		#address-cells = <1>;
		#size-cells = <1>;
		clocks = <&cru PCLK_EFUSE256>;
		clock-names = "pclk_efuse";

		/* Data cells */
		cpu_leakage: cpu_leakage {
			reg = <0x17 0x1>;
		};
	};

= Data consumers =
Are device nodes which consume nvmem data cells.

Example:

	cpu_leakage {
		...
		nvmem-cells = <&cpu_leakage>;
		nvmem-cell-names = "cpu_leakage";
	};
```

## Documentation/devicetree/bindings/nvmem/rockchip-efuse.yaml
```yaml
# SPDX-License-Identifier: GPL-2.0-or-later OR BSD-2-Clause
%YAML 1.2
---
$id: http://devicetree.org/schemas/nvmem/rockchip-efuse.yaml#
$schema: http://devicetree.org/meta-schemas/core.yaml#

title: Rockchip eFuse device tree bindings

maintainers:
  - Heiko Stuebner <heiko@sntech.de>

allOf:
  - $ref: "nvmem.yaml#"

properties:
  compatible:
    enum:
      - rockchip,rk3066a-efuse
      - rockchip,rk3188-efuse
      - rockchip,rk3228-efuse
      - rockchip,rk3288-efuse
      - rockchip,rk3328-efuse
      - rockchip,rk3368-efuse
      - rockchip,rk3399-efuse

      # Deprecated: old compatible value for rk3066a, rk3188 and rk3288
      - rockchip,rockchip-efuse

  reg:
    description:
      Registers location and eFuse size.
    maxItems: 1

  clocks:
    description:
      eFuse clock id.
    maxItems: 1

  clock-names:
    const: pclk_efuse

  rockchip,efuse-size:
    description:
      eFuse size in bytes. The eFuse size in property <reg> will be invalid if
      this property is defined.
    $ref: /schemas/types.yaml#/definitions/uint32

required:
  - compatible
  - reg
  - clocks
  - clock-names

unevaluatedProperties: false

examples:
  - |
    #include <dt-bindings/clock/rk3288-cru.h>
    efuse: efuse@ffb40000 {
            compatible = "rockchip,rk3288-efuse";
            reg = <0xffb40000 0x20>;
            #address-cells = <1>;
            #size-cells = <1>;
            clocks = <&cru PCLK_EFUSE256>;
            clock-names = "pclk_efuse";

            /* Data cells */
            cpu_leakage: cpu_leakage@17 {
                    reg = <0x17 0x1>;
            };
    };
...
```

## Documentation/devicetree/bindings/nvmem/rockchip-otp.txt
```
Rockchip internal OTP (One Time Programmable) memory device tree bindings

Required properties:
- compatible: Should be one of the following.
  - "rockchip,px30-otp" - for PX30 SoCs.
  - "rockchip,rk3308-otp" - for RK3308 SoCs.
- reg: Should contain the registers location and size
- clocks: Must contain an entry for each entry in clock-names.
- clock-names: Should be "otp", "apb_pclk" and "phy".
- resets: Must contain an entry for each entry in reset-names.
  See ../../reset/reset.txt for details.
- reset-names: Should be "phy".

See nvmem.txt for more information.

Example:
	otp: otp@ff290000 {
		compatible = "rockchip,px30-otp";
		reg = <0x0 0xff290000 0x0 0x4000>;
		#address-cells = <1>;
		#size-cells = <1>;
		clocks = <&cru SCLK_OTP_USR>, <&cru PCLK_OTP_NS>,
			 <&cru PCLK_OTP_PHY>;
		clock-names = "otp", "apb_pclk", "phy";
	};
```

## Documentation/devicetree/bindings/nvmem/rockchip-secure-otp.yaml
```yaml
# SPDX-License-Identifier: (GPL-2.0-only OR BSD-2-Clause)
%YAML 1.2
---
$id: http://devicetree.org/schemas/nvmem/rockchip-secure-otp.yaml#
$schema: http://devicetree.org/meta-schemas/core.yaml#

title: Rockchip secure otp device tree bindings

maintainers:
  - Hisping <hisping.lin@rock-chips.com>

allOf:
  - $ref: "nvmem.yaml#"

properties:
  compatible:
    enum:
      - rockchip,secure-otp

  rockchip,otp-size:
    description:
      size of non-protected oem zone in secure otp, In bytes.
    $ref: /schemas/types.yaml#/definitions/uint32

required:
  - compatible
  - rockchip,otp-size

unevaluatedProperties: false

examples:
  - |
    secure_otp: secure-otp {
            compatible = "rockchip,secure-otp";
            rockchip,otp-size = <32>;
    };
...
```

## Documentation/devicetree/bindings/nvmem/sc27xx-efuse.txt
```
= Spreadtrum SC27XX PMIC eFuse device tree bindings =

Required properties:
- compatible: Should be one of the following.
	"sprd,sc2720-efuse"
	"sprd,sc2721-efuse"
	"sprd,sc2723-efuse"
	"sprd,sc2730-efuse"
	"sprd,sc2731-efuse"
- reg: Specify the address offset of efuse controller.
- hwlocks: Reference to a phandle of a hwlock provider node.

= Data cells =
Are child nodes of eFuse, bindings of which as described in
bindings/nvmem/nvmem.txt

Example:

	sc2731_pmic: pmic@0 {
		compatible = "sprd,sc2731";
		reg = <0>;
		spi-max-frequency = <26000000>;
		interrupts = <GIC_SPI 31 IRQ_TYPE_LEVEL_HIGH>;
		interrupt-controller;
		#interrupt-cells = <2>;
		#address-cells = <1>;
		#size-cells = <0>;

		efuse@380 {
			compatible = "sprd,sc2731-efuse";
			reg = <0x380>;
			#address-cells = <1>;
			#size-cells = <1>;
			hwlocks = <&hwlock 12>;

			/* Data cells */
			thermal_calib: calib@10 {
				reg = <0x10 0x2>;
			};
		};
	};

= Data consumers =
Are device nodes which consume nvmem data cells.

Example:

	thermal {
		...
		nvmem-cells = <&thermal_calib>;
		nvmem-cell-names = "calibration";
	};
```

## Documentation/devicetree/bindings/nvmem/snvs-lpgpr.txt
```
Device tree bindings for Low Power General Purpose Register found in i.MX6Q/D
and i.MX7 Secure Non-Volatile Storage.

This DT node should be represented as a sub-node of a "syscon",
"simple-mfd" node.

Required properties:
- compatible: should be one of the fallowing variants:
	"fsl,imx6q-snvs-lpgpr" for Freescale i.MX6Q/D/DL/S
	"fsl,imx6ul-snvs-lpgpr" for Freescale i.MX6UL
	"fsl,imx7d-snvs-lpgpr" for Freescale i.MX7D/S

Example:
snvs: snvs@020cc000 {
	compatible = "fsl,sec-v4.0-mon", "syscon", "simple-mfd";
	reg = <0x020cc000 0x4000>;

	snvs_lpgpr: snvs-lpgpr {
		compatible = "fsl,imx6q-snvs-lpgpr";
	};
};
```

## Documentation/devicetree/bindings/nvmem/snvs-lpgpr.yaml
```yaml
# SPDX-License-Identifier: (GPL-2.0-only OR BSD-2-Clause)
%YAML 1.2
---
$id: http://devicetree.org/schemas/nvmem/snvs-lpgpr.yaml#
$schema: http://devicetree.org/meta-schemas/core.yaml#

title: Low Power General Purpose Register found in i.MX Secure Non-Volatile Storage

maintainers:
  - Oleksij Rempel <o.rempel@pengutronix.de>

properties:
  compatible:
    enum:
      - fsl,imx6q-snvs-lpgpr
      - fsl,imx6ul-snvs-lpgpr
      - fsl,imx7d-snvs-lpgpr
      - fsl,imx8mm-snvs-lpgpr
      - fsl,imx8mn-snvs-lpgpr
      - fsl,imx8mp-snvs-lpgpr
      - fsl,imx8mq-snvs-lpgpr

required:
  - compatible

additionalProperties: false

examples:
  - |
    snvs@20cc000 {
        compatible = "fsl,sec-v4.0-mon", "syscon", "simple-mfd";
        reg = <0x20cc000 0x4000>;

        snvs_lpgpr: snvs-lpgpr {
            compatible = "fsl,imx6q-snvs-lpgpr";
        };
    };
```

## Documentation/devicetree/bindings/nvmem/socionext,uniphier-efuse.yaml
```yaml
# SPDX-License-Identifier: (GPL-2.0-only OR BSD-2-Clause)
%YAML 1.2
---
$id: http://devicetree.org/schemas/nvmem/socionext,uniphier-efuse.yaml#
$schema: http://devicetree.org/meta-schemas/core.yaml#

title: Socionext UniPhier eFuse bindings

maintainers:
  - Keiji Hayashibara <hayashibara.keiji@socionext.com>
  - Kunihiko Hayashi <hayashi.kunihiko@socionext.com>

allOf:
  - $ref: "nvmem.yaml#"

properties:
  "#address-cells": true
  "#size-cells": true

  compatible:
    const: socionext,uniphier-efuse

  reg:
    maxItems: 1

required:
  - compatible
  - reg

unevaluatedProperties: false

examples:
  - |
    // The UniPhier eFuse should be a subnode of a "soc-glue" node.

    soc-glue@5f900000 {
        compatible = "simple-mfd";
        #address-cells = <1>;
        #size-cells = <1>;
        ranges = <0x0 0x5f900000 0x2000>;

        efuse@100 {
            compatible = "socionext,uniphier-efuse";
            reg = <0x100 0x28>;
        };

        efuse@200 {
            compatible = "socionext,uniphier-efuse";
            reg = <0x200 0x68>;
            #address-cells = <1>;
            #size-cells = <1>;

            /* Data cells */
            usb_rterm0: trim@54,4 {
                reg = <0x54 1>;
                bits = <4 2>;
            };
            usb_rterm1: trim@55,4 {
                reg = <0x55 1>;
                bits = <4 2>;
            };
            usb_rterm2: trim@58,4 {
                reg = <0x58 1>;
                bits = <4 2>;
            };
            usb_rterm3: trim@59,4 {
                reg = <0x59 1>;
                bits = <4 2>;
            };
            usb_sel_t0: trim@54,0 {
                reg = <0x54 1>;
                bits = <0 4>;
            };
            usb_sel_t1: trim@55,0 {
                reg = <0x55 1>;
                bits = <0 4>;
            };
            usb_sel_t2: trim@58,0 {
                reg = <0x58 1>;
                bits = <0 4>;
            };
            usb_sel_t3: trim@59,0 {
                reg = <0x59 1>;
                bits = <0 4>;
            };
            usb_hs_i0: trim@56,0 {
                reg = <0x56 1>;
                bits = <0 4>;
            };
            usb_hs_i2: trim@5a,0 {
                reg = <0x5a 1>;
                bits = <0 4>;
            };
        };
    };
```

## Documentation/devicetree/bindings/nvmem/sprd,sc2731-efuse.yaml
```yaml
# SPDX-License-Identifier: GPL-2.0-only OR BSD-2-Clause
%YAML 1.2
---
$id: http://devicetree.org/schemas/nvmem/sprd,sc2731-efuse.yaml#
$schema: http://devicetree.org/meta-schemas/core.yaml#

title: Spreadtrum SC27XX PMIC eFuse

maintainers:
  - Orson Zhai <orsonzhai@gmail.com>
  - Baolin Wang <baolin.wang7@gmail.com>
  - Chunyan Zhang <zhang.lyra@gmail.com>

properties:
  compatible:
    enum:
      - sprd,sc2720-efuse
      - sprd,sc2721-efuse
      - sprd,sc2723-efuse
      - sprd,sc2730-efuse
      - sprd,sc2731-efuse

  reg:
    maxItems: 1

  hwlocks:
    maxItems: 1

required:
  - compatible
  - reg
  - hwlocks

allOf:
  - $ref: nvmem.yaml#
  - $ref: nvmem-deprecated-cells.yaml#

unevaluatedProperties: false
...
```
