## Documentation/devicetree/bindings/nvmem/sprd,ums312-efuse.yaml
```yaml
# SPDX-License-Identifier: GPL-2.0-only OR BSD-2-Clause
%YAML 1.2
---
$id: http://devicetree.org/schemas/nvmem/sprd,ums312-efuse.yaml#
$schema: http://devicetree.org/meta-schemas/core.yaml#

title: Spreadtrum UMS312 eFuse

maintainers:
  - Orson Zhai <orsonzhai@gmail.com>
  - Baolin Wang <baolin.wang7@gmail.com>
  - Chunyan Zhang <zhang.lyra@gmail.com>

properties:
  compatible:
    const: sprd,ums312-efuse

  reg:
    maxItems: 1

  clocks:
    maxItems: 1

  clock-names:
    const: enable

  hwlocks:
    maxItems: 1

required:
  - compatible
  - reg
  - clocks
  - clock-names
  - hwlocks

allOf:
  - $ref: nvmem.yaml#
  - $ref: nvmem-deprecated-cells.yaml#

unevaluatedProperties: false

examples:
  - |
    #include <dt-bindings/clock/sprd,ums512-clk.h>

    efuse@32240000 {
      compatible = "sprd,ums312-efuse";
      reg = <0x32240000 0x10000>;
      clocks = <&aonapb_gate CLK_EFUSE_EB>;
      clock-names = "enable";
      hwlocks = <&hwlock 8>;
      #address-cells = <1>;
      #size-cells = <1>;

      /* Data cells */
      thermal_calib: calib@10 {
        reg = <0x10 0x2>;
      };
    };
...
```

## Documentation/devicetree/bindings/nvmem/sprd-efuse.txt
```
= Spreadtrum eFuse device tree bindings =

Required properties:
- compatible: Should be "sprd,ums312-efuse".
- reg: Specify the address offset of efuse controller.
- clock-names: Should be "enable".
- clocks: The phandle and specifier referencing the controller's clock.
- hwlocks: Reference to a phandle of a hwlock provider node.

= Data cells =
Are child nodes of eFuse, bindings of which as described in
bindings/nvmem/nvmem.txt

Example:

	ap_efuse: efuse@32240000 {
		compatible = "sprd,ums312-efuse";
		reg = <0 0x32240000 0 0x10000>;
		clock-names = "enable";
		hwlocks = <&hwlock 8>;
		clocks = <&aonapb_gate CLK_EFUSE_EB>;

		/* Data cells */
		thermal_calib: calib@10 {
			reg = <0x10 0x2>;
		};
	};

= Data consumers =
Are device nodes which consume nvmem data cells.

Example:

	thermal {
		...

		nvmem-cells = <&thermal_calib>;
		nvmem-cell-names = "calibration";
	};
```

## Documentation/devicetree/bindings/nvmem/st,stm32-romem.txt
```
STMicroelectronics STM32 Factory-programmed data device tree bindings

This represents STM32 Factory-programmed read only non-volatile area: locked
flash, OTP, read-only HW regs... This contains various information such as:
analog calibration data for temperature sensor (e.g. TS_CAL1, TS_CAL2),
internal vref (VREFIN_CAL), unique device ID...

Required properties:
- compatible:		Should be one of:
			"st,stm32f4-otp"
			"st,stm32mp15-bsec"
- reg:			Offset and length of factory-programmed area.
- #address-cells:	Should be '<1>'.
- #size-cells:		Should be '<1>'.

Optional Data cells:
- Must be child nodes as described in nvmem.txt.

Example on stm32f4:
	romem: nvmem@1fff7800 {
		compatible = "st,stm32f4-otp";
		reg = <0x1fff7800 0x400>;
		#address-cells = <1>;
		#size-cells = <1>;

		/* Data cells: ts_cal1 at 0x1fff7a2c */
		ts_cal1: calib@22c {
			reg = <0x22c 0x2>;
		};
		...
	};
```

## Documentation/devicetree/bindings/nvmem/st,stm32-romem.yaml
```yaml
# SPDX-License-Identifier: (GPL-2.0-only OR BSD-2-Clause)
%YAML 1.2
---
$id: http://devicetree.org/schemas/nvmem/st,stm32-romem.yaml#
$schema: http://devicetree.org/meta-schemas/core.yaml#

title: STMicroelectronics STM32 Factory-programmed data bindings

description: |
  This represents STM32 Factory-programmed read only non-volatile area: locked
  flash, OTP, read-only HW regs... This contains various information such as:
  analog calibration data for temperature sensor (e.g. TS_CAL1, TS_CAL2),
  internal vref (VREFIN_CAL), unique device ID...

maintainers:
  - Fabrice Gasnier <fabrice.gasnier@st.com>

allOf:
  - $ref: "nvmem.yaml#"

properties:
  compatible:
    enum:
      - st,stm32f4-otp
      - st,stm32mp15-bsec

patternProperties:
  "^.*@[0-9a-f]+$":
    type: object

    properties:
      st,non-secure-otp:
        description: |
          This property explicits a factory programmed area that both secure
          and non-secure worlds can access. It is needed when, by default, the
          related area can only be reached by the secure world.
        type: boolean

required:
  - "#address-cells"
  - "#size-cells"
  - compatible
  - reg

examples:
  - |
    efuse@1fff7800 {
      compatible = "st,stm32f4-otp";
      reg = <0x1fff7800 0x400>;
      #address-cells = <1>;
      #size-cells = <1>;

      calib@22c {
        reg = <0x22c 0x2>;
      };

      mac_addr@e4 {
        reg = <0xe4 0x8>;
        st,non-secure-otp;
      };
    };

...
```

## Documentation/devicetree/bindings/nvmem/sunplus,sp7021-ocotp.yaml
```yaml
# SPDX-License-Identifier: (GPL-2.0-only OR BSD-2-Clause)
# Copyright (C) Sunplus Co., Ltd. 2021
%YAML 1.2
---
$id: http://devicetree.org/schemas/nvmem/sunplus,sp7021-ocotp.yaml#
$schema: http://devicetree.org/meta-schemas/core.yaml#

title: On-Chip OTP Memory for Sunplus SP7021

maintainers:
  - Vincent Shih <vincent.sunplus@gmail.com>

allOf:
  - $ref: nvmem.yaml#
  - $ref: nvmem-deprecated-cells.yaml#

properties:
  compatible:
    const: sunplus,sp7021-ocotp

  reg:
    maxItems: 2

  reg-names:
    items:
      - const: hb_gpio
      - const: otprx

  clocks:
    maxItems: 1

  thermal-calibration:
    type: object
    description: thermal calibration values

  disconnect-voltage:
    type: object
    description: disconnect voltages of usb2 port 0 and port 1

  mac-address0:
    type: object
    description: MAC address of ethernet port 0

  mac-address1:
    type: object
    description: MAC address of ethernet port 1

required:
  - compatible
  - reg
  - reg-names
  - clocks

unevaluatedProperties: false

examples:
  - |
    otp: otp@9c00af00 {
        compatible = "sunplus,sp7021-ocotp";
        reg = <0x9c00af00 0x34>, <0x9c00af80 0x58>;
        reg-names = "hb_gpio", "otprx";
        clocks = <&clkc 0x15>;

        #address-cells = <1>;
        #size-cells = <1>;
        therm_calib: thermal-calibration@14 {
          reg = <0x14 0x3>;
        };
        disc_vol: disconnect-voltage@18 {
          reg = <0x18 0x2>;
        };
        mac_addr0: mac-address0@34 {
          reg = <0x34 0x6>;
        };
        mac_addr1: mac-address1@3a {
          reg = <0x3a 0x6>;
        };
    };
...
```

## Documentation/devicetree/bindings/nvmem/u-boot,env.yaml
```yaml
# SPDX-License-Identifier: GPL-2.0-only OR BSD-2-Clause
%YAML 1.2
---
$id: http://devicetree.org/schemas/nvmem/u-boot,env.yaml#
$schema: http://devicetree.org/meta-schemas/core.yaml#

title: U-Boot environment variables

description: |
  U-Boot uses environment variables to store device parameters and
  configuration. They may be used for booting process, setup or keeping end user
  info.

  Data is stored using U-Boot specific formats (variant specific header and NUL
  separated key-value pairs).

  Environment data can be stored on various storage entities, e.g.:
  1. Raw flash partition
  2. UBI volume

  This binding allows marking storage device (as containing env data) and
  specifying used format.

  Right now only flash partition case is covered but it may be extended to e.g.
  UBI volumes in the future.

  Variables can be defined as NVMEM device subnodes.

maintainers:
  - Rafał Miłecki <rafal@milecki.pl>

properties:
  compatible:
    oneOf:
      - description: A standalone env data block
        const: u-boot,env
      - description: Two redundant blocks with active one flagged
        const: u-boot,env-redundant-bool
      - description: Two redundant blocks with active having higher counter
        const: u-boot,env-redundant-count
      - description: Broadcom's variant with custom header
        const: brcm,env

  reg:
    maxItems: 1

  bootcmd:
    type: object
    description: Command to use for automatic booting

  ethaddr:
    type: object
    description: Ethernet interfaces base MAC address.
    properties:
      "#nvmem-cell-cells":
        description: The first argument is a MAC address offset.
        const: 1

additionalProperties: false

examples:
  - |
    partitions {
        compatible = "fixed-partitions";
        #address-cells = <1>;
        #size-cells = <1>;

        partition@0 {
            reg = <0x0 0x40000>;
            label = "u-boot";
            read-only;
        };

        env: partition@40000 {
            compatible = "u-boot,env";
            reg = <0x40000 0x10000>;

            mac: ethaddr {
                #nvmem-cell-cells = <1>;
            };
        };
    };
  - |
    partitions {
        compatible = "fixed-partitions";
        #address-cells = <1>;
        #size-cells = <1>;

        partition@0 {
            reg = <0x0 0x100000>;
            compatible = "brcm,u-boot";
            label = "u-boot";

            partition-u-boot-env {
                compatible = "brcm,env";

                ethaddr {
                };
            };
        };
    };
```

## Documentation/devicetree/bindings/nvmem/uniphier-efuse.txt
```
= UniPhier eFuse device tree bindings =

This UniPhier eFuse must be under soc-glue.

Required properties:
- compatible: should be "socionext,uniphier-efuse"
- reg: should contain the register location and length

= Data cells =
Are child nodes of efuse, bindings of which as described in
bindings/nvmem/nvmem.txt

Example:

	soc-glue@5f900000 {
		compatible = "socionext,uniphier-ld20-soc-glue-debug",
			     "simple-mfd";
		#address-cells = <1>;
		#size-cells = <1>;
		ranges = <0x0 0x5f900000 0x2000>;

		efuse@100 {
			compatible = "socionext,uniphier-efuse";
			reg = <0x100 0x28>;
		};

		efuse@200 {
			compatible = "socionext,uniphier-efuse";
			reg = <0x200 0x68>;
			#address-cells = <1>;
			#size-cells = <1>;

			/* Data cells */
			usb_mon: usb-mon@54 {
				reg = <0x54 0xc>;
			};
		};
	};

= Data consumers =
Are device nodes which consume nvmem data cells.

Example:

	usb {
		...
		nvmem-cells = <&usb_mon>;
		nvmem-cell-names = "usb_mon";
	}
```

## Documentation/devicetree/bindings/nvmem/vf610-ocotp.txt
```
On-Chip OTP Memory for Freescale Vybrid

Required Properties:
  compatible:
  - "fsl,vf610-ocotp" for VF5xx/VF6xx
  #address-cells : Should be 1
  #size-cells : Should be 1
  reg : Address and length of OTP controller and fuse map registers
  clocks : ipg clock we associate with the OCOTP peripheral

Example for Vybrid VF5xx/VF6xx:

	ocotp: ocotp@400a5000 {
		compatible = "fsl,vf610-ocotp";
		#address-cells = <1>;
		#size-cells = <1>;
		reg = <0x400a5000 0xCF0>;
		clocks = <&clks VF610_CLK_OCOTP>;
	};
```

## Documentation/devicetree/bindings/nvmem/xlnx,zynqmp-nvmem.txt
```
--------------------------------------------------------------------------
=  Zynq UltraScale+ MPSoC nvmem firmware driver binding =
--------------------------------------------------------------------------
The nvmem_firmware node provides access to the hardware related data
like soc revision, IDCODE... etc, By using the firmware interface.

Required properties:
- compatible: should be "xlnx,zynqmp-nvmem-fw"

= Data cells =
Are child nodes of silicon id, bindings of which as described in
bindings/nvmem/nvmem.txt

-------
 Example
-------
firmware {
	zynqmp_firmware: zynqmp-firmware {
		compatible = "xlnx,zynqmp-firmware";
		method = "smc";

		nvmem_firmware {
			compatible = "xlnx,zynqmp-nvmem-fw";
			#address-cells = <1>;
			#size-cells = <1>;

			/* Data cells */
			soc_revision: soc_revision {
				reg = <0x0 0x4>;
			};
		};
	};
};

= Data consumers =
Are device nodes which consume nvmem data cells.

For example:
	pcap {
		...

		nvmem-cells = <&soc_revision>;
		nvmem-cell-names = "soc_revision";

		...
	};
```

## Documentation/devicetree/bindings/nvmem/xlnx,zynqmp-nvmem.yaml
```yaml
# SPDX-License-Identifier: (GPL-2.0-only OR BSD-2-Clause)
%YAML 1.2
---
$id: http://devicetree.org/schemas/nvmem/xlnx,zynqmp-nvmem.yaml#
$schema: http://devicetree.org/meta-schemas/core.yaml#

title: Zynq UltraScale+ MPSoC Non Volatile Memory interface

description: |
    The ZynqMP MPSoC provides access to the hardware related data
    like SOC revision, IDCODE and specific purpose efuses.

maintainers:
  - Kalyani Akula <kalyani.akula@amd.com>
  - Praveen Teja Kundanala <praveen.teja.kundanala@amd.com>

allOf:
  - $ref: nvmem.yaml#

properties:
  compatible:
    const: xlnx,zynqmp-nvmem-fw

required:
  - compatible

unevaluatedProperties: false

examples:
  - |
    nvmem {
        compatible = "xlnx,zynqmp-nvmem-fw";
        nvmem-layout {
            compatible = "fixed-layout";
            #address-cells = <1>;
            #size-cells = <1>;

            soc_revision: soc-revision@0 {
                reg = <0x0 0x4>;
            };
        };
    };
```

## Documentation/devicetree/bindings/nvmem/zii,rave-sp-eeprom.txt
```
Zodiac Inflight Innovations RAVE EEPROM Bindings

RAVE SP EEPROM device is a "MFD cell" device exposing physical EEPROM
attached to RAVE Supervisory Processor. It is expected that its Device
Tree node is specified as a child of the node corresponding to the
parent RAVE SP device (as documented in
Documentation/devicetree/bindings/mfd/zii,rave-sp.txt)

Required properties:

- compatible: Should be "zii,rave-sp-eeprom"

Optional properties:

- zii,eeprom-name: Unique EEPROM identifier describing its function in the
  system. Will be used as created NVMEM deivce's name.

Data cells:

Data cells are child nodes of eerpom node, bindings for which are
documented in Documentation/devicetree/bindings/nvmem/nvmem.txt

Example:

	rave-sp {
		compatible = "zii,rave-sp-rdu1";
		current-speed = <38400>;

		eeprom@a4 {
			compatible = "zii,rave-sp-eeprom";
			reg = <0xa4 0x4000>;
			#address-cells = <1>;
			#size-cells = <1>;
			zii,eeprom-name = "main-eeprom";

			wdt_timeout: wdt-timeout@81 {
				reg = <0x81 2>;
			};
		};
	}
```

## Documentation/devicetree/bindings/nvmem/zii,rave-sp-eeprom.yaml
```yaml
# SPDX-License-Identifier: (GPL-2.0-only OR BSD-2-Clause)
%YAML 1.2
---
$id: http://devicetree.org/schemas/nvmem/zii,rave-sp-eeprom.yaml#
$schema: http://devicetree.org/meta-schemas/core.yaml#

title: Zodiac Inflight Innovations RAVE EEPROM

maintainers:
  - Frank Li <Frank.Li@nxp.com>

description:
  RAVE SP EEPROM device is a "MFD cell" device exposing physical EEPROM
  attached to RAVE Supervisory Processor. It is expected that its Device
  Tree node is specified as a child of the node corresponding to the
  parent RAVE SP device (as documented in
  Documentation/devicetree/bindings/mfd/zii,rave-sp.yaml)

properties:
  compatible:
    const: zii,rave-sp-eeprom

  reg:
    maxItems: 1

  zii,eeprom-name:
    $ref: /schemas/types.yaml#/definitions/string
    description:
      Unique EEPROM identifier describing its function in the
      system. Will be used as created NVMEM deivce's name.

required:
  - compatible

allOf:
  - $ref: nvmem.yaml#
  - $ref: nvmem-deprecated-cells.yaml#

unevaluatedProperties: false

examples:
  - |
    eeprom@a4 {
        compatible = "zii,rave-sp-eeprom";
        reg = <0xa4 0x4000>;
        #address-cells = <1>;
        #size-cells = <1>;
        zii,eeprom-name = "main-eeprom";

        wdt-timeout@81 {
            reg = <0x81 2>;
        };
    };
```
