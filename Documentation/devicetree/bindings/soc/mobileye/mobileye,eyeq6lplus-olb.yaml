## Documentation/devicetree/bindings/soc/qcom/qcom,apr-services.yaml
```yaml
# SPDX-License-Identifier: GPL-2.0 OR BSD-2-Clause
%YAML 1.2
---
$id: http://devicetree.org/schemas/soc/qcom/qcom,apr-services.yaml#
$schema: http://devicetree.org/meta-schemas/core.yaml#

title: Qualcomm APR/GPR services shared parts

maintainers:
  - Srinivas Kandagatla <srinivas.kandagatla@linaro.org>

description:
  Common parts of a static service in Qualcomm APR/GPR (Asynchronous/Generic
  Packet Router).

properties:
  reg:
    minimum: 1
    maximum: 13
    description: |
      APR Service ID
        3 = DSP Core Service
        4 = Audio  Front End Service.
        5 = Voice Stream Manager Service.
        6 = Voice processing manager.
        7 = Audio Stream Manager Service.
        8 = Audio Device Manager Service.
        9 = Multimode voice manager.
        10 = Core voice stream.
        11 = Core voice processor.
        12 = Ultrasound stream manager.
        13 = Listen stream manager.
      GPR Service ID
        1 = Audio Process Manager Service
        2 = Proxy Resource Manager Service.
        3 = AMDB Service.
        4 = Voice processing manager.

  qcom,protection-domain:
    $ref: /schemas/types.yaml#/definitions/string-array
    description: |
      Protection domain service name and path for APR service (if supported).
      Possible values are::
      "avs/audio", "msm/adsp/audio_pd".
      "kernel/elf_loader", "msm/modem/wlan_pd".
      "tms/servreg", "msm/adsp/audio_pd".
      "tms/servreg", "msm/modem/wlan_pd".
      "tms/servreg", "msm/slpi/sensor_pd".

required:
  - reg

additionalProperties: true
```

## Documentation/devicetree/bindings/soc/qcom/qcom,apr.txt
```
Qualcomm APR (Asynchronous Packet Router) binding

This binding describes the Qualcomm APR. APR is a IPC protocol for
communication between Application processor and QDSP. APR is mainly
used for audio/voice services on the QDSP.

- compatible:
	Usage: required
	Value type: <stringlist>
	Definition: must be "qcom,apr-v<VERSION-NUMBER>", example "qcom,apr-v2"

- qcom,apr-domain
	Usage: required
	Value type: <u32>
	Definition: Destination processor ID.
	Possible values are :
			1 - APR simulator
			2 - PC
			3 - MODEM
			4 - ADSP
			5 - APPS
			6 - MODEM2
			7 - APPS2

= APR SERVICES
Each subnode of the APR node represents service tied to this apr. The name
of the nodes are not important. The properties of these nodes are defined
by the individual bindings for the specific service
- All APR services MUST contain the following property:

- reg
	Usage: required
	Value type: <u32>
	Definition: APR Service ID
	Possible values are :
			3 - DSP Core Service
			4 - Audio Front End Service.
			5 - Voice Stream Manager Service.
			6 - Voice processing manager.
			7 - Audio Stream Manager Service.
			8 - Audio Device Manager Service.
			9 - Multimode voice manager.
			10 - Core voice stream.
			11 - Core voice processor.
			12 - Ultrasound stream manager.
			13 - Listen stream manager.

- qcom,protection-domain
	Usage: optional
	Value type: <stringlist>
	Definition: Must list the protection domain service name and path
		    that the particular apr service has a dependency on.
	Possible values are :
			"avs/audio", "msm/adsp/audio_pd".
			"kernel/elf_loader", "msm/modem/wlan_pd".
			"tms/servreg", "msm/adsp/audio_pd".
			"tms/servreg", "msm/modem/wlan_pd".
			"tms/servreg", "msm/slpi/sensor_pd".

= EXAMPLE
The following example represents a QDSP based sound card on a MSM8996 device
which uses apr as communication between Apps and QDSP.

	apr {
		compatible = "qcom,apr-v2";
		qcom,apr-domain = <APR_DOMAIN_ADSP>;

		apr-service@3 {
			compatible = "qcom,q6core";
			reg = <APR_SVC_ADSP_CORE>;
		};

		apr-service@4 {
			compatible = "qcom,q6afe";
			reg = <APR_SVC_AFE>;

			dais {
				#sound-dai-cells = <1>;
				dai@1 {
					reg = <HDMI_RX>;
				};
			};
		};

		apr-service@7 {
			compatible = "qcom,q6asm";
			reg = <APR_SVC_ASM>;
			...
		};

		apr-service@8 {
			compatible = "qcom,q6adm";
			reg = <APR_SVC_ADM>;
			...
		};
	};

= EXAMPLE 2
The following example represents a QDSP based sound card with protection domain
dependencies specified. Here some of the apr services are dependent on services
running on protection domain hosted on ADSP/SLPI remote processors while others
have no such dependency.

	apr {
		compatible = "qcom,apr-v2";
		qcom,glink-channels = "apr_audio_svc";
		qcom,apr-domain = <APR_DOMAIN_ADSP>;

		apr-service@3 {
			compatible = "qcom,q6core";
			reg = <APR_SVC_ADSP_CORE>;
		};

		q6afe: apr-service@4 {
			compatible = "qcom,q6afe";
			reg = <APR_SVC_AFE>;
			qcom,protection-domain = "avs/audio", "msm/adsp/audio_pd";
			...
		};

		q6asm: apr-service@7 {
			compatible = "qcom,q6asm";
			reg = <APR_SVC_ASM>;
			qcom,protection-domain = "tms/servreg", "msm/slpi/sensor_pd";
			...
		};

		q6adm: apr-service@8 {
			compatible = "qcom,q6adm";
			reg = <APR_SVC_ADM>;
			qcom,protection-domain = "avs/audio", "msm/adsp/audio_pd";
			...
		};
	};
```

## Documentation/devicetree/bindings/soc/qcom/qcom,apr.yaml
```yaml
# SPDX-License-Identifier: (GPL-2.0 OR BSD-2-Clause)
%YAML 1.2
---
$id: "http://devicetree.org/schemas/soc/qcom/qcom,apr.yaml#"
$schema: "http://devicetree.org/meta-schemas/core.yaml#"

title: Qualcomm APR/GPR (Asynchronous/Generic Packet Router) binding

maintainers:
  - Srinivas Kandagatla <srinivas.kandagatla@linaro.org>

description: |
  This binding describes the Qualcomm APR/GPR, APR/GPR is a IPC protocol for
  communication between Application processor and QDSP. APR/GPR is mainly
  used for audio/voice services on the QDSP.

properties:
  compatible:
    enum:
      - qcom,apr-v2
      - qcom,gpr

  power-domains:
    maxItems: 1

  qcom,apr-domain:
    $ref: /schemas/types.yaml#/definitions/uint32
    enum: [1, 2, 3, 4, 5, 6, 7]
    description:
      Selects the processor domain for apr
        1 = APR simulator
        2 = PC Domain
        3 = Modem Domain
        4 = ADSP Domain
        5 = Application processor Domain
        6 = Modem2 Domain
        7 = Application Processor2 Domain
    deprecated: true

  qcom,domain:
    $ref: /schemas/types.yaml#/definitions/uint32
    minimum: 1
    maximum: 7
    description:
      Selects the processor domain for apr
        1 = APR simulator
        2 = PC Domain
        3 = Modem Domain
        4 = ADSP Domain
        5 = Application processor Domain
        6 = Modem2 Domain
        7 = Application Processor2 Domain
      Selects the processor domain for gpr
        1 = Modem Domain
        2 = Audio DSP Domain
        3 = Application Processor Domain

  qcom,glink-channels:
    $ref: /schemas/types.yaml#/definitions/string-array
    description: Channel name used for the communication
    items:
      - const: apr_audio_svc

  qcom,intents:
    $ref: /schemas/types.yaml#/definitions/uint32-array
    description:
      List of (size, amount) pairs describing what intents should be
      preallocated for this virtual channel. This can be used to tweak the
      default intents available for the channel to meet expectations of the
      remote.

  qcom,smd-channels:
    $ref: /schemas/types.yaml#/definitions/string-array
    description: Channel name used for the communication
    items:
      - const: apr_audio_svc

  '#address-cells':
    const: 1

  '#size-cells':
    const: 0

#APR/GPR Services
patternProperties:
  "^service@[1-9a-d]$":
    type: object
    description:
      APR/GPR node's client devices use subnodes for desired static port services.

    properties:
      compatible:
        enum:
          - qcom,q6core
          - qcom,q6asm
          - qcom,q6afe
          - qcom,q6adm
          - qcom,q6apm
          - qcom,q6prm

      reg:
        minimum: 1
        maximum: 13
        description:
          APR Service ID
            3 = DSP Core Service
            4 = Audio  Front End Service.
            5 = Voice Stream Manager Service.
            6 = Voice processing manager.
            7 = Audio Stream Manager Service.
            8 = Audio Device Manager Service.
            9 = Multimode voice manager.
            10 = Core voice stream.
            11 = Core voice processor.
            12 = Ultrasound stream manager.
            13 = Listen stream manager.
          GPR Service ID
            1 = Audio Process Manager Service
            2 = Proxy Resource Manager Service.
            3 = AMDB Service.
            4 = Voice processing manager.

      clock-controller:
        $ref: /schemas/sound/qcom,q6dsp-lpass-clocks.yaml#
        description: Qualcomm DSP LPASS clock controller
        unevaluatedProperties: false

      dais:
        type: object
        oneOf:
          - $ref: /schemas/sound/qcom,q6apm-dai.yaml#
          - $ref: /schemas/sound/qcom,q6dsp-lpass-ports.yaml#
          - $ref: /schemas/sound/qcom,q6asm-dais.yaml#
        unevaluatedProperties: false
        description: Qualcomm DSP audio ports

      routing:
        type: object
        $ref: /schemas/sound/qcom,q6adm-routing.yaml#
        unevaluatedProperties: false
        description: Qualcomm DSP LPASS audio routing

      qcom,protection-domain:
        $ref: /schemas/types.yaml#/definitions/string-array
        description: protection domain service name and path for apr service
          possible values are
          "avs/audio", "msm/adsp/audio_pd".
          "kernel/elf_loader", "msm/modem/wlan_pd".
          "tms/servreg", "msm/adsp/audio_pd".
          "tms/servreg", "msm/modem/wlan_pd".
          "tms/servreg", "msm/slpi/sensor_pd".

    allOf:
      - if:
          properties:
            compatible:
              enum:
                - qcom,q6afe
        then:
          properties:
            dais:
              properties:
                compatible:
                  const: qcom,q6afe-dais

      - if:
          properties:
            compatible:
              enum:
                - qcom,q6apm
        then:
          properties:
            dais:
              properties:
                compatible:
                  enum:
                    - qcom,q6apm-dais
                    - qcom,q6apm-lpass-dais

      - if:
          properties:
            compatible:
              enum:
                - qcom,q6asm
        then:
          properties:
            dais:
              properties:
                compatible:
                  const: qcom,q6asm-dais

    additionalProperties: false

required:
  - compatible
  - qcom,domain

allOf:
  - if:
      properties:
        compatible:
          enum:
            - qcom,gpr
    then:
      properties:
        power-domains: false

  - if:
      required:
        - qcom,glink-channels
    then:
      properties:
        qcom,smd-channels: false

  - if:
      required:
        - qcom,smd-channels
    then:
      properties:
        qcom,glink-channels: false

additionalProperties: false

examples:
  - |
    #include <dt-bindings/soc/qcom,apr.h>
    apr {
        compatible = "qcom,apr-v2";
        qcom,domain = <APR_DOMAIN_ADSP>;
        #address-cells = <1>;
        #size-cells = <0>;

        q6core: service@3 {
          compatible = "qcom,q6core";
          reg = <APR_SVC_ADSP_CORE>;
          qcom,protection-domain = "avs/audio", "msm/adsp/audio_pd";
        };

        q6afe: service@4 {
          compatible = "qcom,q6afe";
          reg = <APR_SVC_AFE>;
          qcom,protection-domain = "avs/audio", "msm/adsp/audio_pd";
        };

        q6asm: service@7 {
          compatible = "qcom,q6asm";
          reg = <APR_SVC_ASM>;
          qcom,protection-domain = "avs/audio", "msm/adsp/audio_pd";
        };

        q6adm: service@8 {
          compatible = "qcom,q6adm";
          reg = <APR_SVC_ADM>;
          qcom,protection-domain = "avs/audio", "msm/adsp/audio_pd";
        };
    };

  - |
    #include <dt-bindings/soc/qcom,gpr.h>
    gpr {
        compatible = "qcom,gpr";
        qcom,domain = <GPR_DOMAIN_ID_ADSP>;
        #address-cells = <1>;
        #size-cells = <0>;

        service@1 {
          compatible = "qcom,q6apm";
          reg = <GPR_APM_MODULE_IID>;
          qcom,protection-domain = "avs/audio", "msm/adsp/audio_pd";
        };
    };
```

## Documentation/devicetree/bindings/soc/qcom/qcom,dcc.yaml
```yaml
# SPDX-License-Identifier: (GPL-2.0-or-later OR BSD-2-Clause)
%YAML 1.2
---
$id: http://devicetree.org/schemas/soc/qcom/qcom,dcc.yaml#
$schema: http://devicetree.org/meta-schemas/core.yaml#

title: Data Capture and Compare

maintainers:
  - Souradeep Chowdhury <quic_schowdhu@quicinc.com>

description: |
    DCC (Data Capture and Compare) is a DMA engine which is used to save
    configuration data or system memory contents during catastrophic failure
    or SW trigger. DCC is used to capture and store data for debugging purpose

properties:
  compatible:
    items:
      - enum:
          - qcom,sm8150-dcc
          - qcom,sc7280-dcc
          - qcom,sc7180-dcc
          - qcom,sdm845-dcc
      - const: qcom,dcc

  reg:
    items:
      - description: DCC base
      - description: DCC RAM base

required:
  - compatible
  - reg

additionalProperties: false

examples:
  - |
    dma@10a2000{
        compatible = "qcom,sm8150-dcc", "qcom,dcc";
        reg = <0x010a2000 0x1000>,
              <0x010ad000 0x2000>;
    };
```

## Documentation/devicetree/bindings/soc/qcom/qcom,eud.yaml
```yaml
# SPDX-License-Identifier: (GPL-2.0 OR BSD-2-Clause)
%YAML 1.2
---
$id: "http://devicetree.org/schemas/soc/qcom/qcom,eud.yaml#"
$schema: "http://devicetree.org/meta-schemas/core.yaml#"

title: Qualcomm Embedded USB Debugger

maintainers:
  - Souradeep Chowdhury <quic_schowdhu@quicinc.com>

description:
  This binding is used to describe the Qualcomm Embedded USB Debugger, which is
  mini USB-hub implemented on chip to support USB-based debug capabilities.

properties:
  compatible:
    items:
      - enum:
          - qcom,sc7280-eud
      - const: qcom,eud

  reg:
    items:
      - description: EUD Base Register Region
      - description: EUD Mode Manager Register

  interrupts:
    description: EUD interrupt
    maxItems: 1

  ports:
    $ref: /schemas/graph.yaml#/properties/ports
    description:
      These ports is to be attached to the endpoint of the DWC3 controller node
      and type C connector node. The controller has the "usb-role-switch"
      property.

    properties:
      port@0:
        $ref: /schemas/graph.yaml#/properties/port
        description: This port is to be attached to the DWC3 controller.

      port@1:
        $ref: /schemas/graph.yaml#/properties/port
        description: This port is to be attached to the type C connector.

required:
  - compatible
  - reg
  - ports

additionalProperties: false

examples:
  - |
    eud@88e0000 {
           compatible = "qcom,sc7280-eud","qcom,eud";
           reg = <0x88e0000 0x2000>,
                 <0x88e2000 0x1000>;
           ports {
                   #address-cells = <1>;
                   #size-cells = <0>;
                   port@0 {
                           reg = <0>;
                           eud_ep: endpoint {
                                   remote-endpoint = <&usb2_role_switch>;
                           };
                   };
                   port@1 {
                           reg = <1>;
                           eud_con: endpoint {
                                   remote-endpoint = <&con_eud>;
                           };
                   };
           };
    };
```
