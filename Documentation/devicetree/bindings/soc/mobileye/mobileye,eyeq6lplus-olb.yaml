## Documentation/devicetree/bindings/soc/qcom/qcom,gsbi.yaml
```yaml
# SPDX-License-Identifier: GPL-2.0 OR BSD-2-Clause
%YAML 1.2
---
$id: http://devicetree.org/schemas/soc/qcom/qcom,gsbi.yaml#
$schema: http://devicetree.org/meta-schemas/core.yaml#

title: Qualcomm General Serial Bus Interface (GSBI)

maintainers:
  - Andy Gross <agross@kernel.org>
  - Bjorn Andersson <bjorn.andersson@linaro.org>
  - Krzysztof Kozlowski <krzysztof.kozlowski@linaro.org>

description:
  The GSBI controller is modeled as a node with zero or more child nodes, each
  representing a serial sub-node device that is mux'd as part of the GSBI
  configuration settings.  The mode setting will govern the input/output mode
  of the 4 GSBI IOs.

  A GSBI controller node can contain 0 or more child nodes representing serial
  devices.  These serial devices can be a QCOM UART, I2C controller, spi
  controller, or some combination of aforementioned devices.

properties:
  compatible:
    const: qcom,gsbi-v1.0.0

  '#address-cells':
    const: 1

  cell-index:
    $ref: /schemas/types.yaml#/definitions/uint32
    description:
      The GSBI index.

  clocks:
    maxItems: 1

  clock-names:
    const: iface

  qcom,crci:
    $ref: /schemas/types.yaml#/definitions/uint32
    description:
      CRCI MUX value for QUP CRCI ports.  Please reference
      include/dt-bindings/soc/qcom,gsbi.h for valid CRCI mux values.

  qcom,mode:
    $ref: /schemas/types.yaml#/definitions/uint32
    description:
      MUX value for configuration of the serial interface.  Please reference
      include/dt-bindings/soc/qcom,gsbi.h for valid mux values.

  '#size-cells':
    const: 1

  syscon-tcsr:
    $ref: /schemas/types.yaml#/definitions/phandle
    description:
      Phandle of TCSR syscon node.Required if child uses dma.

  ranges: true

  reg:
    maxItems: 1

patternProperties:
  "spi@[0-9a-f]+$":
    type: object
    $ref: /schemas/spi/qcom,spi-qup.yaml#

  "i2c@[0-9a-f]+$":
    type: object
    $ref: /schemas/i2c/qcom,i2c-qup.yaml#

  "serial@[0-9a-f]+$":
    type: object
    $ref: /schemas/serial/qcom,msm-uartdm.yaml#

required:
  - compatible
  - cell-index
  - clocks
  - clock-names
  - qcom,mode
  - reg

additionalProperties: false

examples:
  - |
    #include <dt-bindings/clock/qcom,gcc-msm8960.h>
    #include <dt-bindings/interrupt-controller/arm-gic.h>
    #include <dt-bindings/soc/qcom,gsbi.h>

    gsbi@12440000 {
        compatible = "qcom,gsbi-v1.0.0";
        reg = <0x12440000 0x100>;
        cell-index = <1>;
        clocks = <&gcc GSBI1_H_CLK>;
        clock-names = "iface";
        #address-cells = <1>;
        #size-cells = <1>;
        ranges;

        syscon-tcsr = <&tcsr>;
        qcom,mode = <GSBI_PROT_I2C_UART>;

        serial@12450000 {
            compatible = "qcom,msm-uartdm-v1.3", "qcom,msm-uartdm";
            reg = <0x12450000 0x100>,
                  <0x12400000 0x03>;
            interrupts = <0 193 IRQ_TYPE_LEVEL_HIGH>;
            clocks = <&gcc GSBI1_UART_CLK>, <&gcc GSBI1_H_CLK>;
            clock-names = "core", "iface";
        };

        i2c@12460000 {
            compatible = "qcom,i2c-qup-v1.1.1";
            reg = <0x12460000 0x1000>;
            pinctrl-0 = <&i2c1_pins>;
            pinctrl-1 = <&i2c1_pins_sleep>;
            pinctrl-names = "default", "sleep";
            interrupts = <0 194 IRQ_TYPE_LEVEL_HIGH>;
            clocks = <&gcc GSBI1_QUP_CLK>, <&gcc GSBI1_H_CLK>;
            clock-names = "core", "iface";
            #address-cells = <1>;
            #size-cells = <0>;

            status = "disabled"; /* UART chosen */
        };
    };
```

## Documentation/devicetree/bindings/soc/qcom/qcom,memshare.yaml
```yaml
# SPDX-License-Identifier: (GPL-2.0 OR BSD-2-Clause)
%YAML 1.2
---
$id: "http://devicetree.org/schemas/soc/qcom/qcom,memshare.yaml#"
$schema: "http://devicetree.org/meta-schemas/core.yaml#"

title: Qualcomm QMI Shared Memory Service

description: |
  This driver provides a QMI service that allows remote processors (like modem)
  to request additional memory. It is used for applications like GPS in modem.

maintainers:
  - Nikita Travkin <nikitos.tr@gmail.com>

properties:
  compatible:
    const: qcom,memshare

  qcom,legacy-client:
    $ref: /schemas/types.yaml#/definitions/phandle
    description: Phandle to a memshare client node used for legacy requests.

  "#address-cells":
    const: 1

  "#size-cells":
    const: 0

patternProperties:
  "^.*@[0-9]+$":
    type: object

    properties:
      reg:
        description: Proc-ID for clients in this node.

      qcom,qrtr-node:
        $ref: /schemas/types.yaml#/definitions/uint32
        description: Node from which the requests are expected.

      "#address-cells":
        const: 1

      "#size-cells":
        const: 0

    patternProperties:
      "^.*@[0-9]+$":
        type: object

        properties:
          reg:
            description: ID of this client.

          memory-region:
            $ref: /schemas/types.yaml#/definitions/phandle
            description: |
              Reserved memory region that should be used for allocation.

        required:
          - reg

    required:
      - reg
      - qcom,qrtr-node

required:
  - compatible

additionalProperties: false

examples:
  - |
    #include <dt-bindings/soc/qcom,memshare.h>

    reserved-memory {

      #address-cells = <2>;
      #size-cells = <2>;

      gps_mem: gps@93c00000 {
        reg = <0x0 0x93c00000 0x0 0x200000>;
        no-map;
      };
    };

    memshare {
      compatible = "qcom,memshare";
      qcom,legacy-client = <&memshare_gps>;

      #address-cells = <1>;
      #size-cells = <0>;

      mpss@0 {
        reg = <MEMSHARE_PROC_MPSS_V01>;
        qcom,qrtr-node = <0>;

        #address-cells = <1>;
        #size-cells = <0>;

        memshare_gps: gps@0 {
          reg = <0>;
          memory-region = <&gps_mem>;
        };
      };
    };

...
```

## Documentation/devicetree/bindings/soc/qcom/qcom,msm8976-ramp-controller.yaml
```yaml
# SPDX-License-Identifier: (GPL-2.0 OR BSD-2-Clause)
%YAML 1.2
---
$id: http://devicetree.org/schemas/soc/qcom/qcom,msm8976-ramp-controller.yaml#
$schema: http://devicetree.org/meta-schemas/core.yaml#

title: Qualcomm Ramp Controller

maintainers:
  - AngeloGioacchino Del Regno <angelogioacchino.delregno@collabora.com>

description:
  The Ramp Controller is used to program the sequence ID for pulse
  swallowing, enable sequences and link Sequence IDs (SIDs) for the
  CPU cores on some Qualcomm SoCs.

properties:
  compatible:
    enum:
      - qcom,msm8976-ramp-controller

  reg:
    maxItems: 1

required:
  - compatible
  - reg

additionalProperties: false

examples:
  - |
    cpu-power-controller@b014000 {
        compatible = "qcom,msm8976-ramp-controller";
        reg = <0x0b014000 0x68>;
    };
```

## Documentation/devicetree/bindings/soc/qcom/qcom,pbs.yaml
```yaml
# SPDX-License-Identifier: (GPL-2.0-only OR BSD-2-Clause)
%YAML 1.2
---
$id: http://devicetree.org/schemas/soc/qcom/qcom,pbs.yaml#
$schema: http://devicetree.org/meta-schemas/core.yaml#

title: Qualcomm Technologies, Inc. Programmable Boot Sequencer

maintainers:
  - Anjelique Melendez <quic_amelende@quicinc.com>

description: |
  The Qualcomm Technologies, Inc. Programmable Boot Sequencer (PBS)
  supports triggering power up and power down sequences for clients
  upon request.

properties:
  compatible:
    items:
      - enum:
          - qcom,pmi632-pbs
      - const: qcom,pbs

  reg:
    maxItems: 1

required:
  - compatible
  - reg

additionalProperties: false

examples:
  - |
    #include <dt-bindings/spmi/spmi.h>

    pmic@0 {
      reg = <0x0 SPMI_USID>;
      #address-cells = <1>;
      #size-cells = <0>;

      pbs@7400 {
        compatible = "qcom,pmi632-pbs", "qcom,pbs";
        reg = <0x7400>;
      };
    };
```

## Documentation/devicetree/bindings/soc/qcom/qcom,pmic-glink.yaml
```yaml
# SPDX-License-Identifier: (GPL-2.0-only OR BSD-2-Clause)
%YAML 1.2
---
$id: http://devicetree.org/schemas/soc/qcom/qcom,pmic-glink.yaml#
$schema: http://devicetree.org/meta-schemas/core.yaml#

title: Qualcomm PMIC GLINK firmware interface for battery management, USB
  Type-C and other things.

maintainers:
  - Bjorn Andersson <andersson@kernel.org>

description:
  The PMIC GLINK service, running on a coprocessor on some modern Qualcomm
  platforms and implement USB Type-C handling and battery management. This
  binding describes the component in the OS used to communicate with the
  firmware and connect it's resources to those described in the Devicetree,
  particularly the USB Type-C controllers relationship with USB and DisplayPort
  components.

properties:
  compatible:
    oneOf:
      - items:
          - enum:
              - qcom,qcm6490-pmic-glink
              - qcom,sc8180x-pmic-glink
              - qcom,sc8280xp-pmic-glink
              - qcom,sm8350-pmic-glink
              - qcom,sm8450-pmic-glink
              - qcom,sm8550-pmic-glink
          - const: qcom,pmic-glink
      - items:
          - enum:
              - qcom,sm8650-pmic-glink
              - qcom,x1e80100-pmic-glink
          - const: qcom,sm8550-pmic-glink
          - const: qcom,pmic-glink

  '#address-cells':
    const: 1

  '#size-cells':
    const: 0

  orientation-gpios:
    description: Array of input gpios for the Type-C connector orientation indication.
      The GPIO indication is used to detect the orientation of the Type-C connector.
      The array should contain a gpio entry for each PMIC Glink connector, in reg order.
      It is defined that GPIO active level means "CC2" or Reversed/Flipped orientation.

patternProperties:
  '^connector@\d$':
    $ref: /schemas/connector/usb-connector.yaml#
    required:
      - reg

required:
  - compatible

additionalProperties: false

examples:
  - |+
    pmic-glink {
        compatible = "qcom,sc8280xp-pmic-glink", "qcom,pmic-glink";

        #address-cells = <1>;
        #size-cells = <0>;

        connector@0 {
            compatible = "usb-c-connector";
            reg = <0>;
            power-role = "dual";
            data-role = "dual";

            ports {
                #address-cells = <1>;
                #size-cells = <0>;

                port@0 {
                    reg = <0>;
                    endpoint {
                        remote-endpoint = <&usb_role>;
                    };
                };

                port@1 {
                    reg = <1>;
                    endpoint {
                        remote-endpoint = <&ss_phy_out>;
                    };
                };

                port@2 {
                    reg = <2>;
                    endpoint {
                        remote-endpoint = <&sbu_mux>;
                    };
                };
            };
        };
    };
...
```

## Documentation/devicetree/bindings/soc/qcom/qcom,rpm-master-stats.yaml
```yaml
# SPDX-License-Identifier: (GPL-2.0-only OR BSD-2-Clause)
%YAML 1.2
---
$id: http://devicetree.org/schemas/soc/qcom/qcom,rpm-master-stats.yaml#
$schema: http://devicetree.org/meta-schemas/core.yaml#

title: Qualcomm Technologies, Inc. (QTI) RPM Master Stats

maintainers:
  - Konrad Dybcio <konrad.dybcio@linaro.org>

description: |
  The Qualcomm RPM (Resource Power Manager) architecture includes a concept
  of "RPM Masters". They can be thought of as "the local gang leaders", usually
  spanning a single subsystem (e.g. APSS, ADSP, CDSP). All of the RPM decisions
  (particularly around entering hardware-driven low power modes: XO shutdown
  and total system-wide power collapse) are first made at Master-level, and
  only then aggregated for the entire system.

  The Master Stats provide a few useful bits that can be used to assess whether
  our device has entered the desired low-power mode, how long it took to do so,
  the duration of that residence, how long it took to come back online,
  how many times a given sleep state was entered and which cores are actively
  voting for staying awake.

  This scheme has been used on various SoCs in the 2013-2023 era, with some
  newer or higher-end designs providing this information through an SMEM query.

properties:
  compatible:
    const: qcom,rpm-master-stats

  qcom,rpm-msg-ram:
    $ref: /schemas/types.yaml#/definitions/phandle-array
    description: Phandle to an RPM MSG RAM slice containing the master stats
    minItems: 1
    maxItems: 5
    items:
      maxItems: 1

  qcom,master-names:
    $ref: /schemas/types.yaml#/definitions/string-array
    description:
      The name of the RPM Master which owns the MSG RAM slice where this
      instance of Master Stats resides
    minItems: 1
    maxItems: 5

required:
  - compatible
  - qcom,rpm-msg-ram
  - qcom,master-names

additionalProperties: false

examples:
  - |
    stats {
      compatible = "qcom,rpm-master-stats";
      qcom,rpm-msg-ram = <&apss_master_stats>,
                         <&mpss_master_stats>,
                         <&adsp_master_stats>,
                         <&cdsp_master_stats>,
                         <&tz_master_stats>;
      qcom,master-names = "APSS",
                          "MPSS",
                          "ADSP",
                          "CDSP",
                          "TZ";
    };
...
```
