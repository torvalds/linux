## Documentation/devicetree/bindings/soc/qcom/qcom,rpm.yaml
```yaml
# SPDX-License-Identifier: (GPL-2.0 OR BSD-2-Clause)
%YAML 1.2
---
$id: http://devicetree.org/schemas/soc/qcom/qcom,rpm.yaml#
$schema: http://devicetree.org/meta-schemas/core.yaml#

title: Qualcomm Resource Power Manager (RPM)

description:
  This driver is used to interface with the Resource Power Manager (RPM) found
  in various Qualcomm platforms. The RPM allows each component in the system
  to vote for state of the system resources, such as clocks, regulators and bus
  frequencies.

maintainers:
  - Bjorn Andersson <andersson@kernel.org>

properties:
  compatible:
    enum:
      - qcom,rpm-apq8064
      - qcom,rpm-msm8660
      - qcom,rpm-msm8960
      - qcom,rpm-ipq8064
      - qcom,rpm-mdm9615

  reg:
    maxItems: 1

  interrupts:
    maxItems: 3

  interrupt-names:
    items:
      - const: ack
      - const: err
      - const: wakeup

  clocks:
    maxItems: 1

  clock-names:
    items:
      - const: ram

  qcom,ipc:
    $ref: /schemas/types.yaml#/definitions/phandle-array
    items:
      - items:
          - description: phandle to a syscon node representing the APCS registers
          - description: u32 representing offset to the register within the syscon
          - description: u32 representing the ipc bit within the register
    description:
      Three entries specifying the outgoing ipc bit used for signaling the RPM.

  clock-controller:
    type: object
    additionalProperties: true
    properties:
      compatible:
        contains:
          const: qcom,rpmcc

patternProperties:
  "^regulators(-[01])?$":
    type: object
    $ref: /schemas/regulator/qcom,rpm-regulator.yaml#
    unevaluatedProperties: false

required:
  - compatible
  - reg
  - interrupts
  - interrupt-names
  - qcom,ipc

additionalProperties: false

examples:
  - |
    #include <dt-bindings/interrupt-controller/arm-gic.h>
    #include <dt-bindings/interrupt-controller/irq.h>
    #include <dt-bindings/mfd/qcom-rpm.h>

    rpm@108000 {
      compatible = "qcom,rpm-msm8960";
      reg = <0x108000 0x1000>;
      qcom,ipc = <&apcs 0x8 2>;

      interrupts = <GIC_SPI 19 IRQ_TYPE_NONE>, <GIC_SPI 21 IRQ_TYPE_NONE>, <GIC_SPI 22 IRQ_TYPE_NONE>;
      interrupt-names = "ack", "err", "wakeup";

      regulators {
        compatible = "qcom,rpm-pm8921-regulators";
        vdd_l1_l2_l12_l18-supply = <&pm8921_s4>;

        s1 {
          regulator-min-microvolt = <1225000>;
          regulator-max-microvolt = <1225000>;

          bias-pull-down;

          qcom,switch-mode-frequency = <3200000>;
        };

        pm8921_s4: s4 {
          regulator-min-microvolt = <1800000>;
          regulator-max-microvolt = <1800000>;

          qcom,switch-mode-frequency = <1600000>;
          bias-pull-down;

          qcom,force-mode = <QCOM_RPM_FORCE_MODE_AUTO>;
        };
      };
    };
```

## Documentation/devicetree/bindings/soc/qcom/qcom,rpmh-rsc.yaml
```yaml
# SPDX-License-Identifier: GPL-2.0-only
%YAML 1.2
---
$id: http://devicetree.org/schemas/soc/qcom/qcom,rpmh-rsc.yaml#
$schema: http://devicetree.org/meta-schemas/core.yaml#

title: Qualcomm RPMH RSC

maintainers:
  - Bjorn Andersson <bjorn.andersson@linaro.org>

description: |
  Resource Power Manager Hardened (RPMH) is the mechanism for communicating
  with the hardened resource accelerators on Qualcomm SoCs. Requests to the
  resources can be written to the Trigger Command Set (TCS)  registers and
  using a (addr, val) pair and triggered. Messages in the TCS are then sent in
  sequence over an internal bus.

  The hardware block (Direct Resource Voter or DRV) is a part of the h/w entity
  (Resource State Coordinator a.k.a RSC) that can handle multiple sleep and
  active/wake resource requests. Multiple such DRVs can exist in a SoC and can
  be written to from Linux. The structure of each DRV follows the same template
  with a few variations that are captured by the properties here.

  A TCS may be triggered from Linux or triggered by the F/W after all the CPUs
  have powered off to facilitate idle power saving. TCS could be classified as::
    ACTIVE  - Triggered by Linux
    SLEEP   - Triggered by F/W
    WAKE    - Triggered by F/W
    CONTROL - Triggered by F/W
  See also:: <dt-bindings/soc/qcom,rpmh-rsc.h>

  The order in which they are described in the DT, should match the hardware
  configuration.

  Requests can be made for the state of a resource, when the subsystem is
  active or idle. When all subsystems like Modem, GPU, CPU are idle, the
  resource state will be an aggregate of the sleep votes from each of those
  subsystems. Clients may request a sleep value for their shared resources in
  addition to the active mode requests.

  Drivers that want to use the RSC to communicate with RPMH must specify their
  bindings as child nodes of the RSC controllers they wish to communicate with.

properties:
  compatible:
    const: qcom,rpmh-rsc

  interrupts:
    minItems: 1
    maxItems: 4
    description:
      The interrupt that trips when a message complete/response is received for
      this DRV from the accelerators.
      Number of interrupts must match number of DRV blocks.

  label:
    description:
      Name for the RSC. The name would be used in trace logs.

  qcom,drv-id:
    $ref: /schemas/types.yaml#/definitions/uint32
    description:
      The ID of the DRV in the RSC block that will be used by this controller.

  qcom,tcs-config:
    $ref: /schemas/types.yaml#/definitions/uint32-matrix
    minItems: 4
    maxItems: 4
    items:
      items:
        - description: |
            TCS type::
             - ACTIVE_TCS
             - SLEEP_TCS
             - WAKE_TCS
             - CONTROL_TCS
          enum: [ 0, 1, 2, 3 ]
        - description: Number of TCS
    description: |
      The tuple defining the configuration of TCS. Must have two cells which
      describe each TCS type.  The order of the TCS must match the hardware
      configuration.

  qcom,tcs-offset:
    $ref: /schemas/types.yaml#/definitions/uint32
    description:
      The offset of the TCS blocks.

  reg:
    minItems: 1
    maxItems: 4

  reg-names:
    minItems: 1
    items:
      - const: drv-0
      - const: drv-1
      - const: drv-2
      - const: drv-3

  power-domains:
    maxItems: 1

  bcm-voter:
    $ref: /schemas/interconnect/qcom,bcm-voter.yaml#

  clock-controller:
    $ref: /schemas/clock/qcom,rpmhcc.yaml#

  power-controller:
    $ref: /schemas/power/qcom,rpmpd.yaml#

patternProperties:
  '-regulators$':
    $ref: /schemas/regulator/qcom,rpmh-regulator.yaml#

required:
  - compatible
  - interrupts
  - qcom,drv-id
  - qcom,tcs-config
  - qcom,tcs-offset
  - reg
  - reg-names

additionalProperties: false

examples:
  - |
    // For a TCS whose RSC base address is 0x179C0000 and is at a DRV id of
    // 2, the register offsets for DRV2 start at 0D00, the register
    // calculations are like this::
    // DRV0: 0x179C0000
    // DRV2: 0x179C0000 + 0x10000 = 0x179D0000
    // DRV2: 0x179C0000 + 0x10000 * 2 = 0x179E0000
    // TCS-OFFSET: 0xD00
    #include <dt-bindings/interrupt-controller/arm-gic.h>
    #include <dt-bindings/soc/qcom,rpmh-rsc.h>

    rsc@179c0000 {
        compatible = "qcom,rpmh-rsc";
        reg = <0x179c0000 0x10000>,
              <0x179d0000 0x10000>,
              <0x179e0000 0x10000>;
        reg-names = "drv-0", "drv-1", "drv-2";
        interrupts = <GIC_SPI 3 IRQ_TYPE_LEVEL_HIGH>,
                     <GIC_SPI 4 IRQ_TYPE_LEVEL_HIGH>,
                     <GIC_SPI 5 IRQ_TYPE_LEVEL_HIGH>;
        label = "apps_rsc";
        qcom,tcs-offset = <0xd00>;
        qcom,drv-id = <2>;
        qcom,tcs-config = <ACTIVE_TCS  2>,
                          <SLEEP_TCS   3>,
                          <WAKE_TCS    3>,
                          <CONTROL_TCS 1>;
        power-domains = <&CLUSTER_PD>;
      };

  - |
    // For a TCS whose RSC base address is 0xAF20000 and is at DRV id of 0, the
    // register offsets for DRV0 start at 01C00, the register calculations are
    // like this::
    // DRV0: 0xAF20000
    // TCS-OFFSET: 0x1C00
    #include <dt-bindings/interrupt-controller/arm-gic.h>
    #include <dt-bindings/soc/qcom,rpmh-rsc.h>

    rsc@af20000 {
        compatible = "qcom,rpmh-rsc";
        reg = <0xaf20000 0x10000>;
        reg-names = "drv-0";
        interrupts = <GIC_SPI 129 IRQ_TYPE_LEVEL_HIGH>;
        label = "disp_rsc";
        qcom,tcs-offset = <0x1c00>;
        qcom,drv-id = <0>;
        qcom,tcs-config = <ACTIVE_TCS  0>,
                          <SLEEP_TCS   1>,
                          <WAKE_TCS    1>,
                          <CONTROL_TCS 0>;
    };

  - |
    #include <dt-bindings/interrupt-controller/arm-gic.h>
    #include <dt-bindings/soc/qcom,rpmh-rsc.h>
    #include <dt-bindings/power/qcom-rpmpd.h>

    rsc@18200000 {
        compatible = "qcom,rpmh-rsc";
        reg = <0x18200000 0x10000>,
              <0x18210000 0x10000>,
              <0x18220000 0x10000>;
        reg-names = "drv-0", "drv-1", "drv-2";
        interrupts = <GIC_SPI 3 IRQ_TYPE_LEVEL_HIGH>,
                     <GIC_SPI 4 IRQ_TYPE_LEVEL_HIGH>,
                     <GIC_SPI 5 IRQ_TYPE_LEVEL_HIGH>;
        label = "apps_rsc";
        qcom,tcs-offset = <0xd00>;
        qcom,drv-id = <2>;
        qcom,tcs-config = <ACTIVE_TCS  2>,
                          <SLEEP_TCS   3>,
                          <WAKE_TCS    3>,
                          <CONTROL_TCS 0>;
        power-domains = <&CLUSTER_PD>;

        clock-controller {
            compatible = "qcom,sm8350-rpmh-clk";
            #clock-cells = <1>;
            clock-names = "xo";
            clocks = <&xo_board>;
        };

        power-controller {
            compatible = "qcom,sm8350-rpmhpd";
            #power-domain-cells = <1>;
            operating-points-v2 = <&rpmhpd_opp_table>;

            rpmhpd_opp_table: opp-table {
                compatible = "operating-points-v2";

                rpmhpd_opp_ret: opp1 {
                    opp-level = <RPMH_REGULATOR_LEVEL_RETENTION>;
                };

                rpmhpd_opp_min_svs: opp2 {
                    opp-level = <RPMH_REGULATOR_LEVEL_MIN_SVS>;
                };

                rpmhpd_opp_low_svs: opp3 {
                    opp-level = <RPMH_REGULATOR_LEVEL_LOW_SVS>;
                };

                rpmhpd_opp_svs: opp4 {
                    opp-level = <RPMH_REGULATOR_LEVEL_SVS>;
                };

                rpmhpd_opp_svs_l1: opp5 {
                    opp-level = <RPMH_REGULATOR_LEVEL_SVS_L1>;
                };

                rpmhpd_opp_nom: opp6 {
                    opp-level = <RPMH_REGULATOR_LEVEL_NOM>;
                };

                rpmhpd_opp_nom_l1: opp7 {
                    opp-level = <RPMH_REGULATOR_LEVEL_NOM_L1>;
                };

                rpmhpd_opp_nom_l2: opp8 {
                    opp-level = <RPMH_REGULATOR_LEVEL_NOM_L2>;
                };

                rpmhpd_opp_turbo: opp9 {
                    opp-level = <RPMH_REGULATOR_LEVEL_TURBO>;
                };

                rpmhpd_opp_turbo_l1: opp10 {
                    opp-level = <RPMH_REGULATOR_LEVEL_TURBO_L1>;
                };
            };
        };

        bcm-voter {
            compatible = "qcom,bcm-voter";
        };
    };
```

## Documentation/devicetree/bindings/soc/qcom/qcom,sa8255p-geni-se-qup.yaml
```yaml
# SPDX-License-Identifier: (GPL-2.0 OR BSD-2-Clause)
%YAML 1.2
---
$id: http://devicetree.org/schemas/soc/qcom/qcom,sa8255p-geni-se-qup.yaml#
$schema: http://devicetree.org/meta-schemas/core.yaml#

title: GENI Serial Engine QUP Wrapper Controller

maintainers:
  - Praveen Talari <quic_ptalari@quicinc.com>

description:
  Generic Interface (GENI) based Qualcomm Universal Peripheral (QUP) wrapper
  is a programmable module for supporting a wide range of serial interfaces
  like UART, SPI, I2C, I3C, etc. A single QUP module can provide up to 8 Serial
  Interfaces, using its internal Serial Engines. The GENI Serial Engine QUP
  Wrapper controller is modeled as a node with zero or more child nodes each
  representing a serial engine.

properties:
  compatible:
    const: qcom,sa8255p-geni-se-qup

  reg:
    description: QUP wrapper common register address and length.
    maxItems: 1

  "#address-cells":
    const: 2

  "#size-cells":
    const: 2

  ranges: true

  iommus:
    maxItems: 1

  dma-coherent: true

patternProperties:
  "spi@[0-9a-f]+$":
    type: object
    description: GENI serial engine based SPI controller. SPI in master mode
                 supports up to 50MHz, up to four chip selects, programmable
                 data path from 4 bits to 32 bits and numerous protocol
                 variants.
    additionalProperties: true

    properties:
      compatible:
        const: qcom,sa8255p-geni-spi

  "i2c@[0-9a-f]+$":
    type: object
    description: GENI serial engine based I2C controller.
    additionalProperties: true

    properties:
      compatible:
        const: qcom,sa8255p-geni-i2c

  "serial@[0-9a-f]+$":
    type: object
    description: GENI Serial Engine based UART Controller.
    additionalProperties: true

    properties:
      compatible:
        enum:
          - qcom,sa8255p-geni-uart
          - qcom,sa8255p-geni-debug-uart

required:
  - compatible
  - reg
  - "#address-cells"
  - "#size-cells"
  - ranges

additionalProperties: false

examples:
  - |
    #include <dt-bindings/interrupt-controller/arm-gic.h>

    soc {
        #address-cells = <2>;
        #size-cells = <2>;

        geniqup@9c0000 {
            compatible = "qcom,sa8255p-geni-se-qup";
            reg = <0 0x9c0000 0 0x6000>;
            #address-cells = <2>;
            #size-cells = <2>;
            ranges;

            serial@990000 {
                compatible = "qcom,sa8255p-geni-uart";
                reg = <0 0x990000 0 0x4000>;
                interrupts = <GIC_SPI 531 IRQ_TYPE_LEVEL_HIGH>;
                power-domains = <&scmi0_pd 0>, <&scmi0_dvfs 0>;
                power-domain-names = "power", "perf";
            };
        };
    };
...
```
