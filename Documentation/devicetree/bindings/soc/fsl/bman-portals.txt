## Documentation/devicetree/bindings/soc/fsl/cpm_qe/fsl,ucc-hdlc.yaml
```yaml
# SPDX-License-Identifier: (GPL-2.0-only OR BSD-2-Clause)
%YAML 1.2
---
$id: http://devicetree.org/schemas/soc/fsl/cpm_qe/fsl,ucc-hdlc.yaml#
$schema: http://devicetree.org/meta-schemas/core.yaml#

title: High-Level Data Link Control(HDLC)

description: HDLC part in Universal communication controllers (UCCs)

maintainers:
  - Frank Li <Frank.Li@nxp.com>

properties:
  compatible:
    const: fsl,ucc-hdlc

  reg:
    maxItems: 1

  interrupts:
    maxItems: 1

  cell-index:
    $ref: /schemas/types.yaml#/definitions/uint32

  rx-clock-name:
    $ref: /schemas/types.yaml#/definitions/string
    oneOf:
      - pattern: "^brg([0-9]|1[0-6])$"
      - pattern: "^clk([0-9]|1[0-9]|2[0-4])$"

  tx-clock-name:
    $ref: /schemas/types.yaml#/definitions/string
    oneOf:
      - pattern: "^brg([0-9]|1[0-6])$"
      - pattern: "^clk([0-9]|1[0-9]|2[0-4])$"

  fsl,tdm-interface:
    $ref: /schemas/types.yaml#/definitions/flag
    description: Specify that hdlc is based on tdm-interface

  fsl,rx-sync-clock:
    $ref: /schemas/types.yaml#/definitions/string
    description: rx-sync
    enum:
      - none
      - rsync_pin
      - brg9
      - brg10
      - brg11
      - brg13
      - brg14
      - brg15

  fsl,tx-sync-clock:
    $ref: /schemas/types.yaml#/definitions/string
    description: tx-sync
    enum:
      - none
      - tsync_pin
      - brg9
      - brg10
      - brg11
      - brg13
      - brg14
      - brg15

  fsl,tdm-framer-type:
    $ref: /schemas/types.yaml#/definitions/string
    description: required for tdm interface
    enum: [e1, t1]

  fsl,tdm-id:
    $ref: /schemas/types.yaml#/definitions/uint32
    description: number of TDM ID

  fsl,tx-timeslot-mask:
    $ref: /schemas/types.yaml#/definitions/uint32
    description:
      required for tdm interface.
      time slot mask for TDM operation. Indicates which time
      slots used for transmitting and receiving.

  fsl,rx-timeslot-mask:
    $ref: /schemas/types.yaml#/definitions/uint32
    description:
      required for tdm interface.
      time slot mask for TDM operation. Indicates which time
      slots used for transmitting and receiving.

  fsl,siram-entry-id:
    $ref: /schemas/types.yaml#/definitions/uint32
    description:
      required for tdm interface
      Must be 0,2,4...64. the number of TDM entry.

  fsl,tdm-internal-loopback:
    $ref: /schemas/types.yaml#/definitions/flag
    description:
      optional for tdm interface
      Internal loopback connecting on TDM layer.

  fsl,hmask:
    $ref: /schemas/types.yaml#/definitions/uint16
    description: |
      HDLC address recognition. Set to zero to disable
      address filtering of packets:
      fsl,hmask = /bits/ 16 <0x0000>;

required:
  - compatible
  - reg

additionalProperties: false

examples:
  - |
    communication@2000 {
        compatible = "fsl,ucc-hdlc";
        reg = <0x2000 0x200>;
        rx-clock-name = "clk8";
        tx-clock-name = "clk9";
        fsl,rx-sync-clock = "rsync_pin";
        fsl,tx-sync-clock = "tsync_pin";
        fsl,tx-timeslot-mask = <0xfffffffe>;
        fsl,rx-timeslot-mask = <0xfffffffe>;
        fsl,tdm-framer-type = "e1";
        fsl,tdm-id = <0>;
        fsl,siram-entry-id = <0>;
        fsl,tdm-interface;
    };

  - |
    communication@2000 {
        compatible = "fsl,ucc-hdlc";
        reg = <0x2000 0x200>;
        rx-clock-name = "brg1";
        tx-clock-name = "brg1";
    };
```

## Documentation/devicetree/bindings/soc/fsl/cpm_qe/gpio.txt
```
Every GPIO controller node must have #gpio-cells property defined,
this information will be used to translate gpio-specifiers.

On CPM1 devices, all ports are using slightly different register layouts.
Ports A, C and D are 16bit ports and Ports B and E are 32bit ports.

On CPM2 devices, all ports are 32bit ports and use a common register layout.

Required properties:
- compatible : "fsl,cpm1-pario-bank-a", "fsl,cpm1-pario-bank-b",
  "fsl,cpm1-pario-bank-c", "fsl,cpm1-pario-bank-d",
  "fsl,cpm1-pario-bank-e", "fsl,cpm2-pario-bank"
- #gpio-cells : Should be two. The first cell is the pin number and the
  second cell is used to specify optional parameters (currently unused).
- gpio-controller : Marks the port as GPIO controller.
Optional properties:
- fsl,cpm1-gpio-irq-mask : For banks having interrupt capability (like port C
  on CPM1), this item tells which ports have an associated interrupt (ports are
  listed in the same order as in PCINT register)
- interrupts : This property provides the list of interrupt for each GPIO having
  one as described by the fsl,cpm1-gpio-irq-mask property. There should be as
  many interrupts as number of ones in the mask property. The first interrupt in
  the list corresponds to the most significant bit of the mask.

Example of four SOC GPIO banks defined as gpio-controller nodes:

	CPM1_PIO_A: gpio-controller@950 {
		#gpio-cells = <2>;
		compatible = "fsl,cpm1-pario-bank-a";
		reg = <0x950 0x10>;
		gpio-controller;
	};

	CPM1_PIO_B: gpio-controller@ab8 {
		#gpio-cells = <2>;
		compatible = "fsl,cpm1-pario-bank-b";
		reg = <0xab8 0x10>;
		gpio-controller;
	};

	CPM1_PIO_C: gpio-controller@960 {
		#gpio-cells = <2>;
		compatible = "fsl,cpm1-pario-bank-c";
		reg = <0x960 0x10>;
		fsl,cpm1-gpio-irq-mask = <0x0fff>;
		interrupts = <1 2 6 9 10 11 14 15 23 24 26 31>;
		interrupt-parent = <&CPM_PIC>;
		gpio-controller;
	};

	CPM1_PIO_E: gpio-controller@ac8 {
		#gpio-cells = <2>;
		compatible = "fsl,cpm1-pario-bank-e";
		reg = <0xac8 0x18>;
		gpio-controller;
	};
```

## Documentation/devicetree/bindings/soc/fsl/cpm_qe/network.txt
```
* Network

Currently defined compatibles:
- fsl,cpm1-scc-enet
- fsl,cpm2-scc-enet
- fsl,cpm1-fec-enet
- fsl,cpm2-fcc-enet (third resource is GFEMR)
- fsl,qe-enet

Example:

	ethernet@11300 {
		compatible = "fsl,mpc8272-fcc-enet",
			     "fsl,cpm2-fcc-enet";
		reg = <11300 20 8400 100 11390 1>;
		local-mac-address = [ 00 00 00 00 00 00 ];
		interrupts = <20 8>;
		interrupt-parent = <&PIC>;
		phy-handle = <&PHY0>;
		fsl,cpm-command = <12000300>;
	};

* MDIO

Currently defined compatibles:
fsl,pq1-fec-mdio (reg is same as first resource of FEC device)
fsl,cpm2-mdio-bitbang (reg is port C registers)

Properties for fsl,cpm2-mdio-bitbang:
fsl,mdio-pin : pin of port C controlling mdio data
fsl,mdc-pin : pin of port C controlling mdio clock

Example:
	mdio@10d40 {
		compatible = "fsl,mpc8272ads-mdio-bitbang",
			     "fsl,mpc8272-mdio-bitbang",
			     "fsl,cpm2-mdio-bitbang";
		reg = <10d40 14>;
		#address-cells = <1>;
		#size-cells = <0>;
		fsl,mdio-pin = <12>;
		fsl,mdc-pin = <13>;
	};

* HDLC

Currently defined compatibles:
- fsl,ucc-hdlc

Properties for fsl,ucc-hdlc:
- rx-clock-name
- tx-clock-name
	Usage: required
	Value type: <string>
	Definition : Must be "brg1"-"brg16" for internal clock source,
		     Must be "clk1"-"clk24" for external clock source.

- fsl,tdm-interface
	Usage: optional
	Value type: <empty>
	Definition : Specify that hdlc is based on tdm-interface

The property below is dependent on fsl,tdm-interface:
- fsl,rx-sync-clock
	Usage: required
	Value type: <string>
	Definition : Must be "none", "rsync_pin", "brg9-11" and "brg13-15".

- fsl,tx-sync-clock
	Usage: required
	Value type: <string>
	Definition : Must be "none", "tsync_pin", "brg9-11" and "brg13-15".

- fsl,tdm-framer-type
	Usage: required for tdm interface
	Value type: <string>
	Definition : "e1" or "t1".Now e1 and t1 are used, other framer types
		     are not supported.

- fsl,tdm-id
	Usage: required for tdm interface
	Value type: <u32>
	Definition : number of TDM ID

- fsl,tx-timeslot-mask
- fsl,rx-timeslot-mask
	Usage: required for tdm interface
	Value type: <u32>
	Definition : time slot mask for TDM operation. Indicates which time
		     slots used for transmitting and receiving.

- fsl,siram-entry-id
	Usage: required for tdm interface
	Value type: <u32>
	Definition : Must be 0,2,4...64. the number of TDM entry.

- fsl,tdm-internal-loopback
	usage: optional for tdm interface
	value type: <empty>
	Definition : Internal loopback connecting on TDM layer.
- fsl,hmask
	usage: optional
	Value type: <u16>
	Definition: HDLC address recognition. Set to zero to disable
		    address filtering of packets:
		    fsl,hmask = /bits/ 16 <0x0000>;

Example for tdm interface:

	ucc@2000 {
		compatible = "fsl,ucc-hdlc";
		rx-clock-name = "clk8";
		tx-clock-name = "clk9";
		fsl,rx-sync-clock = "rsync_pin";
		fsl,tx-sync-clock = "tsync_pin";
		fsl,tx-timeslot-mask = <0xfffffffe>;
		fsl,rx-timeslot-mask = <0xfffffffe>;
		fsl,tdm-framer-type = "e1";
		fsl,tdm-id = <0>;
		fsl,siram-entry-id = <0>;
		fsl,tdm-interface;
	};

Example for hdlc without tdm interface:

	ucc@2000 {
		compatible = "fsl,ucc-hdlc";
		rx-clock-name = "brg1";
		tx-clock-name = "brg1";
	};
```

## Documentation/devicetree/bindings/soc/fsl/cpm_qe/qe/firmware.txt
```
* Uploaded QE firmware

      If a new firmware has been uploaded to the QE (usually by the
      boot loader), then a 'firmware' child node should be added to the QE
      node.  This node provides information on the uploaded firmware that
      device drivers may need.

      Required properties:
      - id: The string name of the firmware.  This is taken from the 'id'
            member of the qe_firmware structure of the uploaded firmware.
            Device drivers can search this string to determine if the
            firmware they want is already present.
      - extended-modes: The Extended Modes bitfield, taken from the
		   firmware binary.  It is a 64-bit number represented
		   as an array of two 32-bit numbers.
      - virtual-traps: The virtual traps, taken from the firmware binary.
		  It is an array of 8 32-bit numbers.

Example:
	firmware {
		id = "Soft-UART";
		extended-modes = <0 0>;
		virtual-traps = <0 0 0 0 0 0 0 0>;
	};
```

## Documentation/devicetree/bindings/soc/fsl/cpm_qe/qe/par_io.txt
```
* Parallel I/O Ports

This node configures Parallel I/O ports for CPUs with QE support.
The node should reside in the "soc" node of the tree.  For each
device that using parallel I/O ports, a child node should be created.
See the definition of the Pin configuration nodes below for more
information.

Required properties:
- device_type : should be "par_io".
- reg : offset to the register set and its length.
- num-ports : number of Parallel I/O ports

Example:
par_io@1400 {
	reg = <1400 100>;
	#address-cells = <1>;
	#size-cells = <0>;
	device_type = "par_io";
	num-ports = <7>;
	ucc_pin@1 {
		......
	};

Note that "par_io" nodes are obsolete, and should not be used for
the new device trees. Instead, each Par I/O bank should be represented
via its own gpio-controller node.
```

## Documentation/devicetree/bindings/soc/fsl/cpm_qe/qe/ucc.txt
```
* UCC (Unified Communications Controllers)

Required properties:
- device_type : should be "network", "hldc", "uart", "transparent"
  "bisync", "atm", or "serial".
- compatible : could be "ucc_geth" or "fsl_atm" and so on.
- cell-index : the ucc number(1-8), corresponding to UCCx in UM.
- reg : Offset and length of the register set for the device
- interrupts : <a b> where a is the interrupt number and b is a
  field that represents an encoding of the sense and level
  information for the interrupt.  This should be encoded based on
  the information in section 2) depending on the type of interrupt
  controller you have.
- pio-handle : The phandle for the Parallel I/O port configuration.
- port-number : for UART drivers, the port number to use, between 0 and 3.
  This usually corresponds to the /dev/ttyQE device, e.g. <0> = /dev/ttyQE0.
  The port number is added to the minor number of the device.  Unlike the
  CPM UART driver, the port-number is required for the QE UART driver.
- soft-uart : for UART drivers, if specified this means the QE UART device
  driver should use "Soft-UART" mode, which is needed on some SOCs that have
  broken UART hardware.  Soft-UART is provided via a microcode upload.
- rx-clock-name: the UCC receive clock source
  "none": clock source is disabled
  "brg1" through "brg16": clock source is BRG1-BRG16, respectively
  "clk1" through "clk24": clock source is CLK1-CLK24, respectively
- tx-clock-name: the UCC transmit clock source
  "none": clock source is disabled
  "brg1" through "brg16": clock source is BRG1-BRG16, respectively
  "clk1" through "clk24": clock source is CLK1-CLK24, respectively
The following two properties are deprecated.  rx-clock has been replaced
with rx-clock-name, and tx-clock has been replaced with tx-clock-name.
Drivers that currently use the deprecated properties should continue to
do so, in order to support older device trees, but they should be updated
to check for the new properties first.
- rx-clock : represents the UCC receive clock source.
  0x00 : clock source is disabled;
  0x1~0x10 : clock source is BRG1~BRG16 respectively;
  0x11~0x28: clock source is QE_CLK1~QE_CLK24 respectively.
- tx-clock: represents the UCC transmit clock source;
  0x00 : clock source is disabled;
  0x1~0x10 : clock source is BRG1~BRG16 respectively;
  0x11~0x28: clock source is QE_CLK1~QE_CLK24 respectively.

Required properties for network device_type:
- mac-address : list of bytes representing the ethernet address.
- phy-handle : The phandle for the PHY connected to this controller.

Recommended properties:
- phy-connection-type : a string naming the controller/PHY interface type,
  i.e., "mii" (default), "rmii", "gmii", "rgmii", "rgmii-id" (Internal
  Delay), "rgmii-txid" (delay on TX only), "rgmii-rxid" (delay on RX only),
  "tbi", or "rtbi".

Example:
	ucc@2000 {
		device_type = "network";
		compatible = "ucc_geth";
		cell-index = <1>;
		reg = <2000 200>;
		interrupts = <a0 0>;
		interrupt-parent = <700>;
		mac-address = [ 00 04 9f 00 23 23 ];
		rx-clock = "none";
		tx-clock = "clk9";
		phy-handle = <212000>;
		phy-connection-type = "gmii";
		pio-handle = <140001>;
	};
```

## Documentation/devicetree/bindings/soc/fsl/cpm_qe/qe/usb.txt
```
Freescale QUICC Engine USB Controller

Required properties:
- compatible : should be "fsl,<chip>-qe-usb", "fsl,mpc8323-qe-usb".
- reg : the first two cells should contain usb registers location and
  length, the next two two cells should contain PRAM location and
  length.
- interrupts : should contain USB interrupt.
- interrupt-parent : interrupt source phandle.
- fsl,fullspeed-clock : specifies the full speed USB clock source:
  "none": clock source is disabled
  "brg1" through "brg16": clock source is BRG1-BRG16, respectively
  "clk1" through "clk24": clock source is CLK1-CLK24, respectively
- fsl,lowspeed-clock : specifies the low speed USB clock source:
  "none": clock source is disabled
  "brg1" through "brg16": clock source is BRG1-BRG16, respectively
  "clk1" through "clk24": clock source is CLK1-CLK24, respectively
- hub-power-budget : USB power budget for the root hub, in mA.
- gpios : should specify GPIOs in this order: USBOE, USBTP, USBTN, USBRP,
  USBRN, SPEED (optional), and POWER (optional).

Example:

usb@6c0 {
	compatible = "fsl,mpc8360-qe-usb", "fsl,mpc8323-qe-usb";
	reg = <0x6c0 0x40 0x8b00 0x100>;
	interrupts = <11>;
	interrupt-parent = <&qeic>;
	fsl,fullspeed-clock = "clk21";
	gpios = <&qe_pio_b  2 0 /* USBOE */
		 &qe_pio_b  3 0 /* USBTP */
		 &qe_pio_b  8 0 /* USBTN */
		 &qe_pio_b  9 0 /* USBRP */
		 &qe_pio_b 11 0 /* USBRN */
		 &qe_pio_e 20 0 /* SPEED */
		 &qe_pio_e 21 0 /* POWER */>;
};
```
