## Documentation/devicetree/bindings/soc/fsl/cpm_qe/uqe_serial.txt
```
* Serial

Required Properties:
compatible : must be "fsl,<chip>-ucc-uart". For t1040, must be
"fsl,t1040-ucc-uart".
port-number : port number of UCC-UART
tx/rx-clock-name : should be "brg1"-"brg16" for internal clock source,
		   should be "clk1"-"clk28" for external clock source.

Example:

	ucc_serial: ucc@2200 {
		compatible = "fsl,t1040-ucc-uart";
		port-number = <0>;
		rx-clock-name = "brg2";
		tx-clock-name = "brg2";
	};
```

## Documentation/devicetree/bindings/soc/fsl/fsl,bman-portal.yaml
```yaml
# SPDX-License-Identifier: (GPL-2.0-only OR BSD-2-Clause)
%YAML 1.2
---
$id: http://devicetree.org/schemas/soc/fsl/fsl,bman-portal.yaml#
$schema: http://devicetree.org/meta-schemas/core.yaml#

title: QorIQ DPAA Queue Manager Portals

maintainers:
  - Frank Li <Frank.Li@nxp.com>

description:
  QorIQ DPAA Buffer Manager Portal

  Portals are memory mapped interfaces to BMan that allow low-latency, lock-less
  interaction by software running on processor cores, accelerators and network
  interfaces with the BMan

properties:
  compatible:
    oneOf:
      - const: fsl,bman-portal
      - items:
          - enum:
              - fsl,bman-portal-1.0.0
              - fsl,ls1043a-bmap-portal
              - fsl,ls1046a-bmap-portal
          - const: fsl,bman-portal
  reg:
    items:
      - description: the cache-enabled region of the portal
      - description: the cache-inhibited region of the portal

  interrupts:
    maxItems: 1

required:
  - compatible
  - reg
  - interrupts

additionalProperties: false

examples:
  - |
    #include <dt-bindings/interrupt-controller/irq.h>

    bman-portal@0 {
        compatible = "fsl,bman-portal-1.0.0", "fsl,bman-portal";
        reg = <0x0 0x4000>, <0x100000 0x1000>;
        interrupts = <105 IRQ_TYPE_EDGE_FALLING 0 0>;
    };
```

## Documentation/devicetree/bindings/soc/fsl/fsl,bman.yaml
```yaml
# SPDX-License-Identifier: (GPL-2.0-only OR BSD-2-Clause)
%YAML 1.2
---
$id: http://devicetree.org/schemas/soc/fsl/fsl,bman.yaml#
$schema: http://devicetree.org/meta-schemas/core.yaml#

title: QorIQ DPAA Buffer Manager

maintainers:
  - Frank Li <Frank.Li@nxp.com>

description:
  The Buffer Manager is part of the Data-Path Acceleration Architecture (DPAA).
  BMan supports hardware allocation and deallocation of buffers belonging to
  pools originally created by software with configurable depletion thresholds.
  This binding covers the CCSR space programming model

properties:
  compatible:
    oneOf:
      - const: fsl,bman
      - items:
          - enum:
              - fsl,ls1043a-bman
              - fsl,ls1046a-bman
          - const: fsl,bman

  reg:
    items:
      - description: |
          Registers region within the CCSR address space

          The BMan revision information is located in the BMAN_IP_REV_1/2
          registers which are located at offsets 0xbf8 and 0xbfc

  interrupts:
    items:
      - description: The error interrupt

  memory-region:
    minItems: 1
    maxItems: 2
    description:
      List of phandles referencing the BMan private memory
      nodes (described below). The bman-fqd node must be
      first followed by bman-pfdr node. Only used on ARM

      Devices connected to a BMan instance via Direct Connect Portals (DCP) must link
      to the respective BMan instance

  fsl,bman-portals:
    $ref: /schemas/types.yaml#/definitions/phandle
    description: ref fsl,bman-port.yaml

  fsl,liodn:
    $ref: /schemas/types.yaml#/definitions/uint32-array
    description:
      See pamu.txt, PAMU property used for static LIODN assignment

  fsl,iommu-parent:
    $ref: /schemas/types.yaml#/definitions/phandle
    description:
      See pamu.txt, PAMU property used for dynamic LIODN assignment

required:
  - compatible
  - reg
  - interrupts

additionalProperties: false

examples:
  - |
    #include <dt-bindings/interrupt-controller/irq.h>

    bman@31a000 {
        compatible = "fsl,bman";
        reg = <0x31a000 0x1000>;
        interrupts = <16 IRQ_TYPE_EDGE_FALLING 1 2>;
        fsl,liodn = <0x17>;
        fsl,bman-portals = <&bportals>;
        memory-region = <&bman_fbpr>;
    };
```

## Documentation/devicetree/bindings/soc/fsl/fsl,imx23-digctl.yaml
```yaml
# SPDX-License-Identifier: (GPL-2.0-only OR BSD-2-Clause)
%YAML 1.2
---
$id: http://devicetree.org/schemas/soc/fsl/fsl,imx23-digctl.yaml#
$schema: http://devicetree.org/meta-schemas/core.yaml#

title: Freescale mxs digctrl for i.MX23/i.MX28

description: |
  The digital control block provides overall control of various items within
  the top digital block of the chip, including:
    - Default first-level page table (DFLPT) controls
    - HCLK performance counter
    - Free-running microseconds counter
    - Entropy control
    - BIST controls for ARM Core and On-Chip RAM
    - Chip Revision register
    - USB loop back congtrol
    - Other miscellaneous controls

maintainers:
  - Frank Li <Frank.Li@nxp.com>

properties:
  compatible:
    oneOf:
      - items:
          - enum:
              - fsl,imx28-digctl
          - const: fsl,imx23-digctl
      - const: fsl,imx23-digctl

  reg:
    maxItems: 1

  interrupts:
    maxItems: 1

required:
  - compatible
  - reg
  - interrupts

additionalProperties: false

examples:
  - |
    digctl@8001c000 {
        compatible = "fsl,imx28-digctl", "fsl,imx23-digctl";
        reg = <0x8001c000 0x2000>;
        interrupts = <89>;
    };
```

## Documentation/devicetree/bindings/soc/fsl/fsl,layerscape-dcfg.yaml
```yaml
# SPDX-License-Identifier: (GPL-2.0-only OR BSD-2-Clause)
%YAML 1.2
---
$id: http://devicetree.org/schemas/soc/fsl/fsl,layerscape-dcfg.yaml#
$schema: http://devicetree.org/meta-schemas/core.yaml#

title: Freescale Layerscape Device Configuration Unit

maintainers:
  - Shawn Guo <shawnguo@kernel.org>
  - Li Yang <leoyang.li@nxp.com>

description: |
  DCFG is the device configuration unit, that provides general purpose
  configuration and status for the device. Such as setting the secondary
  core start address and release the secondary core from holdoff and
  startup.

properties:
  compatible:
    oneOf:
      - items:
          - enum:
              - fsl,ls1012a-dcfg
              - fsl,ls1021a-dcfg
              - fsl,ls1043a-dcfg
              - fsl,ls1046a-dcfg
              - fsl,ls1088a-dcfg
              - fsl,ls2080a-dcfg
              - fsl,lx2160a-dcfg
          - const: syscon

      - items:
          - enum:
              - fsl,ls1028a-dcfg
          - const: syscon
          - const: simple-mfd

  reg:
    maxItems: 1

  little-endian: true
  big-endian: true

  '#address-cells':
    const: 1

  '#size-cells':
    const: 1

  ranges: true

patternProperties:
  "^clock-controller@[0-9a-z]+$":
    $ref: /schemas/clock/fsl,flexspi-clock.yaml#

required:
  - compatible
  - reg

additionalProperties: false

examples:
  - |
    syscon@1ee0000 {
        compatible = "fsl,ls1021a-dcfg", "syscon";
        reg = <0x1ee0000 0x10000>;
    };
```

## Documentation/devicetree/bindings/soc/fsl/fsl,layerscape-scfg.yaml
```yaml
# SPDX-License-Identifier: (GPL-2.0-only OR BSD-2-Clause)
%YAML 1.2
---
$id: http://devicetree.org/schemas/soc/fsl/fsl,layerscape-scfg.yaml#
$schema: http://devicetree.org/meta-schemas/core.yaml#

title: Freescale Layerscape Supplemental Configuration Unit

maintainers:
  - Shawn Guo <shawnguo@kernel.org>

description: |
  SCFG is the supplemental configuration unit, that provides SoC specific
  configuration and status registers for the chip. Such as getting PEX port
  status.

properties:
  compatible:
    items:
      - enum:
          - fsl,ls1012a-scfg
          - fsl,ls1021a-scfg
          - fsl,ls1028a-scfg
          - fsl,ls1043a-scfg
          - fsl,ls1046a-scfg
      - const: syscon

  reg:
    maxItems: 1

  little-endian: true
  big-endian: true

  '#address-cells':
    const: 1

  '#size-cells':
    const: 1

  ranges: true

patternProperties:
  "^interrupt-controller@[a-f0-9]+$":
    $ref: /schemas/interrupt-controller/fsl,ls-extirq.yaml#

required:
  - compatible
  - reg

additionalProperties: false

examples:
  - |
    syscon@1570000 {
        compatible = "fsl,ls1021a-scfg", "syscon";
        reg = <0x1570000 0x10000>;
    };
```

## Documentation/devicetree/bindings/soc/fsl/fsl,ls1028a-reset.yaml
```yaml
# SPDX-License-Identifier: (GPL-2.0-only OR BSD-2-Clause)
%YAML 1.2
---
$id: http://devicetree.org/schemas/soc/fsl/fsl,ls1028a-reset.yaml#
$schema: http://devicetree.org/meta-schemas/core.yaml#

title: Freescale Layerscape Reset Registers Module

maintainers:
  - Frank Li <Frank.Li@nxp.com>

description:
  Reset Module includes chip reset, service processor control and Reset Control
  Word (RCW) status.

properties:
  $nodename:
    pattern: "^syscon@[0-9a-f]+$"

  compatible:
    items:
      - enum:
          - fsl,ls1028a-reset
      - const: syscon
      - const: simple-mfd

  reg:
    maxItems: 1

  little-endian: true

  reboot:
    $ref: /schemas/power/reset/syscon-reboot.yaml#
    unevaluatedProperties: false

required:
  - compatible
  - reg
  - reboot

additionalProperties: false

examples:
  - |
    syscon@1e60000 {
        compatible = "fsl,ls1028a-reset", "syscon", "simple-mfd";
        reg = <0x1e60000 0x10000>;
        little-endian;

        reboot {
            compatible = "syscon-reboot";
            offset = <0>;
            mask = <0x02>;
        };
    };
```

## Documentation/devicetree/bindings/soc/fsl/fsl,qman-fqd.yaml
```yaml
# SPDX-License-Identifier: (GPL-2.0-only OR BSD-2-Clause)
%YAML 1.2
---
$id: http://devicetree.org/schemas/soc/fsl/fsl,qman-fqd.yaml#
$schema: http://devicetree.org/meta-schemas/core.yaml#

title: QMan Private Memory Nodes

maintainers:
  - Frank Li <Frank.Li@nxp.com>

description: |
  QMan requires two contiguous range of physical memory used for the backing store
  for QMan Frame Queue Descriptor (FQD) and Packed Frame Descriptor Record (PFDR).
  This memory is reserved/allocated as a node under the /reserved-memory node.

  BMan requires a contiguous range of physical memory used for the backing store
  for BMan Free Buffer Proxy Records (FBPR). This memory is reserved/allocated as
  a node under the /reserved-memory node.

  The QMan FQD memory node must be named "qman-fqd"
  The QMan PFDR memory node must be named "qman-pfdr"
  The BMan FBPR memory node must be named "bman-fbpr"

  The following constraints are relevant to the FQD and PFDR private memory:
    - The size must be 2^(size + 1), with size = 11..29. That is 4 KiB to
      1 GiB
    - The alignment must be a muliptle of the memory size

  The size of the FQD and PFDP must be chosen by observing the hardware features
  configured via the Reset Configuration Word (RCW) and that are relevant to a
  specific board (e.g. number of MAC(s) pinned-out, number of offline/host command
  FMan ports, etc.). The size configured in the DT must reflect the hardware
  capabilities and not the specific needs of an application

  For additional details about reserved memory regions see
  reserved-memory/reserved-memory.yaml in dtschema project.

properties:
  $nodename:
    pattern: '^(qman-fqd|qman-pfdr|bman-fbpr)+$'

  compatible:
    enum:
      - fsl,qman-fqd
      - fsl,qman-pfdr
      - fsl,bman-fbpr

required:
  - compatible

allOf:
  - $ref: reserved-memory.yaml

unevaluatedProperties: false

examples:
  - |
    reserved-memory {
        #address-cells = <2>;
        #size-cells = <2>;

        qman-fqd {
            compatible = "shared-dma-pool";
            size = <0 0x400000>;
            alignment = <0 0x400000>;
            no-map;
        };
    };
```

## Documentation/devicetree/bindings/soc/fsl/fsl,qman-portal.yaml
```yaml
# SPDX-License-Identifier: (GPL-2.0-only OR BSD-2-Clause)
%YAML 1.2
---
$id: http://devicetree.org/schemas/soc/fsl/fsl,qman-portal.yaml#
$schema: http://devicetree.org/meta-schemas/core.yaml#

title: QorIQ DPAA Queue Manager Portals

maintainers:
  - Frank Li <Frank.Li@nxp.com>

description:
  Portals are memory mapped interfaces to QMan that allow low-latency, lock-less
  interaction by software running on processor cores, accelerators and network
  interfaces with the QMan

properties:
  compatible:
    oneOf:
      - const: fsl,qman-portal
      - items:
          - enum:
              - fsl,ls1043-qman-portal
              - fsl,ls1046-qman-portal
              - fsl,qman-portal-1.2.0
          - const: fsl,qman-portal

  reg:
    items:
      - description: the cache-enabled region of the portal
      - description: the cache-inhibited region of the portal

  interrupts:
    maxItems: 1

  fsl,liodn:
    $ref: /schemas/types.yaml#/definitions/uint32-array
    maxItems: 2
    description: See pamu.txt. Two LIODN(s). DQRR LIODN (DLIODN) and Frame LIODN
      (FLIODN)

  fsl,iommu-parent:
    $ref: /schemas/types.yaml#/definitions/phandle
    description: See pamu.txt.

  fsl,qman-channel-id:
    $ref: /schemas/types.yaml#/definitions/uint32
    description: qman channel id.

  cell-index:
    $ref: /schemas/types.yaml#/definitions/uint32
    description:
      The hardware index of the channel. This can also be
      determined by dividing any of the channel's 8 work queue
      IDs by 8

      In addition to these properties the qman-portals should have sub-nodes to
      represent the HW devices/portals that are connected to the software portal
      described here

required:
  - compatible
  - reg
  - interrupts

additionalProperties: false

patternProperties:
  '^(fman0|fman1|pme|crypto)+$':
    type: object
    properties:
      fsl,liodn:
        $ref: /schemas/types.yaml#/definitions/uint32-array
        description: See pamu.txt, PAMU property used for static LIODN assignment

      fsl,iommu-parent:
        description: See pamu.txt, PAMU property used for dynamic LIODN assignment

      dev-handle:
        $ref: /schemas/types.yaml#/definitions/phandle
        description:
          The phandle to the particular hardware device that this
          portal is connected to.

    additionalProperties: false

examples:
  - |
    #include <dt-bindings/interrupt-controller/irq.h>

    qman-portal@0 {
        compatible = "fsl,qman-portal-1.2.0", "fsl,qman-portal";
        reg = <0 0x4000>, <0x100000 0x1000>;
        interrupts = <104 IRQ_TYPE_EDGE_FALLING 0 0>;
        fsl,liodn = <1 2>;
        fsl,qman-channel-id = <0>;

        fman0 {
            fsl,liodn = <0x21>;
            dev-handle = <&fman0>;
        };

        fman1 {
            fsl,liodn = <0xa1>;
            dev-handle = <&fman1>;
        };

        crypto {
            fsl,liodn = <0x41 0x66>;
            dev-handle = <&crypto>;
        };
    };
```
