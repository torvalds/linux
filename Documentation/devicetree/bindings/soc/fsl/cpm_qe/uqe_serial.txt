## Documentation/devicetree/bindings/soc/fsl/rcpm.txt
```
* Run Control and Power Management
-------------------------------------------
The RCPM performs all device-level tasks associated with device run control
and power management.

Required properites:
  - reg : Offset and length of the register set of the RCPM block.
  - #fsl,rcpm-wakeup-cells : The number of IPPDEXPCR register cells in the
	fsl,rcpm-wakeup property.
  - compatible : Must contain a chip-specific RCPM block compatible string
	and (if applicable) may contain a chassis-version RCPM compatible
	string. Chip-specific strings are of the form "fsl,<chip>-rcpm",
	such as:
	* "fsl,p2041-rcpm"
	* "fsl,p5020-rcpm"
	* "fsl,t4240-rcpm"

	Chassis-version strings are of the form "fsl,qoriq-rcpm-<version>",
	such as:
	* "fsl,qoriq-rcpm-1.0": for chassis 1.0 rcpm
	* "fsl,qoriq-rcpm-2.0": for chassis 2.0 rcpm
	* "fsl,qoriq-rcpm-2.1": for chassis 2.1 rcpm
	* "fsl,qoriq-rcpm-2.1+": for chassis 2.1+ rcpm

All references to "1.0" and "2.0" refer to the QorIQ chassis version to
which the chip complies.
Chassis Version		Example Chips
---------------		-------------------------------
1.0				p4080, p5020, p5040, p2041, p3041
2.0				t4240, b4860, b4420
2.1				t1040,
2.1+				ls1021a, ls1012a, ls1043a, ls1046a

Optional properties:
 - little-endian : RCPM register block is Little Endian. Without it RCPM
   will be Big Endian (default case).

Example:
The RCPM node for T4240:
	rcpm: global-utilities@e2000 {
		compatible = "fsl,t4240-rcpm", "fsl,qoriq-rcpm-2.0";
		reg = <0xe2000 0x1000>;
		#fsl,rcpm-wakeup-cells = <2>;
	};

* Freescale RCPM Wakeup Source Device Tree Bindings
-------------------------------------------
Required fsl,rcpm-wakeup property should be added to a device node if the device
can be used as a wakeup source.

  - fsl,rcpm-wakeup: Consists of a phandle to the rcpm node and the IPPDEXPCR
	register cells. The number of IPPDEXPCR register cells is defined in
	"#fsl,rcpm-wakeup-cells" in the rcpm node. The first register cell is
	the bit mask that should be set in IPPDEXPCR0, and the second register
	cell is for IPPDEXPCR1, and so on.

	Note: IPPDEXPCR(IP Powerdown Exception Control Register) provides a
	mechanism for keeping certain blocks awake during STANDBY and MEM, in
	order to use them as wake-up sources.

Example:
	lpuart0: serial@2950000 {
		compatible = "fsl,ls1021a-lpuart";
		reg = <0x0 0x2950000 0x0 0x1000>;
		interrupts = <GIC_SPI 80 IRQ_TYPE_LEVEL_HIGH>;
		clocks = <&sysclk>;
		clock-names = "ipg";
		fsl,rcpm-wakeup = <&rcpm 0x0 0x40000000>;
	};
```

## Documentation/devicetree/bindings/soc/google/google,gs101-pmu-intr-gen.yaml
```yaml
# SPDX-License-Identifier: (GPL-2.0 OR BSD-2-Clause)
%YAML 1.2
---
$id: http://devicetree.org/schemas/soc/google/google,gs101-pmu-intr-gen.yaml#
$schema: http://devicetree.org/meta-schemas/core.yaml#

title: Google Power Management Unit (PMU) Interrupt Generation

description: |
  PMU interrupt generator for handshaking between PMU through interrupts.

maintainers:
  - Peter Griffin <peter.griffin@linaro.org>

properties:
  compatible:
    items:
      - const: google,gs101-pmu-intr-gen
      - const: syscon

  reg:
    maxItems: 1

required:
  - compatible
  - reg

additionalProperties: false

examples:
  - |
    pmu_intr_gen: syscon@17470000 {
      compatible = "google,gs101-pmu-intr-gen", "syscon";
      reg = <0x17470000 0x10000>;
    };
```

## Documentation/devicetree/bindings/soc/hisilicon/hisilicon,hi3660-usb3-otg-bc.yaml
```yaml
# SPDX-License-Identifier: GPL-2.0 OR BSD-2-Clause
%YAML 1.2
---
$id: http://devicetree.org/schemas/soc/hisilicon/hisilicon,hi3660-usb3-otg-bc.yaml#
$schema: http://devicetree.org/meta-schemas/core.yaml#

title: Hisilicon Kirin 960 USB OTG Battery Charging Syscon

maintainers:
  - Mauro Carvalho Chehab <mchehab+huawei@kernel.org>

properties:
  compatible:
    items:
      - const: hisilicon,hi3660-usb3-otg-bc
      - const: syscon
      - const: simple-mfd

  reg:
    maxItems: 1

  usb-phy:
    $ref: /schemas/phy/hisilicon,hi3660-usb3.yaml
    description: USB Phy node

required:
  - compatible
  - reg
  - usb-phy

additionalProperties: false

examples:
  - |
    syscon@ff200000 {
        compatible = "hisilicon,hi3660-usb3-otg-bc", "syscon", "simple-mfd";
        reg = <0xff200000 0x1000>;

        usb-phy {
            compatible = "hisilicon,hi3660-usb-phy";
            #phy-cells = <0>;
            hisilicon,pericrg-syscon = <&crg_ctrl>;
            hisilicon,pctrl-syscon = <&pctrl>;
            hisilicon,eye-diagram-param = <0x22466e4>;
        };
    };
```

## Documentation/devicetree/bindings/soc/imx/fsl,aips-bus.yaml
```yaml
# SPDX-License-Identifier: (GPL-2.0 OR BSD-2-Clause)
%YAML 1.2
---
$id: http://devicetree.org/schemas/soc/imx/fsl,aips-bus.yaml#
$schema: http://devicetree.org/meta-schemas/core.yaml#

title: i.MX AHB to IP Bridge

maintainers:
  - Peng Fan <peng.fan@nxp.com>

description: |
  This particular peripheral is designed as the bridge between
  AHB bus and peripherals with the lower bandwidth IP Slave (IPS)
  buses.

select:
  properties:
    compatible:
      contains:
        const: fsl,aips-bus
  required:
    - compatible

properties:
  compatible:
    items:
      - const: fsl,aips-bus
      - const: simple-bus

  reg:
    maxItems: 1

required:
  - compatible
  - reg

additionalProperties: true

examples:
  - |
    bus@30000000 {
      compatible = "fsl,aips-bus", "simple-bus";
      reg = <0x30000000 0x400000>;
      #address-cells = <1>;
      #size-cells = <1>;
      ranges;
    };
...
```

## Documentation/devicetree/bindings/soc/imx/fsl,imx-anatop.yaml
```yaml
# SPDX-License-Identifier: (GPL-2.0-only OR BSD-2-Clause)
%YAML 1.2
---
$id: http://devicetree.org/schemas/soc/imx/fsl,imx-anatop.yaml#
$schema: http://devicetree.org/meta-schemas/core.yaml#

title: ANATOP register

maintainers:
  - Shawn Guo <shawnguo@kernel.org>
  - Sascha Hauer <s.hauer@pengutronix.de>

properties:
  compatible:
    oneOf:
      - items:
          - enum:
              - fsl,imx6sl-anatop
              - fsl,imx6sll-anatop
              - fsl,imx6sx-anatop
              - fsl,imx6ul-anatop
              - fsl,imx7d-anatop
          - const: fsl,imx6q-anatop
          - const: syscon
          - const: simple-mfd
      - items:
          - const: fsl,imx6q-anatop
          - const: syscon
          - const: simple-mfd

  reg:
    maxItems: 1

  interrupts:
    items:
      - description: Temperature sensor event
      - description: Brown-out event on either of the support regulators
      - description: Brown-out event on either the core, gpu or soc regulators
    minItems: 2

  tempmon:
    type: object
    unevaluatedProperties: false
    $ref: /schemas/thermal/imx-thermal.yaml

patternProperties:
  "regulator-((1p1)|(2p5)|(3p0)|(vdd1p0d)|(vdd1p2)|(vddcore)|(vddpcie)|(vddpu)|(vddsoc))$":
    type: object
    unevaluatedProperties: false
    $ref: /schemas/regulator/anatop-regulator.yaml

required:
  - compatible
  - reg

allOf:
  - if:
      properties:
        compatible:
          contains:
            enum:
              - fsl,imx7d-anatop
    then:
      properties:
        interrupts:
          maxItems: 2
    else:
      properties:
        interrupts:
          minItems: 3
          maxItems: 3

additionalProperties: false

examples:
  - |
    #include <dt-bindings/clock/imx6ul-clock.h>
    #include <dt-bindings/interrupt-controller/arm-gic.h>

    anatop: anatop@20c8000 {
        compatible = "fsl,imx6ul-anatop", "fsl,imx6q-anatop",
                     "syscon", "simple-mfd";
        reg = <0x020c8000 0x1000>;
        interrupts = <GIC_SPI 49 IRQ_TYPE_LEVEL_HIGH>,
                     <GIC_SPI 54 IRQ_TYPE_LEVEL_HIGH>,
                     <GIC_SPI 127 IRQ_TYPE_LEVEL_HIGH>;

        reg_3p0: regulator-3p0 {
            compatible = "fsl,anatop-regulator";
            regulator-name = "vdd3p0";
            regulator-min-microvolt = <2625000>;
            regulator-max-microvolt = <3400000>;
            anatop-reg-offset = <0x120>;
            anatop-vol-bit-shift = <8>;
            anatop-vol-bit-width = <5>;
            anatop-min-bit-val = <0>;
            anatop-min-voltage = <2625000>;
            anatop-max-voltage = <3400000>;
            anatop-enable-bit = <0>;
        };

        reg_arm: regulator-vddcore {
            compatible = "fsl,anatop-regulator";
            regulator-name = "cpu";
            regulator-min-microvolt = <725000>;
            regulator-max-microvolt = <1450000>;
            regulator-always-on;
            anatop-reg-offset = <0x140>;
            anatop-vol-bit-shift = <0>;
            anatop-vol-bit-width = <5>;
            anatop-delay-reg-offset = <0x170>;
            anatop-delay-bit-shift = <24>;
            anatop-delay-bit-width = <2>;
            anatop-min-bit-val = <1>;
            anatop-min-voltage = <725000>;
            anatop-max-voltage = <1450000>;
        };

        reg_soc: regulator-vddsoc {
            compatible = "fsl,anatop-regulator";
            regulator-name = "vddsoc";
            regulator-min-microvolt = <725000>;
            regulator-max-microvolt = <1450000>;
            regulator-always-on;
            anatop-reg-offset = <0x140>;
            anatop-vol-bit-shift = <18>;
            anatop-vol-bit-width = <5>;
            anatop-delay-reg-offset = <0x170>;
            anatop-delay-bit-shift = <28>;
            anatop-delay-bit-width = <2>;
            anatop-min-bit-val = <1>;
            anatop-min-voltage = <725000>;
            anatop-max-voltage = <1450000>;
        };

        tempmon: tempmon {
            compatible = "fsl,imx6ul-tempmon", "fsl,imx6sx-tempmon";
            interrupt-parent = <&gpc>;
            interrupts = <GIC_SPI 49 IRQ_TYPE_LEVEL_HIGH>;
            fsl,tempmon = <&anatop>;
            nvmem-cells = <&tempmon_calib>, <&tempmon_temp_grade>;
            nvmem-cell-names = "calib", "temp_grade";
            clocks = <&clks IMX6UL_CLK_PLL3_USB_OTG>;
            #thermal-sensor-cells = <0>;
        };
    };
```

## Documentation/devicetree/bindings/soc/imx/fsl,imx8mm-disp-blk-ctrl.yaml
```yaml
# SPDX-License-Identifier: (GPL-2.0-only OR BSD-2-Clause)
%YAML 1.2
---
$id: http://devicetree.org/schemas/soc/imx/fsl,imx8mm-disp-blk-ctrl.yaml#
$schema: http://devicetree.org/meta-schemas/core.yaml#

title: NXP i.MX8MM DISP blk-ctrl

maintainers:
  - Lucas Stach <l.stach@pengutronix.de>

description:
  The i.MX8MM DISP blk-ctrl is a top-level peripheral providing access to
  the NoC and ensuring proper power sequencing of the display and MIPI CSI
  peripherals located in the DISP domain of the SoC.

properties:
  compatible:
    items:
      - const: fsl,imx8mm-disp-blk-ctrl
      - const: syscon

  reg:
    maxItems: 1

  '#power-domain-cells':
    const: 1

  power-domains:
    minItems: 5
    maxItems: 5

  power-domain-names:
    items:
      - const: bus
      - const: csi-bridge
      - const: lcdif
      - const: mipi-dsi
      - const: mipi-csi

  clocks:
    minItems: 10
    maxItems: 10

  clock-names:
    items:
      - const: csi-bridge-axi
      - const: csi-bridge-apb
      - const: csi-bridge-core
      - const: lcdif-axi
      - const: lcdif-apb
      - const: lcdif-pix
      - const: dsi-pclk
      - const: dsi-ref
      - const: csi-aclk
      - const: csi-pclk

required:
  - compatible
  - reg
  - power-domains
  - power-domain-names
  - clocks
  - clock-names

additionalProperties: false

examples:
  - |
    #include <dt-bindings/clock/imx8mm-clock.h>
    #include <dt-bindings/power/imx8mm-power.h>

    blk-ctrl@32e28000 {
      compatible = "fsl,imx8mm-disp-blk-ctrl", "syscon";
      reg = <0x32e28000 0x100>;
      power-domains = <&pgc_dispmix>, <&pgc_dispmix>, <&pgc_dispmix>,
                      <&pgc_mipi>, <&pgc_mipi>;
      power-domain-names = "bus", "csi-bridge", "lcdif",
                           "mipi-dsi", "mipi-csi";
      clocks = <&clk IMX8MM_CLK_DISP_AXI_ROOT>,
               <&clk IMX8MM_CLK_DISP_APB_ROOT>,
               <&clk IMX8MM_CLK_CSI1_ROOT>,
               <&clk IMX8MM_CLK_DISP_AXI_ROOT>,
               <&clk IMX8MM_CLK_DISP_APB_ROOT>,
               <&clk IMX8MM_CLK_DISP_ROOT>,
               <&clk IMX8MM_CLK_DSI_CORE>,
               <&clk IMX8MM_CLK_DSI_PHY_REF>,
               <&clk IMX8MM_CLK_CSI1_CORE>,
               <&clk IMX8MM_CLK_CSI1_PHY_REF>;
       clock-names = "csi-bridge-axi", "csi-bridge-apb", "csi-bridge-core",
                     "lcdif-axi", "lcdif-apb", "lcdif-pix", "dsi-pclk",
                     "dsi-ref", "csi-aclk", "csi-pclk";
       #power-domain-cells = <1>;
    };
```
