## Documentation/devicetree/bindings/soc/fsl/fsl,qman.yaml
```yaml
# SPDX-License-Identifier: (GPL-2.0-only OR BSD-2-Clause)
%YAML 1.2
---
$id: http://devicetree.org/schemas/soc/fsl/fsl,qman.yaml#
$schema: http://devicetree.org/meta-schemas/core.yaml#

title: QorIQ DPAA Queue Manager

maintainers:
  - Frank Li <Frank.Li@nxp.com>

description:
  The Queue Manager is part of the Data-Path Acceleration Architecture (DPAA). QMan
  supports queuing and QoS scheduling of frames to CPUs, network interfaces and
  DPAA logic modules, maintains packet ordering within flows. Besides providing
  flow-level queuing, is also responsible for congestion management functions such
  as RED/WRED, congestion notifications and tail discards. This binding covers the
  CCSR space programming model

properties:
  compatible:
    oneOf:
      - const: fsl,qman
      - items:
          - enum:
              - fsl,ls1043a-qman
              - fsl,ls1046a-qman
          - const: fsl,qman
  reg:
    items:
      - description: |
          Registers region within the CCSR address space

          The QMan revision information is located in the QMAN_IP_REV_1/2
          registers which are located at offsets 0xbf8 and 0xbfc

  interrupts:
    items:
      - description: The error interrupt

  fsl,qman-portals:
    $ref: /schemas/types.yaml#/definitions/phandle
    description: ref fsl,qman-port.yaml

  fsl,liodn:
    $ref: /schemas/types.yaml#/definitions/uint32-array
    description:
      See pamu.txt, PAMU property used for static LIODN assignment

  fsl,iommu-parent:
    $ref: /schemas/types.yaml#/definitions/phandle
    description:
      See pamu.txt, PAMU property used for dynamic LIODN assignment

  clocks:
    maxItems: 1
    description:
      Reference input clock. Its frequency is half of the platform clock

  memory-region:
    maxItems: 2
    description:
      List of phandles referencing the QMan private memory nodes (described
      below). The qman-fqd node must be first followed by qman-pfdr node.
      Only used on ARM Devices connected to a QMan instance via Direct Connect
      Portals (DCP) must link to the respective QMan instance.

  fsl,qman:
    $ref: /schemas/types.yaml#/definitions/uint32-array
    description:
      List of phandle and DCP index pairs, to the QMan instance
      to which this device is connected via the DCP

required:
  - compatible
  - reg
  - interrupts

additionalProperties: false

examples:
  - |
    #include <dt-bindings/interrupt-controller/irq.h>

    qman: qman@318000 {
        compatible = "fsl,qman";
        reg = <0x318000 0x1000>;
        interrupts = <16 IRQ_TYPE_EDGE_FALLING 1 3>;
        fsl,liodn = <0x16>;
        fsl,qman-portals = <&qportals>;
        memory-region = <&qman_fqd &qman_pfdr>;
        clocks = <&platform_pll 1>;
    };
```

## Documentation/devicetree/bindings/soc/fsl/fsl,rcpm.yaml
```yaml
# SPDX-License-Identifier: (GPL-2.0-only OR BSD-2-Clause)
%YAML 1.2
---
$id: http://devicetree.org/schemas/soc/fsl/fsl,rcpm.yaml#
$schema: http://devicetree.org/meta-schemas/core.yaml#

title: Run Control and Power Management

description:
  The RCPM performs all device-level tasks associated with device run control
  and power management.

maintainers:
  - Frank Li <Frank.Li@nxp.com>

properties:
  compatible:
    oneOf:
      - items:
          - enum:
              - fsl,p2041-rcpm
              - fsl,p3041-rcpm
              - fsl,p4080-rcpm
              - fsl,p5020-rcpm
              - fsl,p5040-rcpm
          - const: fsl,qoriq-rcpm-1.0
      - items:
          - enum:
              - fsl,b4420-rcpm
              - fsl,b4860-rcpm
              - fsl,t4240-rcpm
          - const: fsl,qoriq-rcpm-2.0
      - items:
          - enum:
              - fsl,t1040-rcpm
          - const: fsl,qoriq-rcpm-2.1
      - items:
          - enum:
              - fsl,ls1012a-rcpm
              - fsl,ls1021a-rcpm
              - fsl,ls1028a-rcpm
              - fsl,ls1043a-rcpm
              - fsl,ls1046a-rcpm
              - fsl,ls1088a-rcpm
              - fsl,ls208xa-rcpm
              - fsl,lx2160a-rcpm
          - const: fsl,qoriq-rcpm-2.1+

  reg:
    maxItems: 1

  "#fsl,rcpm-wakeup-cells":
    description: |
      The number of IPPDEXPCR register cells in the
      fsl,rcpm-wakeup property.

      Freescale RCPM Wakeup Source Device Tree Bindings

      Required fsl,rcpm-wakeup property should be added to a device node if
      the device can be used as a wakeup source.

      fsl,rcpm-wakeup: Consists of a phandle to the rcpm node and the IPPDEXPCR
      register cells. The number of IPPDEXPCR register cells is defined in
      "#fsl,rcpm-wakeup-cells" in the rcpm node. The first register cell is
      the bit mask that should be set in IPPDEXPCR0, and the second register
      cell is for IPPDEXPCR1, and so on.

      Note: IPPDEXPCR(IP Powerdown Exception Control Register) provides a
      mechanism for keeping certain blocks awake during STANDBY and MEM, in
      order to use them as wake-up sources.

  little-endian:
    $ref: /schemas/types.yaml#/definitions/flag
    description:
      RCPM register block is Little Endian. Without it RCPM
      will be Big Endian (default case).

additionalProperties: false

examples:
  - |
    #include <dt-bindings/interrupt-controller/arm-gic.h>
    global-utilities@e2000 {
          compatible = "fsl,t4240-rcpm", "fsl,qoriq-rcpm-2.0";
          reg = <0xe2000 0x1000>;
          #fsl,rcpm-wakeup-cells = <2>;
    };
```

## Documentation/devicetree/bindings/soc/fsl/fsl,vf610-src.yaml
```yaml
# SPDX-License-Identifier: (GPL-2.0-only OR BSD-2-Clause)
%YAML 1.2
---
$id: http://devicetree.org/schemas/soc/fsl/fsl,vf610-src.yaml#
$schema: http://devicetree.org/meta-schemas/core.yaml#

title: Freescale vf610 System Reset Controller (SRC)

maintainers:
  - Frank Li <Frank.Li@nxp.com>

description:
  IC reference manual calls it as SRC, but it is not module as reset
  controller, which used to reset individual device. SRC works as reboot
  controller, which reboots whole system. It provides a syscon interface to
  syscon-reboot.

properties:
  compatible:
    items:
      - enum:
          - fsl,vf610-src
      - const: syscon

  reg:
    maxItems: 1

  interrupts:
    maxItems: 1

required:
  - compatible
  - reg
  - interrupts

additionalProperties: false

examples:
  - |
    #include <dt-bindings/interrupt-controller/irq.h>

    syscon@4006e000 {
        compatible = "fsl,vf610-src", "syscon";
        reg = <0x4006e000 0x1000>;
        interrupts = <96 IRQ_TYPE_LEVEL_HIGH>;
    };
```

## Documentation/devicetree/bindings/soc/fsl/qman-portals.txt
```
QorIQ DPAA Queue Manager Portals Device Tree Binding

Copyright (C) 2008 - 2014 Freescale Semiconductor Inc.

CONTENTS

	- QMan Portal
	- QMan Pool Channel
	- Example

QMan Portal Node

Portals are memory mapped interfaces to QMan that allow low-latency, lock-less
interaction by software running on processor cores, accelerators and network
interfaces with the QMan

PROPERTIES

- compatible
	Usage:		Required
	Value type:	<stringlist>
	Definition:	Must include "fsl,qman-portal-<hardware revision>"
			May include "fsl,<SoC>-qman-portal" or "fsl,qman-portal"

- reg
	Usage:		Required
	Value type:	<prop-encoded-array>
	Definition:	Two regions. The first is the cache-enabled region of
			the portal. The second is the cache-inhibited region of
			the portal

- interrupts
	Usage:		Required
	Value type:	<prop-encoded-array>
	Definition:	Standard property

- fsl,liodn
	Usage:		See pamu.txt
	Value type:	<prop-encoded-array>
	Definition:	Two LIODN(s). DQRR LIODN (DLIODN) and Frame LIODN
			(FLIODN)

- fsl,iommu-parent
	Usage:		See pamu.txt
	Value type:	<phandle>
	Definition:	PAMU property used for dynamic LIODN assignment

	For additional details about the PAMU/LIODN binding(s) see pamu.txt

- cell-index
	Usage:		Required
	Value type:	<u32>
	Definition:	The hardware index of the channel. This can also be
			determined by dividing any of the channel's 8 work queue
			IDs by 8

In addition to these properties the qman-portals should have sub-nodes to
represent the HW devices/portals that are connected to the software portal
described here

The currently supported sub-nodes are:
	* fman0
	* fman1
	* pme
	* crypto

These subnodes should have the following properties:

- fsl,liodn
	Usage:		See pamu.txt
	Value type:	<prop-encoded-array>
	Definition:	PAMU property used for static LIODN assignment

- fsl,iommu-parent
	Usage:		See pamu.txt
	Value type:	<phandle>
	Definition:	PAMU property used for dynamic LIODN assignment

- dev-handle
	Usage:		Required
	Value type:	<phandle>
	Definition:	The phandle to the particular hardware device that this
			portal is connected to.

DPAA QMan Pool Channel Nodes

Pool Channels are defined with the following properties.

PROPERTIES

- compatible
	Usage:		Required
	Value type:	<stringlist>
	Definition:	Must include "fsl,qman-pool-channel"
			May include "fsl,<SoC>-qman-pool-channel"

- fsl,qman-channel-id
	Usage:		Required
	Value type:	<u32>
	Definition:	The hardware index of the channel. This can also be
			determined by dividing any of the channel's 8 work queue
			IDs by 8

EXAMPLE

The example below shows a (P4080) QMan portals container/bus node with two portals

	qman-portals@ff4200000 {
		#address-cells = <1>;
		#size-cells = <1>;
		compatible = "simple-bus";
		ranges = <0 0xf 0xf4200000 0x200000>;

		qman-portal@0 {
			compatible = "fsl,qman-portal-1.2.0", "fsl,qman-portal";
			reg = <0 0x4000>, <0x100000 0x1000>;
			interrupts = <104 2 0 0>;
			fsl,liodn = <1 2>;
			fsl,qman-channel-id = <0>;

			fman0 {
				fsl,liodn = <0x21>;
				dev-handle = <&fman0>;
			};
			fman1 {
				fsl,liodn = <0xa1>;
				dev-handle = <&fman1>;
			};
			crypto {
				fsl,liodn = <0x41 0x66>;
				dev-handle = <&crypto>;
			};
		};
		qman-portal@4000 {
			compatible = "fsl,qman-portal-1.2.0", "fsl,qman-portal";
			reg = <0x4000 0x4000>, <0x101000 0x1000>;
			interrupts = <106 2 0 0>;
			fsl,liodn = <3 4>;
			cell-index = <1>;

			fman0 {
				fsl,liodn = <0x22>;
				dev-handle = <&fman0>;
			};
			fman1 {
				fsl,liodn = <0xa2>;
				dev-handle = <&fman1>;
			};
			crypto {
				fsl,liodn = <0x42 0x67>;
				dev-handle = <&crypto>;
			};
		};
	};
```

## Documentation/devicetree/bindings/soc/fsl/qman.txt
```
QorIQ DPAA Queue Manager Device Tree Binding

Copyright (C) 2008 - 2014 Freescale Semiconductor Inc.

CONTENTS

	- QMan Node
	- QMan Private Memory Nodes
	- Example

QMan Node

The Queue Manager is part of the Data-Path Acceleration Architecture (DPAA). QMan
supports queuing and QoS scheduling of frames to CPUs, network interfaces and
DPAA logic modules, maintains packet ordering within flows. Besides providing
flow-level queuing, is also responsible for congestion management functions such
as RED/WRED, congestion notifications and tail discards. This binding covers the
CCSR space programming model

PROPERTIES

- compatible
	Usage:		Required
	Value type:	<stringlist>
	Definition:	Must include "fsl,qman"
			May include "fsl,<SoC>-qman"

- reg
	Usage:		Required
	Value type:	<prop-encoded-array>
	Definition:	Registers region within the CCSR address space

The QMan revision information is located in the QMAN_IP_REV_1/2 registers which
are located at offsets 0xbf8 and 0xbfc

- interrupts
	Usage:		Required
	Value type:	<prop-encoded-array>
	Definition:	Standard property. The error interrupt

- fsl,qman-portals
	Usage:		Required
	Value type:	<phandle>
	Definition:	Phandle to this QMan instance's portals

- fsl,liodn
	Usage:		See pamu.txt
	Value type:	<prop-encoded-array>
	Definition:	PAMU property used for static LIODN assignment

- fsl,iommu-parent
	Usage:		See pamu.txt
	Value type:	<phandle>
	Definition:	PAMU property used for dynamic LIODN assignment

	For additional details about the PAMU/LIODN binding(s) see pamu.txt

- clocks
	Usage:		See clock-bindings.txt and qoriq-clock.txt
	Value type:	<prop-encoded-array>
	Definition:	Reference input clock. Its frequency is half of the
			platform clock
- memory-regions
	Usage:		Required for ARM
	Value type:	<phandle array>
	Definition:	List of phandles referencing the QMan private memory
			nodes (described below). The qman-fqd node must be
			first followed by qman-pfdr node. Only used on ARM

Devices connected to a QMan instance via Direct Connect Portals (DCP) must link
to the respective QMan instance

- fsl,qman
	Usage:		Required
	Value type:	<prop-encoded-array>
	Description:	List of phandle and DCP index pairs, to the QMan instance
			to which this device is connected via the DCP

QMan Private Memory Nodes

QMan requires two contiguous range of physical memory used for the backing store
for QMan Frame Queue Descriptor (FQD) and Packed Frame Descriptor Record (PFDR).
This memory is reserved/allocated as a node under the /reserved-memory node.

For additional details about reserved memory regions see reserved-memory.txt

The QMan FQD memory node must be named "qman-fqd"

PROPERTIES

- compatible
	Usage:		required
	Value type:	<stringlist>
	Definition:	PPC platforms: Must include "fsl,qman-fqd"
			ARM platforms: Must include "shared-dma-pool"
				       as well as the "no-map" property

The QMan PFDR memory node must be named "qman-pfdr"

PROPERTIES

- compatible
	Usage:		required
	Value type:	<stringlist>
	Definition:	PPC platforms: Must include "fsl,qman-pfdr"
			ARM platforms: Must include "shared-dma-pool"
				       as well as the "no-map" property

The following constraints are relevant to the FQD and PFDR private memory:
	- The size must be 2^(size + 1), with size = 11..29. That is 4 KiB to
	  1 GiB
	- The alignment must be a muliptle of the memory size

The size of the FQD and PFDP must be chosen by observing the hardware features
configured via the Reset Configuration Word (RCW) and that are relevant to a
specific board (e.g. number of MAC(s) pinned-out, number of offline/host command
FMan ports, etc.). The size configured in the DT must reflect the hardware
capabilities and not the specific needs of an application

For additional details about reserved memory regions see reserved-memory.txt

EXAMPLE

The example below shows a QMan FQD and a PFDR dynamic allocation memory nodes

	reserved-memory {
		#address-cells = <2>;
		#size-cells = <2>;
		ranges;

		qman_fqd: qman-fqd {
			compatible = "shared-dma-pool";
			size = <0 0x400000>;
			alignment = <0 0x400000>;
			no-map;
		};
		qman_pfdr: qman-pfdr {
			compatible = "shared-dma-pool";
			size = <0 0x2000000>;
			alignment = <0 0x2000000>;
			no-map;
		};
	};

The example below shows a (P4080) QMan CCSR-space node

	qportals: qman-portals@ff4200000 {
		...
	};

	clockgen: global-utilities@e1000 {
		...
		sysclk: sysclk {
			...
		};
		...
		platform_pll: platform-pll@c00 {
			#clock-cells = <1>;
			reg = <0xc00 0x4>;
			compatible = "fsl,qoriq-platform-pll-1.0";
			clocks = <&sysclk>;
			clock-output-names = "platform-pll", "platform-pll-div2";
		};
		...
	};

	crypto@300000 {
		...
		fsl,qman = <&qman, 2>;
		...
	};

	qman: qman@318000 {
		compatible = "fsl,qman";
		reg = <0x318000 0x1000>;
		interrupts = <16 2 1 3>
		fsl,liodn = <0x16>;
		fsl,qman-portals = <&qportals>;
		memory-region = <&qman_fqd &qman_pfdr>;
		clocks = <&platform_pll 1>;
	};

	fman@400000 {
		...
		fsl,qman = <&qman, 0>;
		...
	};
```
