## Documentation/devicetree/bindings/soc/imx/fsl,imx8mm-vpu-blk-ctrl.yaml
```yaml
# SPDX-License-Identifier: (GPL-2.0-only OR BSD-2-Clause)
%YAML 1.2
---
$id: http://devicetree.org/schemas/soc/imx/fsl,imx8mm-vpu-blk-ctrl.yaml#
$schema: http://devicetree.org/meta-schemas/core.yaml#

title: NXP i.MX8MM VPU blk-ctrl

maintainers:
  - Lucas Stach <l.stach@pengutronix.de>

description:
  The i.MX8MM VPU blk-ctrl is a top-level peripheral providing access to
  the NoC and ensuring proper power sequencing of the VPU peripherals
  located in the VPU domain of the SoC.

properties:
  compatible:
    items:
      - const: fsl,imx8mm-vpu-blk-ctrl
      - const: syscon

  reg:
    maxItems: 1

  '#power-domain-cells':
    const: 1

  power-domains:
    maxItems: 4

  power-domain-names:
    maxItems: 4

  clocks:
    maxItems: 3

  clock-names:
    maxItems: 3

  interconnects:
    maxItems: 3

  interconnect-names:
    maxItems: 3

required:
  - compatible
  - reg
  - power-domains
  - power-domain-names
  - clocks
  - clock-names

allOf:
  - if:
      properties:
        compatible:
          contains:
            const: fsl,imx8mm-vpu-blk-ctrl
    then:
      properties:
        power-domains:
          items:
            - description: bus power domain
            - description: G1 decoder power domain
            - description: G2 decoder power domain
            - description: H1 encoder power domain

        power-domain-names:
          items:
            - const: bus
            - const: g1
            - const: g2
            - const: h1

        clocks:
          items:
            - description: G1 decoder clk
            - description: G2 decoder clk
            - description: H1 encoder clk

        clock-names:
          items:
            - const: g1
            - const: g2
            - const: h1

        interconnects:
          items:
            - description: G1 decoder interconnect
            - description: G2 decoder interconnect
            - description: H1 encoder power domain

        interconnect-names:
          items:
            - const: g1
            - const: g2
            - const: h1

  - if:
      properties:
        compatible:
          contains:
            const: fsl,imx8mp-vpu-blk-ctrl
    then:
      properties:
        power-domains:
          items:
            - description: bus power domain
            - description: G1 decoder power domain
            - description: G2 decoder power domain
            - description: VC8000E encoder power domain

        power-domain-names:
          items:
            - const: bus
            - const: g1
            - const: g2
            - const: vc8000e

        clocks:
          items:
            - description: G1 decoder clk
            - description: G2 decoder clk
            - description: VC8000E encoder clk

        clock-names:
          items:
            - const: g1
            - const: g2
            - const: vc8000e

        interconnects:
          items:
            - description: G1 decoder interconnect
            - description: G2 decoder interconnect
            - description: VC8000E encoder interconnect

        interconnect-names:
          items:
            - const: g1
            - const: g2
            - const: vc8000e

additionalProperties: false

examples:
  - |
    #include <dt-bindings/clock/imx8mm-clock.h>
    #include <dt-bindings/power/imx8mm-power.h>

    vpu_blk_ctrl: blk-ctrl@38330000 {
      compatible = "fsl,imx8mm-vpu-blk-ctrl", "syscon";
      reg = <0x38330000 0x100>;
      power-domains = <&pgc_vpumix>, <&pgc_vpu_g1>,
                      <&pgc_vpu_g2>, <&pgc_vpu_h1>;
      power-domain-names = "bus", "g1", "g2", "h1";
      clocks = <&clk IMX8MM_CLK_VPU_G1_ROOT>,
               <&clk IMX8MM_CLK_VPU_G2_ROOT>,
               <&clk IMX8MM_CLK_VPU_H1_ROOT>;
      clock-names = "g1", "g2", "h1";
      #power-domain-cells = <1>;
    };
```

## Documentation/devicetree/bindings/soc/imx/fsl,imx8mn-disp-blk-ctrl.yaml
```yaml
# SPDX-License-Identifier: (GPL-2.0-only OR BSD-2-Clause)
%YAML 1.2
---
$id: http://devicetree.org/schemas/soc/imx/fsl,imx8mn-disp-blk-ctrl.yaml#
$schema: http://devicetree.org/meta-schemas/core.yaml#

title: NXP i.MX8MN DISP blk-ctrl

maintainers:
  - Lucas Stach <l.stach@pengutronix.de>

description:
  The i.MX8MN DISP blk-ctrl is a top-level peripheral providing access to
  the NoC and ensuring proper power sequencing of the display and MIPI CSI
  peripherals located in the DISP domain of the SoC.

properties:
  compatible:
    items:
      - const: fsl,imx8mn-disp-blk-ctrl
      - const: syscon

  reg:
    maxItems: 1

  '#power-domain-cells':
    const: 1

  power-domains:
    minItems: 5
    maxItems: 5

  power-domain-names:
    items:
      - const: bus
      - const: isi
      - const: lcdif
      - const: mipi-dsi
      - const: mipi-csi

  clocks:
    minItems: 11
    maxItems: 11

  clock-names:
    items:
      - const: disp_axi
      - const: disp_apb
      - const: disp_axi_root
      - const: disp_apb_root
      - const: lcdif-axi
      - const: lcdif-apb
      - const: lcdif-pix
      - const: dsi-pclk
      - const: dsi-ref
      - const: csi-aclk
      - const: csi-pclk

required:
  - compatible
  - reg
  - power-domains
  - power-domain-names
  - clocks
  - clock-names

additionalProperties: false

examples:
  - |
    #include <dt-bindings/clock/imx8mn-clock.h>
    #include <dt-bindings/power/imx8mn-power.h>

    blk-ctrl@32e28000 {
      compatible = "fsl,imx8mn-disp-blk-ctrl", "syscon";
      reg = <0x32e28000 0x100>;
      power-domains = <&pgc_dispmix>, <&pgc_dispmix>,
                      <&pgc_dispmix>, <&pgc_mipi>,
                      <&pgc_mipi>;
      power-domain-names = "bus", "isi", "lcdif", "mipi-dsi",
                           "mipi-csi";
      clocks = <&clk IMX8MN_CLK_DISP_AXI>,
               <&clk IMX8MN_CLK_DISP_APB>,
               <&clk IMX8MN_CLK_DISP_AXI_ROOT>,
               <&clk IMX8MN_CLK_DISP_APB_ROOT>,
               <&clk IMX8MN_CLK_DISP_AXI_ROOT>,
               <&clk IMX8MN_CLK_DISP_APB_ROOT>,
               <&clk IMX8MN_CLK_DISP_PIXEL_ROOT>,
               <&clk IMX8MN_CLK_DSI_CORE>,
               <&clk IMX8MN_CLK_DSI_PHY_REF>,
               <&clk IMX8MN_CLK_CSI1_PHY_REF>,
               <&clk IMX8MN_CLK_CAMERA_PIXEL_ROOT>;
       clock-names = "disp_axi", "disp_apb", "disp_axi_root", "disp_apb_root",
                     "lcdif-axi", "lcdif-apb", "lcdif-pix", "dsi-pclk",
                     "dsi-ref", "csi-aclk", "csi-pclk";
       #power-domain-cells = <1>;
    };
```

## Documentation/devicetree/bindings/soc/imx/fsl,imx8mp-hdmi-blk-ctrl.yaml
```yaml
# SPDX-License-Identifier: (GPL-2.0-only OR BSD-2-Clause)
%YAML 1.2
---
$id: http://devicetree.org/schemas/soc/imx/fsl,imx8mp-hdmi-blk-ctrl.yaml#
$schema: http://devicetree.org/meta-schemas/core.yaml#

title: NXP i.MX8MP HDMI blk-ctrl

maintainers:
  - Lucas Stach <l.stach@pengutronix.de>

description:
  The i.MX8MP HDMMI blk-ctrl is a top-level peripheral providing access to
  the NoC and ensuring proper power sequencing of the display pipeline
  peripherals located in the HDMI domain of the SoC.

properties:
  compatible:
    items:
      - const: fsl,imx8mp-hdmi-blk-ctrl
      - const: syscon

  reg:
    maxItems: 1

  '#power-domain-cells':
    const: 1

  power-domains:
    minItems: 10
    maxItems: 10

  power-domain-names:
    items:
      - const: bus
      - const: irqsteer
      - const: lcdif
      - const: pai
      - const: pvi
      - const: trng
      - const: hdmi-tx
      - const: hdmi-tx-phy
      - const: hdcp
      - const: hrv

  clocks:
    minItems: 5
    maxItems: 5

  clock-names:
    items:
      - const: apb
      - const: axi
      - const: ref_266m
      - const: ref_24m
      - const: fdcc

  interconnects:
    maxItems: 3

  interconnect-names:
    items:
      - const: hrv
      - const: lcdif-hdmi
      - const: hdcp

required:
  - compatible
  - reg
  - power-domains
  - power-domain-names
  - clocks
  - clock-names

additionalProperties: false

examples:
  - |
    #include <dt-bindings/clock/imx8mp-clock.h>
    #include <dt-bindings/power/imx8mp-power.h>

    blk-ctrl@32fc0000 {
        compatible = "fsl,imx8mp-hdmi-blk-ctrl", "syscon";
        reg = <0x32fc0000 0x23c>;
        clocks = <&clk IMX8MP_CLK_HDMI_APB>,
                 <&clk IMX8MP_CLK_HDMI_ROOT>,
                 <&clk IMX8MP_CLK_HDMI_REF_266M>,
                 <&clk IMX8MP_CLK_HDMI_24M>,
                 <&clk IMX8MP_CLK_HDMI_FDCC_TST>;
        clock-names = "apb", "axi", "ref_266m", "ref_24m", "fdcc";
        power-domains = <&pgc_hdmimix>, <&pgc_hdmimix>, <&pgc_hdmimix>,
                        <&pgc_hdmimix>, <&pgc_hdmimix>, <&pgc_hdmimix>,
                        <&pgc_hdmimix>, <&pgc_hdmi_phy>,
                        <&pgc_hdmimix>, <&pgc_hdmimix>;
        power-domain-names = "bus", "irqsteer", "lcdif", "pai", "pvi", "trng",
                             "hdmi-tx", "hdmi-tx-phy",
                             "hdcp", "hrv";
        #power-domain-cells = <1>;
    };
```

## Documentation/devicetree/bindings/soc/imx/fsl,imx8mp-hsio-blk-ctrl.yaml
```yaml
# SPDX-License-Identifier: (GPL-2.0-only OR BSD-2-Clause)
%YAML 1.2
---
$id: http://devicetree.org/schemas/soc/imx/fsl,imx8mp-hsio-blk-ctrl.yaml#
$schema: http://devicetree.org/meta-schemas/core.yaml#

title: NXP i.MX8MP HSIO blk-ctrl

maintainers:
  - Lucas Stach <l.stach@pengutronix.de>

description:
  The i.MX8MP HSIO blk-ctrl is a top-level peripheral providing access to
  the NoC and ensuring proper power sequencing of the high-speed IO
  (USB an PCIe) peripherals located in the HSIO domain of the SoC.

properties:
  compatible:
    items:
      - const: fsl,imx8mp-hsio-blk-ctrl
      - const: syscon

  reg:
    maxItems: 1

  '#power-domain-cells':
    const: 1

  power-domains:
    minItems: 6
    maxItems: 6

  power-domain-names:
    items:
      - const: bus
      - const: usb
      - const: usb-phy1
      - const: usb-phy2
      - const: pcie
      - const: pcie-phy

  '#clock-cells':
    const: 0

  clocks:
    minItems: 2
    maxItems: 2

  clock-names:
    items:
      - const: usb
      - const: pcie

  interconnects:
    maxItems: 4

  interconnect-names:
    items:
      - const: noc-pcie
      - const: usb1
      - const: usb2
      - const: pcie

required:
  - compatible
  - reg
  - power-domains
  - power-domain-names
  - clocks
  - clock-names

additionalProperties: false

examples:
  - |
    #include <dt-bindings/clock/imx8mp-clock.h>
    #include <dt-bindings/power/imx8mp-power.h>

    blk-ctrl@32f10000 {
        compatible = "fsl,imx8mp-hsio-blk-ctrl", "syscon";
        reg = <0x32f10000 0x24>;
        clocks = <&clk IMX8MP_CLK_USB_ROOT>,
                 <&clk IMX8MP_CLK_PCIE_ROOT>;
        clock-names = "usb", "pcie";
        power-domains = <&pgc_hsiomix>, <&pgc_hsiomix>,
                        <&pgc_usb1_phy>, <&pgc_usb2_phy>,
                        <&pgc_hsiomix>, <&pgc_pcie_phy>;
        power-domain-names = "bus", "usb", "usb-phy1",
                             "usb-phy2", "pcie", "pcie-phy";
        #power-domain-cells = <1>;
        #clock-cells = <0>;
    };
```

## Documentation/devicetree/bindings/soc/imx/fsl,imx8mp-media-blk-ctrl.yaml
```yaml
# SPDX-License-Identifier: (GPL-2.0-only OR BSD-2-Clause)
%YAML 1.2
---
$id: http://devicetree.org/schemas/soc/imx/fsl,imx8mp-media-blk-ctrl.yaml#
$schema: http://devicetree.org/meta-schemas/core.yaml#

title: NXP i.MX8MP Media Block Control

maintainers:
  - Paul Elder <paul.elder@ideasonboard.com>

description:
  The i.MX8MP Media Block Control (MEDIA BLK_CTRL) is a top-level peripheral
  providing access to the NoC and ensuring proper power sequencing of the
  peripherals within the MEDIAMIX domain.

properties:
  compatible:
    items:
      - const: fsl,imx8mp-media-blk-ctrl
      - const: syscon

  reg:
    maxItems: 1

  '#power-domain-cells':
    const: 1

  power-domains:
    maxItems: 10

  power-domain-names:
    items:
      - const: bus
      - const: mipi-dsi1
      - const: mipi-csi1
      - const: lcdif1
      - const: isi
      - const: mipi-csi2
      - const: lcdif2
      - const: isp
      - const: dwe
      - const: mipi-dsi2

  clocks:
    items:
      - description: The APB clock
      - description: The AXI clock
      - description: The pixel clock for the first CSI2 receiver (aclk)
      - description: The pixel clock for the second CSI2 receiver (aclk)
      - description: The pixel clock for the first LCDIF (pix_clk)
      - description: The pixel clock for the second LCDIF (pix_clk)
      - description: The core clock for the ISP (clk)
      - description: The MIPI-PHY reference clock used by DSI

  clock-names:
    items:
      - const: apb
      - const: axi
      - const: cam1
      - const: cam2
      - const: disp1
      - const: disp2
      - const: isp
      - const: phy

  interconnects:
    maxItems: 8

  interconnect-names:
    items:
      - const: lcdif-rd
      - const: lcdif-wr
      - const: isi0
      - const: isi1
      - const: isi2
      - const: isp0
      - const: isp1
      - const: dwe

required:
  - compatible
  - reg
  - '#power-domain-cells'
  - power-domains
  - power-domain-names
  - clocks
  - clock-names

additionalProperties: false

examples:
  - |
    #include <dt-bindings/clock/imx8mp-clock.h>
    #include <dt-bindings/power/imx8mp-power.h>

    media_blk_ctl: blk-ctl@32ec0000 {
        compatible = "fsl,imx8mp-media-blk-ctrl", "syscon";
        reg = <0x32ec0000 0x138>;
        power-domains = <&mediamix_pd>, <&mipi_phy1_pd>, <&mipi_phy1_pd>,
                        <&mediamix_pd>, <&mediamix_pd>, <&mipi_phy2_pd>,
                        <&mediamix_pd>, <&ispdwp_pd>, <&ispdwp_pd>,
                        <&mipi_phy2_pd>;
        power-domain-names = "bus", "mipi-dsi1", "mipi-csi1", "lcdif1", "isi",
                             "mipi-csi2", "lcdif2", "isp", "dwe", "mipi-dsi2";
        clocks = <&clk IMX8MP_CLK_MEDIA_APB_ROOT>,
                 <&clk IMX8MP_CLK_MEDIA_AXI_ROOT>,
                 <&clk IMX8MP_CLK_MEDIA_CAM1_PIX_ROOT>,
                 <&clk IMX8MP_CLK_MEDIA_CAM2_PIX_ROOT>,
                 <&clk IMX8MP_CLK_MEDIA_DISP1_PIX_ROOT>,
                 <&clk IMX8MP_CLK_MEDIA_DISP2_PIX_ROOT>,
                 <&clk IMX8MP_CLK_MEDIA_ISP_ROOT>,
                 <&clk IMX8MP_CLK_MEDIA_MIPI_PHY1_REF_ROOT>;
        clock-names = "apb", "axi", "cam1", "cam2", "disp1", "disp2",
                      "isp", "phy";
        #power-domain-cells = <1>;
    };
...
```
