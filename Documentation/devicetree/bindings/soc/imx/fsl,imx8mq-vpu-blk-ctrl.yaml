## Documentation/devicetree/bindings/soc/loongson/loongson,ls2k-pmc.yaml
```yaml
# SPDX-License-Identifier: (GPL-2.0 OR BSD-2-Clause)
%YAML 1.2
---
$id: http://devicetree.org/schemas/soc/loongson/loongson,ls2k-pmc.yaml#
$schema: http://devicetree.org/meta-schemas/core.yaml#

title: Loongson-2 Power Manager controller

maintainers:
  - Yinbo Zhu <zhuyinbo@loongson.cn>

properties:
  compatible:
    oneOf:
      - items:
          - const: loongson,ls2k0500-pmc
          - const: syscon
      - items:
          - enum:
              - loongson,ls2k1000-pmc
              - loongson,ls2k2000-pmc
          - const: loongson,ls2k0500-pmc
          - const: syscon

  reg:
    maxItems: 1

  interrupts:
    maxItems: 1

  loongson,suspend-address:
    $ref: /schemas/types.yaml#/definitions/uint64
    description:
      The "loongson,suspend-address" is a deep sleep state (Suspend To
      RAM) firmware entry address which was jumped from kernel and it's
      value was dependent on specific platform firmware code. In
      addition, the PM need according to it to indicate that current
      SoC whether support Suspend To RAM.

  syscon-poweroff:
    $ref: /schemas/power/reset/syscon-poweroff.yaml#
    type: object
    description:
      Node for power off method

  syscon-reboot:
    $ref: /schemas/power/reset/syscon-reboot.yaml#
    type: object
    description:
      Node for reboot method

required:
  - compatible
  - reg
  - interrupts

additionalProperties: false

examples:
  - |
    #include <dt-bindings/interrupt-controller/irq.h>

    power-management@1fe27000 {
        compatible = "loongson,ls2k1000-pmc", "loongson,ls2k0500-pmc", "syscon";
        reg = <0x1fe27000 0x58>;
        interrupt-parent = <&liointc1>;
        interrupts = <11 IRQ_TYPE_LEVEL_LOW>;
        loongson,suspend-address = <0x0 0x1c000500>;

        syscon-reboot {
            compatible = "syscon-reboot";
            offset = <0x30>;
            mask = <0x1>;
        };

        syscon-poweroff {
            compatible = "syscon-poweroff";
            regmap = <&pmc>;
            offset = <0x14>;
            mask = <0x3c00>;
            value = <0x3c00>;
        };
    };
```

## Documentation/devicetree/bindings/soc/mediatek/auxadc.txt
```
MediaTek AUXADC
===============

The Auxiliary Analog/Digital Converter (AUXADC) is an ADC found
in some Mediatek SoCs which among other things measures the temperatures
in the SoC. It can be used directly with register accesses, but it is also
used by thermal controller which reads the temperatures from the AUXADC
directly via its own bus interface. See
Documentation/devicetree/bindings/thermal/mediatek-thermal.txt
for the Thermal Controller which holds a phandle to the AUXADC.

Required properties:
- compatible: Must be "mediatek,mt8173-auxadc"
- reg: Address range of the AUXADC unit

Example:

auxadc: auxadc@11001000 {
	compatible = "mediatek,mt8173-auxadc";
	reg = <0 0x11001000 0 0x1000>;
};
```

## Documentation/devicetree/bindings/soc/mediatek/devapc.yaml
```yaml
# SPDX-License-Identifier: (GPL-2.0 OR BSD-2-Clause)
# # Copyright 2020 MediaTek Inc.
%YAML 1.2
---
$id: "http://devicetree.org/schemas/soc/mediatek/devapc.yaml#"
$schema: "http://devicetree.org/meta-schemas/core.yaml#"

title: MediaTek Device Access Permission Control driver

description: |
  MediaTek bus fabric provides TrustZone security support and data
  protection to prevent slaves from being accessed by unexpected masters.
  The security violation is logged and sent to the processor for further
  analysis and countermeasures.

maintainers:
  - Neal Liu <neal.liu@mediatek.com>

properties:
  compatible:
    enum:
      - mediatek,mt6779-devapc
      - mediatek,mt8186-devapc

  reg:
    description: The base address of devapc register bank
    maxItems: 1

  interrupts:
    description: A single interrupt specifier
    maxItems: 1

  clocks:
    description: Contains module clock source and clock names
    maxItems: 1

  clock-names:
    description: Names of the clocks list in clocks property
    maxItems: 1

required:
  - compatible
  - reg
  - interrupts
  - clocks
  - clock-names

additionalProperties: false

examples:
  - |
    #include <dt-bindings/interrupt-controller/arm-gic.h>
    #include <dt-bindings/clock/mt6779-clk.h>

    devapc: devapc@10207000 {
      compatible = "mediatek,mt6779-devapc";
      reg = <0x10207000 0x1000>;
      interrupts = <GIC_SPI 168 IRQ_TYPE_LEVEL_LOW>;
      clocks = <&infracfg_ao CLK_INFRA_DEVICE_APC>;
      clock-names = "devapc-infra-clock";
    };
```

## Documentation/devicetree/bindings/soc/mediatek/mediatek,ccorr.yaml
```yaml
# SPDX-License-Identifier: (GPL-2.0-only OR BSD-2-Clause)
%YAML 1.2
---
$id: http://devicetree.org/schemas/soc/mediatek/mediatek,ccorr.yaml#
$schema: http://devicetree.org/meta-schemas/core.yaml#

title: MediaTek color correction

maintainers:
  - Matthias Brugger <matthias.bgg@gmail.com>
  - Moudy Ho <moudy.ho@mediatek.com>

description: |
  MediaTek color correction with 3X3 matrix.

properties:
  compatible:
    items:
      - enum:
          - mediatek,mt8183-mdp3-ccorr

  reg:
    maxItems: 1

  mediatek,gce-client-reg:
    $ref: /schemas/types.yaml#/definitions/phandle-array
    items:
      items:
        - description: phandle of GCE
        - description: GCE subsys id
        - description: register offset
        - description: register size
    description: The register of client driver can be configured by gce with
      4 arguments defined in this property. Each GCE subsys id is mapping to
      a client defined in the header include/dt-bindings/gce/<chip>-gce.h.

  mediatek,gce-events:
    description:
      The event id which is mapping to the specific hardware event signal
      to gce. The event id is defined in the gce header
      include/dt-bindings/gce/<chip>-gce.h of each chips.
    $ref: /schemas/types.yaml#/definitions/uint32-array

  clocks:
    minItems: 1

required:
  - compatible
  - reg
  - mediatek,gce-client-reg
  - mediatek,gce-events
  - clocks

additionalProperties: false

examples:
  - |
    #include <dt-bindings/clock/mt8183-clk.h>
    #include <dt-bindings/gce/mt8183-gce.h>

    mdp3_ccorr: mdp3-ccorr@1401c000 {
      compatible = "mediatek,mt8183-mdp3-ccorr";
      reg = <0x1401c000 0x1000>;
      mediatek,gce-client-reg = <&gce SUBSYS_1401XXXX 0xc000 0x1000>;
      mediatek,gce-events = <CMDQ_EVENT_MDP_CCORR_SOF>,
                            <CMDQ_EVENT_MDP_CCORR_EOF>;
      clocks = <&mmsys CLK_MM_MDP_CCORR>;
    };
```

## Documentation/devicetree/bindings/soc/mediatek/mediatek,mt7986-wo-ccif.yaml
```yaml
# SPDX-License-Identifier: (GPL-2.0 OR BSD-2-Clause)
%YAML 1.2
---
$id: http://devicetree.org/schemas/soc/mediatek/mediatek,mt7986-wo-ccif.yaml#
$schema: http://devicetree.org/meta-schemas/core.yaml#

title: MediaTek Wireless Ethernet Dispatch (WED) WO controller interface for MT7986

maintainers:
  - Lorenzo Bianconi <lorenzo@kernel.org>
  - Felix Fietkau <nbd@nbd.name>

description:
  The MediaTek wo-ccif provides a configuration interface for WED WO
  controller used to perform offload rx packet processing (e.g. 802.11
  aggregation packet reordering or rx header translation) on MT7986 soc.

properties:
  compatible:
    items:
      - enum:
          - mediatek,mt7986-wo-ccif
          - mediatek,mt7988-wo-ccif
      - const: syscon

  reg:
    maxItems: 1

  interrupts:
    maxItems: 1

required:
  - compatible
  - reg
  - interrupts

additionalProperties: false

examples:
  - |
    #include <dt-bindings/interrupt-controller/arm-gic.h>
    #include <dt-bindings/interrupt-controller/irq.h>
    soc {
      #address-cells = <2>;
      #size-cells = <2>;

      syscon@151a5000 {
        compatible = "mediatek,mt7986-wo-ccif", "syscon";
        reg = <0 0x151a5000 0 0x1000>;
        interrupts = <GIC_SPI 205 IRQ_TYPE_LEVEL_HIGH>;
      };
    };
```

## Documentation/devicetree/bindings/soc/mediatek/mediatek,mt8183-dvfsrc.yaml
```yaml
# SPDX-License-Identifier: (GPL-2.0 OR BSD-2-Clause)
%YAML 1.2
---
$id: http://devicetree.org/schemas/soc/mediatek/mediatek,mt8183-dvfsrc.yaml#
$schema: http://devicetree.org/meta-schemas/core.yaml#

title: MediaTek Dynamic Voltage and Frequency Scaling Resource Collector (DVFSRC)

description:
  The Dynamic Voltage and Frequency Scaling Resource Collector (DVFSRC) is a
  Hardware module used to collect all the requests from both software and the
  various remote processors embedded into the SoC and decide about a minimum
  operating voltage and a minimum DRAM frequency to fulfill those requests in
  an effort to provide the best achievable performance per watt.
  This hardware IP is capable of transparently performing direct register R/W
  on all of the DVFSRC-controlled regulators and SoC bandwidth knobs.

maintainers:
  - AngeloGioacchino Del Regno <angelogioacchino.delregno@collabora.com>
  - Henry Chen <henryc.chen@mediatek.com>

properties:
  compatible:
    oneOf:
      - enum:
          - mediatek,mt8183-dvfsrc
          - mediatek,mt8195-dvfsrc
      - items:
          - const: mediatek,mt8192-dvfsrc
          - const: mediatek,mt8195-dvfsrc

  reg:
    maxItems: 1
    description: DVFSRC common register address and length.

  regulators:
    type: object
    $ref: /schemas/regulator/mediatek,mt6873-dvfsrc-regulator.yaml#

  interconnect:
    type: object
    $ref: /schemas/interconnect/mediatek,mt8183-emi.yaml#

required:
  - compatible
  - reg

additionalProperties: false

examples:
  - |
    soc {
        #address-cells = <2>;
        #size-cells = <2>;

        system-controller@10012000 {
            compatible = "mediatek,mt8195-dvfsrc";
            reg = <0 0x10012000 0 0x1000>;

            regulators {
                compatible = "mediatek,mt8195-dvfsrc-regulator";

                dvfsrc_vcore: dvfsrc-vcore {
                        regulator-name = "dvfsrc-vcore";
                        regulator-min-microvolt = <550000>;
                        regulator-max-microvolt = <750000>;
                        regulator-always-on;
                };

                dvfsrc_vscp: dvfsrc-vscp {
                        regulator-name = "dvfsrc-vscp";
                        regulator-min-microvolt = <550000>;
                        regulator-max-microvolt = <750000>;
                        regulator-always-on;
                };
            };

            emi_icc: interconnect {
                compatible = "mediatek,mt8195-emi";
                #interconnect-cells = <1>;
            };
        };
    };
```

## Documentation/devicetree/bindings/soc/mediatek/mediatek,pwrap.yaml
```yaml
# SPDX-License-Identifier: (GPL-2.0-only OR BSD-2-Clause)
%YAML 1.2
---
$id: http://devicetree.org/schemas/soc/mediatek/mediatek,pwrap.yaml#
$schema: http://devicetree.org/meta-schemas/core.yaml#

title: Mediatek PMIC Wrapper

maintainers:
  - Flora Fu <flora.fu@mediatek.com>
  - Alexandre Mergnat <amergnat@baylibre.com>

description:
  On MediaTek SoCs the PMIC is connected via SPI. The SPI master interface
  is not directly visible to the CPU, but only through the PMIC wrapper
  inside the SoC. The communication between the SoC and the PMIC can
  optionally be encrypted. Also a non standard Dual IO SPI mode can be
  used to increase speed.

  IP Pairing

  On MT8135 the pins of some SoC internal peripherals can be on the PMIC.
  The signals of these pins are routed over the SPI bus using the pwrap
  bridge. In the binding description below the properties needed for bridging
  are marked with "IP Pairing". These are optional on SoCs which do not support
  IP Pairing

properties:
  compatible:
    oneOf:
      - items:
          - enum:
              - mediatek,mt2701-pwrap
              - mediatek,mt6765-pwrap
              - mediatek,mt6779-pwrap
              - mediatek,mt6795-pwrap
              - mediatek,mt6797-pwrap
              - mediatek,mt6873-pwrap
              - mediatek,mt7622-pwrap
              - mediatek,mt8135-pwrap
              - mediatek,mt8173-pwrap
              - mediatek,mt8183-pwrap
              - mediatek,mt8186-pwrap
              - mediatek,mt8188-pwrap
              - mediatek,mt8195-pwrap
              - mediatek,mt8365-pwrap
              - mediatek,mt8516-pwrap
      - items:
          - enum:
              - mediatek,mt8186-pwrap
              - mediatek,mt8195-pwrap
          - const: syscon

  reg:
    minItems: 1
    items:
      - description: PMIC wrapper registers
      - description: IP pairing registers

  reg-names:
    minItems: 1
    items:
      - const: pwrap
      - const: pwrap-bridge

  interrupts:
    maxItems: 1

  clocks:
    minItems: 2
    items:
      - description: SPI bus clock
      - description: Main module clock
      - description: System module clock
      - description: Timer module clock

  clock-names:
    minItems: 2
    items:
      - const: spi
      - const: wrap
      - const: sys
      - const: tmr

  resets:
    minItems: 1
    items:
      - description: PMIC wrapper reset
      - description: IP pairing reset

  reset-names:
    minItems: 1
    items:
      - const: pwrap
      - const: pwrap-bridge

  pmic:
    type: object

required:
  - compatible
  - reg
  - reg-names
  - interrupts
  - clocks
  - clock-names

dependentRequired:
  resets: [reset-names]

allOf:
  - if:
      properties:
        compatible:
          contains:
            const: mediatek,mt8365-pwrap
    then:
      properties:
        clocks:
          minItems: 4

        clock-names:
          minItems: 4

additionalProperties: false

examples:
  - |
    #include <dt-bindings/interrupt-controller/irq.h>
    #include <dt-bindings/interrupt-controller/arm-gic.h>
    #include <dt-bindings/reset/mt8135-resets.h>

    soc {
        #address-cells = <2>;
        #size-cells = <2>;
        pwrap@1000f000 {
            compatible = "mediatek,mt8135-pwrap";
            reg = <0 0x1000f000 0 0x1000>,
                  <0 0x11017000 0 0x1000>;
            reg-names = "pwrap", "pwrap-bridge";
            interrupts = <GIC_SPI 128 IRQ_TYPE_LEVEL_HIGH>;
            clocks = <&clk26m>, <&clk26m>;
            clock-names = "spi", "wrap";
            resets = <&infracfg MT8135_INFRA_PMIC_WRAP_RST>,
                     <&pericfg MT8135_PERI_PWRAP_BRIDGE_SW_RST>;
            reset-names = "pwrap", "pwrap-bridge";
        };
    };
```
