## Documentation/devicetree/bindings/soc/imx/fsl,imx8mq-vpu-blk-ctrl.yaml
```yaml
# SPDX-License-Identifier: (GPL-2.0-only OR BSD-2-Clause)
%YAML 1.2
---
$id: http://devicetree.org/schemas/soc/imx/fsl,imx8mq-vpu-blk-ctrl.yaml#
$schema: http://devicetree.org/meta-schemas/core.yaml#

title: NXP i.MX8MQ VPU blk-ctrl

maintainers:
  - Lucas Stach <l.stach@pengutronix.de>

description:
  The i.MX8MQ VPU blk-ctrl is a top-level peripheral providing access to
  the NoC and ensuring proper power sequencing of the VPU peripherals
  located in the VPU domain of the SoC.

properties:
  compatible:
    items:
      - const: fsl,imx8mq-vpu-blk-ctrl

  reg:
    maxItems: 1

  '#power-domain-cells':
    const: 1

  power-domains:
    minItems: 3
    maxItems: 3

  power-domain-names:
    items:
      - const: bus
      - const: g1
      - const: g2

  clocks:
    minItems: 2
    maxItems: 2

  clock-names:
    items:
      - const: g1
      - const: g2

required:
  - compatible
  - reg
  - power-domains
  - power-domain-names
  - clocks
  - clock-names

additionalProperties: false

examples:
  - |
    #include <dt-bindings/clock/imx8mq-clock.h>
    #include <dt-bindings/power/imx8mq-power.h>

    vpu_blk_ctrl: blk-ctrl@38320000 {
      compatible = "fsl,imx8mq-vpu-blk-ctrl";
      reg = <0x38320000 0x100>;
      power-domains = <&pgc_vpu>, <&pgc_vpu>, <&pgc_vpu>;
      power-domain-names = "bus", "g1", "g2";
      clocks = <&clk IMX8MQ_CLK_VPU_G1_ROOT>,
               <&clk IMX8MQ_CLK_VPU_G2_ROOT>;
      clock-names = "g1", "g2";
      #power-domain-cells = <1>;
    };
```

## Documentation/devicetree/bindings/soc/imx/fsl,imx93-media-blk-ctrl.yaml
```yaml
# SPDX-License-Identifier: (GPL-2.0-only OR BSD-2-Clause)
%YAML 1.2
---
$id: http://devicetree.org/schemas/soc/imx/fsl,imx93-media-blk-ctrl.yaml#
$schema: http://devicetree.org/meta-schemas/core.yaml#

title: NXP i.MX93 Media blk-ctrl

maintainers:
  - Peng Fan <peng.fan@nxp.com>

description:
  The i.MX93 MEDIAMIX domain contains control and status registers known
  as MEDIAMIX Block Control (MEDIAMIX BLK_CTRL). These registers include
  clocking, reset, and miscellaneous top-level controls for peripherals
  within the MEDIAMIX domain

properties:
  compatible:
    items:
      - enum:
          - fsl,imx91-media-blk-ctrl
          - fsl,imx93-media-blk-ctrl
      - const: syscon

  reg:
    maxItems: 1

  '#power-domain-cells':
    const: 1

  power-domains:
    maxItems: 1

  clocks:
    minItems: 8
    maxItems: 10

  clock-names:
    minItems: 8
    maxItems: 10

  dpi-bridge:
    type: object
    additionalProperties: false

    properties:
      compatible:
        enum:
          - nxp,imx91-pdfc
          - nxp,imx93-pdfc

      ports:
        $ref: /schemas/graph.yaml#/properties/ports

        properties:
          port@0:
            $ref: /schemas/graph.yaml#/properties/port
            description: Input port node to receive pixel data.

          port@1:
            $ref: /schemas/graph.yaml#/$defs/port-base
            unevaluatedProperties: false
            description: Output port node to downstream pixel data receivers.

            properties:
              endpoint:
                $ref: /schemas/media/video-interfaces.yaml#
                unevaluatedProperties: false

                properties:
                  bus-width:
                    enum: [ 16, 18, 24 ]
                    description:
                      Specify the physical parallel bus width.

                      This property is optional if the display bus-width
                      matches the SoC bus-width, e.g. a 18-bit RGB666 (display)
                      is connected and all 18-bit data lines are muxed to the
                      parallel-output pads.

                      This property must be set to 18 to cut only the LSBs
                      instead of the MSBs in case a 24-bit RGB888 display is
                      connected and only the lower 18-bit data lanes are muxed
                      to the parallel-output pads.

        required:
          - port@0
          - port@1

    required:
      - compatible
      - ports

allOf:
  - if:
      properties:
        compatible:
          contains:
            const: fsl,imx91-media-blk-ctrl
    then:
      properties:
        clocks:
          maxItems: 8
        clock-names:
          items:
            - const: apb
            - const: axi
            - const: nic
            - const: disp
            - const: cam
            - const: lcdif
            - const: isi
            - const: csi
  - if:
      properties:
        compatible:
          contains:
            const: fsl,imx93-media-blk-ctrl
    then:
      properties:
        clocks:
          minItems: 10
        clock-names:
          items:
            - const: apb
            - const: axi
            - const: nic
            - const: disp
            - const: cam
            - const: pxp
            - const: lcdif
            - const: isi
            - const: csi
            - const: dsi
required:
  - compatible
  - reg
  - power-domains
  - clocks
  - clock-names

additionalProperties: false

examples:
  - |
    #include <dt-bindings/clock/imx93-clock.h>
    #include <dt-bindings/power/fsl,imx93-power.h>

    system-controller@4ac10000 {
      compatible = "fsl,imx93-media-blk-ctrl", "syscon";
      reg = <0x4ac10000 0x10000>;
      power-domains = <&mediamix>;
      clocks = <&clk IMX93_CLK_MEDIA_APB>,
               <&clk IMX93_CLK_MEDIA_AXI>,
               <&clk IMX93_CLK_NIC_MEDIA_GATE>,
               <&clk IMX93_CLK_MEDIA_DISP_PIX>,
               <&clk IMX93_CLK_CAM_PIX>,
               <&clk IMX93_CLK_PXP_GATE>,
               <&clk IMX93_CLK_LCDIF_GATE>,
               <&clk IMX93_CLK_ISI_GATE>,
               <&clk IMX93_CLK_MIPI_CSI_GATE>,
               <&clk IMX93_CLK_MIPI_DSI_GATE>;
               clock-names = "apb", "axi", "nic", "disp", "cam",
                             "pxp", "lcdif", "isi", "csi", "dsi";
      #power-domain-cells = <1>;

      dpi-bridge {
        compatible = "nxp,imx93-pdfc";

        ports {
          #address-cells = <1>;
          #size-cells = <0>;

          port@0 {
            reg = <0>;

            pdfc_from_lcdif: endpoint {
              remote-endpoint = <&lcdif_to_pdfc>;
            };
          };

          port@1 {
            reg = <1>;

            pdfc_to_panel: endpoint {
              remote-endpoint = <&panel_from_pdfc>;
              bus-width = <18>;
            };
          };
        };
      };
    };
```

## Documentation/devicetree/bindings/soc/imx/fsl,imx93-src.yaml
```yaml
# SPDX-License-Identifier: (GPL-2.0-only OR BSD-2-Clause)
%YAML 1.2
---
$id: http://devicetree.org/schemas/soc/imx/fsl,imx93-src.yaml#
$schema: http://devicetree.org/meta-schemas/core.yaml#

title: NXP i.MX93 System Reset Controller

maintainers:
  - Peng Fan <peng.fan@nxp.com>

description: |
  The System Reset Controller (SRC) is responsible for the generation of
  all the system reset signals and boot argument latching.

  Its main functions are as follows,
  - Deals with all global system reset sources from other modules,
    and generates global system reset.
  - Responsible for power gating of MIXs (Slices) and their memory
    low power control.

properties:
  compatible:
    items:
      - const: fsl,imx93-src
      - const: syscon

  reg:
    maxItems: 1

  ranges: true

  '#address-cells':
    const: 1

  '#size-cells':
    const: 1

patternProperties:
  "power-domain@[0-9a-f]+$":

    type: object
    properties:
      compatible:
        items:
          - const: fsl,imx93-src-slice

      '#power-domain-cells':
        const: 0

      reg:
        items:
          - description: mix slice register region
          - description: mem slice register region

      clocks:
        description: |
          A number of phandles to clocks that need to be enabled
          during domain power-up sequencing to ensure reset
          propagation into devices located inside this power domain.
        minItems: 1
        maxItems: 5

    required:
      - compatible
      - '#power-domain-cells'
      - reg

required:
  - compatible
  - reg
  - ranges
  - '#address-cells'
  - '#size-cells'

additionalProperties: false

examples:
  - |
    #include <dt-bindings/clock/imx93-clock.h>

    system-controller@44460000 {
        compatible = "fsl,imx93-src", "syscon";
        reg = <0x44460000 0x10000>;
        #address-cells = <1>;
        #size-cells = <1>;
        ranges;

        mediamix: power-domain@0 {
            compatible = "fsl,imx93-src-slice";
            reg = <0x44462400 0x400>, <0x44465800 0x400>;
            #power-domain-cells = <0>;
            clocks = <&clk IMX93_CLK_MEDIA_AXI>,
                     <&clk IMX93_CLK_MEDIA_APB>;
        };
    };
```

## Documentation/devicetree/bindings/soc/imx/imx8m-soc.yaml
```yaml
# SPDX-License-Identifier: (GPL-2.0 OR BSD-2-Clause)
%YAML 1.2
---
$id: http://devicetree.org/schemas/soc/imx/imx8m-soc.yaml#
$schema: http://devicetree.org/meta-schemas/core.yaml#

title: NXP i.MX8M Series SoC

maintainers:
  - Alice Guo <alice.guo@nxp.com>

description: |
  NXP i.MX8M series SoCs contain fuse entries from which SoC Unique ID can be
  obtained.

select:
  properties:
    compatible:
      contains:
        enum:
          - fsl,imx8mm
          - fsl,imx8mn
          - fsl,imx8mp
          - fsl,imx8mq
  required:
    - compatible

patternProperties:
  "^soc@[0-9a-f]+$":
    type: object
    properties:
      compatible:
        items:
          - enum:
              - fsl,imx8mm-soc
              - fsl,imx8mn-soc
              - fsl,imx8mp-soc
              - fsl,imx8mq-soc
          - const: simple-bus

      "#address-cells":
        const: 1

      "#size-cells":
        const: 1

      ranges: true

      dma-ranges: true

      nvmem-cells:
        maxItems: 1
        description: Phandle to the SOC Unique ID provided by a nvmem node

      nvmem-cell-names:
        const: soc_unique_id

    required:
      - compatible
      - nvmem-cells
      - nvmem-cell-names

    additionalProperties:
      type: object

additionalProperties: true

examples:
  - |
    / {
        model = "FSL i.MX8MM EVK board";
        compatible = "fsl,imx8mm-evk", "fsl,imx8mm";
        #address-cells = <2>;
        #size-cells = <2>;

        soc@0 {
            compatible = "fsl,imx8mm-soc", "simple-bus";
            #address-cells = <1>;
            #size-cells = <1>;
            ranges = <0x0 0x0 0x0 0x3e000000>;
            nvmem-cells = <&imx8mm_uid>;
            nvmem-cell-names = "soc_unique_id";
        };
    };

...
```

## Documentation/devicetree/bindings/soc/intel/intel,hps-copy-engine.yaml
```yaml
# SPDX-License-Identifier: (GPL-2.0 OR BSD-2-Clause)
# Copyright (C) 2022, Intel Corporation
%YAML 1.2
---
$id: http://devicetree.org/schemas/soc/intel/intel,hps-copy-engine.yaml#
$schema: http://devicetree.org/meta-schemas/core.yaml#

title: Intel HPS Copy Engine

maintainers:
  - Matthew Gerlach <matthew.gerlach@linux.intel.com>

description: |
  The Intel Hard Processor System (HPS) Copy Engine is an IP block used to copy
  a bootable image from host memory to HPS DDR.  Additionally, there is a
  register the HPS can use to indicate the state of booting the copied image as
  well as a keep-a-live indication to the host.

properties:
  compatible:
    const: intel,hps-copy-engine

  '#dma-cells':
    const: 1

  reg:
    maxItems: 1

required:
  - compatible
  - reg

additionalProperties: false

examples:
  - |
    bus@80000000 {
        compatible = "simple-bus";
        reg = <0x80000000 0x60000000>,
              <0xf9000000 0x00100000>;
        reg-names = "axi_h2f", "axi_h2f_lw";
        #address-cells = <2>;
        #size-cells = <1>;
        ranges = <0x00000000 0x00000000 0xf9000000 0x00001000>;

        dma-controller@0 {
            compatible = "intel,hps-copy-engine";
            reg = <0x00000000 0x00000000 0x00001000>;
            #dma-cells = <1>;
        };
    };
```

## Documentation/devicetree/bindings/soc/intel/intel,lgm-syscon.yaml
```yaml
# SPDX-License-Identifier: GPL-2.0-only OR BSD-2-Clause
%YAML 1.2
---
$id: http://devicetree.org/schemas/soc/intel/intel,lgm-syscon.yaml#
$schema: http://devicetree.org/meta-schemas/core.yaml#

title: Intel Lightning Mountain(LGM) Syscon

maintainers:
  - Chuanhua Lei <lchuanhua@maxlinear.com>
  - Rahul Tanwar <rtanwar@maxlinear.com>

properties:
  compatible:
    items:
      - const: intel,lgm-syscon
      - const: syscon

  reg:
    maxItems: 1

  ranges: true

  "#address-cells":
    const: 1

  "#size-cells":
    const: 1

patternProperties:
  "^emmc-phy@[0-9a-f]+$":
    $ref: /schemas/phy/intel,lgm-emmc-phy.yaml#

required:
  - compatible
  - reg
  - "#address-cells"
  - "#size-cells"

additionalProperties: false

examples:
  - |
    chiptop@e0200000 {
        compatible = "intel,lgm-syscon", "syscon";
        reg = <0xe0200000 0x100>;
        ranges = <0x0 0xe0200000 0x100>;
        #address-cells = <1>;
        #size-cells = <1>;

        emmc-phy@a8 {
            compatible = "intel,lgm-emmc-phy";
            reg = <0x00a8 0x10>;
            clocks = <&emmc>;
            #phy-cells = <0>;
        };
    };
```

## Documentation/devicetree/bindings/soc/litex/litex,soc-controller.yaml
```yaml
# SPDX-License-Identifier: GPL-2.0-only OR BSD-2-Clause
# Copyright 2020 Antmicro <www.antmicro.com>
%YAML 1.2
---
$id: "http://devicetree.org/schemas/soc/litex/litex,soc-controller.yaml#"
$schema: "http://devicetree.org/meta-schemas/core.yaml#"

title: LiteX SoC Controller driver

description: |
  This is the SoC Controller driver for the LiteX SoC Builder.
  Its purpose is to verify LiteX CSR (Control&Status Register) access
  operations and provide functions for other drivers to read/write CSRs
  and to check if those accessors are ready to be used.

maintainers:
  - Karol Gugala <kgugala@antmicro.com>
  - Mateusz Holenko <mholenko@antmicro.com>

properties:
  compatible:
    const: litex,soc-controller

  reg:
    maxItems: 1

required:
  - compatible
  - reg

additionalProperties: false

examples:
  - |
    soc_ctrl0: soc-controller@f0000000 {
        compatible = "litex,soc-controller";
        reg = <0xf0000000 0xc>;
        status = "okay";
    };

...
```
