## Documentation/devicetree/bindings/soc/rockchip/rockchip-pm-config.txt
```
* the suspend mode config

Required properties:
- compatible: Should be one of the following.
- "rockchip,pm-px30" - for PX30 SOCs.
- "rockchip,pm-rk1808" - for RK1808 SOCs.
- "rockchip,pm-rk322x" - for RK322x SOCs.
- "rockchip,pm-rk3288" - for RK3288 SOCs.
- "rockchip,pm-rk3328" - for RK3328 SOCs.
- "rockchip,pm-rk3368" - for RK3368 SoCs.
- "rockchip,pm-rk3399" - for RK3399 SoCs.
- "rockchip,pm-rk3588" - for RK3588 SoCs.
- "rockchip,pm-rv1126" - for RV1126 SoCs.

- rockchip,sleep-mode-config : the sleep mode config,
  ARMOFF, OSC disabled ...

- rockchip,wakeup-config: the wake up sourece enable.
  GPIO, USB, SD...

- rockchip,pwm-regulator-config: the pwm regulator name.

Example:
	rockchip_suspend: rockchip-suspend {
		compatible = "rockchip,pm-px30";
		status = "disabled";
		rockchip,sleep-debug-en = <0>;
		rockchip,sleep-mode-config = <
			(0
			| RKPM_SLP_ARMOFF
			| RKPM_SLP_PMU_HW_PLLS_PD
			| RKPM_SLP_PMU_PMUALIVE_32K
			| RKPM_SLP_PMU_DIS_OSC
			| RKPM_SLP_PMIC_LP
			)
		>;
		rockchip,wakeup-config = <
			(0
			| RKPM_CLUSTER_WKUP_EN
			| RKPM_GPIO_WKUP_EN
			| RKPM_USB_WKUP_EN
			)
		>;
	};

	rockchip_suspend: rockchip-suspend {
		compatible = "rockchip,pm-rk1808";
		status = "disabled";
		rockchip,sleep-debug-en = <1>;
		rockchip,sleep-mode-config = <
			(0
			| RKPM_SLP_ARMOFF
			| RKPM_SLP_PMU_PMUALIVE_32K
			| RKPM_SLP_PMU_DIS_OSC
			)
		>;
		rockchip,wakeup-config = <
			(0
			| RKPM_CLUSTER_WKUP_EN
			| RKPM_GPIO_WKUP_EN
			)
		>;
	};

	rockchip_suspend: rockchip-suspend {
		compatible = "rockchip,pm-rk322x";
		status = "disabled";
		rockchip,sleep-mode-config = <
			(0
			|RKPM_CTR_GTCLKS
			|RKPM_CTR_IDLESRAM_MD
			)
		>;
	};

	rockchip_suspend: rockchip-suspend {
		compatible = "rockchip,pm-rk3288";
		status = "disabled";
		rockchip,sleep-mode-config = <
			(0
			|RKPM_CTR_PWR_DMNS
			|RKPM_CTR_GTCLKS
			|RKPM_CTR_PLLS
			|RKPM_CTR_ARMOFF_LPMD
			)
		>;
		rockchip,wakeup-config = <
			(0
			| RKPM_GPIO_WKUP_EN
			)
		>;
		rockchip,pwm-regulator-config = <
			(0
			| PWM2_REGULATOR_EN
			)
		>;
	};

	rockchip_suspend: rockchip-suspend {
		compatible = "rockchip,pm-rk3308";
		status = "okay";
		rockchip,sleep-mode-config = <
			(0
			| RKPM_ARMOFF
			| RKPM_PMU_HW_PLLS_PD
			| RKPM_DBG_FSM_SOUT
			)
		>;
		rockchip,wakeup-config = <
			(0
			| RKPM_GPIO0_WAKEUP_EN
			)
		>;
		rockchip,pwm-regulator-config = <
			(0
			| RKPM_PWM_REGULATOR
			)
		>;
	};

	rockchip_suspend: rockchip-suspend {
		compatible = "rockchip,pm-rk3328";
		status = "disabled";
		rockchip,virtual-poweroff = <0>;
	};

	rockchip_suspend: rockchip-suspend {
		compatible = "rockchip,pm-rk3368";
		status = "disabled";
		rockchip,sleep-mode-config = <
			(0
			| RKPM_SLP_ARMOFF_LOGPD
			| RKPM_SLP_PMU_PLLS_PWRDN
			| RKPM_SLP_PMU_PMUALIVE_32K
			| RKPM_SLP_SFT_PLLS_DEEP
			| RKPM_SLP_PMU_DIS_OSC
			| RKPM_SLP_SFT_PD_NBSCUS
			)
		>;
	};

	rockchip_suspend: rockchip_suspend {
		compatible = "rockchip,pm-rk3399";
		status = "okay";
		rockchip,sleep-mode-config = <
			(0
			| RKPM_SLP_ARMPD
			| RKPM_SLP_PERILPPD
			| RKPM_SLP_DDR_RET
			| RKPM_SLP_PLLPD
			| RKPM_SLP_OSC_DIS
			| RKPM_SLP_CENTER_PD
			| RKPM_SLP_AP_PWROFF
			)
		>;
		rockchip,wakeup-config = <
			(0 |
			RKPM_GPIO_WKUP_EN |
			RKPM_PWM_WKUP_EN)
		>;
		rockchip,pwm-regulator-config = <
			(0 |
			PWM2_REGULATOR_EN
			)
		>;
	};

	rockchip_suspend: rockchip_suspend {
		compatible = "rockchip,pm-rk3568";
		status = "okay";
		rockchip,sleep-debug-en = <0>;
		rockchip,sleep-mode-config = <
				(0
				| RKPM_SLP_ARMOFF
				| RKPM_SLP_PMU_PMUALIVE_32K
				| RKPM_SLP_PMU_DIS_OSC
				| RKPM_SLP_PMIC_LP
				| RKPM_SLP_32K_EXT
				| RKPM_SLP_PIN_REVERSE
				)
		>;

		rockchip,regulator-off-in-mem-lite = ...;
		rockchip,regulator-on-in-mem-lite = ...;

		rockchip,regulator-off-in-mem = ...;
		rockchip,regulator-on-in-mem = ...;

		rockchip,regulator-off-in-mem-ultra = ...;
		rockchip,regulator-on-in-mem-ultra = ...;
	};

	rockchip_suspend: rockchip-suspend {
		compatible = "rockchip,pm-rk3588";
		status = "okay";
		rockchip,sleep-debug-en = <0>;
		rockchip,sleep-mode-config = <
			(0
			| RKPM_SLP_ARMOFF_DDRPD
			| RKPM_SLP_PMU_PMUALIVE_32K
			| RKPM_SLP_PMU_DIS_OSC
			| RKPM_SLP_32K_EXT
			| RKPM_SLP_PMU_DBG
			)
		>;
		rockchip,wakeup-config = <
			(0
			| RKPM_GPIO_WKUP_EN
			)
		>;
	};

	rockchip_suspend: rockchip-suspend {
		compatible = "rockchip,pm-rv1126";
		status = "disabled";
		rockchip,sleep-debug-en = <0>;
		rockchip,sleep-mode-config = <
			(0
			| RKPM_SLP_ARMOFF
			| RKPM_SLP_PMU_PMUALIVE_32K
			| RKPM_SLP_PMU_DIS_OSC
			| RKPM_SLP_PMIC_LP
			)
		>;
		rockchip,wakeup-config = <
			(0
			| RKPM_GPIO_WKUP_EN
			)
		>;
	};
```

## Documentation/devicetree/bindings/soc/rockchip/rockchip-pvtm.txt
```
Rockchip pvtm device tree bindings
----------------------------------

The Process-Voltage-Temperature Monitor (PVTM) is used to monitor the chip
performance variance caused by chip process, voltage and temperature.


Required properties:
- compatible: Should be one of the following.
 - "rockchip,px30-pvtm" - for PX30 SoCs.
 - "rockchip,px30-pmu-pvtm" - for PX30 SoCs.
 - "rockchip,rk1808-pvtm" - for RK1808 SoCs.
 - "rockchip,rk1808-pmu-pvtm" - for RK1808 SoCs.
 - "rockchip,rk1808-npu-pvtm" - for RK1808 SoCs.
 - "rockchip,rk3288-pvtm" - for RK3288 SoCs.
 - "rockchip,rk3308-pvtm" - for RK3308 SoCs.
 - "rockchip,rk3308-pmu-pvtm" - for RK3308 SoCs.
 - "rockchip,rk3399-pvtm" - for RK3399 SoCs.
 - "rockchip,rk3399-pmu-pvtm" - for RK3399 SoCs.
 - "rockchip,rk3568-core-pvtm" - for RK3568 SoCs.
 - "rockchip,rk3568-gpu-pvtm" - for RK3568 SoCs.
 - "rockchip,rk3568-npu-pvtm" - for RK3568 SoCs.
 - "rockchip,rv1126-cpu-pvtm" - for RV1126 SoCs.
 - "rockchip,rv1126-npu-pvtm" - for RV1126 SoCs.
 - "rockchip,rv1126-pmu-pvtm" - for RV1126 SoCs.
- clocks: Must contain an entry for each entry in clock-names.
  See ../../clocks/clock-bindings.txt for details.
- clock-names: Should be "clk", "pclk".

Optional properties:
- resets: Must contain an entry for each entry in reset-names.
  See ../../reset/reset.txt for details.
- reset-names: Should be "rst", "rst-p".


Example:

grf: syscon@ff770000 {
	compatible = "rockchip,rk3399-grf", "syscon", "simple-mfd";
	reg = <0x0 0xff770000 0x0 0x10000>;
	#address-cells = <1>;
	#size-cells = <1>;

...

	pvtm: pvtm {
		compatible = "rockchip,rk3399-pvtm";
		#address-cells = <1>;
		#size-cells = <0>;
		status = "disabled";

		pvtm@0 {
			reg = <0>;
			clocks = <&cru SCLK_PVTM_CORE_L>;
			clock-names = "clk";
			resets = <&cru SRST_PVTM_CORE_L>;
			reset-names = "rst";
		};
		pvtm@1 {
			reg = <1>;
			clocks = <&cru SCLK_PVTM_CORE_B>;
			clock-names = "clk";
			resets = <&cru SRST_PVTM_CORE_B>;
			reset-names = "rst";
		};
		pvtm@2 {
			reg = <2>;
			clocks = <&cru SCLK_PVTM_DDR>;
			clock-names = "clk";
			resets = <&cru SRST_PVTM_DDR>;
			reset-names = "rst";
		};
		pvtm@3 {
			reg = <3>;
			clocks = <&cru SCLK_PVTM_GPU>;
			clock-names = "clk";
			resets = <&cru SRST_PVTM_GPU>;
			reset-names = "rst";
		};
	};
}
```

## Documentation/devicetree/bindings/soc/rockchip/rockchip_system_monitor.txt
```
Rockchip system monitor device tree bindings
----------------------------------

Required properties:
- compatible: Should be one of the following.
 - "rockchip,system-monitor"

Optional properties:
- rockchip,video-4k-offline-cpus: A string containing cpus which will be killed
			when play 4k video.
- rockchip,thermal-zone: A thermal zone node containing thermal sensor,
			it's used to get the current temperature.
- rockchip,polling-delay: The maximum number of milliseconds to wait
			between polls.
- rockchip,offline-cpu-temp: An integer indicating the trip temperature level.
- rockchip,temp-hysteresis: A low hysteresis value on rockchip,offline-cpu-temp
			property (above).
- rockchip,temp-offline-cpus: A string containing cpus which will be killed
			when temperature is high.
- rockchip,thermal-governor-dummy: This property allows system monitor to
			change thermal governor to dummy, and the system
			monitor will manage cooling devices.

Example:

system-monitor {
	compatible = "rockchip,system-monitor";

	rockchip,thermal-zone = "soc-thermal";
	rockchip,polling-delay = <200>; /* milliseconds */
	rockchip,offline-cpu-temp = <110000>; /* millicelsius */
	rockchip,temp-offline-cpus = "2-3";

	rockchip,video-4k-offline-cpus = "2-3";
};
```

## Documentation/devicetree/bindings/soc/samsung/exynos-pmu.yaml
```yaml
# SPDX-License-Identifier: GPL-2.0
%YAML 1.2
---
$id: http://devicetree.org/schemas/soc/samsung/exynos-pmu.yaml#
$schema: http://devicetree.org/meta-schemas/core.yaml#

title: Samsung Exynos SoC series Power Management Unit (PMU)

maintainers:
  - Krzysztof Kozlowski <krzk@kernel.org>

# Custom select to avoid matching all nodes with 'syscon'
select:
  properties:
    compatible:
      contains:
        enum:
          - google,gs101-pmu
          - samsung,exynos3250-pmu
          - samsung,exynos4210-pmu
          - samsung,exynos4212-pmu
          - samsung,exynos4412-pmu
          - samsung,exynos5250-pmu
          - samsung,exynos5260-pmu
          - samsung,exynos5410-pmu
          - samsung,exynos5420-pmu
          - samsung,exynos5433-pmu
          - samsung,exynos7-pmu
          - samsung,exynos850-pmu
          - samsung-s5pv210-pmu
  required:
    - compatible

properties:
  compatible:
    oneOf:
      - items:
          - enum:
              - google,gs101-pmu
              - samsung,exynos3250-pmu
              - samsung,exynos4210-pmu
              - samsung,exynos4212-pmu
              - samsung,exynos4412-pmu
              - samsung,exynos5250-pmu
              - samsung,exynos5260-pmu
              - samsung,exynos5410-pmu
              - samsung,exynos5420-pmu
              - samsung,exynos5433-pmu
              - samsung,exynos7-pmu
              - samsung,exynos850-pmu
              - samsung-s5pv210-pmu
          - const: syscon
      - items:
          - enum:
              - samsung,exynos7885-pmu
              - samsung,exynos8895-pmu
              - samsung,exynos9810-pmu
              - samsung,exynosautov9-pmu
              - samsung,exynosautov920-pmu
              - tesla,fsd-pmu
          - const: samsung,exynos7-pmu
          - const: syscon
      - items:
          - enum:
              - samsung,exynos3250-pmu
              - samsung,exynos4210-pmu
              - samsung,exynos4212-pmu
              - samsung,exynos4412-pmu
              - samsung,exynos5250-pmu
              - samsung,exynos5420-pmu
              - samsung,exynos5433-pmu
          - const: simple-mfd
          - const: syscon

  reg:
    maxItems: 1

  '#clock-cells':
    const: 1

  clock-names:
    description:
      List of clock names for particular CLKOUT mux inputs
    minItems: 1
    maxItems: 32
    items:
      pattern: '^clkout([0-9]|[12][0-9]|3[0-1])$'

  clocks:
    minItems: 1
    maxItems: 32

  dp-phy:
    $ref: /schemas/phy/samsung,dp-video-phy.yaml
    unevaluatedProperties: false

  interrupt-controller:
    description:
      Some PMUs are capable of behaving as an interrupt controller (mostly
      to wake up a suspended PMU).

  '#interrupt-cells':
    description:
      Must be identical to the that of the parent interrupt controller.
    const: 3

  mipi-phy:
    $ref: /schemas/phy/samsung,mipi-video-phy.yaml
    unevaluatedProperties: false

  reboot-mode:
    $ref: /schemas/power/reset/syscon-reboot-mode.yaml
    type: object
    description:
      Reboot mode to alter bootloader behavior for the next boot

  syscon-poweroff:
    $ref: /schemas/power/reset/syscon-poweroff.yaml#
    type: object
    description:
      Node for power off method

  syscon-reboot:
    $ref: /schemas/power/reset/syscon-reboot.yaml#
    type: object
    description:
      Node for reboot method

required:
  - compatible
  - reg

additionalProperties: false

allOf:
  - if:
      properties:
        compatible:
          contains:
            enum:
              - samsung,exynos3250-pmu
              - samsung,exynos4210-pmu
              - samsung,exynos4212-pmu
              - samsung,exynos4412-pmu
              - samsung,exynos5250-pmu
              - samsung,exynos5410-pmu
              - samsung,exynos5420-pmu
              - samsung,exynos5433-pmu
    then:
      required:
        - '#clock-cells'
        - clock-names
        - clocks

  - if:
      properties:
        compatible:
          contains:
            enum:
              - samsung,exynos3250-pmu
              - samsung,exynos4210-pmu
              - samsung,exynos4212-pmu
              - samsung,exynos4412-pmu
              - samsung,exynos5250-pmu
              - samsung,exynos5420-pmu
              - samsung,exynos5433-pmu
    then:
      properties:
        mipi-phy: true
    else:
      properties:
        mipi-phy: false

  - if:
      properties:
        compatible:
          contains:
            enum:
              - samsung,exynos5250-pmu
              - samsung,exynos5420-pmu
              - samsung,exynos5433-pmu
    then:
      properties:
        dp-phy: true
    else:
      properties:
        dp-phy: false

examples:
  - |
    #include <dt-bindings/clock/exynos5250.h>

    pmu_system_controller: system-controller@10040000 {
        compatible = "samsung,exynos5250-pmu", "syscon";
        reg = <0x10040000 0x5000>;
        interrupt-controller;
        #interrupt-cells = <3>;
        interrupt-parent = <&gic>;
        #clock-cells = <1>;
        clock-names = "clkout16";
        clocks = <&clock CLK_FIN_PLL>;

        dp-phy {
            compatible = "samsung,exynos5250-dp-video-phy";
            #phy-cells = <0>;
        };

        mipi-phy {
            compatible = "samsung,s5pv210-mipi-video-phy";
            #phy-cells = <1>;
        };
    };
```
