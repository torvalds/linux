## Documentation/devicetree/bindings/soc/samsung/exynos-usi.yaml
```yaml
# SPDX-License-Identifier: (GPL-2.0-only OR BSD-2-Clause)
%YAML 1.2
---
$id: http://devicetree.org/schemas/soc/samsung/exynos-usi.yaml#
$schema: http://devicetree.org/meta-schemas/core.yaml#

title: Samsung's Exynos USI (Universal Serial Interface)

maintainers:
  - Sam Protsenko <semen.protsenko@linaro.org>
  - Krzysztof Kozlowski <krzk@kernel.org>

description: |
  The USI IP-core provides configurable support for serial protocols, enabling
  different serial communication modes depending on the version.

  In USIv1, configurations are available to enable either one or two protocols
  simultaneously in select combinations - High-Speed I2C0, High-Speed
  I2C1, SPI, UART, High-Speed I2C0 and I2C1 or both High-Speed
  I2C1 and UART.

  In USIv2, only one protocol can be active at a time, either UART, SPI, or
  High-Speed I2C.

  The USI core shares internal circuits across protocols, meaning only the
  selected configuration is active at any given time. USI is modeled as a node
  with zero or more child nodes, each representing a serial sub-node device. The
  mode setting selects which particular function will be used.

properties:
  $nodename:
    pattern: "^usi@[0-9a-f]+$"

  compatible:
    oneOf:
      - items:
          - enum:
              - google,gs101-usi
              - samsung,exynos2200-usi
              - samsung,exynosautov9-usi
              - samsung,exynosautov920-usi
          - const: samsung,exynos850-usi
      - enum:
          - samsung,exynos850-usi
          - samsung,exynos8895-usi

  reg:
    maxItems: 1

  clocks:
    maxItems: 2

  clock-names:
    items:
      - const: pclk
      - const: ipclk

  ranges: true

  "#address-cells":
    const: 1

  "#size-cells":
    const: 1

  samsung,sysreg:
    $ref: /schemas/types.yaml#/definitions/phandle-array
    items:
      - items:
          - description: phandle to System Register syscon node
          - description: offset of SW_CONF register for this USI controller
    description:
      Should be phandle/offset pair. The phandle to System Register syscon node
      (for the same domain where this USI controller resides) and the offset
      of SW_CONF register for this USI controller.

  samsung,mode:
    $ref: /schemas/types.yaml#/definitions/uint32
    enum: [0, 1, 2, 3, 4, 5, 6]
    description:
      Selects USI function (which serial protocol to use). Refer to
      <include/dt-bindings/soc/samsung,exynos-usi.h> for valid USI mode values.

  samsung,clkreq-on:
    type: boolean
    description:
      Enable this property if underlying protocol requires the clock to be
      continuously provided without automatic gating. As suggested by SoC
      manual, it should be set in case of SPI/I2C slave, UART Rx and I2C
      multi-master mode. Usually this property is needed if USI mode is set
      to "UART".

      This property is optional.

patternProperties:
  "^i2c@[0-9a-f]+$":
    $ref: /schemas/i2c/i2c-exynos5.yaml
    description: Child node describing underlying I2C

  "^serial@[0-9a-f]+$":
    $ref: /schemas/serial/samsung_uart.yaml
    description: Child node describing underlying UART/serial

  "^spi@[0-9a-f]+$":
    $ref: /schemas/spi/samsung,spi.yaml
    description: Child node describing underlying SPI

required:
  - compatible
  - ranges
  - "#address-cells"
  - "#size-cells"
  - samsung,sysreg
  - samsung,mode

allOf:
  - if:
      properties:
        compatible:
          contains:
            enum:
              - samsung,exynos850-usi

    then:
      properties:
        reg:
          maxItems: 1

        clocks:
          items:
            - description: Bus (APB) clock
            - description: Operating clock for UART/SPI/I2C protocol

        clock-names:
          maxItems: 2

        samsung,mode:
          enum: [0, 1, 2, 3]

      required:
        - reg
        - clocks
        - clock-names

  - if:
      properties:
        compatible:
          contains:
            enum:
              - samsung,exynos8895-usi

    then:
      properties:
        reg: false

        clocks:
          items:
            - description: Bus (APB) clock
            - description: Operating clock for UART/SPI protocol

        clock-names:
          maxItems: 2

        samsung,clkreq-on: false

      required:
        - clocks
        - clock-names

additionalProperties: false

examples:
  - |
    #include <dt-bindings/interrupt-controller/arm-gic.h>
    #include <dt-bindings/soc/samsung,exynos-usi.h>

    usi0: usi@138200c0 {
        compatible = "samsung,exynos850-usi";
        reg = <0x138200c0 0x20>;
        samsung,sysreg = <&sysreg_peri 0x1010>;
        samsung,mode = <USI_MODE_UART>;
        samsung,clkreq-on; /* needed for UART mode */
        #address-cells = <1>;
        #size-cells = <1>;
        ranges;
        clocks = <&cmu_peri 32>, <&cmu_peri 31>;
        clock-names = "pclk", "ipclk";

        serial_0: serial@13820000 {
            compatible = "samsung,exynos850-uart";
            reg = <0x13820000 0xc0>;
            interrupts = <GIC_SPI 227 IRQ_TYPE_LEVEL_HIGH>;
            clocks = <&cmu_peri 32>, <&cmu_peri 31>;
            clock-names = "uart", "clk_uart_baud0";
        };

        hsi2c_0: i2c@13820000 {
            compatible = "samsung,exynos850-hsi2c", "samsung,exynosautov9-hsi2c";
            reg = <0x13820000 0xc0>;
            interrupts = <GIC_SPI 227 IRQ_TYPE_LEVEL_HIGH>;
            #address-cells = <1>;
            #size-cells = <0>;
            clocks = <&cmu_peri 31>, <&cmu_peri 32>;
            clock-names = "hsi2c", "hsi2c_pclk";
            status = "disabled";
        };
    };
```

## Documentation/devicetree/bindings/soc/samsung/samsung,exynos-sysreg.yaml
```yaml
# SPDX-License-Identifier: GPL-2.0-only OR BSD-2-Clause
%YAML 1.2
---
$id: http://devicetree.org/schemas/soc/samsung/samsung,exynos-sysreg.yaml#
$schema: http://devicetree.org/meta-schemas/core.yaml#

title: Samsung Exynos SoC series System Registers (SYSREG)

maintainers:
  - Krzysztof Kozlowski <krzk@kernel.org>

properties:
  compatible:
    oneOf:
      - items:
          - enum:
              - google,gs101-apm-sysreg
              - google,gs101-hsi2-sysreg
              - google,gs101-peric0-sysreg
              - google,gs101-peric1-sysreg
              - samsung,exynos3-sysreg
              - samsung,exynos4-sysreg
              - samsung,exynos5-sysreg
              - samsung,exynosautov920-peric0-sysreg
              - samsung,exynosautov920-peric1-sysreg
              - tesla,fsd-cam-sysreg
              - tesla,fsd-fsys0-sysreg
              - tesla,fsd-fsys1-sysreg
              - tesla,fsd-peric-sysreg
          - const: syscon
      - items:
          - enum:
              - samsung,exynos5433-cam0-sysreg
              - samsung,exynos5433-cam1-sysreg
              - samsung,exynos5433-disp-sysreg
              - samsung,exynos5433-fsys-sysreg
          - const: samsung,exynos5433-sysreg
          - const: syscon
      - items:
          - enum:
              - samsung,exynos5433-sysreg
              - samsung,exynos850-sysreg
              - samsung,exynosautov9-sysreg
          - const: syscon
        deprecated: true
      - items:
          - enum:
              - samsung,exynos850-cmgp-sysreg
              - samsung,exynos850-peri-sysreg
          - const: samsung,exynos850-sysreg
          - const: syscon
      - items:
          - enum:
              - samsung,exynosautov9-fsys2-sysreg
              - samsung,exynosautov9-peric0-sysreg
              - samsung,exynosautov9-peric1-sysreg
          - const: samsung,exynosautov9-sysreg
          - const: syscon

  reg:
    maxItems: 1

  clocks:
    maxItems: 1

required:
  - compatible
  - reg

allOf:
  - if:
      properties:
        compatible:
          contains:
            enum:
              - google,gs101-hsi2-sysreg
              - google,gs101-peric0-sysreg
              - google,gs101-peric1-sysreg
              - samsung,exynos850-cmgp-sysreg
              - samsung,exynos850-peri-sysreg
              - samsung,exynos850-sysreg
    then:
      required:
        - clocks
    else:
      properties:
        clocks: false

additionalProperties: false

examples:
  - |
    system-controller@10010000 {
        compatible = "samsung,exynos4-sysreg", "syscon";
        reg = <0x10010000 0x400>;
    };
```

## Documentation/devicetree/bindings/soc/socionext/socionext,uniphier-adamv.yaml
```yaml
# SPDX-License-Identifier: (GPL-2.0-only OR BSD-2-Clause)
%YAML 1.2
---
$id: http://devicetree.org/schemas/soc/socionext/socionext,uniphier-adamv.yaml#
$schema: http://devicetree.org/meta-schemas/core.yaml#

title: Socionext UniPhier ADAMV block

maintainers:
  - Kunihiko Hayashi <hayashi.kunihiko@socionext.com>

description: |+
  ADAMV block implemented on Socionext UniPhier SoCs is an analog signal
  amplifier that is a part of the external video and audio I/O system.

  This block is defined for controlling audio I/O reset only.

properties:
  compatible:
    items:
      - enum:
          - socionext,uniphier-ld11-adamv
          - socionext,uniphier-ld20-adamv
      - const: simple-mfd
      - const: syscon

  reg:
    maxItems: 1

  reset-controller:
    $ref: /schemas/reset/socionext,uniphier-reset.yaml#

required:
  - compatible
  - reg

additionalProperties: false

examples:
  - |
    syscon@57920000 {
        compatible = "socionext,uniphier-ld20-adamv",
                     "simple-mfd", "syscon";
        reg = <0x57920000 0x1000>;

        reset-controller {
            compatible = "socionext,uniphier-ld20-adamv-reset";
            #reset-cells = <1>;
        };
    };
```

## Documentation/devicetree/bindings/soc/socionext/socionext,uniphier-ahci-glue.yaml
```yaml
# SPDX-License-Identifier: (GPL-2.0-only OR BSD-2-Clause)
%YAML 1.2
---
$id: http://devicetree.org/schemas/soc/socionext/socionext,uniphier-ahci-glue.yaml#
$schema: http://devicetree.org/meta-schemas/core.yaml#

title: Socionext UniPhier SoC AHCI glue layer

maintainers:
  - Kunihiko Hayashi <hayashi.kunihiko@socionext.com>

description: |+
  AHCI glue layer implemented on Socionext UniPhier SoCs is a sideband
  logic handling signals to AHCI host controller inside AHCI component.

properties:
  compatible:
    items:
      - enum:
          - socionext,uniphier-pro4-ahci-glue
          - socionext,uniphier-pxs2-ahci-glue
          - socionext,uniphier-pxs3-ahci-glue
      - const: simple-mfd

  reg:
    maxItems: 1

  "#address-cells":
    const: 1

  "#size-cells":
    const: 1

  ranges: true

patternProperties:
  "^reset-controller@[0-9a-f]+$":
    $ref: /schemas/reset/socionext,uniphier-glue-reset.yaml#

  "phy@[0-9a-f]+$":
    $ref: /schemas/phy/socionext,uniphier-ahci-phy.yaml#

required:
  - compatible
  - reg

additionalProperties: false

examples:
  - |
    sata-controller@65700000 {
        compatible = "socionext,uniphier-pxs3-ahci-glue", "simple-mfd";
        reg = <0x65b00000 0x400>;
        #address-cells = <1>;
        #size-cells = <1>;
        ranges = <0 0x65700000 0x100>;

        reset-controller@0 {
            compatible = "socionext,uniphier-pxs3-ahci-reset";
            reg = <0x0 0x4>;
            clock-names = "link";
            clocks = <&sys_clk 28>;
            reset-names = "link";
            resets = <&sys_rst 28>;
            #reset-cells = <1>;
        };

        phy@10 {
            compatible = "socionext,uniphier-pxs3-ahci-phy";
            reg = <0x10 0x10>;
            clock-names = "link", "phy";
            clocks = <&sys_clk 28>, <&sys_clk 30>;
            reset-names = "link", "phy";
            resets = <&sys_rst 28>, <&sys_rst 30>;
            #phy-cells = <0>;
        };
    };
```

## Documentation/devicetree/bindings/soc/socionext/socionext,uniphier-dwc3-glue.yaml
```yaml
# SPDX-License-Identifier: (GPL-2.0-only OR BSD-2-Clause)
%YAML 1.2
---
$id: http://devicetree.org/schemas/soc/socionext/socionext,uniphier-dwc3-glue.yaml#
$schema: http://devicetree.org/meta-schemas/core.yaml#

title: Socionext UniPhier SoC DWC3 USB3.0 glue layer

maintainers:
  - Kunihiko Hayashi <hayashi.kunihiko@socionext.com>

description: |+
  DWC3 USB3.0 glue layer implemented on Socionext UniPhier SoCs is
  a sideband logic handling signals to DWC3 host controller inside
  USB3.0 component.

properties:
  compatible:
    items:
      - enum:
          - socionext,uniphier-pro4-dwc3-glue
          - socionext,uniphier-pro5-dwc3-glue
          - socionext,uniphier-pxs2-dwc3-glue
          - socionext,uniphier-ld20-dwc3-glue
          - socionext,uniphier-pxs3-dwc3-glue
          - socionext,uniphier-nx1-dwc3-glue
      - const: simple-mfd

  reg:
    maxItems: 1

  "#address-cells":
    const: 1

  "#size-cells":
    const: 1

  ranges: true

patternProperties:
  "^reset-controller@[0-9a-f]+$":
    $ref: /schemas/reset/socionext,uniphier-glue-reset.yaml#

  "^regulator@[0-9a-f]+$":
    $ref: /schemas/regulator/socionext,uniphier-regulator.yaml#

  "^phy@[0-9a-f]+$":
    oneOf:
      - $ref: /schemas/phy/socionext,uniphier-usb3hs-phy.yaml#
      - $ref: /schemas/phy/socionext,uniphier-usb3ss-phy.yaml#

required:
  - compatible
  - reg

additionalProperties: false

examples:
  - |
    usb@65b00000 {
        compatible = "socionext,uniphier-ld20-dwc3-glue", "simple-mfd";
        reg = <0x65b00000 0x400>;
        #address-cells = <1>;
        #size-cells = <1>;
        ranges = <0 0x65b00000 0x400>;

        reset-controller@0 {
            compatible = "socionext,uniphier-ld20-usb3-reset";
            reg = <0x0 0x4>;
            #reset-cells = <1>;
            clock-names = "link";
            clocks = <&sys_clk 14>;
            reset-names = "link";
            resets = <&sys_rst 14>;
        };

        regulator@100 {
            compatible = "socionext,uniphier-ld20-usb3-regulator";
            reg = <0x100 0x10>;
            clock-names = "link";
            clocks = <&sys_clk 14>;
            reset-names = "link";
            resets = <&sys_rst 14>;
        };

        phy@200 {
            compatible = "socionext,uniphier-ld20-usb3-hsphy";
            reg = <0x200 0x10>;
            #phy-cells = <0>;
            clock-names = "link", "phy";
            clocks = <&sys_clk 14>, <&sys_clk 16>;
            reset-names = "link", "phy";
            resets = <&sys_rst 14>, <&sys_rst 16>;
        };

        phy@300 {
            compatible = "socionext,uniphier-ld20-usb3-ssphy";
            reg = <0x300 0x10>;
            #phy-cells = <0>;
            clock-names = "link", "phy";
            clocks = <&sys_clk 14>, <&sys_clk 18>;
            reset-names = "link", "phy";
            resets = <&sys_rst 14>, <&sys_rst 18>;
        };
    };
```
