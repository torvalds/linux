## Documentation/devicetree/bindings/soc/sophgo/sophgo.yaml
```yaml
# SPDX-License-Identifier: (GPL-2.0-only OR BSD-2-Clause)
%YAML 1.2
---
$id: http://devicetree.org/schemas/soc/sophgo/sophgo.yaml#
$schema: http://devicetree.org/meta-schemas/core.yaml#

title: Sophgo SoC-based boards

maintainers:
  - Chao Wei <chao.wei@sophgo.com>
  - Chen Wang <unicorn_wang@outlook.com>

description:
  Sophgo SoC-based boards

properties:
  $nodename:
    const: '/'
  compatible:
    oneOf:
      - items:
          - enum:
              - milkv,duo
          - const: sophgo,cv1800b
      - items:
          - enum:
              - sophgo,huashan-pi
          - const: sophgo,cv1812h
      - items:
          - enum:
              - milkv,duo-module-01-evb
          - const: milkv,duo-module-01
          - const: sophgo,sg2000
      - items:
          - enum:
              - sipeed,licheerv-nano-b
          - const: sipeed,licheerv-nano
          - const: sophgo,sg2002
      - items:
          - enum:
              - milkv,pioneer
              - sophgo,sg2042-evb-v1
              - sophgo,sg2042-evb-v2
          - const: sophgo,sg2042
      - items:
          - enum:
              - sophgo,srd3-10
          - const: sophgo,sg2044

additionalProperties: true

...
```

## Documentation/devicetree/bindings/soc/spacemit/spacemit,k1-syscon.yaml
```yaml
# SPDX-License-Identifier: (GPL-2.0-only OR BSD-2-Clause)
%YAML 1.2
---
$id: http://devicetree.org/schemas/soc/spacemit/spacemit,k1-syscon.yaml#
$schema: http://devicetree.org/meta-schemas/core.yaml#

title: SpacemiT K1 SoC System Controller

maintainers:
  - Haylen Chu <heylenay@4d2.org>

description:
  System controllers found on SpacemiT K1 SoC, which are capable of
  clock, reset and power-management functions.

properties:
  compatible:
    enum:
      - spacemit,k1-syscon-apbc
      - spacemit,k1-syscon-apmu
      - spacemit,k1-syscon-mpmu
      - spacemit,k1-syscon-rcpu
      - spacemit,k1-syscon-rcpu2
      - spacemit,k1-syscon-apbc2

  reg:
    maxItems: 1

  clocks:
    maxItems: 4

  clock-names:
    items:
      - const: osc
      - const: vctcxo_1m
      - const: vctcxo_3m
      - const: vctcxo_24m

  "#clock-cells":
    const: 1
    description:
      See <dt-bindings/clock/spacemit,k1-syscon.h> for valid indices.

  "#power-domain-cells":
    const: 1

  "#reset-cells":
    const: 1

required:
  - compatible
  - reg
  - "#reset-cells"

allOf:
  - if:
      properties:
        compatible:
          contains:
            enum:
              - spacemit,k1-syscon-apmu
              - spacemit,k1-syscon-mpmu
    then:
      required:
        - "#power-domain-cells"
    else:
      properties:
        "#power-domain-cells": false
  - if:
      properties:
        compatible:
          contains:
            enum:
              - spacemit,k1-syscon-apbc
              - spacemit,k1-syscon-apmu
              - spacemit,k1-syscon-mpmu
    then:
      required:
        - clocks
        - clock-names
        - "#clock-cells"

additionalProperties: false

examples:
  - |
    system-controller@d4050000 {
        compatible = "spacemit,k1-syscon-mpmu";
        reg = <0xd4050000 0x209c>;
        clocks = <&osc>, <&vctcxo_1m>, <&vctcxo_3m>, <&vctcxo_24m>;
        clock-names = "osc", "vctcxo_1m", "vctcxo_3m", "vctcxo_24m";
        #clock-cells = <1>;
        #power-domain-cells = <1>;
        #reset-cells = <1>;
    };
```

## Documentation/devicetree/bindings/soc/sprd/sprd,sc9863a-glbregs.yaml
```yaml
# SPDX-License-Identifier: (GPL-2.0-only OR BSD-2-Clause)
%YAML 1.2
---
$id: http://devicetree.org/schemas/soc/sprd/sprd,sc9863a-glbregs.yaml#
$schema: http://devicetree.org/meta-schemas/core.yaml#

title: SC9863A Syscon

maintainers:
  - Orson Zhai <orsonzhai@gmail.com>
  - Baolin Wang <baolin.wang7@gmail.com>
  - Chunyan Zhang <zhang.lyra@gmail.com>

properties:
  compatible:
    items:
      - const: sprd,sc9863a-glbregs
      - const: syscon
      - const: simple-mfd

  reg:
    maxItems: 1

  ranges: true

  "#address-cells":
    const: 1

  "#size-cells":
    const: 1

patternProperties:
  "@[0-9a-f]+$":
    $ref: /schemas/clock/sprd,sc9863a-clk.yaml
    description: Clock controllers

additionalProperties: false

examples:
  - |
    syscon@20e00000 {
      compatible = "sprd,sc9863a-glbregs", "syscon", "simple-mfd";
      reg = <0x20e00000 0x4000>;
      ranges = <0 0x20e00000 0x4000>;
      #address-cells = <1>;
      #size-cells = <1>;

      apahb_gate: apahb-gate@0 {
        compatible = "sprd,sc9863a-apahb-gate";
        reg = <0x0 0x1020>;
        #clock-cells = <1>;
      };
    };

...
```

## Documentation/devicetree/bindings/soc/starfive/starfive,jh7110-syscon.yaml
```yaml
# SPDX-License-Identifier: (GPL-2.0 OR BSD-2-Clause)
%YAML 1.2
---
$id: http://devicetree.org/schemas/soc/starfive/starfive,jh7110-syscon.yaml#
$schema: http://devicetree.org/meta-schemas/core.yaml#

title: StarFive JH7110 SoC system controller

maintainers:
  - William Qiu <william.qiu@starfivetech.com>

description:
  The StarFive JH7110 SoC system controller provides register information such
  as offset, mask and shift to configure related modules such as MMC and PCIe.

properties:
  compatible:
    oneOf:
      - items:
          - const: starfive,jh7110-sys-syscon
          - const: syscon
          - const: simple-mfd
      - items:
          - enum:
              - starfive,jh7110-aon-syscon
              - starfive,jh7110-stg-syscon
          - const: syscon

  reg:
    maxItems: 1

  clock-controller:
    $ref: /schemas/clock/starfive,jh7110-pll.yaml#
    type: object

  "#power-domain-cells":
    const: 1

required:
  - compatible
  - reg

allOf:
  - if:
      properties:
        compatible:
          contains:
            const: starfive,jh7110-sys-syscon
    then:
      required:
        - clock-controller
    else:
      properties:
        clock-controller: false
  - if:
      properties:
        compatible:
          contains:
            const: starfive,jh7110-aon-syscon
    then:
      required:
        - "#power-domain-cells"
    else:
      properties:
        "#power-domain-cells": false

additionalProperties: false

examples:
  - |
    syscon@10240000 {
        compatible = "starfive,jh7110-stg-syscon", "syscon";
        reg = <0x10240000 0x1000>;
    };

    syscon@13030000 {
        compatible = "starfive,jh7110-sys-syscon", "syscon", "simple-mfd";
        reg = <0x13030000 0x1000>;

        clock-controller {
            compatible = "starfive,jh7110-pll";
            clocks = <&osc>;
            #clock-cells = <1>;
        };
    };

    syscon@17010000 {
        compatible = "starfive,jh7110-aon-syscon", "syscon";
        reg = <0x17010000 0x1000>;
        #power-domain-cells = <1>;
    };

...
```
