## Documentation/devicetree/bindings/soc/socionext/socionext,uniphier-mioctrl.yaml
```yaml
# SPDX-License-Identifier: (GPL-2.0-only OR BSD-2-Clause)
%YAML 1.2
---
$id: http://devicetree.org/schemas/soc/socionext/socionext,uniphier-mioctrl.yaml#
$schema: http://devicetree.org/meta-schemas/core.yaml#

title: Socionext UniPhier media I/O block (MIO) controller

maintainers:
  - Kunihiko Hayashi <hayashi.kunihiko@socionext.com>

description: |+
  Media I/O block implemented on Socionext UniPhier SoCs is a legacy
  integrated component of the stream type peripherals including USB2.0,
  SD/eMMC, and MIO-DMAC.
  Media I/O block has a common logic to control the component.

  Recent SoCs have SD interface logic specialized only for SD functions
  as a subset of media I/O block. See socionext,uniphier-sdctrl.yaml.

properties:
  compatible:
    items:
      - enum:
          - socionext,uniphier-ld4-mioctrl
          - socionext,uniphier-pro4-mioctrl
          - socionext,uniphier-sld8-mioctrl
          - socionext,uniphier-ld11-mioctrl
      - const: simple-mfd
      - const: syscon

  reg:
    maxItems: 1

  clock-controller:
    $ref: /schemas/clock/socionext,uniphier-clock.yaml#

  reset-controller:
    $ref: /schemas/reset/socionext,uniphier-reset.yaml#

required:
  - compatible
  - reg

additionalProperties: false

examples:
  - |
    syscon@5b3e0000 {
        compatible = "socionext,uniphier-ld11-mioctrl",
                     "simple-mfd", "syscon";
        reg = <0x5b3e0000 0x800>;

        clock-controller {
            compatible = "socionext,uniphier-ld11-mio-clock";
            #clock-cells = <1>;
        };

        reset-controller {
            compatible = "socionext,uniphier-ld11-mio-reset";
            #reset-cells = <1>;
            resets = <&sys_rst 7>;
        };
    };
```

## Documentation/devicetree/bindings/soc/socionext/socionext,uniphier-perictrl.yaml
```yaml
# SPDX-License-Identifier: (GPL-2.0-only OR BSD-2-Clause)
%YAML 1.2
---
$id: http://devicetree.org/schemas/soc/socionext/socionext,uniphier-perictrl.yaml#
$schema: http://devicetree.org/meta-schemas/core.yaml#

title: Socionext UniPhier peripheral block controller

maintainers:
  - Kunihiko Hayashi <hayashi.kunihiko@socionext.com>

description: |+
  Peripheral block implemented on Socionext UniPhier SoCs is an integrated
  component of the peripherals including UART, I2C/FI2C, and SCSSI.
  Peripheral block controller is a logic to control the component.

properties:
  compatible:
    items:
      - enum:
          - socionext,uniphier-ld4-perictrl
          - socionext,uniphier-pro4-perictrl
          - socionext,uniphier-pro5-perictrl
          - socionext,uniphier-pxs2-perictrl
          - socionext,uniphier-sld8-perictrl
          - socionext,uniphier-ld11-perictrl
          - socionext,uniphier-ld20-perictrl
          - socionext,uniphier-pxs3-perictrl
          - socionext,uniphier-nx1-perictrl
      - const: simple-mfd
      - const: syscon

  reg:
    maxItems: 1

  clock-controller:
    $ref: /schemas/clock/socionext,uniphier-clock.yaml#

  reset-controller:
    $ref: /schemas/reset/socionext,uniphier-reset.yaml#

required:
  - compatible
  - reg

additionalProperties: false

examples:
  - |
    syscon@59820000 {
        compatible = "socionext,uniphier-ld20-perictrl",
                     "simple-mfd", "syscon";
        reg = <0x59820000 0x200>;

        clock-controller {
            compatible = "socionext,uniphier-ld20-peri-clock";
            #clock-cells = <1>;
        };

        reset-controller {
            compatible = "socionext,uniphier-ld20-peri-reset";
            #reset-cells = <1>;
        };
    };
```

## Documentation/devicetree/bindings/soc/socionext/socionext,uniphier-sdctrl.yaml
```yaml
# SPDX-License-Identifier: (GPL-2.0-only OR BSD-2-Clause)
%YAML 1.2
---
$id: http://devicetree.org/schemas/soc/socionext/socionext,uniphier-sdctrl.yaml#
$schema: http://devicetree.org/meta-schemas/core.yaml#

title: Socionext UniPhier SD interface logic

maintainers:
  - Kunihiko Hayashi <hayashi.kunihiko@socionext.com>

description: |+
  SD interface logic implemented on Socionext UniPhier SoCs is
  attached outside SDHC, and has some SD related functions such as
  clock control, reset control, mode switch, and so on.

properties:
  compatible:
    items:
      - enum:
          - socionext,uniphier-pro5-sdctrl
          - socionext,uniphier-pxs2-sdctrl
          - socionext,uniphier-ld11-sdctrl
          - socionext,uniphier-ld20-sdctrl
          - socionext,uniphier-pxs3-sdctrl
          - socionext,uniphier-nx1-sdctrl
      - const: simple-mfd
      - const: syscon

  reg:
    maxItems: 1

  clock-controller:
    $ref: /schemas/clock/socionext,uniphier-clock.yaml#

  reset-controller:
    $ref: /schemas/reset/socionext,uniphier-reset.yaml#

required:
  - compatible
  - reg

additionalProperties: false

examples:
  - |
    syscon@59810000 {
        compatible = "socionext,uniphier-ld20-sdctrl",
                     "simple-mfd", "syscon";
        reg = <0x59810000 0x400>;

        clock-controller {
            compatible = "socionext,uniphier-ld20-sd-clock";
            #clock-cells = <1>;
        };

        reset-controller {
            compatible = "socionext,uniphier-ld20-sd-reset";
            #reset-cells = <1>;
        };
    };
```

## Documentation/devicetree/bindings/soc/socionext/socionext,uniphier-soc-glue-debug.yaml
```yaml
# SPDX-License-Identifier: (GPL-2.0-only OR BSD-2-Clause)
%YAML 1.2
---
$id: http://devicetree.org/schemas/soc/socionext/socionext,uniphier-soc-glue-debug.yaml#
$schema: http://devicetree.org/meta-schemas/core.yaml#

title: Socionext UniPhier SoC-glue logic debug part

maintainers:
  - Kunihiko Hayashi <hayashi.kunihiko@socionext.com>

description: |+
  SoC-glue logic debug part implemented on Socionext UniPhier SoCs is
  a collection of miscellaneous function registers handling signals outside
  system components for debug and monitor use.

properties:
  compatible:
    items:
      - enum:
          - socionext,uniphier-ld4-soc-glue-debug
          - socionext,uniphier-pro4-soc-glue-debug
          - socionext,uniphier-pro5-soc-glue-debug
          - socionext,uniphier-pxs2-soc-glue-debug
          - socionext,uniphier-sld8-soc-glue-debug
          - socionext,uniphier-ld11-soc-glue-debug
          - socionext,uniphier-ld20-soc-glue-debug
          - socionext,uniphier-pxs3-soc-glue-debug
          - socionext,uniphier-nx1-soc-glue-debug
      - const: simple-mfd
      - const: syscon

  reg:
    maxItems: 1

  "#address-cells":
    const: 1

  "#size-cells":
    const: 1

  ranges: true

patternProperties:
  "^efuse@[0-9a-f]+$":
    $ref: /schemas/nvmem/socionext,uniphier-efuse.yaml#

required:
  - compatible
  - reg

additionalProperties: false

examples:
  - |
    syscon@5f900000 {
        compatible = "socionext,uniphier-pxs2-soc-glue-debug",
                     "simple-mfd", "syscon";
        reg = <0x5f900000 0x2000>;
        #address-cells = <1>;
        #size-cells = <1>;
        ranges = <0 0x5f900000 0x2000>;

        efuse@100 {
            compatible = "socionext,uniphier-efuse";
            reg = <0x100 0x28>;
        };
    };
```

## Documentation/devicetree/bindings/soc/socionext/socionext,uniphier-soc-glue.yaml
```yaml
# SPDX-License-Identifier: (GPL-2.0-only OR BSD-2-Clause)
%YAML 1.2
---
$id: http://devicetree.org/schemas/soc/socionext/socionext,uniphier-soc-glue.yaml#
$schema: http://devicetree.org/meta-schemas/core.yaml#

title: Socionext UniPhier SoC-glue logic

maintainers:
  - Kunihiko Hayashi <hayashi.kunihiko@socionext.com>

description: |+
  SoC-glue logic implemented on Socionext UniPhier SoCs is a collection of
  miscellaneous function registers handling signals outside system components.

properties:
  compatible:
    items:
      - enum:
          - socionext,uniphier-ld4-soc-glue
          - socionext,uniphier-pro4-soc-glue
          - socionext,uniphier-pro5-soc-glue
          - socionext,uniphier-pxs2-soc-glue
          - socionext,uniphier-sld8-soc-glue
          - socionext,uniphier-ld11-soc-glue
          - socionext,uniphier-ld20-soc-glue
          - socionext,uniphier-pxs3-soc-glue
          - socionext,uniphier-nx1-soc-glue
      - const: simple-mfd
      - const: syscon

  reg:
    maxItems: 1

  pinctrl:
    $ref: /schemas/pinctrl/socionext,uniphier-pinctrl.yaml#

  usb-hub:
    $ref: /schemas/phy/socionext,uniphier-usb2-phy.yaml#

  clock-controller:
    $ref: /schemas/clock/socionext,uniphier-clock.yaml#

allOf:
  - if:
      not:
        properties:
          compatible:
            contains:
              enum:
                - socionext,uniphier-pro4-soc-glue
                - socionext,uniphier-ld11-soc-glue
    then:
      properties:
        usb-hub: false

  - if:
      not:
        properties:
          compatible:
            contains:
              const: socionext,uniphier-pro4-soc-glue
    then:
      properties:
        clock-controller: false

required:
  - compatible
  - reg

additionalProperties: false

examples:
  - |
    syscon@5f800000 {
        compatible = "socionext,uniphier-pro4-soc-glue",
                     "simple-mfd", "syscon";
        reg = <0x5f800000 0x2000>;

        pinctrl {
            compatible = "socionext,uniphier-pro4-pinctrl";
        };

        usb-hub {
            compatible = "socionext,uniphier-pro4-usb2-phy";
            #address-cells = <1>;
            #size-cells = <0>;

            phy@0 {
                reg = <0>;
                #phy-cells = <0>;
            };

            phy@1 {
                reg = <1>;
                #phy-cells = <0>;
            };

            phy@2 {
                reg = <2>;
                #phy-cells = <0>;
            };

            phy@3 {
                reg = <3>;
                #phy-cells = <0>;
            };
        };

        clock-controller {
            compatible = "socionext,uniphier-pro4-sg-clock";
            #clock-cells = <1>;
        };
    };
```

## Documentation/devicetree/bindings/soc/socionext/socionext,uniphier-sysctrl.yaml
```yaml
# SPDX-License-Identifier: (GPL-2.0-only OR BSD-2-Clause)
%YAML 1.2
---
$id: http://devicetree.org/schemas/soc/socionext/socionext,uniphier-sysctrl.yaml#
$schema: http://devicetree.org/meta-schemas/core.yaml#

title: Socionext UniPhier system controller

maintainers:
  - Kunihiko Hayashi <hayashi.kunihiko@socionext.com>

description: |+
  System controller implemented on Socionext UniPhier SoCs has multiple
  functions such as clock control, reset control, internal watchdog timer,
  thermal management, and so on.

properties:
  compatible:
    items:
      - enum:
          - socionext,uniphier-ld4-sysctrl
          - socionext,uniphier-pro4-sysctrl
          - socionext,uniphier-pro5-sysctrl
          - socionext,uniphier-pxs2-sysctrl
          - socionext,uniphier-sld8-sysctrl
          - socionext,uniphier-ld11-sysctrl
          - socionext,uniphier-ld20-sysctrl
          - socionext,uniphier-pxs3-sysctrl
          - socionext,uniphier-nx1-sysctrl
      - const: simple-mfd
      - const: syscon

  reg:
    maxItems: 1

  clock-controller:
    $ref: /schemas/clock/socionext,uniphier-clock.yaml#

  reset-controller:
    $ref: /schemas/reset/socionext,uniphier-reset.yaml#

  watchdog:
    $ref: /schemas/watchdog/socionext,uniphier-wdt.yaml#

  thermal-sensor:
    $ref: /schemas/thermal/socionext,uniphier-thermal.yaml#

allOf:
  - if:
      properties:
        compatible:
          contains:
            const: socionext,uniphier-ld4-sysctrl
    then:
      properties:
        watchdog: false

  - if:
      properties:
        compatible:
          contains:
            enum:
              - socionext,uniphier-ld4-sysctrl
              - socionext,uniphier-pro4-sysctrl
              - socionext,uniphier-sld8-sysctrl
              - socionext,uniphier-ld11-sysctrl
    then:
      properties:
        thermal-sensor: false

additionalProperties: false

required:
  - compatible
  - reg

examples:
  - |
    #include <dt-bindings/interrupt-controller/arm-gic.h>
    syscon@61840000 {
        compatible = "socionext,uniphier-ld20-sysctrl",
                     "simple-mfd", "syscon";
        reg = <0x61840000 0x4000>;

        clock-controller {
            compatible = "socionext,uniphier-ld20-clock";
            #clock-cells = <1>;
        };

        reset-controller {
            compatible = "socionext,uniphier-ld20-reset";
            #reset-cells = <1>;
        };

        watchdog {
            compatible = "socionext,uniphier-wdt";
        };

        thermal-sensor {
            compatible = "socionext,uniphier-ld20-thermal";
            interrupts = <GIC_SPI 3 IRQ_TYPE_LEVEL_HIGH>;
            #thermal-sensor-cells = <0>;
        };
    };
```

## Documentation/devicetree/bindings/soc/sophgo/sophgo,cv1800b-top-syscon.yaml
```yaml
# SPDX-License-Identifier: (GPL-2.0 OR BSD-2-Clause)
%YAML 1.2
---
$id: http://devicetree.org/schemas/soc/sophgo/sophgo,cv1800b-top-syscon.yaml#
$schema: http://devicetree.org/meta-schemas/core.yaml#

title: Sophgo CV18XX/SG200X SoC top system controller

maintainers:
  - Inochi Amaoto <inochiama@outlook.com>

description:
  The Sophgo CV18XX/SG200X SoC top misc system controller provides
  register access to configure related modules.

properties:
  compatible:
    oneOf:
      - items:
          - const: sophgo,cv1800b-top-syscon
          - const: syscon
          - const: simple-mfd

  reg:
    maxItems: 1

  "#address-cells":
    const: 1

  "#size-cells":
    const: 1

  ranges: true

  dma-router@154:
    $ref: /schemas/dma/sophgo,cv1800b-dmamux.yaml#
    unevaluatedProperties: false

  phy@48:
    $ref: /schemas/phy/sophgo,cv1800b-usb2-phy.yaml#
    unevaluatedProperties: false

required:
  - compatible
  - reg
  - "#address-cells"
  - "#size-cells"

additionalProperties: false

examples:
  - |
    #include <dt-bindings/clock/sophgo,cv1800.h>

    syscon@3000000 {
      compatible = "sophgo,cv1800b-top-syscon", "syscon", "simple-mfd";
      reg = <0x03000000 0x1000>;
      #address-cells = <1>;
      #size-cells = <1>;

      phy@48 {
        compatible = "sophgo,cv1800b-usb2-phy";
        reg = <0x48 0x4>;
        #phy-cells = <0>;
        clocks = <&clk CLK_USB_125M>,
                 <&clk CLK_USB_33K>,
                 <&clk CLK_USB_12M>;
        clock-names = "app", "stb", "lpm";
        resets = <&rst 58>;
      };

      dma-router@154 {
        compatible = "sophgo,cv1800b-dmamux";
        reg = <0x154 0x8>, <0x298 0x4>;
        #dma-cells = <2>;
        dma-masters = <&dmac>;
      };
    };

...
```

## Documentation/devicetree/bindings/soc/sophgo/sophgo,sg2044-top-syscon.yaml
```yaml
# SPDX-License-Identifier: (GPL-2.0 OR BSD-2-Clause)
%YAML 1.2
---
$id: http://devicetree.org/schemas/soc/sophgo/sophgo,sg2044-top-syscon.yaml#
$schema: http://devicetree.org/meta-schemas/core.yaml#

title: Sophgo SG2044 SoC TOP system controller

maintainers:
  - Inochi Amaoto <inochiama@gmail.com>

description:
  The Sophgo SG2044 TOP system controller is a hardware block grouping
  multiple small functions, such as clocks and some other internal
  function.

properties:
  compatible:
    items:
      - const: sophgo,sg2044-top-syscon
      - const: syscon

  reg:
    maxItems: 1

  clocks:
    maxItems: 1

  '#clock-cells':
    const: 1
    description:
      See <dt-bindings/clock/sophgo,sg2044-pll.h> for valid clock.

required:
  - compatible
  - reg
  - clocks
  - '#clock-cells'

additionalProperties: false

examples:
  - |
    syscon@50000000 {
      compatible = "sophgo,sg2044-top-syscon", "syscon";
      reg = <0x50000000 0x1000>;
      #clock-cells = <1>;
      clocks = <&osc>;
    };
```
