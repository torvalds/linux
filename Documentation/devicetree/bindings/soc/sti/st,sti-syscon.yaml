## Documentation/devicetree/bindings/soc/sti/st,sti-syscon.yaml
```yaml
# SPDX-License-Identifier: (GPL-2.0-only OR BSD-2-Clause)
%YAML 1.2
---
$id: http://devicetree.org/schemas/soc/sti/st,sti-syscon.yaml#
$schema: http://devicetree.org/meta-schemas/core.yaml#

title: STMicroelectronics STi platform sysconfig

maintainers:
  - Patrice Chotard <patrice.chotard@foss.st.com>

description: |
  Binding for the various sysconfig nodes used within the STi
  platform device-tree to point to some common configuration
  registers used by other nodes.

properties:
  compatible:
    items:
      - enum:
          - st,stih407-core-syscfg
          - st,stih407-flash-syscfg
          - st,stih407-front-syscfg
          - st,stih407-lpm-syscfg
          - st,stih407-rear-syscfg
          - st,stih407-sbc-reg-syscfg
          - st,stih407-sbc-syscfg
      - const: syscon

  reg:
    maxItems: 1

  sti-sasg-codec:
    description: STi internal audio codec
    type: object
    additionalProperties: true

    properties:
      compatible:
        const: st,stih407-sas-codec

required:
  - compatible
  - reg

additionalProperties: false

examples:
  - |
    syscfg_sbc: syscon@9620000 {
        compatible = "st,stih407-sbc-syscfg", "syscon";
        reg = <0x9620000 0x1000>;
    };

...
```

## Documentation/devicetree/bindings/soc/sunxi/sram.txt
```
Allwinnner SoC SRAM controllers
-----------------------------------------------------

The SRAM controller found on most Allwinner devices is represented by
a regular node for the SRAM controller itself, with sub-nodes
reprensenting the SRAM handled by the SRAM controller.

Controller Node
---------------

Required properties:
- compatible : "allwinner,sun4i-a10-sram-controller"
- reg : sram controller register offset + length

SRAM nodes
----------

Each SRAM is described using the mmio-sram bindings documented in
Documentation/devicetree/bindings/misc/sram.txt

Each SRAM will have SRAM sections that are going to be handled by the
SRAM controller as subnodes. These sections are represented following
once again the representation described in the mmio-sram binding.

The valid sections compatible are:
    - allwinner,sun4i-a10-sram-a3-a4
    - allwinner,sun4i-a10-sram-d

Devices using SRAM sections
---------------------------

Some devices need to request to the SRAM controller to map an SRAM for
their exclusive use.

The relationship between such a device and an SRAM section is
expressed through the allwinner,sram property, that will take a
phandle and an argument.

This valid values for this argument are:
  - 0: CPU
  - 1: Device

Example
-------
sram-controller@01c00000 {
	compatible = "allwinner,sun4i-a10-sram-controller";
	reg = <0x01c00000 0x30>;
	#address-cells = <1>;
	#size-cells = <1>;
	ranges;

	sram_a: sram@00000000 {
		compatible = "mmio-sram";
		reg = <0x00000000 0xc000>;
		#address-cells = <1>;
		#size-cells = <1>;
		ranges = <0 0x00000000 0xc000>;

		emac_sram: sram-section@8000 {
			compatible = "allwinner,sun4i-a10-sram-a3-a4";
			reg = <0x8000 0x4000>;
			status = "disabled";
		};
	};
};

emac: ethernet@01c0b000 {
	compatible = "allwinner,sun4i-a10-emac";
	...

	allwinner,sram = <&emac_sram 1>;
};
```

## Documentation/devicetree/bindings/soc/tegra/nvidia,nvec.yaml
```yaml
# SPDX-License-Identifier: (GPL-2.0-only OR BSD-2-Clause)
%YAML 1.2
---
$id: http://devicetree.org/schemas/soc/tegra/nvidia,nvec.yaml#
$schema: http://devicetree.org/meta-schemas/core.yaml#

title: NVIDIA compliant embedded controller

maintainers:
  - Thierry Reding <thierry.reding@gmail.com>
  - Jon Hunter <jonathanh@nvidia.com>

properties:
  compatible:
    const: nvidia,nvec

  reg:
    maxItems: 1

  interrupts:
    maxItems: 1

  clocks:
    minItems: 1
    items:
      - description: divider clock
      - description: fast clock

  clock-names:
    minItems: 1
    items:
      - const: div-clk
      - const: fast-clk

  resets:
    items:
      - description: module reset

  reset-names:
    items:
      - const: i2c

  clock-frequency: true

  request-gpios:
    description: phandle to the GPIO used for EC request

  slave-addr:
    $ref: /schemas/types.yaml#/definitions/uint32
    description: I2C address of the slave controller

additionalProperties: false

required:
  - compatible
  - reg
  - interrupts
  - clocks
  - clock-names
  - resets
  - reset-names
  - clock-frequency
  - request-gpios
  - slave-addr

examples:
  - |
    #include <dt-bindings/clock/tegra20-car.h>
    #include <dt-bindings/gpio/tegra-gpio.h>
    #include <dt-bindings/interrupt-controller/arm-gic.h>

    i2c@7000c500 {
        compatible = "nvidia,nvec";
        reg = <0x7000c500 0x100>;
        interrupts = <GIC_SPI 92 IRQ_TYPE_LEVEL_HIGH>;
        clock-frequency = <80000>;
        request-gpios = <&gpio TEGRA_GPIO(V, 2) GPIO_ACTIVE_HIGH>;
        slave-addr = <138>;
        clocks = <&tegra_car TEGRA20_CLK_I2C3>,
                 <&tegra_car TEGRA20_CLK_PLL_P_OUT3>;
        clock-names = "div-clk", "fast-clk";
        resets = <&tegra_car 67>;
        reset-names = "i2c";
    };
```

## Documentation/devicetree/bindings/soc/tegra/nvidia,tegra20-ahb.yaml
```yaml
# SPDX-License-Identifier: (GPL-2.0-only OR BSD-2-Clause)
%YAML 1.2
---
$id: http://devicetree.org/schemas/soc/tegra/nvidia,tegra20-ahb.yaml#
$schema: http://devicetree.org/meta-schemas/core.yaml#

maintainers:
  - Thierry Reding <thierry.reding@gmail.com>
  - Jon Hunter <jonathanh@nvidia.com>

title: NVIDIA Tegra AHB

properties:
  compatible:
    oneOf:
      - enum:
          - nvidia,tegra20-ahb
          - nvidia,tegra30-ahb
      - items:
          - enum:
              - nvidia,tegra114-ahb
              - nvidia,tegra124-ahb
              - nvidia,tegra210-ahb
          - const: nvidia,tegra30-ahb

  reg:
    maxItems: 1

additionalProperties: false

required:
  - compatible
  - reg

examples:
  - |
    ahb@6000c004 {
        compatible = "nvidia,tegra20-ahb";
        reg = <0x6000c004 0x10c>; /* AHB Arbitration + Gizmo Controller */
    };
```

## Documentation/devicetree/bindings/soc/tegra/nvidia,tegra20-flowctrl.yaml
```yaml
# SPDX-License-Identifier: (GPL-2.0-only OR BSD-2-Clause)
%YAML 1.2
---
$id: http://devicetree.org/schemas/soc/tegra/nvidia,tegra20-flowctrl.yaml#
$schema: http://devicetree.org/meta-schemas/core.yaml#

title: NVIDIA Tegra Flow Controller

maintainers:
  - Thierry Reding <thierry.reding@gmail.com>
  - Jon Hunter <jonathanh@nvidia.com>

properties:
  compatible:
    oneOf:
      - enum:
          - nvidia,tegra20-flowctrl
          - nvidia,tegra30-flowctrl
          - nvidia,tegra114-flowctrl
          - nvidia,tegra124-flowctrl
          - nvidia,tegra210-flowctrl

      - items:
          - const: nvidia,tegra132-flowctrl
          - const: nvidia,tegra124-flowctrl

  reg:
    maxItems: 1

required:
  - compatible
  - reg

additionalProperties: false

examples:
  - |
    flow-controller@60007000 {
        compatible = "nvidia,tegra20-flowctrl";
        reg = <0x60007000 0x1000>;
    };
```

## Documentation/devicetree/bindings/soc/ti/k3-ringacc.txt
```
* Texas Instruments K3 NavigatorSS Ring Accelerator

The Ring Accelerator (RA) is a machine which converts read/write accesses
from/to a constant address into corresponding read/write accesses from/to a
circular data structure in memory. The RA eliminates the need for each DMA
controller which needs to access ring elements from having to know the current
state of the ring (base address, current offset). The DMA controller
performs a read or write access to a specific address range (which maps to the
source interface on the RA) and the RA replaces the address for the transaction
with a new address which corresponds to the head or tail element of the ring
(head for reads, tail for writes).

The Ring Accelerator is a hardware module that is responsible for accelerating
management of the packet queues. The K3 SoCs can have more than one RA instances

Required properties:
- compatible	: Must be "ti,am654-navss-ringacc";
- reg		: Should contain register location and length of the following
		  named register regions.
- reg-names	: should be
		  "rt" - The RA Ring Real-time Control/Status Registers
		  "fifos" - The RA Queues Registers
		  "proxy_gcfg" - The RA Proxy Global Config Registers
		  "proxy_target" - The RA Proxy Datapath Registers
- ti,num-rings	: Number of rings supported by RA
- ti,sci-rm-range-gp-rings : TI-SCI RM subtype for GP ring range
- ti,sci	: phandle on TI-SCI compatible System controller node
- ti,sci-dev-id	: TI-SCI device id of the ring accelerator
- msi-parent	: phandle for "ti,sci-inta" interrupt controller

Optional properties:
 -- ti,dma-ring-reset-quirk : enable ringacc / udma ring state interoperability
		  issue software w/a

Example:

ringacc: ringacc@3c000000 {
	compatible = "ti,am654-navss-ringacc";
	reg =	<0x0 0x3c000000 0x0 0x400000>,
		<0x0 0x38000000 0x0 0x400000>,
		<0x0 0x31120000 0x0 0x100>,
		<0x0 0x33000000 0x0 0x40000>;
	reg-names = "rt", "fifos",
		    "proxy_gcfg", "proxy_target";
	ti,num-rings = <818>;
	ti,sci-rm-range-gp-rings = <0x2>; /* GP ring range */
	ti,dma-ring-reset-quirk;
	ti,sci = <&dmsc>;
	ti,sci-dev-id = <187>;
	msi-parent = <&inta_main_udmass>;
};

client:

dma_ipx: dma_ipx@<addr> {
	...
	ti,ringacc = <&ringacc>;
	...
}
```

## Documentation/devicetree/bindings/soc/ti/k3-ringacc.yaml
```yaml
# SPDX-License-Identifier: (GPL-2.0-only OR BSD-2-Clause)
# Copyright (C) 2020 Texas Instruments Incorporated - http://www.ti.com/
%YAML 1.2
---
$id: "http://devicetree.org/schemas/soc/ti/k3-ringacc.yaml#"
$schema: "http://devicetree.org/meta-schemas/core.yaml#"

title: Texas Instruments K3 NavigatorSS Ring Accelerator

maintainers:
  - Santosh Shilimkar <ssantosh@kernel.org>
  - Grygorii Strashko <grygorii.strashko@ti.com>

description: |
  The Ring Accelerator (RA) is a machine which converts read/write accesses
  from/to a constant address into corresponding read/write accesses from/to a
  circular data structure in memory. The RA eliminates the need for each DMA
  controller which needs to access ring elements from having to know the current
  state of the ring (base address, current offset). The DMA controller
  performs a read or write access to a specific address range (which maps to the
  source interface on the RA) and the RA replaces the address for the transaction
  with a new address which corresponds to the head or tail element of the ring
  (head for reads, tail for writes).

  The Ring Accelerator is a hardware module that is responsible for accelerating
  management of the packet queues. The K3 SoCs can have more than one RA instances

properties:
  compatible:
    items:
      - const: ti,am654-navss-ringacc

  reg:
    items:
      - description: real time registers regions
      - description: fifos registers regions
      - description: proxy gcfg registers regions
      - description: proxy target registers regions

  reg-names:
    items:
      - const: rt
      - const: fifos
      - const: proxy_gcfg
      - const: proxy_target

  msi-parent: true

  ti,num-rings:
    $ref: /schemas/types.yaml#/definitions/uint32
    description: Number of rings supported by RA

  ti,sci-rm-range-gp-rings:
    $ref: /schemas/types.yaml#/definitions/uint32
    description: TI-SCI RM subtype for GP ring range

  ti,sci:
    $ref: /schemas/types.yaml#definitions/phandle-array
    description: phandle on TI-SCI compatible System controller node

  ti,sci-dev-id:
    $ref: /schemas/types.yaml#/definitions/uint32
    description: TI-SCI device id of the ring accelerator

  ti,dma-ring-reset-quirk:
    $ref: /schemas/types.yaml#definitions/flag
    description: |
      enable ringacc/udma ring state interoperability issue software w/a

required:
  - compatible
  - reg
  - reg-names
  - msi-parent
  - ti,num-rings
  - ti,sci-rm-range-gp-rings
  - ti,sci
  - ti,sci-dev-id

additionalProperties: false

examples:
  - |
    bus {
        #address-cells = <2>;
        #size-cells = <2>;

        ringacc: ringacc@3c000000 {
            compatible = "ti,am654-navss-ringacc";
            reg = <0x0 0x3c000000 0x0 0x400000>,
                  <0x0 0x38000000 0x0 0x400000>,
                  <0x0 0x31120000 0x0 0x100>,
                  <0x0 0x33000000 0x0 0x40000>;
            reg-names = "rt", "fifos", "proxy_gcfg", "proxy_target";
            ti,num-rings = <818>;
            ti,sci-rm-range-gp-rings = <0x2>; /* GP ring range */
            ti,dma-ring-reset-quirk;
            ti,sci = <&dmsc>;
            ti,sci-dev-id = <187>;
            msi-parent = <&inta_main_udmass>;
        };
    };
```

## Documentation/devicetree/bindings/soc/ti/k3-socinfo.yaml
```yaml
# SPDX-License-Identifier: (GPL-2.0-only OR BSD-2-Clause)
%YAML 1.2
---
$id: http://devicetree.org/schemas/soc/ti/k3-socinfo.yaml#
$schema: http://devicetree.org/meta-schemas/core.yaml#

title: Texas Instruments K3 Multicore SoC platforms chipid module

maintainers:
  - Tero Kristo <t-kristo@ti.com>
  - Nishanth Menon <nm@ti.com>

description: |
  Texas Instruments (ARM64) K3 Multicore SoC platforms chipid module is
  represented by CTRLMMR_xxx_JTAGID register which contains information about
  SoC id and revision.

properties:
  $nodename:
    pattern: "^chipid@[0-9a-f]+$"

  compatible:
    items:
      - const: ti,am654-chipid

  reg:
    maxItems: 1

required:
  - compatible
  - reg

additionalProperties: false

examples:
  - |
    chipid@43000014 {
        compatible = "ti,am654-chipid";
        reg = <0x43000014 0x4>;
    };
```
