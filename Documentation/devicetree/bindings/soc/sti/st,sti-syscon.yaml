## Documentation/devicetree/bindings/soc/xilinx/xlnx,vcu-settings.yaml
```yaml
# SPDX-License-Identifier: (GPL-2.0 OR BSD-2-Clause)
%YAML 1.2
---
$id: http://devicetree.org/schemas/soc/xilinx/xlnx,vcu-settings.yaml#
$schema: http://devicetree.org/meta-schemas/core.yaml#

title: Xilinx VCU Settings

maintainers:
  - Michael Tretter <kernel@pengutronix.de>

description: |
  The Xilinx VCU Settings provides information about the configuration of the
  video codec unit.

properties:
  compatible:
    items:
      - const: xlnx,vcu-settings
      - const: syscon

  reg:
    maxItems: 1

required:
  - compatible
  - reg

additionalProperties: false

examples:
  - |
    fpga {
        #address-cells = <2>;
        #size-cells = <2>;

        xlnx_vcu: vcu@a0041000 {
            compatible = "xlnx,vcu-settings", "syscon";
            reg = <0x0 0xa0041000 0x0 0x1000>;
        };
    };

...
```

## Documentation/devicetree/bindings/soc/xilinx/xlnx,vcu.txt
```
LogicoreIP designed compatible with Xilinx ZYNQ family.
-------------------------------------------------------

General concept
---------------

LogicoreIP design to provide the isolation between processing system
and programmable logic. Also provides the list of register set to configure
the frequency.

Required properties:
- compatible: shall be one of:
	"xlnx,vcu"
	"xlnx,vcu-logicoreip-1.0"
- reg : The base offset and size of the VCU_PL_SLCR register space.
- clocks: phandle for aclk and pll_ref clocksource
- clock-names: The identification string, "aclk", is always required for
   the axi clock. "pll_ref" is required for pll.
Example:

	xlnx_vcu: vcu@a0040000 {
		compatible = "xlnx,vcu-logicoreip-1.0";
		reg = <0x0 0xa0040000 0x0 0x1000>;
		clocks = <&si570_1>, <&clkc 71>;
		clock-names = "pll_ref", "aclk";
	};
```

## Documentation/devicetree/bindings/soc/zte/pd-2967xx.txt
```
* ZTE zx2967 family Power Domains

zx2967 family includes support for multiple power domains which are used
to gate power to one or more peripherals on the processor.

Required Properties:
  - compatible: should be one of the following.
      * zte,zx296718-pcu - for zx296718 power domain.
  - reg: physical base address of the controller and length of memory mapped
      region.
  - #power-domain-cells: Must be 1.

Example:

	pcu_domain: pcu@117000 {
		compatible = "zte,zx296718-pcu";
		reg = <0x00117000 0x1000>;
		#power-domain-cells = <1>;
	};
```

## Documentation/devicetree/bindings/sound/ac97-bus.txt
```
Generic AC97 Device Properties

This documents describes the devicetree bindings for an ac97 controller child
node describing ac97 codecs.

Required properties:
-compatible : Must be "ac97,vendor_id1,vendor_id2
	      The ids shall be the 4 characters hexadecimal encoding, such as
	      given by "%04x" formatting of printf
-reg	    : Must be the ac97 codec number, between 0 and 3

Example:
ac97: sound@40500000 {
	compatible = "marvell,pxa270-ac97";
	reg = < 0x40500000 0x1000 >;
	interrupts = <14>;
	reset-gpios = <&gpio 95 GPIO_ACTIVE_HIGH>;
	#sound-dai-cells = <1>;
	pinctrl-names = "default";
	pinctrl-0 = < &pinctrl_ac97_default >;
	clocks = <&clks CLK_AC97>, <&clks CLK_AC97CONF>;
	clock-names = "AC97CLK", "AC97CONFCLK";

	#address-cells = <1>;
	#size-cells = <0>;
	audio-codec@0 {
		reg = <0>;
		compatible = "ac97,574d,4c13";
		clocks = <&fixed_wm9713_clock>;
		clock-names = "ac97_clk";
	}
};
```

## Documentation/devicetree/bindings/sound/adi,adau1372.yaml
```yaml
# SPDX-License-Identifier: (GPL-2.0-only OR BSD-2-Clause)
%YAML 1.2
---
$id: http://devicetree.org/schemas/sound/adi,adau1372.yaml#
$schema: http://devicetree.org/meta-schemas/core.yaml#


title: Analog Devices ADAU1372 CODEC

maintainers:
  - Alexandre Belloni <alexandre.belloni@bootlin.om>

description: |
  Analog Devices ADAU1372 four inputs and two outputs codec.
  https://www.analog.com/media/en/technical-documentation/data-sheets/ADAU1372.pdf

properties:
  compatible:
    enum:
      - adi,adau1372

  reg:
    maxItems: 1

  "#sound-dai-cells":
    const: 0

  clocks:
    maxItems: 1

  clock-names:
    const: "mclk"

  powerdown-gpios:
    description: GPIO used for hardware power-down.
    maxItems: 1

required:
  - "#sound-dai-cells"
  - compatible
  - reg
  - clocks
  - clock-names

additionalProperties: false

examples:
  - |
    i2c {
        #address-cells = <1>;
        #size-cells = <0>;
        audio-codec@3c {
                compatible = "adi,adau1372";
                reg = <0x3c>;
                #sound-dai-cells = <0>;
                clock-names = "mclk";
                clocks = <&adau1372z_xtal>;
        };
    };

    adau1372z_xtal: clock {
        compatible = "fixed-clock";
        #clock-cells = <0>;
        clock-frequency = <12288000>;
    };
...
```

## Documentation/devicetree/bindings/sound/adi,adau1373.yaml
```yaml
# SPDX-License-Identifier: (GPL-2.0-only OR BSD-2-Clause)
%YAML 1.2
---
$id: http://devicetree.org/schemas/sound/adi,adau1373.yaml#
$schema: http://devicetree.org/meta-schemas/core.yaml#

title: Analog Devices ADAU1373 CODEC

maintainers:
  - Nuno Sá <nuno.sa@analog.com>

description: |
  Analog Devices ADAU1373 Low power codec with speaker and headphone amplifiers.
  https://www.analog.com/media/en/technical-documentation/data-sheets/ADAU1373.pdf

allOf:
  - $ref: dai-common.yaml#

properties:
  compatible:
    enum:
      - adi,adau1373

  reg:
    maxItems: 1

  "#sound-dai-cells":
    const: 0

  powerdown-gpios:
    description: GPIO used for hardware power-down.
    maxItems: 1

  adi,micbias1-microvolt:
    description:
      This property sets the microphone bias voltage for the first microphone.
    enum: [1800000, 2200000, 2600000, 2900000]
    default: 2900000

  adi,micbias2-microvolt:
    description:
      This property sets the microphone bias voltage for the second microphone.
    enum: [1800000, 2200000, 2600000, 2900000]
    default: 2900000

  adi,input1-differential:
    description: This property sets the first analog input as differential.
    type: boolean

  adi,input2-differential:
    description: This property sets the second analog input as differential.
    type: boolean

  adi,input3-differential:
    description: This property sets the third analog input as differential.
    type: boolean

  adi,input4-differential:
    description: This property sets the fourth analog input as differential.
    type: boolean

  adi,lineout-differential:
    description: This property sets the line output as differential.
    type: boolean

  adi,lineout-gnd-sense:
    description: This property enables the line output ground sense control.
    type: boolean

  adi,drc-settings:
    description:
      This setting is used to control the dynamic range of the signal. The
      device provides a maximum of three full band DRCs with 13 entries each.
    $ref: /schemas/types.yaml#/definitions/uint8-array
    oneOf:
      - minItems: 13
        maxItems: 13
      - minItems: 26
        maxItems: 26
      - minItems: 39
        maxItems: 39

required:
  - "#sound-dai-cells"
  - compatible
  - reg

unevaluatedProperties: false

examples:
  - |
    #include <dt-bindings/gpio/gpio.h>

    i2c {
        #address-cells = <1>;
        #size-cells = <0>;
        audio-codec@1a {
            compatible = "adi,adau1373";
            reg = <0x1a>;
            #sound-dai-cells = <0>;
            powerdown-gpios = <&gpio 100 GPIO_ACTIVE_LOW>;
            adi,input2-differential;
            adi,input1-differential;
            adi,lineout-differential;
            adi,micbias2-microvolt = <1800000>;
            adi,drc-settings = /bits/ 8 <
                0xff 0xff 0x1 0x2 0xa 0xa 0xd 0x1 0xff 0xff 0x5 0xd 0xff
            >;
        };
    };
...
```
