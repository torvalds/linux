## Documentation/devicetree/bindings/soc/ti/sci-pm-domain.yaml
```yaml
# SPDX-License-Identifier: (GPL-2.0-only OR BSD-2-Clause)
%YAML 1.2
---
$id: http://devicetree.org/schemas/soc/ti/sci-pm-domain.yaml#
$schema: http://devicetree.org/meta-schemas/core.yaml#

title: TI-SCI generic power domain

maintainers:
  - Nishanth Menon <nm@ti.com>

allOf:
  - $ref: /schemas/power/power-domain.yaml#

description: |
  Some TI SoCs contain a system controller (like the Power Management Micro
  Controller (PMMC) on Keystone 66AK2G SoC) that are responsible for controlling
  the state of the various hardware modules present on the SoC. Communication
  between the host processor running an OS and the system controller happens
  through a protocol called TI System Control Interface (TI-SCI protocol).

  This PM domain node represents the global PM domain managed by the TI-SCI
  controller. Since this relies on the TI SCI protocol to communicate with
  the TI-SCI controller, it must be a child of the TI-SCI controller node.

properties:
  compatible:
    const: ti,sci-pm-domain

  "#power-domain-cells":
    enum: [1, 2]
    description:
      The two cells represent values that the TI-SCI controller defines.

      The first cell should contain the device ID.

      The second cell, if cell-value is 2, should be one of the following
      TI_SCI_PD_EXCLUSIVE - Allows the device to be exclusively controlled
      or
      TI_SCI_PD_SHARED - Allows the device to be shared by multiple hosts.
      Please refer to dt-bindings/soc/ti,sci_pm_domain.h for the definitions.

      Please see  http://processors.wiki.ti.com/index.php/TISCI for
      protocol documentation for the values to be used for different devices.

additionalProperties: false

examples:
  - |
    k2g_pds: power-controller {
        compatible = "ti,sci-pm-domain";
        #power-domain-cells = <1>;
    };

  - |
    k3_pds: power-controller {
        compatible = "ti,sci-pm-domain";
        #power-domain-cells = <2>;
    };
```

## Documentation/devicetree/bindings/soc/ti/ti,am654-serdes-ctrl.yaml
```yaml
# SPDX-License-Identifier: GPL-2.0-only OR BSD-2-Clause
%YAML 1.2
---
$id: http://devicetree.org/schemas/soc/ti/ti,am654-serdes-ctrl.yaml#
$schema: http://devicetree.org/meta-schemas/core.yaml#

title: Texas Instruments AM654 Serdes Control Syscon

maintainers:
  - Nishanth Menon <nm@ti.com>

properties:
  compatible:
    items:
      - const: ti,am654-serdes-ctrl
      - const: syscon

  reg:
    maxItems: 1

  mux-controller:
    $ref: /schemas/mux/reg-mux.yaml#

required:
  - compatible
  - reg
  - mux-controller

additionalProperties: false

examples:
  - |
    clock@4080 {
        compatible = "ti,am654-serdes-ctrl", "syscon";
        reg = <0x4080 0x4>;

        mux-controller {
            compatible = "mmio-mux";
            #mux-control-cells = <1>;
            mux-reg-masks = <0x0 0x3>; /* lane select */
        };
    };
```

## Documentation/devicetree/bindings/soc/ti/ti,j784s4-bist.yaml
```yaml
# SPDX-License-Identifier: (GPL-2.0-only OR BSD-2-Clause)
# Copyright (C) 2025 Texas Instruments Incorporated
%YAML 1.2
---
$id: http://devicetree.org/schemas/soc/ti/ti,j784s4-bist.yaml#
$schema: http://devicetree.org/meta-schemas/core.yaml#

title: Texas Instruments K3 BIST

maintainers:
  - Neha Malcom Francis <n-francis@ti.com>

allOf:
  - $ref: /schemas/arm/keystone/ti,k3-sci-common.yaml#

description:
  The BIST (Built-In Self Test) module is an IP block present in K3 devices
  that support triggering of BIST tests, both PBIST (Memory BIST) and LBIST
  (Logic BIST) on a core. Both tests are destructive in nature. At boot, BIST
  is executed by hardware for the MCU domain automatically as part of HW POST.

properties:
  compatible:
    const: ti,j784s4-bist

  reg:
    maxItems: 2

  reg-names:
    items:
      - const: cfg
      - const: ctrl_mmr

  clocks:
    maxItems: 1

  power-domains:
    maxItems: 1

required:
  - compatible
  - reg
  - reg-names
  - ti,sci-dev-id

unevaluatedProperties: false

examples:
  - |
    #include <dt-bindings/soc/ti,sci_pm_domain.h>
    bus {
        #address-cells = <2>;
        #size-cells = <2>;
        safety-selftest@33c0000 {
            compatible = "ti,j784s4-bist";
            reg = <0x00 0x033c0000 0x00 0x400>,
                  <0x00 0x0010c1a0 0x00 0x01c>;
            reg-names = "cfg", "ctrl_mmr";
            clocks = <&k3_clks 237 7>;
            power-domains = <&k3_pds 237 TI_SCI_PD_EXCLUSIVE>;
            ti,sci-dev-id = <234>;
        };
    };
```

## Documentation/devicetree/bindings/soc/ti/ti,omap-dmm.yaml
```yaml
# SPDX-License-Identifier: (GPL-2.0-only OR BSD-2-Clause)
%YAML 1.2
---
$id: http://devicetree.org/schemas/soc/ti/ti,omap-dmm.yaml#
$schema: http://devicetree.org/meta-schemas/core.yaml#

title: OMAP Dynamic Memory Manager (DMM)

maintainers:
  - Bhargav Joshi <j.bhargav.u@gmail.com>

description:
  The dynamic memory manager (DMM) is a module located immediately in front of
  the SDRAM controllers (called EMIFs on OMAP). DMM manages various aspects of
  memory accesses such as priority generation amongst initiators, configuration
  of SDRAM interleaving, optimizing transfer of 2D block objects, and provide
  MMU-like page translation for initiators which need contiguous dma bus
  addresses.

properties:
  compatible:
    enum:
      - ti,omap4-dmm
      - ti,omap5-dmm

  reg:
    maxItems: 1

  interrupts:
    maxItems: 1

  ti,hwmods:
    $ref: /schemas/types.yaml#/definitions/string
    description: Name of the hwmod associated to DMM, which is typically "dmm"
    deprecated: true

required:
  - compatible
  - reg
  - interrupts

additionalProperties: false

examples:
  - |
    #include <dt-bindings/interrupt-controller/arm-gic.h>

    dmm@4e000000 {
      compatible = "ti,omap4-dmm";
      reg = <0x4e000000 0x800>;
      interrupts = <GIC_SPI 113 IRQ_TYPE_LEVEL_HIGH>;
      ti,hwmods = "dmm";
    };
```
