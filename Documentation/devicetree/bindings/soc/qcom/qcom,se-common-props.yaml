## Documentation/devicetree/bindings/soc/renesas/renesas,rzn1-gpioirqmux.yaml
```yaml
# SPDX-License-Identifier: (GPL-2.0-only OR BSD-2-Clause)
%YAML 1.2
---
$id: http://devicetree.org/schemas/soc/renesas/renesas,rzn1-gpioirqmux.yaml#
$schema: http://devicetree.org/meta-schemas/core.yaml#

title: Renesas RZ/N1 SoCs GPIO Interrupt Multiplexer

description: |
   The Renesas RZ/N1 GPIO Interrupt Multiplexer multiplexes GPIO interrupt
   lines to the interrupt controller available in the SoC.

   It selects up to 8 of the 96 GPIO interrupt lines available and connect them
   to 8 output interrupt lines.

maintainers:
  - Herve Codina <herve.codina@bootlin.com>

properties:
  compatible:
    items:
      - enum:
          - renesas,r9a06g032-gpioirqmux
      - const: renesas,rzn1-gpioirqmux

  reg:
    maxItems: 1

  "#address-cells":
    const: 0

  "#interrupt-cells":
    const: 1

  interrupt-map-mask:
    items:
      - const: 0x7f

  interrupt-map:
    description: |
      Specifies the mapping from external GPIO interrupt lines to the output
      interrupts. The array has up to 8 items defining the mapping related to
      the output line 0 (GIC 103) up to the output line 7 (GIC 110).

      The child interrupt number set in arrays items is computed using the
      following formula:
          gpio_bank * 32 + gpio_number
      with:
        - gpio_bank: The GPIO bank number
            - 0 for GPIO0A,
            - 1 for GPIO1A,
            - 2 for GPIO2A
        - gpio_number: Number of the gpio in the bank (0..31)
    minItems: 1
    maxItems: 8

required:
  - compatible
  - reg
  - "#address-cells"
  - "#interrupt-cells"
  - interrupt-map-mask
  - interrupt-map

additionalProperties: false

examples:
  - |
    #include <dt-bindings/interrupt-controller/arm-gic.h>

    gic: interrupt-controller {
        interrupt-controller;
        #address-cells = <0>;
        #interrupt-cells = <3>;
    };

    interrupt-controller@51000480 {
        compatible = "renesas,r9a06g032-gpioirqmux", "renesas,rzn1-gpioirqmux";
        reg = <0x51000480 0x20>;
        #address-cells = <0>;
        #interrupt-cells = <1>;
        interrupt-map-mask = <0x7f>;
        interrupt-map =
            <32 &gic GIC_SPI 103 IRQ_TYPE_LEVEL_HIGH>, /* line 0, GPIO1A.0 */
            <89 &gic GIC_SPI 104 IRQ_TYPE_LEVEL_HIGH>, /* line 1, GPIO2A.25 */
            <9 &gic GIC_SPI 106 IRQ_TYPE_LEVEL_HIGH>; /* line 3, GPIO0A.9 */
    };
```

## Documentation/devicetree/bindings/soc/renesas/renesas,rzv2m-pwc.yaml
```yaml
# SPDX-License-Identifier: (GPL-2.0-only OR BSD-2-Clause)
%YAML 1.2
---
$id: http://devicetree.org/schemas/soc/renesas/renesas,rzv2m-pwc.yaml#
$schema: http://devicetree.org/meta-schemas/core.yaml#

title: Renesas RZ/V2M External Power Sequence Controller (PWC)

description: |+
  The PWC IP found in the RZ/V2M family of chips comes with the below
  capabilities
    - external power supply on/off sequence generation
    - on/off signal generation for the LPDDR4 core power supply (LPVDD)
    - key input signals processing
    - general-purpose output pins

maintainers:
  - Fabrizio Castro <fabrizio.castro.jz@renesas.com>

properties:
  compatible:
    items:
      - enum:
          - renesas,r9a09g011-pwc # RZ/V2M
          - renesas,r9a09g055-pwc # RZ/V2MA
      - const: renesas,rzv2m-pwc

  reg:
    maxItems: 1

  gpio-controller: true

  '#gpio-cells':
    const: 2

  renesas,rzv2m-pwc-power:
    description: The PWC is used to control the system power supplies.
    type: boolean

required:
  - compatible
  - reg
  - gpio-controller
  - '#gpio-cells'

additionalProperties: false

examples:
  - |
    pwc: pwc@a3700000 {
      compatible = "renesas,r9a09g011-pwc", "renesas,rzv2m-pwc";
      reg = <0xa3700000 0x800>;
      gpio-controller;
      #gpio-cells = <2>;
      renesas,rzv2m-pwc-power;
    };
```

## Documentation/devicetree/bindings/soc/renesas/renesas-soc.yaml
```yaml
# SPDX-License-Identifier: GPL-2.0-only OR BSD-2-Clause
%YAML 1.2
---
$id: http://devicetree.org/schemas/soc/renesas/renesas-soc.yaml#
$schema: http://devicetree.org/meta-schemas/core.yaml#

title: Renesas SoC compatibles naming convention

maintainers:
  - Geert Uytterhoeven <geert+renesas@glider.be>
  - Niklas Söderlund <niklas.soderlund@ragnatech.se>

description: |
  Guidelines for new compatibles for SoC blocks/components.
  When adding new compatibles in new bindings, use the format::
    renesas,SoC-IP

  For example::
   renesas,r8a77965-csi2

  When adding new compatibles to existing bindings, use the format in the
  existing binding, even if it contradicts the above.

select:
  properties:
    compatible:
      contains:
        pattern: "^renesas,.+-.+$"
  required:
    - compatible

properties:
  compatible:
    minItems: 1
    maxItems: 4
    items:
      anyOf:
        # Preferred naming style for compatibles of SoC components
        - pattern: "^renesas,(emev2|r(7s|8a|9a)[a-z0-9]+|rcar|rmobile|rz[a-z0-9]*|sh(7[a-z0-9]+)?|mobile)-[a-z0-9-]+$"
        - pattern: "^renesas,(condor|falcon|gr-peach|gray-hawk|salvator|sk-rz|smar(c(2)?)?|spider|white-hawk)(.*)?$"

        # Legacy compatibles
        #
        # New compatibles are not allowed.
        - pattern: "^renesas,(can|cpg|dmac|du|(g)?ether(avb)?|gpio|hscif|(r)?i[i2]c|imr|intc|ipmmu|irqc|jpu|mmcif|msiof|mtu2|pci(e)?|pfc|pwm|[rq]spi|rcar_sound|sata|scif[ab]*|sdhi|thermal|tmu|tpu|usb(2|hs)?|vin|xhci)-[a-z0-9-]+$"
        - pattern: "^renesas,(d|s)?bsc(3)?-(r8a73a4|r8a7740|sh73a0)$"
        - pattern: "^renesas,em-(gio|sti|uart)$"
        - pattern: "^renesas,fsi2-(r8a7740|sh73a0)$"
        - pattern: "^renesas,hspi-r8a777[89]$"
        - pattern: "^renesas,sysc-(r8a73a4|r8a7740|rmobile|sh73a0)$"
        - enum:
            - renesas,imr-lx4
            - renesas,mtu2-r7s72100

        # None SoC component compatibles
        #
        # Compatibles with the Renesas vendor prefix that do not relate to any SoC
        # component are OK. New compatibles are allowed.
        - enum:
            - renesas,smp-sram

        # Do not fail compatibles not matching the select pattern
        #
        # Some SoC components in addition to a Renesas compatible list
        # compatibles not related to Renesas. The select pattern for this
        # schema hits all compatibles that have at lest one Renesas compatible
        # and try to validate all values in that compatible array, allow all
        # that don't match the schema select pattern. For example,
        #
        #   compatible = "renesas,r9a07g044-mali", "arm,mali-bifrost";
        - pattern: "^(?!renesas,.+-.+).+$"

additionalProperties: true
```
