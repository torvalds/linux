## Documentation/devicetree/bindings/soc/rockchip/grf.txt
```
* Rockchip General Register Files (GRF)

The general register file will be used to do static set by software, which
is composed of many registers for system control.

From RK3368 SoCs, the GRF is divided into two sections,
- GRF, used for general non-secure system,
- PMUGRF, used for always on system

Required Properties:

- compatible: GRF should be one of the followings
   - "rockchip,rk3066-grf", "syscon": for rk3066
   - "rockchip,rk3188-grf", "syscon": for rk3188
   - "rockchip,rk3228-grf", "syscon": for rk3228
   - "rockchip,rk3288-grf", "syscon": for rk3288
   - "rockchip,rk3368-grf", "syscon": for rk3368
   - "rockchip,rk3399-grf", "syscon": for rk3399
- compatible: PMUGRF should be one of the followings
   - "rockchip,rk3368-pmugrf", "syscon": for rk3368
   - "rockchip,rk3399-pmugrf", "syscon": for rk3399
- reg: physical base address of the controller and length of memory mapped
  region.

Example: GRF and PMUGRF of RK3399 SoCs

	pmugrf: syscon@ff320000 {
		compatible = "rockchip,rk3399-pmugrf", "syscon";
		reg = <0x0 0xff320000 0x0 0x1000>;
	};

	grf: syscon@ff770000 {
		compatible = "rockchip,rk3399-grf", "syscon";
		reg = <0x0 0xff770000 0x0 0x10000>;
	};
```
