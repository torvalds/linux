## Documentation/devicetree/bindings/rtc/s3c-rtc.txt
```
* Samsung's S3C Real Time Clock controller

Required properties:
- compatible: should be one of the following.
    * "samsung,s3c2410-rtc" - for controllers compatible with s3c2410 rtc.
    * "samsung,s3c2416-rtc" - for controllers compatible with s3c2416 rtc.
    * "samsung,s3c2443-rtc" - for controllers compatible with s3c2443 rtc.
    * "samsung,s3c6410-rtc" - for controllers compatible with s3c6410 rtc.
    * "samsung,exynos3250-rtc" - for controllers compatible with exynos3250 rtc.
- reg: physical base address of the controller and length of memory mapped
  region.
- interrupts: Two interrupt numbers to the cpu should be specified. First
  interrupt number is the rtc alarm interrupt and second interrupt number
  is the rtc tick interrupt. The number of cells representing a interrupt
  depends on the parent interrupt controller.

Example:

	rtc@10070000 {
		compatible = "samsung,s3c6410-rtc";
		reg = <0x10070000 0x100>;
		interrupts = <44 0 45 0>;
	};
```

## Documentation/devicetree/bindings/rtc/s3c-rtc.yaml
```yaml
# SPDX-License-Identifier: GPL-2.0
%YAML 1.2
---
$id: http://devicetree.org/schemas/rtc/s3c-rtc.yaml#
$schema: http://devicetree.org/meta-schemas/core.yaml#

title: Samsung S3C, S5P and Exynos Real Time Clock controller

maintainers:
  - Krzysztof Kozlowski <krzk@kernel.org>

properties:
  compatible:
    oneOf:
      - enum:
          - samsung,s3c6410-rtc
      - items:
          - enum:
              - samsung,exynos7-rtc
              - samsung,exynos850-rtc
          - const: samsung,s3c6410-rtc
      - const: samsung,exynos3250-rtc
        deprecated: true

  reg:
    maxItems: 1

  clocks:
    maxItems: 2

  clock-names:
    items:
      - const: rtc
      - const: rtc_src

  interrupts:
    description:
      Two interrupt numbers to the cpu should be specified. First
      interrupt number is the rtc alarm interrupt and second interrupt number
      is the rtc tick interrupt. The number of cells representing a interrupt
      depends on the parent interrupt controller.
    minItems: 2
    maxItems: 2

allOf:
  - $ref: rtc.yaml#

unevaluatedProperties: false

examples:
  - |
    #include <dt-bindings/clock/exynos5420.h>
    #include <dt-bindings/clock/samsung,s2mps11.h>

    rtc@10070000 {
        compatible = "samsung,s3c6410-rtc";
        reg = <0x10070000 0x100>;
        interrupts = <0 44 4>, <0 45 4>;
        clocks = <&clock CLK_RTC>,
                 <&s2mps11_osc S2MPS11_CLK_AP>;
        clock-names = "rtc", "rtc_src";
    };
```

## Documentation/devicetree/bindings/rtc/sa1100-rtc.txt
```
* Marvell Real Time Clock controller

Required properties:
- compatible: should be "mrvl,sa1100-rtc"
- reg: physical base address of the controller and length of memory mapped
  region.
- interrupts: Should be two. The first interrupt number is the rtc alarm
  interrupt and the second interrupt number is the rtc hz interrupt.
- interrupt-names: Assign name of irq resource.

Example:
	rtc: rtc@d4010000 {
		compatible = "mrvl,mmp-rtc";
		reg = <0xd4010000 0x1000>;
		interrupts = <5>, <6>;
		interrupt-name = "rtc 1Hz", "rtc alarm";
	};
```

## Documentation/devicetree/bindings/rtc/sa1100-rtc.yaml
```yaml
# SPDX-License-Identifier: GPL-2.0-only
%YAML 1.2
---
$id: http://devicetree.org/schemas/rtc/sa1100-rtc.yaml#
$schema: http://devicetree.org/meta-schemas/core.yaml#

title: Marvell Real Time Clock controller

allOf:
  - $ref: rtc.yaml#

maintainers:
  - Alessandro Zummo <a.zummo@towertech.it>
  - Alexandre Belloni <alexandre.belloni@bootlin.com>
  - Rob Herring <robh@kernel.org>

properties:
  compatible:
    enum:
      - mrvl,sa1100-rtc
      - mrvl,mmp-rtc

  reg:
    maxItems: 1

  clocks:
    maxItems: 1

  resets:
    maxItems: 1

  interrupts:
    minItems: 2

  interrupt-names:
    items:
      - const: rtc 1Hz
      - const: rtc alarm

required:
  - compatible
  - reg
  - interrupts
  - interrupt-names

additionalProperties: false

examples:
  - |
    rtc: rtc@d4010000 {
        compatible = "mrvl,mmp-rtc";
        reg = <0xd4010000 0x1000>;
        interrupts = <5>, <6>;
        interrupt-names = "rtc 1Hz", "rtc alarm";
    };

...
```

## Documentation/devicetree/bindings/rtc/sirf,prima2-sysrtc.txt
```
SiRFSoC Real Time Clock

Required properties:
- compatible: must be "sirf,prima2-sysrtc"
- reg: address range of rtc register set.
- interrupts: rtc alarm interrupts.

Example:
	rtc@2000 {
		compatible = "sirf,prima2-sysrtc";
		reg = <0x2000 0x1000>;
		interrupts = <52 53 54>;
	};
```

## Documentation/devicetree/bindings/rtc/sophgo,cv1800b-rtc.yaml
```yaml
# SPDX-License-Identifier: (GPL-2.0-only OR BSD-2-Clause)
%YAML 1.2
---
$id: http://devicetree.org/schemas/rtc/sophgo,cv1800b-rtc.yaml#
$schema: http://devicetree.org/meta-schemas/core.yaml#

title: Real Time Clock of the Sophgo CV1800 SoC

description:
  The RTC (Real Time Clock) is an independently powered module in the chip. It
  contains a 32KHz oscillator and a Power-On-Reset (POR) sub-module, which can
  be used for time display and scheduled alarm produce. In addition, the
  hardware state machine provides triggering and timing control for chip
  power-on, power-off and reset.

  Furthermore, the 8051 subsystem is located within RTCSYS and is independently
  powered. System software can use the 8051 to manage wake conditions and wake
  the system while the system is asleep, and communicate with external devices
  through peripheral controllers.

  Technical Reference Manual available at
    https://github.com/sophgo/sophgo-doc/tree/main/SG200X/TRM

maintainers:
  - sophgo@lists.linux.dev

allOf:
  - $ref: /schemas/rtc/rtc.yaml#

properties:
  compatible:
    items:
      - const: sophgo,cv1800b-rtc
      - const: syscon

  reg:
    maxItems: 1

  interrupts:
    items:
      - description: RTC Alarm
      - description: RTC Longpress
      - description: VBAT DET

  interrupt-names:
    items:
      - const: alarm
      - const: longpress
      - const: vbat

  clocks:
    items:
      - description: RTC clock source
      - description: DW8051 MCU clock source

  clock-names:
    items:
      - const: rtc
      - const: mcu

required:
  - compatible
  - reg
  - interrupts
  - interrupt-names
  - clocks
  - clock-names

unevaluatedProperties: false

examples:
  - |
    #include <dt-bindings/clock/sophgo,cv1800.h>
    #include <dt-bindings/interrupt-controller/irq.h>

    rtc@5025000 {
        compatible = "sophgo,cv1800b-rtc", "syscon";
        reg = <0x5025000 0x2000>;
        interrupts = <17 IRQ_TYPE_LEVEL_HIGH>,
                     <18 IRQ_TYPE_LEVEL_HIGH>,
                     <19 IRQ_TYPE_LEVEL_HIGH>;
        interrupt-names = "alarm", "longpress", "vbat";
        clocks = <&clk CLK_RTC_25M>,
                 <&clk CLK_SRC_RTC_SYS_0>;
        clock-names = "rtc", "mcu";
    };
```

## Documentation/devicetree/bindings/rtc/spear-rtc.txt
```
* SPEAr RTC

Required properties:
- compatible : "st,spear600-rtc"
- reg : Address range of the rtc registers
- interrupt: Should contain the rtc interrupt number

Example:

	rtc@fc000000 {
		compatible = "st,spear600-rtc";
		reg = <0xfc000000 0x1000>;
		interrupt-parent = <&vic1>;
		interrupts = <12>;
	};
```

## Documentation/devicetree/bindings/rtc/sprd,sc2731-rtc.yaml
```yaml
# SPDX-License-Identifier: GPL-2.0-only OR BSD-2-Clause
%YAML 1.2
---
$id: http://devicetree.org/schemas/rtc/sprd,sc2731-rtc.yaml#
$schema: http://devicetree.org/meta-schemas/core.yaml#

title: Spreadtrum SC2731 Real Time Clock

maintainers:
  - Orson Zhai <orsonzhai@gmail.com>
  - Baolin Wang <baolin.wang7@gmail.com>
  - Chunyan Zhang <zhang.lyra@gmail.com>

properties:
  compatible:
    const: sprd,sc2731-rtc

  reg:
    maxItems: 1

  interrupts:
    maxItems: 1

required:
  - compatible
  - reg
  - interrupts

allOf:
  - $ref: rtc.yaml#

unevaluatedProperties: false
...
```

## Documentation/devicetree/bindings/rtc/sprd,sc27xx-rtc.txt
```
Spreadtrum SC27xx Real Time Clock

Required properties:
- compatible: should be "sprd,sc2731-rtc".
- reg: address offset of rtc register.
- interrupts: rtc alarm interrupt.

Example:

	sc2731_pmic: pmic@0 {
		compatible = "sprd,sc2731";
		reg = <0>;
		spi-max-frequency = <26000000>;
		interrupts = <GIC_SPI 31 IRQ_TYPE_LEVEL_HIGH>;
		interrupt-controller;
		#interrupt-cells = <2>;
		#address-cells = <1>;
		#size-cells = <0>;

		rtc@280 {
			compatible = "sprd,sc2731-rtc";
			reg = <0x280>;
			interrupt-parent = <&sc2731_pmic>;
			interrupts = <2 IRQ_TYPE_LEVEL_HIGH>;
		};
	};
```

## Documentation/devicetree/bindings/rtc/st,m41t80.yaml
```yaml
# SPDX-License-Identifier: (GPL-2.0-only OR BSD-2-Clause)
%YAML 1.2
---
$id: http://devicetree.org/schemas/rtc/st,m41t80.yaml#
$schema: http://devicetree.org/meta-schemas/core.yaml#

title: ST M41T80 family of RTC and compatible

maintainers:
  - Alexandre Belloni <alexandre.belloni@bootlin.com>

properties:
  compatible:
    enum:
      - st,m41t62
      - st,m41t65
      - st,m41t80
      - st,m41t81
      - st,m41t81s
      - st,m41t82
      - st,m41t83
      - st,m41t84
      - st,m41t85
      - st,m41t87
      - microcrystal,rv4162

  reg:
    maxItems: 1

  interrupts:
    maxItems: 1

  "#clock-cells":
    const: 1

  clock-output-names:
    maxItems: 1
    description: From common clock binding to override the default output clock name.

  clock:
    type: object
    $ref: /schemas/clock/fixed-clock.yaml#
    properties:
      clock-frequency:
        const: 32768

allOf:
  - $ref: rtc.yaml

unevaluatedProperties: false

required:
  - compatible
  - reg

examples:
  - |
    i2c {
      #address-cells = <1>;
      #size-cells = <0>;
      rtc@68 {
        compatible = "st,m41t80";
        reg = <0x68>;
        interrupt-parent = <&UIC0>;
        interrupts = <0x9 0x8>;

        clock {
          compatible = "fixed-clock";
          #clock-cells = <0>;
          clock-frequency = <32768>;
        };
      };
    };
```

## Documentation/devicetree/bindings/rtc/st,m41t93.yaml
```yaml
# SPDX-License-Identifier: (GPL-2.0-only OR BSD-2-Clause)
%YAML 1.2
---
$id: http://devicetree.org/schemas/rtc/st,m41t93.yaml#
$schema: http://devicetree.org/meta-schemas/core.yaml#

title: ST M41T93 RTC and compatible

maintainers:
  - Akhilesh Patil <akhilesh@ee.iitb.ac.in>

description:
  ST M41T93 is spi based Real Time Clock (RTC) with time, date,
  alarm, watchdog, square wave clock output, 8 bit timer and
  7 bytes of user SRAM.

properties:
  compatible:
    enum:
      - st,m41t93

  reg:
    maxItems: 1

  "#clock-cells":
    const: 0

required:
  - compatible
  - reg

allOf:
  - $ref: rtc.yaml
  - $ref: /schemas/spi/spi-peripheral-props.yaml#

unevaluatedProperties: false

examples:
  - |
    spi {
      #address-cells = <1>;
      #size-cells = <0>;
      rtc@0 {
        compatible = "st,m41t93";
        reg = <0>;
        #clock-cells = <0>;
        spi-max-frequency = <2000000>;
      };
    };
```

## Documentation/devicetree/bindings/rtc/st,m48t86.yaml
```yaml
# SPDX-License-Identifier: (GPL-2.0-only OR BSD-2-Clause)
%YAML 1.2
---
$id: http://devicetree.org/schemas/rtc/st,m48t86.yaml#
$schema: http://devicetree.org/meta-schemas/core.yaml#

title: ST M48T86 / Dallas DS12887 RTC with SRAM

maintainers:
  - Alexandre Belloni <alexandre.belloni@bootlin.com>

allOf:
  - $ref: rtc.yaml

properties:
  compatible:
    enum:
      - st,m48t86

  reg:
    items:
      - description: index register
      - description: data register

required:
  - compatible
  - reg

unevaluatedProperties: false

examples:
  - |
    rtc@10800000 {
      compatible = "st,m48t86";
      reg = <0x10800000 0x1>, <0x11700000 0x1>;
    };

...
```

## Documentation/devicetree/bindings/rtc/st,stm32-rtc.txt
```
STM32 Real Time Clock

Required properties:
- compatible: can be one of the following:
  - "st,stm32-rtc" for devices compatible with stm32(f4/f7).
  - "st,stm32h7-rtc" for devices compatible with stm32h7.
  - "st,stm32mp1-rtc" for devices compatible with stm32mp1.
- reg: address range of rtc register set.
- clocks: can use up to two clocks, depending on part used:
  - "rtc_ck": RTC clock source.
  - "pclk": RTC APB interface clock.
    It is not present on stm32(f4/f7).
    It is required on stm32(h7/mp1).
- clock-names: must be "rtc_ck" and "pclk".
    It is required on stm32(h7/mp1).
- interrupts: rtc alarm interrupt. On stm32mp1, a second interrupt is required
  for rtc alarm wakeup interrupt.
- st,syscfg: phandle/offset/mask triplet. The phandle to pwrcfg used to
  access control register at offset, and change the dbp (Disable Backup
  Protection) bit represented by the mask, mandatory to disable/enable backup
  domain (RTC registers) write protection.
    It is required on stm32(f4/f7/h7).

Optional properties (to override default rtc_ck parent clock on stm32(f4/f7/h7):
- assigned-clocks: reference to the rtc_ck clock entry.
- assigned-clock-parents: phandle of the new parent clock of rtc_ck.

Example:

	rtc: rtc@40002800 {
		compatible = "st,stm32-rtc";
		reg = <0x40002800 0x400>;
		clocks = <&rcc 1 CLK_RTC>;
		assigned-clocks = <&rcc 1 CLK_RTC>;
		assigned-clock-parents = <&rcc 1 CLK_LSE>;
		interrupt-parent = <&exti>;
		interrupts = <17 1>;
		st,syscfg = <&pwrcfg 0x00 0x100>;
	};

	rtc: rtc@58004000 {
		compatible = "st,stm32h7-rtc";
		reg = <0x58004000 0x400>;
		clocks = <&rcc RTCAPB_CK>, <&rcc RTC_CK>;
		clock-names = "pclk", "rtc_ck";
		assigned-clocks = <&rcc RTC_CK>;
		assigned-clock-parents = <&rcc LSE_CK>;
		interrupt-parent = <&exti>;
		interrupts = <17 1>;
		interrupt-names = "alarm";
		st,syscfg = <&pwrcfg 0x00 0x100>;
	};

	rtc: rtc@5c004000 {
		compatible = "st,stm32mp1-rtc";
		reg = <0x5c004000 0x400>;
		clocks = <&rcc RTCAPB>, <&rcc RTC>;
		clock-names = "pclk", "rtc_ck";
		interrupts-extended = <&intc GIC_SPI 3 IRQ_TYPE_NONE>,
				      <&exti 19 1>;
	};
```
