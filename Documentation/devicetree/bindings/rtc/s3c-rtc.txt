## Documentation/devicetree/bindings/rtc/st,stm32-rtc.yaml
```yaml
# SPDX-License-Identifier: (GPL-2.0-only OR BSD-2-Clause)
%YAML 1.2
---
$id: http://devicetree.org/schemas/rtc/st,stm32-rtc.yaml#
$schema: http://devicetree.org/meta-schemas/core.yaml#

title: STMicroelectronics STM32 Real Time Clock

maintainers:
  - Gabriel Fernandez <gabriel.fernandez@foss.st.com>

properties:
  compatible:
    enum:
      - st,stm32-rtc
      - st,stm32h7-rtc
      - st,stm32mp1-rtc
      - st,stm32mp25-rtc

  reg:
    maxItems: 1

  clocks:
    minItems: 1
    maxItems: 2

  clock-names:
    items:
      - const: pclk
      - const: rtc_ck

  interrupts:
    maxItems: 1

  st,syscfg:
    $ref: /schemas/types.yaml#/definitions/phandle-array
    items:
      minItems: 3
      maxItems: 3
    description: |
      Phandle/offset/mask triplet. The phandle to pwrcfg used to
      access control register at offset, and change the dbp (Disable Backup
      Protection) bit represented by the mask, mandatory to disable/enable backup
      domain (RTC registers) write protection.

  assigned-clocks:
    description: |
      override default rtc_ck parent clock reference to the rtc_ck clock entry
    maxItems: 1

  assigned-clock-parents:
    description: |
      override default rtc_ck parent clock phandle of the new parent clock of rtc_ck
    maxItems: 1

patternProperties:
  "^rtc-[a-z]+-[0-9]+$":
    type: object
    $ref: /schemas/pinctrl/pinmux-node.yaml
    description: |
      Configuration of STM32 RTC pins description. STM32 RTC is able to output
      some signals on specific pins:
      - LSCO (Low Speed Clock Output) that allow to output LSE clock on a pin.
      - Alarm out that allow to send a pulse on a pin when alarm A of the RTC
        expires.
    additionalProperties: false
    properties:
      function:
        enum:
          - lsco
          - alarm-a
      pins:
        enum:
          - out1
          - out2
          - out2_rmp

allOf:
  - if:
      properties:
        compatible:
          contains:
            const: st,stm32-rtc

    then:
      properties:
        clocks:
          minItems: 1
          maxItems: 1

        clock-names: false

      patternProperties:
        "^rtc-[a-z]+-[0-9]+$": false

      required:
        - st,syscfg

  - if:
      properties:
        compatible:
          contains:
            const: st,stm32h7-rtc

    then:
      properties:
        clocks:
          minItems: 2
          maxItems: 2

      patternProperties:
        "^rtc-[a-z]+-[0-9]+$": false

      required:
        - clock-names
        - st,syscfg

  - if:
      properties:
        compatible:
          contains:
            enum:
              - st,stm32mp1-rtc
              - st,stm32mp25-rtc

    then:
      properties:
        clocks:
          minItems: 2
          maxItems: 2

        assigned-clocks: false
        assigned-clock-parents: false

      required:
        - clock-names

required:
  - compatible
  - reg
  - clocks
  - interrupts

additionalProperties: false

examples:
  - |
    #include <dt-bindings/mfd/stm32f4-rcc.h>
    #include <dt-bindings/clock/stm32fx-clock.h>
    rtc@40002800 {
      compatible = "st,stm32-rtc";
      reg = <0x40002800 0x400>;
      clocks = <&rcc 1 CLK_RTC>;
      assigned-clocks = <&rcc 1 CLK_RTC>;
      assigned-clock-parents = <&rcc 1 CLK_LSE>;
      interrupt-parent = <&exti>;
      interrupts = <17 1>;
      st,syscfg = <&pwrcfg 0x00 0x100>;
    };

  - |
    #include <dt-bindings/interrupt-controller/arm-gic.h>
    #include <dt-bindings/clock/stm32mp1-clks.h>
    rtc@5c004000 {
      compatible = "st,stm32mp1-rtc";
      reg = <0x5c004000 0x400>;
      clocks = <&rcc RTCAPB>, <&rcc RTC>;
      clock-names = "pclk", "rtc_ck";
      interrupts = <GIC_SPI 3 IRQ_TYPE_LEVEL_HIGH>;
    };

...
```

## Documentation/devicetree/bindings/rtc/stericsson,coh901331.txt
```
ST-Ericsson COH 901 331 Real Time Clock

Required properties:
- compatible: must be "stericsson,coh901331"
- reg: address range of rtc register set.
- interrupts: rtc alarm interrupt.
- clocks: phandle to the rtc clock source

Example:
	rtc: rtc@c0017000 {
		compatible = "stericsson,coh901331";
		reg = <0xc0017000 0x1000>;
		interrupt-parent = <&vicb>;
		interrupts = <10>;
		clocks = <&rtc_clk>;
	};
```

## Documentation/devicetree/bindings/rtc/stmp3xxx-rtc.txt
```
* STMP3xxx/i.MX28 Time Clock controller

Required properties:
- compatible: should be one of the following.
    * "fsl,stmp3xxx-rtc"
- reg: physical base address of the controller and length of memory mapped
  region.
- interrupts: rtc alarm interrupt

Optional properties:
- stmp,crystal-freq: override crystal frequency as determined from fuse bits.
  Only <32000> and <32768> are possible for the hardware.  Use <0> for
  "no crystal".

Example:

rtc@80056000 {
	compatible = "fsl,imx28-rtc", "fsl,stmp3xxx-rtc";
	reg = <0x80056000 2000>;
	interrupts = <29>;
};
```

## Documentation/devicetree/bindings/rtc/sun6i-rtc.txt
```
* sun6i Real Time Clock

RTC controller for the Allwinner A31

Required properties:
- compatible	: Should be one of the following combinations:
		    - "allwinner,sun6i-a31-rtc"
		    - "allwinner,sun8i-a23-rtc"
		    - "allwinner,sun8i-h3-rtc"
		    - "allwinner,sun8i-r40-rtc", "allwinner,sun8i-h3-rtc"
		    - "allwinner,sun8i-v3-rtc"
		    - "allwinner,sun50i-a64-rtc", "allwinner,sun8i-h3-rtc"
		    - "allwinner,sun50i-h5-rtc"

		  Where there are two or more compatible strings, this
		  denotes the hardware covered by the most specific one
		  is backward-compatible with the latter ones, and the
		  implementation for the latter ones can be used, albeit
		  with reduced functionality.

- reg		: physical base address of the controller and length of
		  memory mapped region.
- interrupts	: IRQ lines for the RTC alarm 0 and alarm 1, in that order.

Required properties for new device trees
- clocks	: phandle to the 32kHz external oscillator
- clock-output-names : names of the two clock outputs. See below.
- #clock-cells  : must be equal to 1.

The RTC provides the following clocks at the given indices:
- 0: LOSC
- 1: LOSC external output, known as X32KFOUT in the datasheet.

Example:

rtc: rtc@1f00000 {
	compatible = "allwinner,sun6i-a31-rtc";
	reg = <0x01f00000 0x54>;
	interrupts = <0 40 4>, <0 41 4>;
	clock-output-names = "osc32k", "osc32k-out";
	clocks = <&ext_osc32k>;
	#clock-cells = <1>;
};
```

## Documentation/devicetree/bindings/rtc/sunplus,sp7021-rtc.yaml
```yaml
# SPDX-License-Identifier: (GPL-2.0-only OR BSD-2-Clause)
# Copyright (C) Sunplus Co., Ltd. 2021
%YAML 1.2
---
$id: http://devicetree.org/schemas/rtc/sunplus,sp7021-rtc.yaml#
$schema: http://devicetree.org/meta-schemas/core.yaml#

title: Sunplus SP7021 Real Time Clock controller

maintainers:
  - Vincent Shih <vincent.sunplus@gmail.com>

properties:
  compatible:
    const: sunplus,sp7021-rtc

  reg:
    maxItems: 1

  reg-names:
    items:
      - const: rtc

  clocks:
    maxItems: 1

  resets:
    maxItems: 1

  interrupts:
    maxItems: 1

required:
  - compatible
  - reg
  - reg-names
  - clocks
  - resets
  - interrupts

additionalProperties: false

examples:
  - |
    #include <dt-bindings/interrupt-controller/irq.h>

    rtc: serial@9c003a00 {
        compatible = "sunplus,sp7021-rtc";
        reg = <0x9c003a00 0x80>;
        reg-names = "rtc";
        clocks = <&clkc 0x12>;
        resets = <&rstc 0x02>;
        interrupt-parent = <&intc>;
        interrupts = <163 IRQ_TYPE_EDGE_RISING>;
    };
...
```

## Documentation/devicetree/bindings/rtc/sunxi-rtc.txt
```
* sun4i/sun7i Real Time Clock

RTC controller for the Allwinner A10/A20

Required properties:
- compatible : Should be "allwinner,sun4i-a10-rtc" or "allwinner,sun7i-a20-rtc"
- reg: physical base address of the controller and length of memory mapped
  region.
- interrupts: IRQ line for the RTC.

Example:

rtc: rtc@1c20d00 {
	compatible = "allwinner,sun4i-a10-rtc";
	reg = <0x01c20d00 0x20>;
	interrupts = <24>;
};
```

## Documentation/devicetree/bindings/rtc/ti,bq32000.yaml
```yaml
# SPDX-License-Identifier: (GPL-2.0-only OR BSD-2-Clause)
%YAML 1.2
---
$id: http://devicetree.org/schemas/rtc/ti,bq32000.yaml#
$schema: http://devicetree.org/meta-schemas/core.yaml#

title: TI BQ32000 I2C Serial Real-Time Clock

maintainers:
  - Alexandre Belloni <alexandre.belloni@bootlin.com>

allOf:
  - $ref: rtc.yaml#

properties:
  compatible:
    const: ti,bq32000

  reg:
    const: 0x68

  interrupts:
    maxItems: 1

  start-year: true

  trickle-resistor-ohms:
    enum: [ 1120, 20180 ]

  trickle-diode-disable: true

required:
  - compatible
  - reg

additionalProperties: false

examples:
  - |
    i2c {
            #address-cells = <1>;
            #size-cells = <0>;

            bq32000: rtc@68 {
                    compatible = "ti,bq32000";
                    reg = <0x68>;
                    trickle-resistor-ohms = <1120>;
            };
    };
```

## Documentation/devicetree/bindings/rtc/ti,bq32k.txt
```
* TI BQ32000                I2C Serial Real-Time Clock

Required properties:
- compatible: Should contain "ti,bq32000".
- reg: I2C address for chip

Optional properties:
- trickle-resistor-ohms : Selected resistor for trickle charger
       Values usable are 1120 and 20180
       Should be given if trickle charger should be enabled
- trickle-diode-disable : Do not use internal trickle charger diode
       Should be given if internal trickle charger diode should be disabled
Example:
       bq32000: rtc@68 {
               compatible = "ti,bq32000";
               trickle-resistor-ohms = <1120>;
               reg = <0x68>;
       };
```

## Documentation/devicetree/bindings/rtc/ti,k3-rtc.yaml
```yaml
# SPDX-License-Identifier: (GPL-2.0-only OR BSD-2-Clause)
%YAML 1.2
---
$id: http://devicetree.org/schemas/rtc/ti,k3-rtc.yaml#
$schema: http://devicetree.org/meta-schemas/core.yaml#

title: Texas Instruments K3 Real Time Clock

maintainers:
  - Nishanth Menon <nm@ti.com>

description: |
  This RTC appears in the AM62x family of SoCs.

allOf:
  - $ref: rtc.yaml#

properties:
  compatible:
    enum:
      - ti,am62-rtc

  reg:
    maxItems: 1

  interrupts:
    maxItems: 1

  clocks:
    items:
      - description: VBUS Interface clock
      - description: 32k Clock source (external or internal).

  clock-names:
    items:
      - const: vbus
      - const: osc32k

  power-domains:
    maxItems: 1

required:
  - compatible
  - reg
  - interrupts
  - clocks
  - clock-names

unevaluatedProperties: false

examples:
  - |
    #include <dt-bindings/interrupt-controller/arm-gic.h>
    rtc@2b1f0000 {
        compatible = "ti,am62-rtc";
        reg = <0x2b1f0000 0x100>;
        interrupts = <GIC_SPI 100 IRQ_TYPE_LEVEL_HIGH>;
        power-domains = <&bar 0>;
        clocks = <&foo 0>, <&foo 1>;
        clock-names = "vbus", "osc32k";
        wakeup-source;
    };
```

## Documentation/devicetree/bindings/rtc/trivial-rtc.yaml
```yaml
# SPDX-License-Identifier: GPL-2.0
%YAML 1.2
---
$id: http://devicetree.org/schemas/rtc/trivial-rtc.yaml#
$schema: http://devicetree.org/meta-schemas/core.yaml#

title: Trivial RTCs

maintainers:
  - Alexandre Belloni <alexandre.belloni@bootlin.com>

description: |
  This is a list of trivial RTC devices that have simple device tree
  bindings, consisting only of a compatible field, an address and
  possibly an interrupt line.

allOf:
  - $ref: rtc.yaml#

properties:
  compatible:
    enum:
      # AB-RTCMC-32.768kHz-B5ZE-S3: Real Time Clock/Calendar Module with I2C Interface
      - abracon,abb5zes3
      # AB-RTCMC-32.768kHz-EOZ9: Real Time Clock/Calendar Module with I2C Interface
      - abracon,abeoz9
      # ASPEED BMC ast2400 Real-time Clock
      - aspeed,ast2400-rtc
      # ASPEED BMC ast2500 Real-time Clock
      - aspeed,ast2500-rtc
      # ASPEED BMC ast2600 Real-time Clock
      - aspeed,ast2600-rtc
      # Conexant Digicolor Real Time Clock Controller
      - cnxt,cx92755-rtc
      # I2C, 32-Bit Binary Counter Watchdog RTC with Trickle Charger and Reset Input/Output
      - dallas,ds1374
      # Dallas DS1672 Real-time Clock
      - dallas,ds1672
      # Extremely Accurate I²C RTC with Integrated Crystal and SRAM
      - dallas,ds3232
      # SD2405AL Real-Time Clock
      - dfrobot,sd2405al
      # EM Microelectronic EM3027 RTC
      - emmicro,em3027
      # I2C-BUS INTERFACE REAL TIME CLOCK MODULE
      - epson,rx8010
      # I2C-BUS INTERFACE REAL TIME CLOCK MODULE
      - epson,rx8035
      # I2C-BUS INTERFACE REAL TIME CLOCK MODULE with Battery Backed RAM
      - epson,rx8111
      - epson,rx8571
      # I2C-BUS INTERFACE REAL TIME CLOCK MODULE
      - epson,rx8581
      # Android Goldfish Real-time Clock
      - google,goldfish-rtc
      # Mvebu Real-time Clock
      - marvell,orion-rtc
      # Maxim DS1742/DS1743 Real-time Clock
      - maxim,ds1742
      # SPI-BUS INTERFACE REAL TIME CLOCK MODULE
      - maxim,mcp795
      # Real Time Clock Module with I2C-Bus
      - microcrystal,rv3029
      # Real Time Clock
      - microcrystal,rv8523
      # NXP LPC32xx SoC Real-time Clock
      - nxp,lpc3220-rtc
      # I2C bus SERIAL INTERFACE REAL-TIME CLOCK IC
      - ricoh,r2025sd
      # I2C bus SERIAL INTERFACE REAL-TIME CLOCK IC
      - ricoh,r2221tl
      # I2C bus SERIAL INTERFACE REAL-TIME CLOCK IC
      - ricoh,rs5c372a
      # I2C bus SERIAL INTERFACE REAL-TIME CLOCK IC
      - ricoh,rs5c372b
      # I2C bus SERIAL INTERFACE REAL-TIME CLOCK IC
      - ricoh,rv5c386
      # I2C bus SERIAL INTERFACE REAL-TIME CLOCK IC
      - ricoh,rv5c387a
      # 2-wire CMOS real-time clock
      - sii,s35390a
      # ST SPEAr Real-time Clock
      - st,spear600-rtc
      # VIA/Wondermedia VT8500 Real-time Clock
      - via,vt8500-rtc
      # I2C bus SERIAL INTERFACE REAL-TIME CLOCK IC
      - whwave,sd3078
      # Xircom X1205 I2C RTC
      - xircom,x1205

  reg:
    maxItems: 1

  interrupts:
    maxItems: 1

  start-year: true

required:
  - compatible
  - reg

additionalProperties: false

...
```

## Documentation/devicetree/bindings/rtc/twl-rtc.txt
```
* Texas Instruments TWL4030/6030 RTC

Required properties:
- compatible : Should be "ti,twl4030-rtc"
- interrupts : Should be the interrupt number.

Example:
	rtc {
		compatible = "ti,twl4030-rtc";
		interrupts = <11>;
	};
```
