## Documentation/devicetree/bindings/rtc/fsl,stmp3xxx-rtc.yaml
```yaml
# SPDX-License-Identifier: (GPL-2.0-only OR BSD-2-Clause)
%YAML 1.2
---
$id: http://devicetree.org/schemas/rtc/fsl,stmp3xxx-rtc.yaml#
$schema: http://devicetree.org/meta-schemas/core.yaml#

title: STMP3xxx/i.MX28 Time Clock Controller

maintainers:
  - Javier Carrasco <javier.carrasco.cruz@gmail.com>

allOf:
  - $ref: rtc.yaml#

properties:
  compatible:
    oneOf:
      - items:
          - enum:
              - fsl,imx28-rtc
              - fsl,imx23-rtc
          - const: fsl,stmp3xxx-rtc
      - const: fsl,stmp3xxx-rtc

  reg:
    maxItems: 1

  interrupts:
    maxItems: 1

  stmp,crystal-freq:
    description:
      Override crystal frequency as determined from fuse bits.
      Use <0> for "no crystal".
    $ref: /schemas/types.yaml#/definitions/uint32
    enum: [0, 32000, 32768]

required:
  - compatible
  - reg
  - interrupts

unevaluatedProperties: false

examples:
  - |
    rtc@80056000 {
        compatible = "fsl,imx28-rtc", "fsl,stmp3xxx-rtc";
        reg = <0x80056000 2000>;
        interrupts = <29>;
    };
```

## Documentation/devicetree/bindings/rtc/google,goldfish-rtc.txt
```
Android Goldfish RTC

Android Goldfish RTC device used by Android emulator.

Required properties:

- compatible : should contain "google,goldfish-rtc"
- reg        : <registers mapping>
- interrupts : <interrupt mapping>

Example:

	goldfish_timer@9020000 {
		compatible = "google,goldfish-rtc";
		reg = <0x9020000 0x1000>;
		interrupts = <0x3>;
	};
```

## Documentation/devicetree/bindings/rtc/haoyu,hym8563.txt
```
Haoyu Microelectronics HYM8563 Real Time Clock

The HYM8563 provides basic rtc and alarm functionality
as well as a clock output of up to 32kHz.

Required properties:
- compatible: should be: "haoyu,hym8563"
- reg: i2c address
- interrupts: rtc alarm/event interrupt
- #clock-cells: the value should be 0

Example:

hym8563: hym8563@51 {
	compatible = "haoyu,hym8563";
	reg = <0x51>;

	interrupts = <13 IRQ_TYPE_EDGE_FALLING>;

	#clock-cells = <0>;
};

device {
...
	clocks = <&hym8563>;
...
};
```

## Documentation/devicetree/bindings/rtc/haoyu,hym8563.yaml
```yaml
# SPDX-License-Identifier: (GPL-2.0-only OR BSD-2-Clause)
%YAML 1.2
---
$id: http://devicetree.org/schemas/rtc/haoyu,hym8563.yaml#
$schema: http://devicetree.org/meta-schemas/core.yaml#

title: Haoyu Microelectronics HYM8563 RTC

maintainers:
  - Alexandre Belloni <alexandre.belloni@bootlin.com>

properties:
  compatible:
    const: haoyu,hym8563

  reg:
    maxItems: 1

  interrupts:
    maxItems: 1

  "#clock-cells":
    const: 0

  clock-output-names:
    description: From common clock binding to override the default output clock name.
    maxItems: 1

  wakeup-source:
    description: Enables wake up of host system on alarm.

allOf:
  - $ref: rtc.yaml

unevaluatedProperties: false

required:
  - compatible
  - reg
  - "#clock-cells"

examples:
  - |
    #include <dt-bindings/interrupt-controller/irq.h>

    i2c {
        #address-cells = <1>;
        #size-cells = <0>;

        rtc@51 {
            compatible = "haoyu,hym8563";
            reg = <0x51>;
            interrupts = <13 IRQ_TYPE_EDGE_FALLING>;
            #clock-cells = <0>;
        };
    };
```

## Documentation/devicetree/bindings/rtc/imxdi-rtc.txt
```
* i.MX25 Real Time Clock controller

Required properties:
- compatible: should be: "fsl,imx25-rtc"
- reg: physical base address of the controller and length of memory mapped
  region.
- clocks: should contain the phandle for the rtc clock
- interrupts: rtc alarm interrupt

Optional properties:
- interrupts: dryice security violation interrupt (second entry)

Example:

rtc@53ffc000 {
	compatible = "fsl,imx25-rtc";
	reg = <0x53ffc000 0x4000>;
	clocks = <&clks 81>;
	interrupts = <25 56>;
};
```

## Documentation/devicetree/bindings/rtc/imxdi-rtc.yaml
```yaml
# SPDX-License-Identifier: (GPL-2.0-only OR BSD-2-Clause)
%YAML 1.2
---
$id: http://devicetree.org/schemas/rtc/imxdi-rtc.yaml#
$schema: http://devicetree.org/meta-schemas/core.yaml#

title: i.MX25 Real Time Clock controller

maintainers:
  - Roland Stigge <stigge@antcom.de>

properties:
  compatible:
    const: fsl,imx25-rtc

  reg:
    maxItems: 1

  interrupts:
    items:
      - description: rtc alarm interrupt
      - description: dryice security violation interrupt
    minItems: 1

  clocks:
    maxItems: 1

required:
  - compatible
  - reg
  - interrupts
  - clocks

additionalProperties: false

examples:
  - |
    rtc@53ffc000 {
        compatible = "fsl,imx25-rtc";
        reg = <0x53ffc000 0x4000>;
        clocks = <&clks 81>;
        interrupts = <25>, <56>;
    };
```

## Documentation/devicetree/bindings/rtc/ingenic,jz4740-rtc.txt
```
JZ4740 and similar SoCs real-time clock driver

Required properties:

- compatible: One of:
  - "ingenic,jz4740-rtc" - for use with the JZ4740 SoC
  - "ingenic,jz4780-rtc" - for use with the JZ4780 SoC
- reg: Address range of rtc register set
- interrupts: IRQ number for the alarm interrupt
- clocks: phandle to the "rtc" clock
- clock-names: must be "rtc"

Optional properties:
- system-power-controller: To use this component as the
  system power controller
- reset-pin-assert-time-ms: Reset pin low-level assertion
  time after wakeup (default 60ms; range 0-125ms if RTC clock
  at 32 kHz)
- min-wakeup-pin-assert-time-ms: Minimum wakeup pin assertion
  time (default 100ms; range 0-2s if RTC clock at 32 kHz)

Example:

rtc@10003000 {
	compatible = "ingenic,jz4740-rtc";
	reg = <0x10003000 0x40>;

	interrupt-parent = <&intc>;
	interrupts = <32>;

	clocks = <&rtc_clock>;
	clock-names = "rtc";

	system-power-controller;
	reset-pin-assert-time-ms = <60>;
	min-wakeup-pin-assert-time-ms = <100>;
};
```
