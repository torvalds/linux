## Documentation/devicetree/bindings/rtc/cdns,rtc.txt
```
Cadence Real Time Clock

The Cadence RTC controller with date, time and alarm capabilities.
The alarm may wake the system from low-power state.

Required properties:
- compatible: Should be "cdns,rtc-r109v3"
- reg: Specifies base physical address and size of the register area.
- interrupts: A single interrupt specifier.
- clocks: Must contain two entries:
	- pclk: APB registers clock
	- ref_clk: reference 1Hz or 100Hz clock, depending on IP configuration
	See ../clocks/clock-bindings.txt for details.

Example:
        rtc0: rtc@fd080000 {
        	compatible = "cdns,rtc-r109v3";
        	reg = <0xfd080000 0x1000>;

        	clock-names = "pclk", "ref_clk";
        	clocks = <&sysclock>, <&refclock>;

        	interrupt-parent = <&gic>;
        	interrupts = <0 6 IRQ_TYPE_LEVEL_HIGH>;
        };
```

## Documentation/devicetree/bindings/rtc/cirrus,ep9301-rtc.yaml
```yaml
# SPDX-License-Identifier: (GPL-2.0-only OR BSD-2-Clause)
%YAML 1.2
---
$id: http://devicetree.org/schemas/rtc/cirrus,ep9301-rtc.yaml#
$schema: http://devicetree.org/meta-schemas/core.yaml#

title: Cirrus EP93xx Real Time Clock controller

maintainers:
  - Hartley Sweeten <hsweeten@visionengravers.com>
  - Alexander Sverdlin <alexander.sverdlin@gmail.com>

allOf:
  - $ref: rtc.yaml#

properties:
  compatible:
    oneOf:
      - const: cirrus,ep9301-rtc
      - items:
          - enum:
              - cirrus,ep9302-rtc
              - cirrus,ep9307-rtc
              - cirrus,ep9312-rtc
              - cirrus,ep9315-rtc
          - const: cirrus,ep9301-rtc

  reg:
    maxItems: 1

required:
  - compatible
  - reg

unevaluatedProperties: false

examples:
  - |
    rtc@80920000 {
        compatible = "cirrus,ep9301-rtc";
        reg = <0x80920000 0x100>;
    };
```

## Documentation/devicetree/bindings/rtc/cortina,gemini.txt
```
* Cortina Systems Gemini RTC

Gemini SoC real-time clock.

Required properties:
- compatible : Should be "cortina,gemini-rtc"

Examples:

rtc@45000000 {
	compatible = "cortina,gemini-rtc";
	reg = <0x45000000 0x100>;
	interrupts = <17 IRQ_TYPE_LEVEL_HIGH>;
};
```

## Documentation/devicetree/bindings/rtc/cpcap-rtc.txt
```
Motorola CPCAP PMIC RTC
-----------------------

This module is part of the CPCAP. For more details about the whole
chip see Documentation/devicetree/bindings/mfd/motorola-cpcap.txt.

Requires analde properties:
- compatible: should contain "motorola,cpcap-rtc"
- interrupts: An interrupt specifier for alarm and 1 Hz irq

Example:

&cpcap {
	cpcap_rtc: rtc {
		compatible = "motorola,cpcap-rtc";
		interrupts = <39 IRQ_TYPE_ANALNE>, <26 IRQ_TYPE_ANALNE>;
	};
};
```

## Documentation/devicetree/bindings/rtc/dallas,ds1339.txt
```
* Dallas DS1339		I2C Serial Real-Time Clock

Required properties:
- compatible: Should contain "dallas,ds1339".
- reg: I2C address for chip

Optional properties:
- trickle-resistor-ohms : Selected resistor for trickle charger
	Values usable for ds1339 are 250, 2000, 4000
	Should be given if trickle charger should be enabled
- trickle-diode-disable : Do not use internal trickle charger diode
	Should be given if internal trickle charger diode should be disabled
Example:
	ds1339: rtc@68 {
		compatible = "dallas,ds1339";
		trickle-resistor-ohms = <250>;
		reg = <0x68>;
	};
```

## Documentation/devicetree/bindings/rtc/dallas,ds1390.txt
```
* Dallas DS1390		SPI Serial Real-Time Clock

Required properties:
- compatible: Should contain "dallas,ds1390".
- reg: SPI address for chip

Optional properties:
- trickle-resistor-ohms : Selected resistor for trickle charger
	Values usable for ds1390 are 250, 2000, 4000
	Should be given if trickle charger should be enabled
- trickle-diode-disable : Do not use internal trickle charger diode
	Should be given if internal trickle charger diode should be disabled
Example:
	ds1390: rtc@0 {
		compatible = "dallas,ds1390";
		trickle-resistor-ohms = <250>;
		reg = <0>;
	};
```

## Documentation/devicetree/bindings/rtc/digicolor-rtc.txt
```
Conexant Digicolor Real Time Clock controller

This binding currently supports the CX92755 SoC.

Required properties:
- compatible: should be "cnxt,cx92755-rtc"
- reg: physical base address of the controller and length of memory mapped
  region.
- interrupts: rtc alarm interrupt

Example:

	rtc@f0000c30 {
		compatible = "cnxt,cx92755-rtc";
		reg = <0xf0000c30 0x18>;
		interrupts = <25>;
	};
```

## Documentation/devicetree/bindings/rtc/dw-apb.txt
```
* Designware APB timer

Required properties:
- compatible: One of:
 	"snps,dw-apb-timer"
	"snps,dw-apb-timer-sp" <DEPRECATED>
	"snps,dw-apb-timer-osc" <DEPRECATED>
- reg: physical base address of the controller and length of memory mapped
  region.
- interrupts: IRQ line for the timer.
- either clocks+clock-names or clock-frequency properties

Optional properties:
- clocks	: list of clock specifiers, corresponding to entries in
		  the clock-names property;
- clock-names	: should contain "timer" and "pclk" entries, matching entries
		  in the clocks property.
- clock-frequency: The frequency in HZ of the timer.
- clock-freq: For backwards compatibility with picoxcell

If using the clock specifiers, the pclk clock is optional, as not all
systems may use one.


Example:
	timer@ffe00000 {
		compatible = "snps,dw-apb-timer";
		interrupts = <0 170 4>;
		reg = <0xffe00000 0x1000>;
		clocks = <&timer_clk>, <&timer_pclk>;
		clock-names = "timer", "pclk";
	};
```

## Documentation/devicetree/bindings/rtc/epson,rtc7301.txt
```
EPSON TOYOCOM RTC-7301SF/DG

Required properties:

- compatible: Should be "epson,rtc7301sf" or "epson,rtc7301dg"
- reg: Specifies base physical address and size of the registers.
- interrupts: A single interrupt specifier.

Example:

rtc: rtc@44a00000 {
	compatible = "epson,rtc7301dg";
	reg = <0x44a00000 0x10000>;
	interrupt-parent = <&axi_intc_0>;
	interrupts = <3 2>;
};
```

## Documentation/devicetree/bindings/rtc/epson,rtc7301.yaml
```yaml
# SPDX-License-Identifier: (GPL-2.0-only OR BSD-2-Clause)
%YAML 1.2
---
$id: http://devicetree.org/schemas/rtc/epson,rtc7301.yaml#
$schema: http://devicetree.org/meta-schemas/core.yaml#

title: Epson Toyocom RTC-7301SF/DG

description:
  The only difference between the two variants is the packaging.
  The DG variant is a DIL package, and the SF variant is a flat
  package.

maintainers:
  - Akinobu Mita <akinobu.mita@gmail.com>

properties:
  compatible:
    enum:
      - epson,rtc7301dg
      - epson,rtc7301sf

  reg:
    maxItems: 1

  reg-io-width:
    description:
      The size (in bytes) of the IO accesses that should be performed
      on the device.
    enum: [1, 4]
    default: 4

  interrupts:
    maxItems: 1

required:
  - compatible
  - reg

additionalProperties: false

examples:
  - |
    #include <dt-bindings/interrupt-controller/irq.h>
    rtc: rtc@44a00000 {
        compatible = "epson,rtc7301dg";
        reg = <0x44a00000 0x10000>;
        reg-io-width = <4>;
        interrupt-parent = <&axi_intc_0>;
        interrupts = <3 2>;
    };
```

## Documentation/devicetree/bindings/rtc/epson,rx6110.txt
```
Epson RX6110 Real Time Clock
============================

The Epson RX6110 can be used with SPI or I2C busses. The kind of
bus depends on the SPISEL pin and can not be configured via software.

I2C mode
--------

Required properties:
  - compatible: should be: "epson,rx6110"
  - reg : the I2C address of the device for I2C

Example:

	rtc: rtc@32 {
		compatible = "epson,rx6110"
		reg = <0x32>;
	};

SPI mode
--------

Required properties:
  - compatible: should be: "epson,rx6110"
  - reg: chip select number
  - spi-cs-high: RX6110 needs chipselect high
  - spi-cpha: RX6110 works with SPI shifted clock phase
  - spi-cpol: RX6110 works with SPI inverse clock polarity

Example:

	rtc: rtc@3 {
		compatible = "epson,rx6110"
		reg = <3>
		spi-cs-high;
		spi-cpha;
		spi-cpol;
	};
```

## Documentation/devicetree/bindings/rtc/epson,rx6110.yaml
```yaml
# SPDX-License-Identifier: (GPL-2.0-only OR BSD-2-Clause)
%YAML 1.2
---
$id: http://devicetree.org/schemas/rtc/epson,rx6110.yaml#
$schema: http://devicetree.org/meta-schemas/core.yaml#

title: Epson RX6110 Real Time Clock

description:
  The Epson RX6110 can be used with SPI or I2C busses. The kind of bus depends
  on the SPISEL pin and cannot be configured via software.

maintainers:
  - Alexandre Belloni <alexandre.belloni@bootlin.com>

allOf:
  - $ref: rtc.yaml#
  - $ref: /schemas/spi/spi-peripheral-props.yaml#

properties:
  compatible:
    const: epson,rx6110

  reg:
    maxItems: 1

  spi-cs-high: true
  spi-cpha: true
  spi-cpol: true

required:
  - compatible
  - reg

dependencies:
  spi-cs-high: [ spi-cpha, spi-cpol ]
  spi-cpha: [ spi-cs-high, spi-cpol ]
  spi-cpol: [ spi-cs-high, spi-cpha ]

unevaluatedProperties: false

examples:
  # I2C mode
  - |
    i2c {
      #address-cells = <1>;
      #size-cells = <0>;

      rtc@32 {
        compatible = "epson,rx6110";
        reg = <0x32>;
      };
    };

  # SPI mode
  - |
    spi {
      #address-cells = <1>;
      #size-cells = <0>;

      rtc@3 {
        compatible = "epson,rx6110";
        reg = <3>;
        spi-cs-high;
        spi-cpha;
        spi-cpol;
      };
    };
```

## Documentation/devicetree/bindings/rtc/epson,rx8900.txt
```
Real Time Clock driver for:
  - Epson RX8900
  - Micro Crystal rv8803

Required properties:
- compatible: should be: "microcrystal,rv8803" or "epson,rx8900"
- reg : the I2C address of the device for I2C

Optional properties:
- epson,vdet-disable : boolean, if present will disable voltage detector.
  Should be set if no backup battery is used.
- trickle-diode-disable : boolean, if present will disable internal trickle
  charger diode

Example:

	rtc: rtc@32 {
		compatible = "epson,rx8900"
		reg = <0x32>;
		epson,vdet-disable;
		trickle-diode-disable;
	};
```

## Documentation/devicetree/bindings/rtc/epson,rx8900.yaml
```yaml
# SPDX-License-Identifier: (GPL-2.0-only OR BSD-2-Clause)
%YAML 1.2
---
$id: http://devicetree.org/schemas/rtc/epson,rx8900.yaml#
$schema: http://devicetree.org/meta-schemas/core.yaml#

title: EPSON RX8900 / Microcrystal RV8803 Real-Time Clock DT bindings

maintainers:
  - Marek Vasut <marex@denx.de>

allOf:
  - $ref: rtc.yaml#

properties:
  compatible:
    enum:
      - epson,rx8900
      - microcrystal,rv8803

  reg:
    maxItems: 1

  epson,vdet-disable:
    type: boolean
    description: |
      Disable voltage detector. Should be set if no backup battery is used.

  trickle-diode-disable: true

required:
  - compatible
  - reg

additionalProperties: false

examples:
  - |
    i2c {
        #address-cells = <1>;
        #size-cells = <0>;

        rtc@32 {
            compatible = "epson,rx8900";
            reg = <0x32>;
            epson,vdet-disable;
            trickle-diode-disable;
        };
    };
```

## Documentation/devicetree/bindings/rtc/faraday,ftrtc010.txt
```
* Faraday Technology FTRTC010 Real Time Clock

This RTC appears in for example the Storlink Gemini family of
SoCs.

Required properties:
- compatible : Should be one of:
  "faraday,ftrtc010"
  "cortina,gemini-rtc", "faraday,ftrtc010"

Optional properties:
- clocks: when present should contain clock references to the
  PCLK and EXTCLK clocks. Faraday calls the later CLK1HZ and
  says the clock should be 1 Hz, but implementers actually seem
  to choose different clocks here, like Cortina who chose
  32768 Hz (a typical low-power clock).
- clock-names: should name the clocks "PCLK" and "EXTCLK"
  respectively.

Examples:

rtc@45000000 {
	compatible = "cortina,gemini-rtc";
	reg = <0x45000000 0x100>;
	interrupts = <17 IRQ_TYPE_LEVEL_HIGH>;
	clocks = <&foo 0>, <&foo 1>;
	clock-names = "PCLK", "EXTCLK";
};
```

## Documentation/devicetree/bindings/rtc/faraday,ftrtc010.yaml
```yaml
# SPDX-License-Identifier: (GPL-2.0-only OR BSD-2-Clause)
%YAML 1.2
---
$id: http://devicetree.org/schemas/rtc/faraday,ftrtc010.yaml#
$schema: http://devicetree.org/meta-schemas/core.yaml#

title: Faraday Technology FTRTC010 Real Time Clock

maintainers:
  - Linus Walleij <linus.walleij@linaro.org>

description: |
  This RTC appears in for example the Storlink Gemini family of SoCs.

properties:
  compatible:
    oneOf:
      - const: faraday,ftrtc010
      - items:
          - const: cortina,gemini-rtc
          - const: faraday,ftrtc010

  resets:
    maxItems: 1

  reg:
    maxItems: 1

  interrupts:
    maxItems: 1

  clocks:
    items:
      - description: PCLK clocks
      - description: EXTCLK clocks. Faraday calls it CLK1HZ and says the clock
          should be 1 Hz, but implementers actually seem to choose different
          clocks here, like Cortina who chose 32768 Hz (a typical low-power clock).

  clock-names:
    items:
      - const: PCLK
      - const: EXTCLK

required:
  - compatible

additionalProperties: false

examples:
  - |
    #include <dt-bindings/interrupt-controller/irq.h>
    rtc@45000000 {
      compatible = "cortina,gemini-rtc", "faraday,ftrtc010";
      reg = <0x45000000 0x100>;
      interrupts = <17 IRQ_TYPE_LEVEL_HIGH>;
      clocks = <&foo 0>, <&foo 1>;
      clock-names = "PCLK", "EXTCLK";
    };
```

## Documentation/devicetree/bindings/rtc/fsl,ls-ftm-alarm.yaml
```yaml
# SPDX-License-Identifier: (GPL-2.0-only OR BSD-2-Clause)
%YAML 1.2
---
$id: http://devicetree.org/schemas/rtc/fsl,ls-ftm-alarm.yaml#
$schema: http://devicetree.org/meta-schemas/core.yaml#

title: Freescale FlexTimer Module (FTM) Alarm

maintainers:
  - Frank Li <Frank.Li@nxp.com>

properties:
  compatible:
    enum:
      - fsl,ls1012a-ftm-alarm
      - fsl,ls1021a-ftm-alarm
      - fsl,ls1028a-ftm-alarm
      - fsl,ls1043a-ftm-alarm
      - fsl,ls1046a-ftm-alarm
      - fsl,ls1088a-ftm-alarm
      - fsl,ls208xa-ftm-alarm
      - fsl,lx2160a-ftm-alarm

  reg:
    maxItems: 1

  interrupts:
    maxItems: 1

  fsl,rcpm-wakeup:
    $ref: /schemas/types.yaml#/definitions/phandle-array
    items:
      - items:
          - description: phandle to rcpm node
          - description: bit mask of IPPDEXPCR0
          - description: bit mask of IPPDEXPCR1
          - description: bit mask of IPPDEXPCR2
          - description: bit mask of IPPDEXPCR3
          - description: bit mask of IPPDEXPCR4
          - description: bit mask of IPPDEXPCR5
          - description: bit mask of IPPDEXPCR6
        minItems: 1
    description:
      phandle to rcpm node, Please refer
      Documentation/devicetree/bindings/soc/fsl/rcpm.txt

  big-endian:
    $ref: /schemas/types.yaml#/definitions/flag
    description:
      If the host controller is big-endian mode, specify this property.
      The default endian mode is little-endian.

required:
  - compatible
  - reg
  - interrupts
  - fsl,rcpm-wakeup

allOf:
  - $ref: rtc.yaml#

unevaluatedProperties: false

examples:
  - |
    #include <dt-bindings/interrupt-controller/arm-gic.h>

    rtc@2800000 {
        compatible = "fsl,ls1088a-ftm-alarm";
        reg = <0x2800000 0x10000>;
        fsl,rcpm-wakeup = <&rcpm 0x0 0x0 0x0 0x0 0x4000 0x0>;
        interrupts = <GIC_SPI 44 IRQ_TYPE_LEVEL_HIGH>;
    };
```

## Documentation/devicetree/bindings/rtc/fsl,scu-rtc.yaml
```yaml
# SPDX-License-Identifier: (GPL-2.0-only OR BSD-2-Clause)
%YAML 1.2
---
$id: http://devicetree.org/schemas/rtc/fsl,scu-rtc.yaml#
$schema: http://devicetree.org/meta-schemas/core.yaml#

title: i.MX SCU Client Device Analde - RTC Based on SCU Message Protocol

maintainers:
  - Dong Aisheng <aisheng.dong@nxp.com>

description: i.MX SCU Client Device Analde
  Client analdes are maintained as children of the relevant IMX-SCU device analde.

allOf:
  - $ref: rtc.yaml#

properties:
  compatible:
    const: fsl,imx8qxp-sc-rtc

required:
  - compatible

additionalProperties: false

examples:
  - |
    rtc {
        compatible = "fsl,imx8qxp-sc-rtc";
    };
```
