## Documentation/devicetree/bindings/rtc/ingenic,rtc.yaml
```yaml
# SPDX-License-Identifier: (GPL-2.0-only OR BSD-2-Clause)
%YAML 1.2
---
$id: http://devicetree.org/schemas/rtc/ingenic,rtc.yaml#
$schema: http://devicetree.org/meta-schemas/core.yaml#

title: Ingenic SoCs Real-Time Clock DT bindings

maintainers:
  - Paul Cercueil <paul@crapouillou.net>

allOf:
  - $ref: rtc.yaml#

properties:
  compatible:
    oneOf:
      - enum:
          - ingenic,jz4740-rtc
          - ingenic,jz4760-rtc
      - items:
          - const: ingenic,jz4725b-rtc
          - const: ingenic,jz4740-rtc
      - items:
          - enum:
              - ingenic,jz4770-rtc
              - ingenic,jz4780-rtc
          - const: ingenic,jz4760-rtc

  reg:
    maxItems: 1

  interrupts:
    maxItems: 1

  clocks:
    maxItems: 1

  clock-names:
    const: rtc

  system-power-controller:
    description: |
      Indicates that the RTC is responsible for powering OFF
      the system.
    type: boolean

  ingenic,reset-pin-assert-time-ms:
    minimum: 0
    maximum: 125
    default: 60
    description: |
      Reset pin low-level assertion time after wakeup
      (assuming RTC clock at 32 kHz)

  ingenic,min-wakeup-pin-assert-time-ms:
    minimum: 0
    maximum: 2000
    default: 100
    description: |
      Minimum wakeup pin assertion time
      (assuming RTC clock at 32 kHz)

required:
  - compatible
  - reg
  - interrupts
  - clocks
  - clock-names

unevaluatedProperties: false

examples:
  - |
    #include <dt-bindings/clock/jz4740-cgu.h>
    rtc_dev: rtc@10003000 {
      compatible = "ingenic,jz4740-rtc";
      reg = <0x10003000 0x40>;

      interrupt-parent = <&intc>;
      interrupts = <15>;

      clocks = <&cgu JZ4740_CLK_RTC>;
      clock-names = "rtc";
    };
```

## Documentation/devicetree/bindings/rtc/intersil,isl12022.yaml
```yaml
# SPDX-License-Identifier: GPL-2.0-only OR BSD-2-Clause
%YAML 1.2
---
$id: http://devicetree.org/schemas/rtc/intersil,isl12022.yaml#
$schema: http://devicetree.org/meta-schemas/core.yaml#

title: Intersil ISL12022 Real-time Clock

maintainers:
  - Alexandre Belloni <alexandre.belloni@bootlin.com>

properties:
  compatible:
    const: isil,isl12022

  reg:
    maxItems: 1

  interrupts:
    maxItems: 1

  '#clock-cells':
    const: 0

  isil,battery-trip-levels-microvolt:
    description:
      The battery voltages at which the first alarm and second alarm
      should trigger (normally ~85% and ~75% of nominal V_BAT).
    items:
      - enum: [2125000, 2295000, 2550000, 2805000, 3060000, 4250000, 4675000]
      - enum: [1875000, 2025000, 2250000, 2475000, 2700000, 3750000, 4125000]

required:
  - compatible
  - reg

allOf:
  - $ref: rtc.yaml#
  # If #clock-cells is present, interrupts must not be present
  - if:
      required:
        - '#clock-cells'
    then:
      properties:
        interrupts: false

unevaluatedProperties: false

examples:
  - |
    #include <dt-bindings/interrupt-controller/irq.h>
    i2c {
        #address-cells = <1>;
        #size-cells = <0>;

        rtc@6f {
            compatible = "isil,isl12022";
            reg = <0x6f>;
            interrupts-extended = <&gpio1 5 IRQ_TYPE_LEVEL_LOW>;
            isil,battery-trip-levels-microvolt = <2550000>, <2250000>;
        };
    };

...
```

## Documentation/devicetree/bindings/rtc/isil,isl12026.txt
```
ISL12026 I2C RTC/EEPROM

ISL12026 is an I2C RTC/EEPROM combination device.  The RTC and control
registers respond at bus address 0x6f, and the EEPROM array responds
at bus address 0x57.  The canonical "reg" value will be for the RTC portion.

Required properties supported by the device:

 - "compatible": must be "isil,isl12026"
 - "reg": I2C bus address of the device (always 0x6f)

Optional properties:

 - "isil,pwr-bsw": If present PWR.BSW bit must be set to the specified
                   value for proper operation.

 - "isil,pwr-sbib": If present PWR.SBIB bit must be set to the specified
                    value for proper operation.


Example:

	rtc@6f {
		compatible = "isil,isl12026";
		reg = <0x6f>;
		isil,pwr-bsw = <0>;
		isil,pwr-sbib = <1>;
	}
```

## Documentation/devicetree/bindings/rtc/isil,isl12057.txt
```
Intersil ISL12057 I2C RTC/Alarm chip

ISL12057 is a trivial I2C device (it has simple device tree bindings,
consisting of a compatible field, an address and possibly an interrupt
line).

Nonetheless, it also supports an option boolean property
("wakeup-source") to handle the specific use-case found
on at least three in-tree users of the chip (NETGEAR ReadyNAS 102, 104
and 2120 ARM-based NAS); On those devices, the IRQ#2 pin of the chip
(associated with the alarm supported by the driver) is not connected
to the SoC but to a PMIC. It allows the device to be powered up when
RTC alarm rings. In order to mark the device has a wakeup source and
get access to the 'wakealarm' sysfs entry, this specific property can
be set when the IRQ#2 pin of the chip is not connected to the SoC but
can wake up the device.

Required properties supported by the device:

 - "compatible": must be "isil,isl12057"
 - "reg": I2C bus address of the device

Optional properties:

 - "wakeup-source": mark the chip as a wakeup source, independently of
    the availability of an IRQ line connected to the SoC.
    (Legacy property supported: "isil,irq2-can-wakeup-machine")

 - "interrupt-parent", "interrupts": for passing the interrupt line
   of the SoC connected to IRQ#2 of the RTC chip.


Example isl12057 node without IRQ#2 pin connected (no alarm support):

	isl12057: isl12057@68 {
		compatible = "isil,isl12057";
		reg = <0x68>;
	};


Example isl12057 node with IRQ#2 pin connected to main SoC via MPP6 (note
that the pinctrl-related properties below are given for completeness and
may not be required or may be different depending on your system or
SoC, and the main function of the MPP used as IRQ line, i.e.
"interrupt-parent" and "interrupts" are usually sufficient):

		    pinctrl {
				...

				rtc_alarm_pin: rtc_alarm_pin {
					marvell,pins = "mpp6";
					marvell,function = "gpio";
				};

				...

		    };

	...

	isl12057: isl12057@68 {
		compatible = "isil,isl12057";
		reg = <0x68>;
		pinctrl-0 = <&rtc_alarm_pin>;
		pinctrl-names = "default";
		interrupt-parent = <&gpio0>;
		interrupts = <6 IRQ_TYPE_EDGE_FALLING>;
	};


Example isl12057 node without IRQ#2 pin connected to the SoC but to a
PMIC, allowing the device to be started based on configured alarm:

	isl12057: isl12057@68 {
		compatible = "isil,isl12057";
		reg = <0x68>;
		wakeup-source;
	};
```

## Documentation/devicetree/bindings/rtc/isil,isl1208.txt
```
Intersil ISL1209/19 I2C RTC/Alarm chip with event in

ISL12X9 have additional pins EVIN and #EVDET for tamper detection, while the
ISL1208 and ISL1218 do not.  They are all use the same driver with the bindings
described here, with chip specific properties as noted.

Required properties supported by the device:
 - "compatible": Should be one of the following:
		- "isil,isl1208"
		- "isil,isl1209"
		- "isil,isl1218"
		- "isil,isl1219"
 - "reg": I2C bus address of the device

Optional properties:
 - "interrupt-names": list which may contains "irq" and "evdet"
	evdet applies to isl1209 and isl1219 only
 - "interrupts": list of interrupts for "irq" and "evdet"
	evdet applies to isl1209 and isl1219 only
 - "isil,ev-evienb": Enable or disable internal pull on EVIN pin
	Applies to isl1209 and isl1219 only
	Possible values are 0 and 1
	Value 0 enables internal pull-up on evin pin, 1 disables it.
	Default will leave the non-volatile configuration of the pullup
	as is.

Example isl1219 node with #IRQ pin connected to SoC gpio1 pin12 and #EVDET pin
connected to SoC gpio2 pin 24 and internal pull-up enabled in EVIN pin.

	isl1219: rtc@68 {
		compatible = "isil,isl1219";
		reg = <0x68>;
		interrupt-names = "irq", "evdet";
		interrupts-extended = <&gpio1 12 IRQ_TYPE_EDGE_FALLING>,
			<&gpio2 24 IRQ_TYPE_EDGE_FALLING>;
		isil,ev-evienb = <1>;
	};
```

## Documentation/devicetree/bindings/rtc/isil,isl1208.yaml
```yaml
# SPDX-License-Identifier: (GPL-2.0-only OR BSD-2-Clause)
%YAML 1.2
---
$id: http://devicetree.org/schemas/rtc/isil,isl1208.yaml#
$schema: http://devicetree.org/meta-schemas/core.yaml#

title: Intersil ISL1209/19 I2C RTC/Alarm chip with event in

maintainers:
  - Biju Das <biju.das.jz@bp.renesas.com>
  - Trent Piepho <tpiepho@gmail.com>

description:
  ISL12X9 have additional pins EVIN and EVDET for tamper detection, while the
  ISL1208 and ISL1218 do not.

properties:
  compatible:
    enum:
      - isil,isl1208
      - isil,isl1209
      - isil,isl1218
      - isil,isl1219

  reg:
    maxItems: 1

  clocks:
    maxItems: 1

  clock-names:
    description: |
      Use xin, if connected to an external crystal.
      Use clkin, if connected to an external clock signal.
    enum:
      - xin
      - clkin

  interrupts:
    minItems: 1
    maxItems: 2

  interrupt-names:
    minItems: 1
    items:
      - const: irq
      - const: evdet

  isil,ev-evienb:
    $ref: /schemas/types.yaml#/definitions/uint32
    enum: [ 0, 1 ]
    description: |
      Enable or disable internal pull on EVIN pin
      Default will leave the non-volatile configuration of the pullup
      as is.
        <0> : Enables internal pull-up on evin pin
        <1> : Disables internal pull-up on evin pin

required:
  - compatible
  - reg

allOf:
  - $ref: rtc.yaml#
  - if:
      properties:
        compatible:
          contains:
            enum:
              - isil,isl1209
              - isil,isl1219
    then:
      properties:
        interrupts:
          maxItems: 2
        interrupt-names:
          items:
            - const: irq
            - const: evdet
    else:
      properties:
        interrupts:
          maxItems: 1
        interrupt-names:
          items:
            - const: irq

unevaluatedProperties: false

examples:
  - |
    i2c {
        #address-cells = <1>;
        #size-cells = <0>;

        rtc_twi: rtc@6f {
            compatible = "isil,isl1208";
            reg = <0x6f>;
        };
    };
```

## Documentation/devicetree/bindings/rtc/isil,isl1219.txt
```
Intersil ISL1219 I2C RTC/Alarm chip with event in

ISL1219 has additional pins EVIN and #EVDET for tamper detection.

Required properties supported by the device:

 - "compatible": must be "isil,isl1219"
 - "reg": I2C bus address of the device

Optional properties:

 - "interrupt-names": list which may contains "irq" and "evdet"
 - "interrupts": list of interrupts for "irq" and "evdet"
 - "isil,ev-evienb": if present EV.EVIENB bit is set to the specified
                     value for proper operation.


Example isl1219 node with #IRQ pin connected to SoC gpio1 pin12
 and #EVDET pin connected to SoC gpio2 pin 24:

	isl1219: rtc@68 {
		compatible = "isil,isl1219";
		reg = <0x68>;
		interrupt-names = "irq", "evdet";
		interrupts-extended = <&gpio1 12 IRQ_TYPE_EDGE_FALLING>,
			<&gpio2 24 IRQ_TYPE_EDGE_FALLING>;
		isil,ev-evienb = <1>;
	};
```

## Documentation/devicetree/bindings/rtc/loongson,rtc.yaml
```yaml
# SPDX-License-Identifier: (GPL-2.0-only OR BSD-2-Clause)
%YAML 1.2
---
$id: http://devicetree.org/schemas/rtc/loongson,rtc.yaml#
$schema: http://devicetree.org/meta-schemas/core.yaml#

title: Loongson Real-Time Clock

description:
  The Loongson family chips use an on-chip counter 0 (Time Of Year
  counter) as the RTC.

maintainers:
  - Binbin Zhou <zhoubinbin@loongson.cn>

allOf:
  - $ref: rtc.yaml#

properties:
  compatible:
    oneOf:
      - enum:
          - loongson,ls1b-rtc
          - loongson,ls1c-rtc
          - loongson,ls7a-rtc
          - loongson,ls2k1000-rtc
      - items:
          - enum:
              - loongson,ls2k2000-rtc
              - loongson,ls2k0500-rtc
          - const: loongson,ls7a-rtc

  reg:
    maxItems: 1

  interrupts:
    maxItems: 1

required:
  - compatible
  - reg

unevaluatedProperties: false

examples:
  - |
    #include <dt-bindings/interrupt-controller/irq.h>

    rtc@1fe27800 {
        compatible = "loongson,ls2k1000-rtc";
        reg = <0x1fe27800 0x100>;

        interrupt-parent = <&liointc1>;
        interrupts = <8 IRQ_TYPE_LEVEL_HIGH>;
    };

...
```

## Documentation/devicetree/bindings/rtc/lpc32xx-rtc.txt
```
* NXP LPC32xx SoC Real Time Clock controller

Required properties:
- compatible: must be "nxp,lpc3220-rtc"
- reg: physical base address of the controller and length of memory mapped
  region.
- interrupts: The RTC interrupt

Example:

	rtc@40024000 {
		compatible = "nxp,lpc3220-rtc";
		reg = <0x40024000 0x1000>;
		interrupts = <52 0>;
	};
```

## Documentation/devicetree/bindings/rtc/marvell,armada-380-rtc.yaml
```yaml
# SPDX-License-Identifier: (GPL-2.0 OR BSD-2-Clause)
%YAML 1.2
---
$id: http://devicetree.org/schemas/rtc/marvell,armada-380-rtc.yaml#
$schema: http://devicetree.org/meta-schemas/core.yaml#

title: RTC controller for the Armada 38x, 7K and 8K SoCs

maintainers:
  - Javier Carrasco <javier.carrasco.cruz@gmail.com>

allOf:
  - $ref: rtc.yaml#

properties:
  compatible:
    enum:
      - marvell,armada-380-rtc
      - marvell,armada-8k-rtc

  reg:
    items:
      - description: RTC base address size
      - description: Base address and size of SoC related registers

  reg-names:
    items:
      - const: rtc
      - const: rtc-soc

  interrupts:
    maxItems: 1

required:
  - compatible
  - reg
  - reg-names
  - interrupts

unevaluatedProperties: false

examples:
  - |
    #include <dt-bindings/interrupt-controller/arm-gic.h>

    rtc@a3800 {
        compatible = "marvell,armada-380-rtc";
        reg = <0xa3800 0x20>, <0x184a0 0x0c>;
        reg-names = "rtc", "rtc-soc";
        interrupts = <GIC_SPI 21 IRQ_TYPE_LEVEL_HIGH>;
    };
```

## Documentation/devicetree/bindings/rtc/marvell,pxa-rtc.yaml
```yaml
# SPDX-License-Identifier: (GPL-2.0-only OR BSD-2-Clause)
%YAML 1.2
---
$id: http://devicetree.org/schemas/rtc/marvell,pxa-rtc.yaml#
$schema: http://devicetree.org/meta-schemas/core.yaml#

title: PXA Real Time Clock

maintainers:
  - Javier Carrasco <javier.carrasco.cruz@gmail.com>

allOf:
  - $ref: rtc.yaml#

properties:
  compatible:
    const: marvell,pxa-rtc

  reg:
    maxItems: 1

  interrupts:
    items:
      - description: 1 Hz
      - description: Alarm

required:
  - compatible
  - reg
  - interrupts

unevaluatedProperties: false

examples:
  - |
    rtc@40900000 {
        compatible = "marvell,pxa-rtc";
        reg = <0x40900000 0x3c>;
        interrupts = <30>, <31>;
    };
```

## Documentation/devicetree/bindings/rtc/maxim,ds1742.txt
```
* Maxim (Dallas) DS1742/DS1743 Real Time Clock

Required properties:
- compatible: Should contain "maxim,ds1742".
- reg: Physical base address of the RTC and length of memory
  mapped region.

Example:
	rtc: rtc@10000000 {
		compatible = "maxim,ds1742";
		reg = <0x10000000 0x800>;
	};
```

## Documentation/devicetree/bindings/rtc/maxim,ds3231.txt
```
* Maxim DS3231 Real Time Clock

Required properties:
see: Documentation/devicetree/bindings/i2c/trivial-devices.txt

Optional property:
- #clock-cells: Should be 1.
- clock-output-names:
  overwrite the default clock names "ds3231_clk_sqw" and "ds3231_clk_32khz".

Each clock is assigned an identifier and client nodes can use this identifier
to specify the clock which they consume. Following indices are allowed:
    - 0: square-wave output on the SQW pin
    - 1: square-wave output on the 32kHz pin

- interrupts: rtc alarm/event interrupt. When this property is selected,
  clock on the SQW pin cannot be used.

Example:

ds3231: ds3231@51 {
	compatible = "maxim,ds3231";
	reg = <0x68>;
	#clock-cells = <1>;
};

device1 {
...
	clocks = <&ds3231 0>;
...
};

device2 {
...
	clocks = <&ds3231 1>;
...
};
```

## Documentation/devicetree/bindings/rtc/maxim,mcp795.txt
```
* Maxim MCP795		SPI Serial Real-Time Clock

Required properties:
- compatible: Should contain "maxim,mcp795".
- reg: SPI address for chip

Example:
	mcp795: rtc@0 {
		compatible = "maxim,mcp795";
		reg = <0>;
	};
```
