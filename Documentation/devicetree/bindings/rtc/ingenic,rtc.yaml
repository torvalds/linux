## Documentation/devicetree/bindings/rtc/maxim-ds1302.txt
```
* Maxim/Dallas Semiconductor DS-1302 RTC

Simple device which could be used to store date/time between reboots.

The device uses the standard MicroWire half-duplex transfer timing.
Master output is set on low clock and sensed by the RTC on the rising
edge. Master input is set by the RTC on the trailing edge and is sensed
by the master on low clock.

Required properties:

- compatible : Should be "maxim,ds1302"

Required SPI properties:

- reg : Should be address of the device chip select within
  the controller.

- spi-max-frequency : DS-1302 has 500 kHz if powered at 2.2V,
  and 2MHz if powered at 5V.

- spi-3wire : The device has a shared signal IN/OUT line.

- spi-lsb-first : DS-1302 requires least significant bit first
  transfers.

- spi-cs-high: DS-1302 has active high chip select line. This is
  required unless inverted in hardware.

Example:

spi@901c {
	#address-cells = <1>;
	#size-cells = <0>;
	compatible = "icpdas,lp8841-spi-rtc";
	reg = <0x901c 0x1>;

	rtc@0 {
		compatible = "maxim,ds1302";
		reg = <0>;
		spi-max-frequency = <500000>;
		spi-3wire;
		spi-lsb-first;
		spi-cs-high;
	};
};
```

## Documentation/devicetree/bindings/rtc/mediatek,mt2712-rtc.yaml
```yaml
# SPDX-License-Identifier: GPL-2.0-only OR BSD-2-Clause
%YAML 1.2
---
$id: http://devicetree.org/schemas/rtc/mediatek,mt2712-rtc.yaml#
$schema: http://devicetree.org/meta-schemas/core.yaml#

title: MediaTek MT2712 on-SoC RTC

allOf:
  - $ref: rtc.yaml#

maintainers:
  - Ran Bi <ran.bi@mediatek.com>

properties:
  compatible:
    const: mediatek,mt2712-rtc

  reg:
    maxItems: 1

  interrupts:
    maxItems: 1

required:
  - reg
  - interrupts

unevaluatedProperties: false

examples:
  - |
    #include <dt-bindings/interrupt-controller/arm-gic.h>

    rtc@10011000 {
        compatible = "mediatek,mt2712-rtc";
        reg = <0x10011000 0x1000>;
        interrupts = <GIC_SPI 239 IRQ_TYPE_LEVEL_LOW>;
    };
```

## Documentation/devicetree/bindings/rtc/mediatek,mt7622-rtc.yaml
```yaml
# SPDX-License-Identifier: GPL-2.0-only OR BSD-2-Clause
%YAML 1.2
---
$id: http://devicetree.org/schemas/rtc/mediatek,mt7622-rtc.yaml#
$schema: http://devicetree.org/meta-schemas/core.yaml#

title: MediaTek MT7622 on-SoC RTC

allOf:
  - $ref: rtc.yaml#

maintainers:
  - Sean Wang <sean.wang@mediatek.com>

properties:
  compatible:
    items:
      - const: mediatek,mt7622-rtc
      - const: mediatek,soc-rtc

  reg:
    maxItems: 1

  interrupts:
    maxItems: 1

  clocks:
    maxItems: 1

  clock-names:
    const: rtc

required:
  - reg
  - interrupts
  - clocks
  - clock-names

unevaluatedProperties: false

examples:
  - |
    #include <dt-bindings/clock/mt7622-clk.h>
    #include <dt-bindings/interrupt-controller/arm-gic.h>

    rtc@10212800 {
        compatible = "mediatek,mt7622-rtc", "mediatek,soc-rtc";
        reg = <0x10212800 0x200>;
        interrupts = <GIC_SPI 129 IRQ_TYPE_LEVEL_LOW>;
        clocks = <&topckgen CLK_TOP_RTC>;
        clock-names = "rtc";
    };
```

## Documentation/devicetree/bindings/rtc/microchip,mfps-rtc.yaml
```yaml
# SPDX-License-Identifier: (GPL-2.0-only OR BSD-2-Clause)
%YAML 1.2
---
$id: http://devicetree.org/schemas/rtc/microchip,mfps-rtc.yaml#

$schema: http://devicetree.org/meta-schemas/core.yaml#

title: Microchip PolarFire Soc (MPFS) RTC

allOf:
  - $ref: rtc.yaml#

maintainers:
  - Daire McNamara <daire.mcnamara@microchip.com>
  - Lewis Hanly <lewis.hanly@microchip.com>

properties:
  compatible:
    enum:
      - microchip,mpfs-rtc

  reg:
    maxItems: 1

  interrupts:
    items:
      - description: |
          RTC_WAKEUP interrupt
      - description: |
          RTC_MATCH, asserted when the content of the Alarm register is equal
          to that of the RTC's count register.

  clocks:
    items:
      - description: |
          AHB clock
      - description: |
          Reference clock: divided by the prescaler to create a time-based
          strobe (typically 1 Hz) for the calendar counter. By default, the rtc
          on the PolarFire SoC shares it's reference with MTIMER so this will
          be a 1 MHz clock.

  clock-names:
    items:
      - const: rtc
      - const: rtcref

required:
  - compatible
  - reg
  - interrupts
  - clocks
  - clock-names

additionalProperties: false

examples:
  - |
    #include "dt-bindings/clock/microchip,mpfs-clock.h"
    rtc@20124000 {
        compatible = "microchip,mpfs-rtc";
        reg = <0x20124000 0x1000>;
        clocks = <&clkcfg CLK_RTC>, <&clkcfg CLK_RTCREF>;
        clock-names = "rtc", "rtcref";
        interrupts = <80>, <81>;
    };
...
```

## Documentation/devicetree/bindings/rtc/microchip,pic32-rtc.txt
```
* Microchip PIC32 Real Time Clock and Calendar

The RTCC keeps time in hours, minutes, and seconds, and one half second. It
provides a calendar in weekday, date, month, and year. It also provides a
configurable alarm.

Required properties:
- compatible: should be: "microchip,pic32mzda-rtc"
- reg: physical base address of the controller and length of memory mapped
    region.
- interrupts: RTC alarm/event interrupt
- clocks: clock phandle

Example:

	rtc: rtc@1f8c0000 {
		compatible = "microchip,pic32mzda-rtc";
		reg = <0x1f8c0000 0x60>;
		interrupts = <166 IRQ_TYPE_EDGE_RISING>;
		clocks = <&PBCLK6>;
	};
```

## Documentation/devicetree/bindings/rtc/microcrystal,rv3028.yaml
```yaml
# SPDX-License-Identifier: GPL-2.0-only OR BSD-2-Clause
%YAML 1.2
---
$id: http://devicetree.org/schemas/rtc/microcrystal,rv3028.yaml#
$schema: http://devicetree.org/meta-schemas/core.yaml#

title: Microchip RV-3028 RTC

allOf:
  - $ref: rtc.yaml#

maintainers:
  - Alexandre Belloni <alexandre.belloni@bootlin.com>

properties:
  compatible:
    const: microcrystal,rv3028

  reg:
    maxItems: 1

  interrupts:
    maxItems: 1

  "#clock-cells":
    const: 0

  trickle-resistor-ohms:
    enum:
      - 3000
      - 5000
      - 9000
      - 15000

required:
  - compatible
  - reg

unevaluatedProperties: false

examples:
  - |
    #include <dt-bindings/interrupt-controller/irq.h>
    i2c {
        #address-cells = <1>;
        #size-cells = <0>;

        rtc@51 {
            compatible = "microcrystal,rv3028";
            reg = <0x51>;
            pinctrl-0 = <&rtc_nint_pins>;
            interrupts-extended = <&gpio1 16 IRQ_TYPE_LEVEL_HIGH>;
            trickle-resistor-ohms = <3000>;
        };
    };

...
```

## Documentation/devicetree/bindings/rtc/microcrystal,rv3032.yaml
```yaml
# SPDX-License-Identifier: GPL-2.0-only OR BSD-2-Clause
%YAML 1.2
---
$id: http://devicetree.org/schemas/rtc/microcrystal,rv3032.yaml#
$schema: http://devicetree.org/meta-schemas/core.yaml#

title: Microchip RV-3032 RTC Device Tree Bindings

allOf:
  - $ref: "rtc.yaml#"

maintainers:
  - Alexandre Belloni <alexandre.belloni@bootlin.com>

properties:
  compatible:
    const: microcrystal,rv3032

  reg:
    maxItems: 1

  interrupts:
    maxItems: 1

  start-year: true

  trickle-resistor-ohms:
    enum:
      - 1000
      - 2000
      - 7000
      - 11000

  trickle-voltage-millivolt:
    enum:
      - 1750
      - 3000
      - 4400

required:
  - compatible
  - reg

additionalProperties: false

examples:
  - |
    #include <dt-bindings/interrupt-controller/irq.h>
    i2c {
        #address-cells = <1>;
        #size-cells = <0>;

        rtc@51 {
            compatible = "microcrystal,rv3032";
            reg = <0x51>;
            pinctrl-0 = <&rtc_nint_pins>;
            interrupts-extended = <&gpio1 16 IRQ_TYPE_LEVEL_HIGH>;
            trickle-resistor-ohms = <7000>;
            trickle-voltage-millivolt = <1750>;
        };
    };

...
```

## Documentation/devicetree/bindings/rtc/motorola,cpcap-rtc.yaml
```yaml
# SPDX-License-Identifier: (GPL-2.0 OR BSD-2-Clause)
%YAML 1.2
---
$id: http://devicetree.org/schemas/rtc/motorola,cpcap-rtc.yaml#
$schema: http://devicetree.org/meta-schemas/core.yaml#

title: Motorola CPCAP PMIC RTC

maintainers:
  - Svyatoslav Ryhel <clamor95@gmail.com>

description:
  This module is part of the Motorola CPCAP MFD device. For more details
  see Documentation/devicetree/bindings/mfd/motorola,cpcap.yaml. The
  RTC is represented as a sub-node of the PMIC node on the device tree.

properties:
  compatible:
    const: motorola,cpcap-rtc

  interrupts:
    items:
      - description: alarm interrupt
      - description: 1 Hz interrupt

required:
  - compatible
  - interrupts

additionalProperties: false

...
```

## Documentation/devicetree/bindings/rtc/moxa,moxart-rtc.txt
```
MOXA ART real-time clock

Required properties:

- compatible : Should be "moxa,moxart-rtc"
- rtc-sclk-gpios : RTC sclk gpio, with zero flags
- rtc-data-gpios : RTC data gpio, with zero flags
- rtc-reset-gpios : RTC reset gpio, with zero flags

Example:

	rtc: rtc {
		compatible = "moxa,moxart-rtc";
		rtc-sclk-gpios = <&gpio 5 0>;
		rtc-data-gpios = <&gpio 6 0>;
		rtc-reset-gpios = <&gpio 7 0>;
	};
```

## Documentation/devicetree/bindings/rtc/mstar,msc313-rtc.yaml
```yaml
# SPDX-License-Identifier: (GPL-2.0-only OR BSD-2-Clause)
%YAML 1.2
---
$id: http://devicetree.org/schemas/rtc/mstar,msc313-rtc.yaml#
$schema: http://devicetree.org/meta-schemas/core.yaml#

title: Mstar MSC313e RTC Device Tree Bindings

allOf:
  - $ref: "rtc.yaml#"

maintainers:
  - Daniel Palmer <daniel@0x0f.com>
  - Romain Perier <romain.perier@gmail.com>

properties:
  compatible:
    enum:
      - mstar,msc313-rtc

  reg:
    maxItems: 1

  interrupts:
    maxItems: 1

  start-year: true

  clocks:
    maxItems: 1

required:
  - compatible
  - reg
  - interrupts
  - clocks

additionalProperties: false

examples:
  - |
    #include <dt-bindings/interrupt-controller/arm-gic.h>
    rtc@2400 {
        compatible = "mstar,msc313-rtc";
        reg = <0x2400 0x40>;
        clocks = <&xtal_div2>;
        interrupts-extended = <&intc_irq GIC_SPI 44 IRQ_TYPE_LEVEL_HIGH>;
    };
...
```

## Documentation/devicetree/bindings/rtc/mstar,ssd202d-rtc.yaml
```yaml
# SPDX-License-Identifier: (GPL-2.0-only OR BSD-2-Clause)
%YAML 1.2
---
$id: http://devicetree.org/schemas/rtc/mstar,ssd202d-rtc.yaml#
$schema: http://devicetree.org/meta-schemas/core.yaml#

title: Mstar SSD202D Real Time Clock

maintainers:
  - Daniel Palmer <daniel@0x0f.com>
  - Romain Perier <romain.perier@gmail.com>

allOf:
  - $ref: rtc.yaml#

properties:
  compatible:
    enum:
      - mstar,ssd202d-rtc
  reg:
    maxItems: 1

required:
  - compatible
  - reg

unevaluatedProperties: false

examples:
  - |
    rtc@6800 {
        compatible = "mstar,ssd202d-rtc";
        reg = <0x6800 0x200>;
    };
...
```
