## Documentation/devicetree/bindings/rtc/renesas,rz-rtca3.yaml
```yaml
# SPDX-License-Identifier: (GPL-2.0-only OR BSD-2-Clause)
%YAML 1.2
---
$id: http://devicetree.org/schemas/rtc/renesas,rz-rtca3.yaml#
$schema: http://devicetree.org/meta-schemas/core.yaml#

title: Renesas RTCA-3 Real Time Clock

maintainers:
  - Claudiu Beznea <claudiu.beznea.uj@bp.renesas.com>

allOf:
  - $ref: rtc.yaml#

properties:
  compatible:
    items:
      - enum:
          - renesas,r9a08g045-rtca3 # RZ/G3S
      - const: renesas,rz-rtca3

  reg:
    maxItems: 1

  interrupts:
    items:
      - description: Alarm interrupt
      - description: Periodic interrupt
      - description: Carry interrupt

  interrupt-names:
    items:
      - const: alarm
      - const: period
      - const: carry

  clocks:
    items:
      - description: RTC bus clock
      - description: RTC counter clock

  clock-names:
    items:
      - const: bus
      - const: counter

  power-domains:
    maxItems: 1

  resets:
    items:
      - description: VBATTB module reset

required:
  - compatible
  - reg
  - interrupts
  - interrupt-names
  - clocks
  - clock-names
  - power-domains
  - resets

additionalProperties: false

examples:
  - |
    #include <dt-bindings/clock/r9a08g045-cpg.h>
    #include <dt-bindings/clock/renesas,r9a08g045-vbattb.h>
    #include <dt-bindings/interrupt-controller/arm-gic.h>
    #include <dt-bindings/interrupt-controller/irq.h>

    rtc@1004ec00 {
        compatible = "renesas,r9a08g045-rtca3", "renesas,rz-rtca3";
        reg = <0x1004ec00 0x400>;
        interrupts = <GIC_SPI 315 IRQ_TYPE_LEVEL_HIGH>,
                     <GIC_SPI 316 IRQ_TYPE_LEVEL_HIGH>,
                     <GIC_SPI 317 IRQ_TYPE_LEVEL_HIGH>;
        interrupt-names = "alarm", "period", "carry";
        clocks = <&cpg CPG_MOD R9A08G045_VBAT_BCLK>, <&vbattclk VBATTB_VBATTCLK>;
        clock-names = "bus", "counter";
        power-domains = <&cpg>;
        resets = <&cpg R9A08G045_VBAT_BRESETN>;
    };
```

## Documentation/devicetree/bindings/rtc/renesas,sh-rtc.yaml
```yaml
# SPDX-License-Identifier: GPL-2.0
%YAML 1.2
---
$id: http://devicetree.org/schemas/rtc/renesas,sh-rtc.yaml#
$schema: http://devicetree.org/meta-schemas/core.yaml#

title: Real Time Clock for Renesas SH and ARM SoCs

maintainers:
  - Chris Brandt <chris.brandt@renesas.com>
  - Geert Uytterhoeven <geert+renesas@glider.be>

properties:
  compatible:
    items:
      - const: renesas,r7s72100-rtc  # RZ/A1H
      - const: renesas,sh-rtc

  reg:
    maxItems: 1

  interrupts:
    maxItems: 3

  interrupt-names:
    items:
      - const: alarm
      - const: period
      - const: carry

  clocks:
    # The functional clock source for the RTC controller must be listed
    # first (if it exists). Additionally, potential clock counting sources
    # are to be listed.
    minItems: 1
    maxItems: 4

  clock-names:
    # The functional clock must be labeled as "fck". Other clocks
    # may be named in accordance to the SoC hardware manuals.
    minItems: 1
    maxItems: 4
    items:
      enum: [ fck, rtc_x1, rtc_x3, extal ]

  power-domains:
    maxItems: 1

required:
  - compatible
  - reg
  - interrupts
  - interrupt-names
  - clocks
  - clock-names
  - power-domains

additionalProperties: false

examples:
  - |
    #include <dt-bindings/clock/r7s72100-clock.h>
    #include <dt-bindings/interrupt-controller/arm-gic.h>
    #include <dt-bindings/interrupt-controller/irq.h>

    rtc: rtc@fcff1000 {
        compatible = "renesas,r7s72100-rtc", "renesas,sh-rtc";
        reg = <0xfcff1000 0x2e>;
        interrupts = <GIC_SPI 276 IRQ_TYPE_EDGE_RISING>,
                     <GIC_SPI 277 IRQ_TYPE_EDGE_RISING>,
                     <GIC_SPI 278 IRQ_TYPE_EDGE_RISING>;
        interrupt-names = "alarm", "period", "carry";
        clocks = <&mstp6_clks R7S72100_CLK_RTC>, <&rtc_x1_clk>,
                 <&rtc_x3_clk>, <&extal_clk>;
        power-domains = <&cpg_clocks>;
        clock-names = "fck", "rtc_x1", "rtc_x3", "extal";
    };
```

## Documentation/devicetree/bindings/rtc/rtc-aspeed.txt
```
ASPEED BMC RTC
==============

Required properties:
 - compatible: should be one of the following
   * aspeed,ast2400-rtc for the ast2400
   * aspeed,ast2500-rtc for the ast2500
   * aspeed,ast2600-rtc for the ast2600

 - reg: physical base address of the controller and length of memory mapped
   region

 - interrupts: The interrupt number

Example:

   rtc@1e781000 {
           compatible = "aspeed,ast2400-rtc";
           reg = <0x1e781000 0x18>;
           interrupts = <22>;
           status = "disabled";
   };
```

## Documentation/devicetree/bindings/rtc/rtc-cmos.txt
```
 Motorola mc146818 compatible RTC
~~~~~~~~~~~~~~~~~~~~~~~~~~~~~~~~~~

Required properties:
  - compatible : "motorola,mc146818"
  - reg : should contain registers location and length.

Optional properties:
  - interrupts : should contain interrupt.
  - ctrl-reg : Contains the initial value of the control register also
    called "Register B".
  - freq-reg : Contains the initial value of the frequency register also
    called "Register A".

"Register A" and "B" are usually initialized by the firmware (BIOS for
instance). If this is not done, it can be performed by the driver.

ISA Example:

	rtc@70 {
	         compatible = "motorola,mc146818";
	         interrupts = <8 3>;
	         interrupt-parent = <&ioapic1>;
	         ctrl-reg = <2>;
	         freq-reg = <0x26>;
	         reg = <1 0x70 2>;
	 };
```

## Documentation/devicetree/bindings/rtc/rtc-ds1307.txt
```
Dallas DS1307 and compatible RTC

Required properties:
- compatible: should be one of:
	"dallas,ds1307",
	"dallas,ds1308",
	"dallas,ds1337",
	"dallas,ds1338",
	"dallas,ds1339",
	"dallas,ds1388",
	"dallas,ds1340",
	"dallas,ds1341",
	"maxim,ds3231",
	"st,m41t0",
	"st,m41t00",
	"st,m41t11",
	"microchip,mcp7940x",
	"microchip,mcp7941x",
	"pericom,pt7c4338",
	"epson,rx8025",
	"isil,isl12057"
	"epson,rx8130"
- reg: I2C bus address of the device

Optional properties:
- interrupts: rtc alarm interrupt.
- clock-output-names: From common clock binding to override the default output
                      clock name
- wakeup-source: Enables wake up of host system on alarm
- trickle-resistor-ohms : ds1339, ds1340 and ds 1388 only
	Selected resistor for trickle charger
	Possible values are 250, 2000, 4000
	Should be given if trickle charger should be enabled
- trickle-diode-disable : ds1339, ds1340 and ds 1388 only
	Do not use internal trickle charger diode
	Should be given if internal trickle charger diode should be disabled

Example:
	ds1339: rtc@68 {
		compatible = "dallas,ds1339";
		reg = <0x68>;
		interrupt-parent = <&gpio4>;
		interrupts = <20 0>;
		trickle-resistor-ohms = <250>;
	};
```

## Documentation/devicetree/bindings/rtc/rtc-ds1307.yaml
```yaml
# SPDX-License-Identifier: GPL-2.0
%YAML 1.2
---
$id: http://devicetree.org/schemas/rtc/rtc-ds1307.yaml#
$schema: http://devicetree.org/meta-schemas/core.yaml#

title: Dallas DS1307 and compatible RTC

maintainers:
  - Alexandre Belloni <alexandre.belloni@bootlin.com>

properties:
  compatible:
    oneOf:
      - enum:
          - dallas,ds1307
          - dallas,ds1308
          - dallas,ds1337
          - dallas,ds1338
          - dallas,ds1339
          - dallas,ds1388
          - dallas,ds1340
          - dallas,ds1341
          - maxim,ds3231
          - st,m41t0
          - st,m41t00
          - st,m41t11
          - microchip,mcp7940x
          - microchip,mcp7941x
          - pericom,pt7c4338
          - epson,rx8025
          - isil,isl12057
          - epson,rx8130

      - items:
          - enum:
              - st,m41t00
          - const: dallas,ds1338

  reg:
    maxItems: 1

  interrupts:
    minItems: 1
    maxItems: 2

  interrupt-names:
    maxItems: 2

  "#clock-cells":
    const: 1

  clock-output-names:
    description: From common clock binding to override the default output clock name.

  wakeup-source:
    description: Enables wake up of host system on alarm.

  vcc-supply: true

allOf:
  - $ref: rtc.yaml
  - if:
      properties:
        compatible:
          contains:
            enum:
              - dallas,ds1339
              - dallas,ds1340
              - dallas,ds1388
    then:
      properties:
        trickle-resistor-ohms:
          description: Selected resistor for trickle charger. Should be specified if trickle
            charger should be enabled.
          enum: [ 250, 2000, 4000 ]

        trickle-diode-disable:
          description: Do not use internal trickle charger diode. Should be given if internal
            trickle charger diode should be disabled (superseded by aux-voltage-chargeable)
          deprecated: true

unevaluatedProperties: false

required:
  - compatible
  - reg

examples:
  - |
    i2c {
      #address-cells = <1>;
      #size-cells = <0>;

      rtc@68 {
        compatible = "dallas,ds1337";
        reg = <0x68>;
        interrupt-parent = <&gpio4>;
        interrupts = <20 0>;
        trickle-resistor-ohms = <250>;
      };
    };
```

## Documentation/devicetree/bindings/rtc/rtc-fsl-ftm-alarm.txt
```
Freescale FlexTimer Module (FTM) Alarm

Required properties:
- compatible : Should be "fsl,<chip>-ftm-alarm", the
	       supported chips include
	       "fsl,ls1012a-ftm-alarm"
	       "fsl,ls1021a-ftm-alarm"
	       "fsl,ls1028a-ftm-alarm"
	       "fsl,ls1043a-ftm-alarm"
	       "fsl,ls1046a-ftm-alarm"
	       "fsl,ls1088a-ftm-alarm"
	       "fsl,ls208xa-ftm-alarm"
	       "fsl,lx2160a-ftm-alarm"
- reg : Specifies base physical address and size of the register sets for the
  FlexTimer Module.
- interrupts : Should be the FlexTimer Module interrupt.
- fsl,rcpm-wakeup property and rcpm node : Please refer
	Documentation/devicetree/bindings/soc/fsl/rcpm.txt

Optional properties:
- big-endian: If the host controller is big-endian mode, specify this property.
  The default endian mode is little-endian.

Example:
rcpm: rcpm@1e34040 {
	compatible = "fsl,ls1088a-rcpm", "fsl,qoriq-rcpm-2.1+";
	reg = <0x0 0x1e34040 0x0 0x18>;
	#fsl,rcpm-wakeup-cells = <6>;
};

ftm_alarm0: timer@2800000 {
	compatible = "fsl,ls1088a-ftm-alarm";
	reg = <0x0 0x2800000 0x0 0x10000>;
	fsl,rcpm-wakeup = <&rcpm 0x0 0x0 0x0 0x0 0x4000 0x0>;
	interrupts = <0 44 4>;
};
```

## Documentation/devicetree/bindings/rtc/rtc-m41t80.txt
```
ST M41T80 family of RTC and compatible

Required properties:
- compatible: should be one of:
	"st,m41t62",
	"st,m41t65",
	"st,m41t80",
	"st,m41t81",
	"st,m41t81s",
	"st,m41t82",
	"st,m41t83",
	"st,m41t84",
	"st,m41t85",
	"st,m41t87",
	"microcrystal,rv4162",
- reg: I2C bus address of the device

Optional properties:
- interrupts: rtc alarm interrupt.
- clock-output-names: From common clock binding to override the default output
                      clock name
- wakeup-source: Enables wake up of host system on alarm

Example:
	rtc@68 {
		compatible = "st,m41t80";
		reg = <0x68>;
		interrupt-parent = <&UIC0>;
		interrupts = <0x9 0x8>;
	};
```

## Documentation/devicetree/bindings/rtc/rtc-meson-vrtc.txt
```
* Amlogic Virtual RTC (VRTC)

This is a Linux interface to an RTC managed by firmware, hence it's
virtual from a Linux perspective.  The interface is 1 register where
an alarm time (in seconds) is to be written.

Required properties:
- compatible: should be "amlogic,meson-vrtc"
- reg: physical address for the alarm register

The alarm register is a simple scratch register shared between the
application processors (AP) and the secure co-processor (SCP.)  When
the AP suspends, the SCP will use the value of this register to
program an always-on timer before going sleep. When the timer expires,
the SCP will wake up and will then wake the AP.

Example:

	vrtc: rtc@0a8 {
		compatible = "amlogic,meson-vrtc";
		reg = <0x0 0x000a8 0x0 0x4>;
	};
```

## Documentation/devicetree/bindings/rtc/rtc-meson.txt
```
* Amlogic Meson6, Meson8, Meson8b and Meson8m2 RTC

Required properties:
- compatible: should be one of the following describing the hardware:
	* "amlogic,meson6-rtc"
	* "amlogic,meson8-rtc"
	* "amlogic,meson8b-rtc"
	* "amlogic,meson8m2-rtc"

- reg: physical register space for the controller's memory mapped registers.
- interrupts: the interrupt line of the RTC block.
- clocks: reference to the external 32.768kHz crystal oscillator.
- vdd-supply: reference to the power supply of the RTC block.
- resets: reset controller reference to allow reset of the controller

Optional properties for the battery-backed non-volatile memory:
- #address-cells: should be 1 to address the battery-backed non-volatile memory
- #size-cells: should be 1 to reference the battery-backed non-volatile memory

Optional child nodes:
- see ../nvmem/nvmem.txt

Example:

	rtc: rtc@740 {
		compatible = "amlogic,meson6-rtc";
		reg = <0x740 0x14>;
		interrupts = <GIC_SPI 72 IRQ_TYPE_EDGE_RISING>;
		clocks = <&rtc32k_xtal>;
		vdd-supply = <&rtc_vdd>;
		resets = <&reset RESET_RTC>;

		#address-cells = <1>;
		#size-cells = <1>;
	};
```

## Documentation/devicetree/bindings/rtc/rtc-mt2712.txt
```
Device-Tree bindings for MediaTek SoC based RTC

Required properties:
- compatible	    : Should be "mediatek,mt2712-rtc" : for MT2712 SoC
- reg 		    : Specifies base physical address and size of the registers;
- interrupts	    : Should contain the interrupt for RTC alarm;

Example:

rtc: rtc@10011000 {
	compatible = "mediatek,mt2712-rtc";
	reg = <0 0x10011000 0 0x1000>;
	interrupts = <GIC_SPI 239 IRQ_TYPE_LEVEL_LOW>;
};
```

## Documentation/devicetree/bindings/rtc/rtc-mt6397.txt
```
Device-Tree bindings for MediaTek PMIC based RTC

MediaTek PMIC based RTC is an independent function of MediaTek PMIC that works
as a type of multi-function device (MFD). The RTC can be configured and set up
with PMIC wrapper bus which is a common resource shared with the other
functions found on the same PMIC.

For MediaTek PMIC MFD bindings, see:
../mfd/mt6397.txt

For MediaTek PMIC wrapper bus bindings, see:
../soc/mediatek/pwrap.txt

Required properties:
- compatible: Should be one of follows
       "mediatek,mt6323-rtc": for MT6323 PMIC
       "mediatek,mt6397-rtc": for MT6397 PMIC

Example:

       pmic {
               compatible = "mediatek,mt6323";

               ...

               rtc {
                       compatible = "mediatek,mt6323-rtc";
               };
       };
```

## Documentation/devicetree/bindings/rtc/rtc-mt7622.txt
```
Device-Tree bindings for MediaTek SoC based RTC

Required properties:
- compatible	    : Should be
			"mediatek,mt7622-rtc", "mediatek,soc-rtc" : for MT7622 SoC
- reg 		    : Specifies base physical address and size of the registers;
- interrupts	    : Should contain the interrupt for RTC alarm;
- clocks	    : Specifies list of clock specifiers, corresponding to
		      entries in clock-names property;
- clock-names	    : Should contain "rtc" entries

Example:

rtc: rtc@10212800 {
	compatible = "mediatek,mt7622-rtc",
		     "mediatek,soc-rtc";
	reg = <0 0x10212800 0 0x200>;
	interrupts = <GIC_SPI 129 IRQ_TYPE_LEVEL_LOW>;
	clocks = <&topckgen CLK_TOP_RTC>;
	clock-names = "rtc";
};
```

## Documentation/devicetree/bindings/rtc/rtc-mxc.txt
```
* Real Time Clock of the i.MX SoCs

RTC controller for the i.MX SoCs

Required properties:
- compatible: Should be "fsl,imx1-rtc" or "fsl,imx21-rtc".
- reg: physical base address of the controller and length of memory mapped
  region.
- interrupts: IRQ line for the RTC.
- clocks: should contain two entries:
  * one for the input reference
  * one for the the SoC RTC
- clock-names: should contain:
  * "ref" for the input reference clock
  * "ipg" for the SoC RTC clock

Example:

rtc@10007000 {
	compatible = "fsl,imx21-rtc";
	reg = <0x10007000 0x1000>;
	interrupts = <22>;
	clocks = <&clks IMX27_CLK_CKIL>,
		 <&clks IMX27_CLK_RTC_IPG_GATE>;
	clock-names = "ref", "ipg";
};
```
