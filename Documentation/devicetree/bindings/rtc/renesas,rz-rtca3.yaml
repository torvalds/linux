## Documentation/devicetree/bindings/rtc/rtc-mxc.yaml
```yaml
# SPDX-License-Identifier: (GPL-2.0-only OR BSD-2-Clause)
%YAML 1.2
---
$id: http://devicetree.org/schemas/rtc/rtc-mxc.yaml#
$schema: http://devicetree.org/meta-schemas/core.yaml#

title: Real Time Clock of the i.MX SoCs

allOf:
  - $ref: rtc.yaml#

maintainers:
  - Philippe Reynes <tremyfr@gmail.com>

properties:
  compatible:
    oneOf:
      - const: fsl,imx1-rtc
      - const: fsl,imx21-rtc
      - items:
          - enum:
              - fsl,imx31-rtc
          - const: fsl,imx21-rtc

  reg:
    maxItems: 1

  interrupts:
    maxItems: 1

  clocks:
    items:
      - description: input reference
      - description: the SoC RTC clock

  clock-names:
    items:
      - const: ref
      - const: ipg

required:
  - compatible
  - reg
  - interrupts
  - clocks
  - clock-names

additionalProperties: false

examples:
  - |
    #include <dt-bindings/clock/imx27-clock.h>

    rtc@10007000 {
        compatible = "fsl,imx21-rtc";
        reg = <0x10007000 0x1000>;
        interrupts = <22>;
        clocks = <&clks IMX27_CLK_CKIL>,
                 <&clks IMX27_CLK_RTC_IPG_GATE>;
        clock-names = "ref", "ipg";
    };
```

## Documentation/devicetree/bindings/rtc/rtc-mxc_v2.txt
```
* i.MX53 Secure Real Time Clock (SRTC)

Required properties:
- compatible: should be: "fsl,imx53-rtc"
- reg: physical base address of the controller and length of memory mapped
  region.
- clocks: should contain the phandle for the rtc clock
- interrupts: rtc alarm interrupt

Example:

rtc@53fa4000 {
	compatible = "fsl,imx53-rtc";
	reg = <0x53fa4000 0x4000>;
	interrupts = <24>;
	clocks = <&clks IMX5_CLK_SRTC_GATE>;
};
```

## Documentation/devicetree/bindings/rtc/rtc-mxc_v2.yaml
```yaml
# SPDX-License-Identifier: (GPL-2.0-only OR BSD-2-Clause)
%YAML 1.2
---
$id: http://devicetree.org/schemas/rtc/rtc-mxc_v2.yaml#
$schema: http://devicetree.org/meta-schemas/core.yaml#

title: i.MX53 Secure Real Time Clock (SRTC)

allOf:
  - $ref: rtc.yaml#

maintainers:
  - Patrick Bruenn <p.bruenn@beckhoff.com>

properties:
  compatible:
    enum:
      - fsl,imx53-rtc

  reg:
    maxItems: 1

  clocks:
    maxItems: 1

  interrupts:
    maxItems: 1

required:
  - compatible
  - reg
  - clocks
  - interrupts

additionalProperties: false

examples:
  - |
    #include <dt-bindings/clock/imx5-clock.h>

    rtc@53fa4000 {
        compatible = "fsl,imx53-rtc";
        reg = <0x53fa4000 0x4000>;
        interrupts = <24>;
        clocks = <&clks IMX5_CLK_SRTC_GATE>;
    };
```

## Documentation/devicetree/bindings/rtc/rtc-omap.txt
```
TI Real Time Clock

Required properties:
- compatible:
	- "ti,da830-rtc"  - for RTC IP used similar to that on DA8xx SoC family.
	- "ti,am3352-rtc" - for RTC IP used similar to that on AM335x SoC family.
			    This RTC IP has special WAKE-EN Register to enable
			    Wakeup generation for event Alarm. It can also be
			    used to control an external PMIC via the
			    pmic_power_en pin.
	- "ti,am4372-rtc" - for RTC IP used similar to that on AM437X SoC family.
- reg: Address range of rtc register set
- interrupts: rtc timer, alarm interrupts in order
- interrupt-parent: phandle for the interrupt controller

Optional properties:
- system-power-controller: whether the rtc is controlling the system power
  through pmic_power_en
- clocks: Any internal or external clocks feeding in to rtc
- clock-names: Corresponding names of the clocks
- pinctrl-0: a phandle pointing to the pin settings for the device
- pinctrl-names: should be "default"

Optional subnodes:
- generic pinctrl node

Required pinctrl subnodes properties:
- pins - Names of ext_wakeup pins to configure

Optional pinctrl subnodes properties:
- input-enable - Enables ext_wakeup
- ti,active-high - Set input active high (by default active low)

Example:

rtc@1c23000 {
	compatible = "ti,da830-rtc";
	reg = <0x23000 0x1000>;
	interrupts = <19
		      19>;
	interrupt-parent = <&intc>;
	system-power-controller;
	clocks = <&clk_32k_rtc>, <&clk_32768_ck>;
	clock-names = "ext-clk", "int-clk";

	pinctrl-0 = <&ext_wakeup>;
	pinctrl-names = "default";

	ext_wakeup: ext-wakeup {
		pins = "ext_wakeup0";
		input-enable;
		ti,active-high;
	};
};
```

## Documentation/devicetree/bindings/rtc/rtc-opal.txt
```
IBM OPAL real-time clock
------------------------

Required properties:
- comapatible: Should be "ibm,opal-rtc"

Optional properties:
- wakeup-source: Decides if the wakeup is supported or not
		 (Legacy property supported: "has-tpo")

Example:
	rtc {
		compatible = "ibm,opal-rtc";
		wakeup-source;
		phandle = <0x10000029>;
		linux,phandle = <0x10000029>;
	};
```

## Documentation/devicetree/bindings/rtc/rtc-palmas.txt
```
Palmas RTC controller bindings

Required properties:
- compatible:
  - "ti,palmas-rtc" for palma series of the RTC controller
- interrupt-parent: Parent interrupt device, must be handle of palmas node.
- interrupts: Interrupt number of RTC submodule on device.

Optional properties:

- ti,backup-battery-chargeable: The Palmas series device like TPS65913 or
	TPS80036 supports the backup battery for powering the RTC when main
	battery is removed or in very low power state. The backup battery
	can be chargeable or non-chargeable. This flag will tells whether
	battery is chargeable or not. If charging battery then driver can
	enable the charging.
- ti,backup-battery-charge-high-current: Enable high current charging in
	backup battery. Device supports the < 100uA and > 100uA charging.
	The high current will be > 100uA. Absence of this property will
	charge battery to lower current i.e. < 100uA.

Example:
	palmas: tps65913@58 {
		...
		palmas_rtc: rtc {
			compatible = "ti,palmas-rtc";
			interrupt-parent = <&palmas>;
			interrupts = <8 0>;
			ti,backup-battery-chargeable;
			ti,backup-battery-charge-high-current;
		};
		...
	};
```

## Documentation/devicetree/bindings/rtc/rtc-rk-timer.txt
```
Rockchip rk timer RTC

Required properties:
- compatible: should be:
  "rockchip,rk3308-timer-rtc": for Rockchip RK3308
- reg: base address of the timer register and length of memory mapped region.
- interrupts: should contain the interrupts for the timer
- clocks : must contain an entry for each entry in clock-names
- clock-names : must include the following entries:
  "timer", "pclk"

Example:
	rk_timer_rtc: rk-timer-rtc@ff1a0020 {
		compatible = "rockchip,rk3308-timer-rtc";
		reg = <0x0 0xff1a0020 0x0 0x20>;
		interrupts = <GIC_SPI 26 IRQ_TYPE_LEVEL_HIGH>;
		clocks = <&cru PCLK_TIMER>, <&cru SCLK_TIMER1>;
		clock-names = "pclk", "timer";
	};
```

## Documentation/devicetree/bindings/rtc/rtc-sh.txt
```
* Real Time Clock for Renesas SH and ARM SoCs

Required properties:
- compatible: Should be "renesas,r7s72100-rtc" and "renesas,sh-rtc" as a
  fallback.
- reg: physical base address and length of memory mapped region.
- interrupts: 3 interrupts for alarm, period, and carry.
- interrupt-names: The interrupts should be labeled as "alarm", "period", and
  "carry".
- clocks: The functional clock source for the RTC controller must be listed
  first (if exists). Additionally, potential clock counting sources are to be
  listed.
- clock-names: The functional clock must be labeled as "fck". Other clocks
  may be named in accordance to the SoC hardware manuals.


Example:
rtc: rtc@fcff1000 {
	compatible = "renesas,r7s72100-rtc", "renesas,sh-rtc";
	reg = <0xfcff1000 0x2e>;
	interrupts = <GIC_SPI 276 IRQ_TYPE_EDGE_RISING
		      GIC_SPI 277 IRQ_TYPE_EDGE_RISING
		      GIC_SPI 278 IRQ_TYPE_EDGE_RISING>;
	interrupt-names = "alarm", "period", "carry";
	clocks = <&mstp6_clks R7S72100_CLK_RTC>, <&rtc_x1_clk>,
		 <&rtc_x3_clk>, <&extal_clk>;
	clock-names = "fck", "rtc_x1", "rtc_x3", "extal";
};
```

## Documentation/devicetree/bindings/rtc/rtc-st-lpc.txt
```
STMicroelectronics Low Power Controller (LPC) - RTC
===================================================

LPC currently supports Watchdog OR Real Time Clock functionality.

[See: ../watchdog/st_lpc_wdt.txt for Watchdog options]

Required properties

- compatible 	: Must be one of: "st,stih407-lpc" "st,stih416-lpc"
				  "st,stih415-lpc" "st,stid127-lpc"
- reg		: LPC registers base address + size
- interrupts    : LPC interrupt line number and associated flags
- clocks	: Clock used by LPC device (See: ../clock/clock-bindings.txt)
- st,lpc-mode	: The LPC can run either one of two modes ST_LPC_MODE_RTC [0] or
		  ST_LPC_MODE_WDT [1].  One (and only one) mode must be
		  selected.

Example:
	lpc@fde05000 {
		compatible	= "st,stih407-lpc";
		reg		= <0xfde05000 0x1000>;
		clocks 		= <&clk_s_d3_flexgen CLK_LPC_0>;
		st,lpc-mode	= <ST_LPC_MODE_RTC>;
	};
```

## Documentation/devicetree/bindings/rtc/rtc.yaml
```yaml
# SPDX-License-Identifier: GPL-2.0
%YAML 1.2
---
$id: http://devicetree.org/schemas/rtc/rtc.yaml#
$schema: http://devicetree.org/meta-schemas/core.yaml#

title: RTC Generic Binding

maintainers:
  - Alexandre Belloni <alexandre.belloni@bootlin.com>

description: |
  This document describes generic bindings which can be used to
  describe Real Time Clock devices in a device tree.

properties:
  $nodename:
    pattern: "^rtc(@.*|-[0-9a-f])*$"

  aux-voltage-chargeable:
    $ref: /schemas/types.yaml#/definitions/uint32
    enum: [0, 1]
    description: |
      Tells whether the battery/supercap of the RTC (if any) is
      chargeable or not:
      0: not chargeable
      1: chargeable

  quartz-load-femtofarads:
    $ref: /schemas/types.yaml#/definitions/uint32
    description:
      The capacitive load of the quartz(x-tal), expressed in femto
      Farad (fF). The default value shall be listed (if optional),
      and likewise all valid values.

  start-year:
    $ref: /schemas/types.yaml#/definitions/uint32
    description:
      If provided, the default hardware range supported by the RTC is
      shifted so the first usable year is the specified one.

  trickle-diode-disable:
    $ref: /schemas/types.yaml#/definitions/flag
    description:
      Do not use internal trickle charger diode. Should be given if
      internal trickle charger diode should be disabled.
    deprecated: true

  trickle-resistor-ohms:
    $ref: /schemas/types.yaml#/definitions/uint32
    description:
      Selected resistor for trickle charger. Should be given
      if trickle charger should be enabled.

  trickle-voltage-millivolt:
    description:
      Selected voltage for trickle charger. Should be given
      if trickle charger should be enabled and the trickle voltage is different
      from the RTC main power supply.

  wakeup-source:
    $ref: /schemas/types.yaml#/definitions/flag
    description:
      Enables wake up of host system on alarm.

  reset-source:
    $ref: /schemas/types.yaml#/definitions/flag
    description:
      The RTC is able to reset the machine.

additionalProperties: true

...
```
