## Documentation/devicetree/bindings/rtc/nuvoton,ma35d1-rtc.yaml
```yaml
# SPDX-License-Identifier: (GPL-2.0-only OR BSD-2-Clause)
%YAML 1.2
---
$id: http://devicetree.org/schemas/rtc/nuvoton,ma35d1-rtc.yaml#
$schema: http://devicetree.org/meta-schemas/core.yaml#

title: Nuvoton MA35D1 Real Time Clock

maintainers:
  - Min-Jen Chen <mjchen@nuvoton.com>

allOf:
  - $ref: rtc.yaml#

properties:
  compatible:
    enum:
      - nuvoton,ma35d1-rtc

  reg:
    maxItems: 1

  interrupts:
    maxItems: 1

  clocks:
    maxItems: 1

required:
  - compatible
  - reg
  - interrupts
  - clocks

unevaluatedProperties: false

examples:
  - |
    #include <dt-bindings/interrupt-controller/arm-gic.h>
    #include <dt-bindings/clock/nuvoton,ma35d1-clk.h>
    rtc@40410000 {
        compatible = "nuvoton,ma35d1-rtc";
        reg = <0x40410000 0x200>;
        interrupts = <GIC_SPI 5 IRQ_TYPE_EDGE_RISING>;
        clocks = <&clk RTC_GATE>;
    };

...
```

## Documentation/devicetree/bindings/rtc/nuvoton,nct3018y.yaml
```yaml
# SPDX-License-Identifier: GPL-2.0-only OR BSD-2-Clause
%YAML 1.2
---
$id: http://devicetree.org/schemas/rtc/nuvoton,nct3018y.yaml#
$schema: http://devicetree.org/meta-schemas/core.yaml#

title: NUVOTON NCT3018Y Real Time Clock

allOf:
  - $ref: "rtc.yaml#"

maintainers:
  - Medad CChien <ctcchien@nuvoton.com>
  - Mia Lin <mimi05633@gmail.com>

properties:
  compatible:
    const: nuvoton,nct3018y

  reg:
    maxItems: 1

  start-year: true

  reset-source: true

required:
  - compatible
  - reg

additionalProperties: false

examples:
  - |
    i2c {
        #address-cells = <1>;
        #size-cells = <0>;

        rtc@6f {
            compatible = "nuvoton,nct3018y";
            reg = <0x6f>;
        };
    };

...
```

## Documentation/devicetree/bindings/rtc/nvidia,tegra20-rtc.txt
```
NVIDIA Tegra20 real-time clock

The Tegra RTC maintains seconds and milliseconds counters, and five alarm
registers. The alarms and other interrupts may wake the system from low-power
state.

Required properties:

- compatible : For Tegra20, must contain "nvidia,tegra20-rtc".  Otherwise,
  must contain '"nvidia,<chip>-rtc", "nvidia,tegra20-rtc"', where <chip>
  can be tegra30, tegra114, tegra124, or tegra132.
- reg : Specifies base physical address and size of the registers.
- interrupts : A single interrupt specifier.
- clocks : Must contain one entry, for the module clock.
  See ../clocks/clock-bindings.txt for details.

Example:

timer {
	compatible = "nvidia,tegra20-rtc";
	reg = <0x7000e000 0x100>;
	interrupts = <0 2 0x04>;
	clocks = <&tegra_car 4>;
};
```

## Documentation/devicetree/bindings/rtc/nvidia,tegra20-rtc.yaml
```yaml
# SPDX-License-Identifier: (GPL-2.0-only OR BSD-2-Clause)
%YAML 1.2
---
$id: http://devicetree.org/schemas/rtc/nvidia,tegra20-rtc.yaml#
$schema: http://devicetree.org/meta-schemas/core.yaml#

title: NVIDIA Tegra real-time clock

maintainers:
  - Thierry Reding <thierry.reding@gmail.com>
  - Jon Hunter <jonathanh@nvidia.com>

description: |
  The Tegra RTC maintains seconds and milliseconds counters, and five
  alarm registers. The alarms and other interrupts may wake the system
  from low-power state.

properties:
  compatible:
    oneOf:
      - const: nvidia,tegra20-rtc
      - items:
          - enum:
              - nvidia,tegra30-rtc
              - nvidia,tegra114-rtc
              - nvidia,tegra124-rtc
              - nvidia,tegra210-rtc
              - nvidia,tegra186-rtc
              - nvidia,tegra194-rtc
              - nvidia,tegra234-rtc
              - nvidia,tegra264-rtc
          - const: nvidia,tegra20-rtc

  reg:
    maxItems: 1

  interrupts:
    maxItems: 1

  clocks:
    maxItems: 1

  clock-names:
    items:
      - const: rtc

additionalProperties: false

required:
  - compatible
  - reg
  - interrupts
  - clocks

examples:
  - |
    timer@7000e000 {
        compatible = "nvidia,tegra20-rtc";
        reg = <0x7000e000 0x100>;
        interrupts = <0 2 0x04>;
        clocks = <&tegra_car 4>;
    };
```

## Documentation/devicetree/bindings/rtc/nvidia,vrs-10.yaml
```yaml
# SPDX-License-Identifier: (GPL-2.0-only OR BSD-2-Clause)
%YAML 1.2
---
$id: http://devicetree.org/schemas/rtc/nvidia,vrs-10.yaml#
$schema: http://devicetree.org/meta-schemas/core.yaml#

title: NVIDIA Voltage Regulator Specification Real Time Clock

maintainers:
  - Shubhi Garg <shgarg@nvidia.com>

description:
  NVIDIA VRS-10 (Voltage Regulator Specification) is a Power Management IC
  (PMIC) that implements a power sequencing solution with I2C interface.
  The device includes a real-time clock (RTC) with 32kHz clock output and
  backup battery support, alarm functionality for system wake-up from
  suspend and shutdown states, OTP memory for power sequencing configuration,
  and an interrupt controller for managing VRS events.

properties:
  compatible:
    const: nvidia,vrs-10

  reg:
    maxItems: 1

  interrupts:
    maxItems: 1

  interrupt-controller: true

  '#interrupt-cells':
    const: 2

required:
  - compatible
  - reg
  - interrupts
  - interrupt-controller
  - '#interrupt-cells'

additionalProperties: false

examples:
  - |
    #include <dt-bindings/interrupt-controller/irq.h>
    i2c {
        #address-cells = <1>;
        #size-cells = <0>;

        pmic@3c {
            compatible = "nvidia,vrs-10";
            reg = <0x3c>;
            interrupt-parent = <&pmc>;
            interrupts = <24 IRQ_TYPE_LEVEL_LOW>;
            interrupt-controller;
            #interrupt-cells = <2>;
        };
    };
```

## Documentation/devicetree/bindings/rtc/nxp,lpc1788-rtc.txt
```
NXP LPC1788 real-time clock

The LPC1788 RTC provides calendar and clock functionality
together with periodic tick and alarm interrupt support.

Required properties:
- compatible	: must contain "nxp,lpc1788-rtc"
- reg		: Specifies base physical address and size of the registers.
- interrupts	: A single interrupt specifier.
- clocks	: Must contain clock specifiers for rtc and register clock
- clock-names	: Must contain "rtc" and "reg"
  See ../clocks/clock-bindings.txt for details.

Example:
rtc: rtc@40046000 {
	compatible = "nxp,lpc1788-rtc";
	reg = <0x40046000 0x1000>;
	interrupts = <47>;
	clocks = <&creg_clk 0>, <&ccu1 CLK_CPU_BUS>;
	clock-names = "rtc", "reg";
};
```

## Documentation/devicetree/bindings/rtc/nxp,lpc1788-rtc.yaml
```yaml
# SPDX-License-Identifier: (GPL-2.0 OR BSD-2-Clause)
%YAML 1.2
---
$id: http://devicetree.org/schemas/rtc/nxp,lpc1788-rtc.yaml#
$schema: http://devicetree.org/meta-schemas/core.yaml#

title: NXP LPC1788 real-time clock

description:
  The LPC1788 RTC provides calendar and clock functionality
  together with periodic tick and alarm interrupt support.

maintainers:
  - Javier Carrasco <javier.carrasco.cruz@gmail.com>

allOf:
  - $ref: rtc.yaml#

properties:
  compatible:
    const: nxp,lpc1788-rtc

  reg:
    maxItems: 1

  clocks:
    items:
      - description: RTC clock
      - description: Register clock

  clock-names:
    items:
      - const: rtc
      - const: reg

  interrupts:
    maxItems: 1

required:
  - compatible
  - reg
  - clocks
  - clock-names
  - interrupts

unevaluatedProperties: false

examples:
  - |
    #include <dt-bindings/clock/lpc18xx-ccu.h>

    rtc@40046000 {
        compatible = "nxp,lpc1788-rtc";
        reg = <0x40046000 0x1000>;
        clocks = <&creg_clk 0>, <&ccu1 CLK_CPU_BUS>;
        clock-names = "rtc", "reg";
        interrupts = <47>;
    };
```

## Documentation/devicetree/bindings/rtc/nxp,lpc3220-rtc.yaml
```yaml
# SPDX-License-Identifier: (GPL-2.0-only OR BSD-2-Clause)
%YAML 1.2
---
$id: http://devicetree.org/schemas/rtc/nxp,lpc3220-rtc.yaml#
$schema: http://devicetree.org/meta-schemas/core.yaml#

title: NXP LPC32xx SoC Real-time Clock

maintainers:
  - Frank Li <Frank.Li@nxp.com>

properties:
  compatible:
    enum:
      - nxp,lpc3220-rtc

  reg:
    maxItems: 1

  clocks:
    maxItems: 1

  interrupts:
    maxItems: 1

  start-year: true

required:
  - compatible
  - reg

allOf:
  - $ref: rtc.yaml#

unevaluatedProperties: false

examples:
  - |
    #include <dt-bindings/interrupt-controller/irq.h>
    #include <dt-bindings/clock/lpc32xx-clock.h>

    rtc@40024000 {
        compatible = "nxp,lpc3220-rtc";
        reg = <0x40024000 0x1000>;
        interrupt-parent = <&sic1>;
        interrupts = <20 IRQ_TYPE_LEVEL_HIGH>;
        clocks = <&clk LPC32XX_CLK_RTC>;
    };
```

## Documentation/devicetree/bindings/rtc/nxp,pcf2123.yaml
```yaml
# SPDX-License-Identifier: (GPL-2.0-only OR BSD-2-Clause)
%YAML 1.2
---
$id: http://devicetree.org/schemas/rtc/nxp,pcf2123.yaml#
$schema: http://devicetree.org/meta-schemas/core.yaml#

title: NXP PCF2123 SPI Real Time Clock

maintainers:
  - Javier Carrasco <javier.carrasco.cruz@gmail.com>

allOf:
  - $ref: /schemas/spi/spi-peripheral-props.yaml#
  - $ref: rtc.yaml#

properties:
  compatible:
    enum:
      - nxp,pcf2123

  reg:
    maxItems: 1

  interrupts:
    maxItems: 1

required:
  - compatible
  - reg

unevaluatedProperties: false

examples:
  - |
    #include <dt-bindings/interrupt-controller/arm-gic.h>
    spi {
        #address-cells = <1>;
        #size-cells = <0>;

        rtc@3 {
            compatible = "nxp,pcf2123";
            reg = <3>;
            interrupts = <GIC_SPI 130 IRQ_TYPE_LEVEL_LOW>;
            spi-cs-high;
        };
    };
...
```

## Documentation/devicetree/bindings/rtc/nxp,pcf2127.yaml
```yaml
# SPDX-License-Identifier: GPL-2.0-only OR BSD-2-Clause
%YAML 1.2
---
$id: http://devicetree.org/schemas/rtc/nxp,pcf2127.yaml#
$schema: http://devicetree.org/meta-schemas/core.yaml#

title: NXP PCF2127 Real Time Clock

allOf:
  - $ref: "rtc.yaml#"

maintainers:
  - Alexandre Belloni <alexandre.belloni@bootlin.com>

properties:
  compatible:
    enum:
      - nxp,pca2129
      - nxp,pcf2127
      - nxp,pcf2129

  reg:
    maxItems: 1

  interrupts:
    maxItems: 1

  start-year: true

  reset-source: true

required:
  - compatible
  - reg

additionalProperties: false

examples:
  - |
    #include <dt-bindings/interrupt-controller/irq.h>
    i2c {
        #address-cells = <1>;
        #size-cells = <0>;

        rtc@51 {
            compatible = "nxp,pcf2127";
            reg = <0x51>;
            pinctrl-0 = <&rtc_nint_pins>;
            interrupts-extended = <&gpio1 16 IRQ_TYPE_LEVEL_HIGH>;
            reset-source;
        };
    };

...
```

## Documentation/devicetree/bindings/rtc/nxp,pcf85063.txt
```
* NXP PCF85063 Real Time Clock

Required properties:
- compatible: Should one of contain:
	"nxp,pca85073a",
	"nxp,pcf85063",
	"nxp,pcf85063a",
	"nxp,pcf85063tp",
	"microcrystal,rv8263"
- reg: I2C address for chip.

Optional property:
- quartz-load-femtofarads: The capacitive load of the quartz(x-tal),
  expressed in femto Farad (fF). Valid values are 7000 and 12500.
  Default value (if no value is specified) is 7000fF.

Optional child node:
- clock: Provide this if the square wave pin is used as boot-enabled fixed clock.

Example:

pcf85063: rtc@51 {
	compatible = "nxp,pcf85063";
	reg = <0x51>;
	quartz-load-femtofarads = <12500>;

		clock {
			compatible = "fixed-clock";
			#clock-cells = <0>;
			clock-frequency = <32768>;
		};
};
```

## Documentation/devicetree/bindings/rtc/nxp,pcf85063.yaml
```yaml
# SPDX-License-Identifier: (GPL-2.0-only OR BSD-2-Clause)
%YAML 1.2
---
$id: http://devicetree.org/schemas/rtc/nxp,pcf85063.yaml#
$schema: http://devicetree.org/meta-schemas/core.yaml#

title: NXP PCF85063 Real Time Clock

maintainers:
  - Alexander Stein <alexander.stein@ew.tq-group.com>

properties:
  compatible:
    enum:
      - microcrystal,rv8063
      - microcrystal,rv8263
      - nxp,pcf85063
      - nxp,pcf85063a
      - nxp,pcf85063tp
      - nxp,pca85073a

  reg:
    maxItems: 1

  "#clock-cells":
    const: 0

  clock-output-names:
    maxItems: 1

  interrupts:
    maxItems: 1

  quartz-load-femtofarads:
    description:
      The capacitive load of the quartz(x-tal).
    enum: [7000, 12500]
    default: 7000

  clock:
    $ref: /schemas/clock/fixed-clock.yaml
    description:
      Provide this if the square wave pin is used as boot-enabled
      fixed clock.

  wakeup-source: true

  spi-cs-high: true

  spi-3wire: true

allOf:
  - $ref: /schemas/spi/spi-peripheral-props.yaml#
  - $ref: rtc.yaml#
  - if:
      properties:
        compatible:
          contains:
            enum:
              - microcrystal,rv8063
              - microcrystal,rv8263
    then:
      properties:
        quartz-load-femtofarads: false
  - if:
      properties:
        compatible:
          not:
            contains:
              enum:
                - microcrystal,rv8063
    then:
      properties:
        spi-cs-high: false
        spi-3wire: false

required:
  - compatible
  - reg

unevaluatedProperties: false

examples:
  - |
    i2c {
        #address-cells = <1>;
        #size-cells = <0>;

        rtc@51 {
          compatible = "nxp,pcf85063a";
          reg = <0x51>;
          quartz-load-femtofarads = <12500>;

          clock {
            compatible = "fixed-clock";
            #clock-cells = <0>;
            clock-frequency = <32768>;
          };
        };
      };

  - |
    spi {
        #address-cells = <1>;
        #size-cells = <0>;

        rtc@0 {
            compatible = "microcrystal,rv8063";
            reg = <0>;
            spi-cs-high;
            spi-3wire;
        };
    };
```

## Documentation/devicetree/bindings/rtc/nxp,pcf8523.txt
```
* NXP PCF8523 Real Time Clock

Required properties:
- compatible: Should contain "nxp,pcf8523".
- reg: I2C address for chip.

Optional property:
- quartz-load-femtofarads: The capacitive load of the quartz(x-tal),
  expressed in femto Farad (fF). Valid values are 7000 and 12500.
  Default value (if no value is specified) is 12500fF.

Example:

pcf8523: rtc@68 {
	compatible = "nxp,pcf8523";
	reg = <0x68>;
	quartz-load-femtofarads = <7000>;
};
```

## Documentation/devicetree/bindings/rtc/nxp,pcf8523.yaml
```yaml
# SPDX-License-Identifier: (GPL-2.0-only OR BSD-2-Clause)
%YAML 1.2
---
$id: http://devicetree.org/schemas/rtc/nxp,pcf8523.yaml#
$schema: http://devicetree.org/meta-schemas/core.yaml#

title: NXP PCF8523 Real Time Clock

maintainers:
  - Sam Ravnborg <sam@ravnborg.org>

allOf:
  - $ref: rtc.yaml#

properties:
  compatible:
    const: nxp,pcf8523

  reg:
    maxItems: 1

  quartz-load-femtofarads:
    description:
      The capacitive load of the crystal, expressed in femto Farad (fF).
    enum: [ 7000, 12500 ]
    default: 12500

required:
  - compatible
  - reg

unevaluatedProperties: false

examples:
  - |
    i2c {
        #address-cells = <1>;
        #size-cells = <0>;

        rtc@68 {
            compatible = "nxp,pcf8523";
            reg = <0x68>;
            quartz-load-femtofarads = <7000>;
        };
    };
```

## Documentation/devicetree/bindings/rtc/nxp,pcf85363.yaml
```yaml
# SPDX-License-Identifier: (GPL-2.0-only OR BSD-2-Clause)
%YAML 1.2
---
$id: http://devicetree.org/schemas/rtc/nxp,pcf85363.yaml#
$schema: http://devicetree.org/meta-schemas/core.yaml#

title: Philips PCF85263/PCF85363 Real Time Clock

maintainers:
  - Alexandre Belloni <alexandre.belloni@bootlin.com>

allOf:
  - $ref: rtc.yaml#

properties:
  compatible:
    enum:
      - nxp,pcf85263
      - nxp,pcf85363

  reg:
    maxItems: 1

  "#clock-cells":
    const: 0

  clock-output-names:
    maxItems: 1

  interrupts:
    maxItems: 1

  quartz-load-femtofarads:
    description:
      The capacitive load of the quartz(x-tal).
    enum: [6000, 7000, 12500]
    default: 7000

  start-year: true
  wakeup-source: true

required:
  - compatible
  - reg

additionalProperties: false

examples:
  - |
    i2c {
        #address-cells = <1>;
        #size-cells = <0>;

        rtc@51 {
            compatible = "nxp,pcf85363";
            reg = <0x51>;
            #clock-cells = <0>;
            quartz-load-femtofarads = <12500>;
        };
    };
```
