## Documentation/devicetree/bindings/rtc/nxp,pcf8563.yaml
```yaml
# SPDX-License-Identifier: GPL-2.0
%YAML 1.2
---
$id: http://devicetree.org/schemas/rtc/nxp,pcf8563.yaml#
$schema: http://devicetree.org/meta-schemas/core.yaml#

title: Philips PCF8563/Epson RTC8564 Real Time Clock

maintainers:
  - Alexandre Belloni <alexandre.belloni@bootlin.com>

allOf:
  - $ref: rtc.yaml#

properties:
  compatible:
    enum:
      - epson,rtc8564
      - microcrystal,rv8564
      - nxp,pca8565
      - nxp,pcf8563
      - nxp,pcf85263
      - nxp,pcf85363

  reg:
    maxItems: 1

  "#clock-cells":
    const: 0

  clock-output-names:
    maxItems: 1

  interrupts:
    maxItems: 1

  start-year: true
  wakeup-source: true

required:
  - compatible
  - reg

additionalProperties: false

examples:
  - |
    i2c {
        #address-cells = <1>;
        #size-cells = <0>;

        rtc@51 {
            compatible = "nxp,pcf8563";
            reg = <0x51>;
            #clock-cells = <0>;
        };
    };
...
```

## Documentation/devicetree/bindings/rtc/nxp,rtc-2123.txt
```
NXP PCF2123 SPI Real Time Clock

Required properties:
- compatible: should be: "nxp,rtc-pcf2123"
- reg: should be the SPI slave chipselect address

Optional properties:
- spi-cs-high: PCF2123 needs chipselect high

Example:

rtc: nxp,rtc-pcf2123@3 {
	compatible = "nxp,rtc-pcf2123"
	reg = <3>
	spi-cs-high;
};
```

## Documentation/devicetree/bindings/rtc/nxp,s32g-rtc.yaml
```yaml
# SPDX-License-Identifier: (GPL-2.0 OR BSD-2-Clause)
%YAML 1.2
---
$id: http://devicetree.org/schemas/rtc/nxp,s32g-rtc.yaml#
$schema: http://devicetree.org/meta-schemas/core.yaml#

title: NXP S32G2/S32G3 Real Time Clock (RTC)

maintainers:
  - Bogdan Hamciuc <bogdan.hamciuc@nxp.com>
  - Ciprian Marian Costea <ciprianmarian.costea@nxp.com>

description:
  RTC hardware module present on S32G2/S32G3 SoCs is used as a wakeup source.
  It is not kept alive during system reset and it is not battery-powered.

allOf:
  - $ref: rtc.yaml#

properties:
  compatible:
    oneOf:
      - enum:
          - nxp,s32g2-rtc
      - items:
          - const: nxp,s32g3-rtc
          - const: nxp,s32g2-rtc

  reg:
    maxItems: 1

  interrupts:
    maxItems: 1

  clocks:
    items:
      - description: ipg clock drives the access to the RTC iomapped registers
      - description: Clock source for the RTC module. Can be selected between
          4 different clock sources using an integrated hardware mux.
          On S32G2/S32G3 SoCs, 'source0' is the SIRC clock (~32KHz) and it is
          available during standby and runtime. 'source1' is reserved and cannot
          be used. 'source2' is the FIRC clock and it is only available during
          runtime providing a better resolution (~48MHz). 'source3' is an external
          RTC clock source which can be additionally added in hardware.

  clock-names:
    items:
      - const: ipg
      - enum: [ source0, source1, source2, source3 ]

required:
  - compatible
  - reg
  - interrupts
  - clocks
  - clock-names

additionalProperties: false

examples:
  - |
    #include <dt-bindings/interrupt-controller/arm-gic.h>
    #include <dt-bindings/interrupt-controller/irq.h>

    rtc@40060000 {
        compatible = "nxp,s32g3-rtc",
                     "nxp,s32g2-rtc";
        reg = <0x40060000 0x1000>;
        interrupts = <GIC_SPI 121 IRQ_TYPE_LEVEL_HIGH>;
        clocks = <&clks 54>, <&clks 55>;
        clock-names = "ipg", "source0";
    };
```

## Documentation/devicetree/bindings/rtc/olpc-xo1-rtc.txt
```
OLPC XO-1 RTC
~~~~~~~~~~~~~

Required properties:
 - compatible : "olpc,xo1-rtc"
```

## Documentation/devicetree/bindings/rtc/orion-rtc.txt
```
* Mvebu Real Time Clock

RTC controller for the Kirkwood, the Dove, the Armada 370 and the
Armada XP SoCs

Required properties:
- compatible : Should be "marvell,orion-rtc"
- reg: physical base address of the controller and length of memory mapped
  region.
- interrupts: IRQ line for the RTC.

Example:

rtc@10300 {
        compatible = "marvell,orion-rtc";
        reg = <0xd0010300 0x20>;
        interrupts = <50>;
};
```

## Documentation/devicetree/bindings/rtc/pcf85363.txt
```
NXP PCF85263/PCF85363 Real Time Clock
============================

Required properties:
- compatible: Should contain "nxp,pcf85263" or "nxp,pcf85363".
- reg: I2C address for chip.

Optional properties:
- interrupts: IRQ line for the RTC (not implemented).

Example:

pcf85363: pcf85363@51 {
	compatible = "nxp,pcf85363";
	reg = <0x51>;
};
```

## Documentation/devicetree/bindings/rtc/pcf8563.txt
```
* Philips PCF8563/Epson RTC8564 Real Time Clock

Philips PCF8563/Epson RTC8564 Real Time Clock

Required properties:
- compatible: Should contain "nxp,pcf8563".
- reg: I2C address for chip.

Optional property:
- #clock-cells: Should be 0.
- clock-output-names:
  overwrite the default clock name "pcf8563-clkout"

Example:

pcf8563: pcf8563@51 {
	compatible = "nxp,pcf8563";
	reg = <0x51>;
	#clock-cells = <0>;
};

device {
...
	clocks = <&pcf8563>;
...
};
```

## Documentation/devicetree/bindings/rtc/pxa-rtc.txt
```
* PXA RTC

PXA specific RTC driver.

Required properties:
- compatible : Should be "marvell,pxa-rtc"

Examples:

rtc@40900000 {
	compatible = "marvell,pxa-rtc";
	reg = <0x40900000 0x3c>;
	interrupts = <30 31>;
};
```

## Documentation/devicetree/bindings/rtc/qcom-pm8xxx-rtc.yaml
```yaml
# SPDX-License-Identifier: (GPL-2.0 OR BSD-2-Clause)
%YAML 1.2
---
$id: http://devicetree.org/schemas/rtc/qcom-pm8xxx-rtc.yaml#
$schema: http://devicetree.org/meta-schemas/core.yaml#

title: Qualcomm PM8xxx PMIC RTC device

maintainers:
  - Satya Priya <quic_c_skakit@quicinc.com>

properties:
  compatible:
    oneOf:
      - enum:
          - qcom,pm8058-rtc
          - qcom,pm8921-rtc
          - qcom,pm8941-rtc
          - qcom,pmk8350-rtc
      - items:
          - enum:
              - qcom,pm8018-rtc
          - const: qcom,pm8921-rtc

  reg:
    minItems: 1
    maxItems: 2

  reg-names:
    minItems: 1
    items:
      - const: rtc
      - const: alarm

  interrupts:
    maxItems: 1

  allow-set-time:
    $ref: /schemas/types.yaml#/definitions/flag
    description:
      Indicates that the setting of RTC time is allowed by the host CPU.

  nvmem-cells:
    items:
      - description:
          four-byte nvmem cell holding a little-endian offset from the Unix
          epoch representing the time when the RTC timer was last reset

  nvmem-cell-names:
    items:
      - const: offset

  qcom,no-alarm:
    type: boolean
    description:
      RTC alarm is not owned by the OS

  qcom,uefi-rtc-info:
    type: boolean
    description:
      RTC offset is stored as a four-byte GPS time offset in a 12-byte UEFI
      variable 882f8c2b-9646-435f-8de5-f208ff80c1bd-RTCInfo

  wakeup-source: true

required:
  - compatible
  - reg
  - interrupts

additionalProperties: false

examples:
  - |
    #include <dt-bindings/interrupt-controller/irq.h>
    #include <dt-bindings/spmi/spmi.h>

    spmi {
        #address-cells = <2>;
        #size-cells = <0>;

        pmic@0 {
            compatible = "qcom,pm8941", "qcom,spmi-pmic";
            reg = <0x0 SPMI_USID>;
            #address-cells = <1>;
            #size-cells = <0>;

            rtc@6000 {
                compatible = "qcom,pm8941-rtc";
                reg = <0x6000>, <0x6100>;
                reg-names = "rtc", "alarm";
                interrupts = <0x0 0x61 0x1 IRQ_TYPE_EDGE_RISING>;
                nvmem-cells = <&rtc_offset>;
                nvmem-cell-names = "offset";
            };
        };
    };
...
```

## Documentation/devicetree/bindings/rtc/realtek,rtd119x.txt
```
Realtek RTD129x Real-Time Clock
===============================

Required properties:
- compatible :  Should be "realtek,rtd1295-rtc"
- reg        :  Specifies the physical base address and size
- clocks     :  Specifies the clock gate


Example:

	rtc@9801b600 {
		compatible = "realtek,rtd1295-clk";
		reg = <0x9801b600 0x100>;
		clocks = <&clkc RTD1295_CLK_EN_MISC_RTC>;
	};
```
