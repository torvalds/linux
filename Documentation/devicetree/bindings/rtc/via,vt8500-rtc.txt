## Documentation/devicetree/bindings/scsi/hisilicon-sas.txt
```
* HiSilicon SAS controller

The HiSilicon SAS controller supports SAS/SATA.

Main node required properties:
  - compatible : value should be as follows:
	(a) "hisilicon,hip05-sas-v1" for v1 hw in hip05 chipset
	(b) "hisilicon,hip06-sas-v2" for v2 hw in hip06 chipset
	(c) "hisilicon,hip07-sas-v2" for v2 hw in hip07 chipset
  - sas-addr : array of 8 bytes for host SAS address
  - reg : Address and length of the SAS register
  - hisilicon,sas-syscon: phandle of syscon used for sas control
  - ctrl-reset-reg : offset to controller reset register in ctrl reg
  - ctrl-reset-sts-reg : offset to controller reset status register in ctrl reg
  - ctrl-clock-ena-reg : offset to controller clock enable register in ctrl reg
  - queue-count : number of delivery and completion queues in the controller
  - phy-count : number of phys accessible by the controller
  - interrupts : For v1 hw: Interrupts for phys, completion queues, and fatal
		sources; the interrupts are ordered in 3 groups, as follows:
			- Phy interrupts
			- Completion queue interrupts
			- Fatal interrupts
		Phy interrupts : Each phy has 3 interrupt sources:
			- broadcast
			- phyup
			- abnormal
		The phy interrupts are ordered into groups of 3 per phy
		(broadcast, phyup, and abnormal) in increasing order.
		Completion queue interrupts : each completion queue has 1
			interrupt source.
			The interrupts are ordered in increasing order.
		Fatal interrupts : the fatal interrupts are ordered as follows:
			- ECC
			- AXI bus
		For v2 hw: Interrupts for phys, Sata, and completion queues;
		the interrupts are ordered in 3 groups, as follows:
			- Phy interrupts
			- Sata interrupts
			- Completion queue interrupts
		Phy interrupts : Each controller has 2 phy interrupts:
			- phy up/down
			- channel interrupt
		Sata interrupts : Each phy on the controller has 1 Sata
			interrupt. The interrupts are ordered in increasing
			order.
		Completion queue interrupts : each completion queue has 1
			interrupt source. The interrupts are ordered in
			increasing order.

Optional main node properties:
 - hip06-sas-v2-quirk-amt : when set, indicates that the v2 controller has the
			    "am-max-transmissions" limitation.

Example:
	sas0: sas@c1000000 {
		compatible = "hisilicon,hip05-sas-v1";
		sas-addr = [50 01 88 20 16 00 00 0a];
		reg = <0x0 0xc1000000 0x0 0x10000>;
		hisilicon,sas-syscon = <&pcie_sas>;
		ctrl-reset-reg = <0xa60>;
		ctrl-reset-sts-reg = <0x5a30>;
		ctrl-clock-ena-reg = <0x338>;
		queue-count = <32>;
		phy-count = <8>;
		dma-coherent;
		interrupt-parent = <&mbigen_dsa>;
		interrupts =    <259 4>,<263 4>,<264 4>,/* phy0 */
				<269 4>,<273 4>,<274 4>,/* phy1 */
				<279 4>,<283 4>,<284 4>,/* phy2 */
				<289 4>,<293 4>,<294 4>,/* phy3 */
				<299 4>,<303 4>,<304 4>,/* phy4 */
				<309 4>,<313 4>,<314 4>,/* phy5 */
				<319 4>,<323 4>,<324 4>,/* phy6 */
				<329 4>,<333 4>,<334 4>,/* phy7 */
				<336 1>,<337 1>,<338 1>,/* cq0-2 */
				<339 1>,<340 1>,<341 1>,/* cq3-5 */
				<342 1>,<343 1>,<344 1>,/* cq6-8 */
				<345 1>,<346 1>,<347 1>,/* cq9-11 */
				<348 1>,<349 1>,<350 1>,/* cq12-14 */
				<351 1>,<352 1>,<353 1>,/* cq15-17 */
				<354 1>,<355 1>,<356 1>,/* cq18-20 */
				<357 1>,<358 1>,<359 1>,/* cq21-23 */
				<360 1>,<361 1>,<362 1>,/* cq24-26 */
				<363 1>,<364 1>,<365 1>,/* cq27-29 */
				<366 1>,<367 1>/* cq30-31 */
				<376 4>,/* fatal ecc */
				<381 4>;/* fatal axi */
	};
```

## Documentation/devicetree/bindings/security/tpm/google,cr50.txt
```
* H1 Secure Microcontroller with Cr50 Firmware on SPI Bus.

H1 Secure Microcontroller running Cr50 firmware provides several
functions, including TPM-like functionality. It communicates over
SPI using the FIFO protocol described in the PTP Spec, section 6.

Required properties:
- compatible: Should be "google,cr50".
- spi-max-frequency: Maximum SPI frequency.

Example:

&spi0 {
	tpm@0 {
		compatible = "google,cr50";
		reg = <0>;
		spi-max-frequency = <800000>;
	};
};
```

## Documentation/devicetree/bindings/security/tpm/ibmvtpm.txt
```
* Device Tree Bindings for IBM Virtual Trusted Platform Module(vtpm)

Required properties:

- compatible            : property name that conveys the platform architecture
                          identifiers, as 'IBM,vtpm'
- device_type           : specifies type of virtual device
- interrupts            : property specifying the interrupt source number and
                          sense code associated with this virtual I/O Adapters
- ibm,my-drc-index      : integer index for the connector between the device
                          and its parent - present only if Dynamic
                          Reconfiguration(DR) Connector is enabled
- ibm,#dma-address-cells: specifies the number of cells that are used to
                          encode the physical address field of dma-window
                          properties
- ibm,#dma-size-cells   : specifies the number of cells that are used to
                          encode the size field of dma-window properties
- ibm,my-dma-window     : specifies DMA window associated with this virtual
                          IOA
- ibm,loc-code          : specifies the unique and persistent location code
                          associated with this virtual I/O Adapters
- linux,sml-base        : 64-bit base address of the reserved memory allocated
                          for the firmware event log
- linux,sml-size        : size of the memory allocated for the firmware event log

Example (IBM Virtual Trusted Platform Module)
---------------------------------------------

                vtpm@30000003 {
                        ibm,#dma-size-cells = <0x2>;
                        compatible = "IBM,vtpm";
                        device_type = "IBM,vtpm";
                        ibm,my-drc-index = <0x30000003>;
                        ibm,#dma-address-cells = <0x2>;
                        linux,sml-base = <0xc60e 0x0>;
                        interrupts = <0xa0003 0x0>;
                        ibm,my-dma-window = <0x10000003 0x0 0x0 0x0 0x10000000>;
                        ibm,loc-code = "U8286.41A.10082DV-V3-C3";
                        reg = <0x30000003>;
                        linux,sml-size = <0xbce10200>;
                };
```

## Documentation/devicetree/bindings/security/tpm/st33zp24-i2c.txt
```
* STMicroelectronics SAS. ST33ZP24 TPM SoC

Required properties:
- compatible: Should be "st,st33zp24-i2c".
- clock-frequency: I²C work frequency.
- reg: address on the bus

Optional ST33ZP24 Properties:
- interrupts: GPIO interrupt to which the chip is connected
- lpcpd-gpios: Output GPIO pin used for ST33ZP24 power management D1/D2 state.
If set, power must be present when the platform is going into sleep/hibernate mode.

Optional SoC Specific Properties:
- pinctrl-names: Contains only one value - "default".
- pintctrl-0: Specifies the pin control groups used for this controller.

Example (for ARM-based BeagleBoard xM with ST33ZP24 on I2C2):

&i2c2 {


        st33zp24: st33zp24@13 {

                compatible = "st,st33zp24-i2c";

                reg = <0x13>;
                clock-frequency = <400000>;

                interrupt-parent = <&gpio5>;
                interrupts = <7 IRQ_TYPE_LEVEL_HIGH>;

                lpcpd-gpios = <&gpio5 15 GPIO_ACTIVE_HIGH>;
        };
};
```

## Documentation/devicetree/bindings/security/tpm/st33zp24-spi.txt
```
* STMicroelectronics SAS. ST33ZP24 TPM SoC

Required properties:
- compatible: Should be "st,st33zp24-spi".
- spi-max-frequency: Maximum SPI frequency (<= 10000000).

Optional ST33ZP24 Properties:
- interrupt-parent: phandle for the interrupt gpio controller
- interrupts: GPIO interrupt to which the chip is connected
- lpcpd-gpios: Output GPIO pin used for ST33ZP24 power management D1/D2 state.
If set, power must be present when the platform is going into sleep/hibernate mode.

Optional SoC Specific Properties:
- pinctrl-names: Contains only one value - "default".
- pintctrl-0: Specifies the pin control groups used for this controller.

Example (for ARM-based BeagleBoard xM with ST33ZP24 on SPI4):

&mcspi4 {


        st33zp24@0 {

                compatible = "st,st33zp24-spi";

                spi-max-frequency = <10000000>;

                interrupt-parent = <&gpio5>;
                interrupts = <7 IRQ_TYPE_LEVEL_HIGH>;

                lpcpd-gpios = <&gpio5 15 GPIO_ACTIVE_HIGH>;
        };
};
```

## Documentation/devicetree/bindings/security/tpm/tpm-i2c.txt
```
* Device Tree Bindings for I2C based Trusted Platform Module(TPM)

Required properties:

- compatible     : 'manufacturer,model', eg. nuvoton,npct650
- label          : human readable string describing the device, eg. "tpm"
- linux,sml-base : 64-bit base address of the reserved memory allocated for
                   the firmware event log
- linux,sml-size : size of the memory allocated for the firmware event log

Example (for OpenPower Systems with Nuvoton TPM 2.0 on I2C)
----------------------------------------------------------

tpm@57 {
	reg = <0x57>;
	label = "tpm";
	compatible = "nuvoton,npct650", "nuvoton,npct601";
	linux,sml-base = <0x7f 0xfd450000>;
	linux,sml-size = <0x10000>;
	status = "okay";
};
```

## Documentation/devicetree/bindings/security/tpm/tpm-tis-i2c.yaml
```yaml
# SPDX-License-Identifier: (GPL-2.0-only OR BSD-2-Clause)
%YAML 1.2
---
$id: http://devicetree.org/schemas/security/tpm/tpm-tis-i2c.yaml#
$schema: http://devicetree.org/meta-schemas/core.yaml#

title: I2C PTP based TPM Devices

maintainers:
  - Johannes Holland <johannes.holland@infineon.com>

description:
  Device Tree Bindings for I2C based Trusted Platform Module (TPM).

properties:
  $nodename:
    pattern: "^tpm(@[0-9a-f]+)?$"

  compatible:
    oneOf:
      - description: Infineon's Trusted Platform Module (TPM) (SLB9673).
        items:
          - const: infineon,slb9673
          - const: tcg,tpm-tis-i2c
      - description: Nuvoton's Trusted Platform Module (TPM) (NPCT75x).
        items:
          - const: nuvoton,npct75x
          - const: tcg,tpm-tis-i2c
      - const: tcg,tpm-tis-i2c
  reg:
    maxItems: 1

required:
  - compatible
  - reg

additionalProperties: false

examples:
  - |
    i2c {
      #address-cells = <1>;
      #size-cells = <0>;

      tpm@2e {
        compatible = "nuvoton,npct75x", "tcg,tpm-tis-i2c";
        reg = <0x2e>;
      };
    };
...
```

## Documentation/devicetree/bindings/security/tpm/tpm_tis_mmio.txt
```
Trusted Computing Group MMIO Trusted Platform Module

The TCG defines multi vendor standard for accessing a TPM chip, this
is the standard protocol defined to access the TPM via MMIO. Typically
this interface will be implemented over Intel's LPC bus.

Refer to the 'TCG PC Client Specific TPM Interface Specification (TIS)' TCG
publication for the specification.

Required properties:

- compatible: should contain a string below for the chip, followed by
              "tcg,tpm-tis-mmio". Valid chip strings are:
	          * "atmel,at97sc3204"
- reg: The location of the MMIO registers, should be at least 0x5000 bytes
- interrupts: An optional interrupt indicating command completion.

Example:

	tpm_tis@90000 {
				compatible = "atmel,at97sc3204", "tcg,tpm-tis-mmio";
				reg = <0x90000 0x5000>;
				interrupt-parent = <&EIC0>;
				interrupts = <1 2>;
	};
```

## Documentation/devicetree/bindings/security/tpm/tpm_tis_spi.txt
```
Required properties:
- compatible: should be one of the following
    "st,st33htpm-spi"
    "infineon,slb9670"
    "tcg,tpm_tis-spi"
- spi-max-frequency: Maximum SPI frequency (depends on TPMs).

Optional SoC Specific Properties:
- pinctrl-names: Contains only one value - "default".
- pintctrl-0: Specifies the pin control groups used for this controller.

Example (for ARM-based BeagleBoard xM with TPM_TIS on SPI4):

&mcspi4 {


        tpm_tis@0 {

                compatible = "tcg,tpm_tis-spi";

                spi-max-frequency = <10000000>;
        };
};
```

## Documentation/devicetree/bindings/serial/8250.txt
```
* UART (Universal Asynchronous Receiver/Transmitter)

Required properties:
- compatible : one of:
	- "ns8250"
	- "ns16450"
	- "ns16550a"
	- "ns16550"
	- "ns16750"
	- "ns16850"
	- For Tegra20, must contain "nvidia,tegra20-uart"
	- For other Tegra, must contain '"nvidia,<chip>-uart",
	  "nvidia,tegra20-uart"' where <chip> is tegra30, tegra114, tegra124,
	  tegra132, or tegra210.
	- "nxp,lpc3220-uart"
	- "ralink,rt2880-uart"
	- For MediaTek BTIF, must contain '"mediatek,<chip>-btif",
	  "mediatek,mtk-btif"' where <chip> is mt7622, mt7623.
	- "altr,16550-FIFO32"
	- "altr,16550-FIFO64"
	- "altr,16550-FIFO128"
	- "fsl,16550-FIFO64"
	- "fsl,ns16550"
	- "ti,da830-uart"
	- "aspeed,ast2400-vuart"
	- "aspeed,ast2500-vuart"
	- "nuvoton,npcm750-uart"
	- "serial" if the port type is unknown.
- reg : offset and length of the register set for the device.
- interrupts : should contain uart interrupt.
- clock-frequency : the input clock frequency for the UART
	 or
  clocks phandle to refer to the clk used as per Documentation/devicetree
  /bindings/clock/clock-bindings.txt

Optional properties:
- current-speed : the current active speed of the UART.
- reg-offset : offset to apply to the mapbase from the start of the registers.
- reg-shift : quantity to shift the register offsets by.
- reg-io-width : the size (in bytes) of the IO accesses that should be
  performed on the device.  There are some systems that require 32-bit
  accesses to the UART (e.g. TI davinci).
- used-by-rtas : set to indicate that the port is in use by the OpenFirmware
  RTAS and should not be registered.
- no-loopback-test: set to indicate that the port does not implements loopback
  test mode
- fifo-size: the fifo size of the UART.
- auto-flow-control: one way to enable automatic flow control support. The
  driver is allowed to detect support for the capability even without this
  property.
- tx-threshold: Specify the TX FIFO low water indication for parts with
  programmable TX FIFO thresholds.
- resets : phandle + reset specifier pairs
- overrun-throttle-ms : how long to pause uart rx when input overrun is encountered.

Note:
* fsl,ns16550:
  ------------
  Freescale DUART is very similar to the PC16552D (and to a
  pair of NS16550A), albeit with some nonstandard behavior such as
  erratum A-004737 (relating to incorrect BRK handling).

  Represents a single port that is compatible with the DUART found
  on many Freescale chips (examples include mpc8349, mpc8548,
  mpc8641d, p4080 and ls2085a).

Example:

	uart@80230000 {
		compatible = "ns8250";
		reg = <0x80230000 0x100>;
		clock-frequency = <3686400>;
		interrupts = <10>;
		reg-shift = <2>;
	};
```
