## Documentation/devicetree/bindings/serial/8250.yaml
```yaml
# Copyright 2020 Lubomir Rintel <lkundrak@v3.sk>
%YAML 1.2
---
$id: http://devicetree.org/schemas/serial/8250.yaml#
$schema: http://devicetree.org/meta-schemas/core.yaml#

title: UART (Universal Asynchronous Receiver/Transmitter)

maintainers:
  - devicetree@vger.kernel.org

allOf:
  - $ref: serial.yaml#
  - $ref: /schemas/memory-controllers/mc-peripheral-props.yaml#
  - if:
      anyOf:
        - required:
            - aspeed,lpc-io-reg
        - required:
            - aspeed,lpc-interrupts
        - required:
            - aspeed,sirq-polarity-sense
    then:
      properties:
        compatible:
          const: aspeed,ast2500-vuart
  - if:
      properties:
        compatible:
          const: mrvl,mmp-uart
    then:
      properties:
        reg-shift:
          const: 2
      required:
        - reg-shift
  - if:
      not:
        properties:
          compatible:
            items:
              - enum:
                  - ns8250
                  - ns16450
                  - ns16550
                  - ns16550a
    then:
      anyOf:
        - required: [ clock-frequency ]
        - required: [ clocks ]

properties:
  compatible:
    oneOf:
      - const: ns8250
      - const: ns16450
      - const: ns16550
      - const: ns16550a
      - const: ns16850
      - const: aspeed,ast2400-vuart
      - const: aspeed,ast2500-vuart
      - const: intel,xscale-uart
      - const: mrvl,pxa-uart
      - const: nuvoton,wpcm450-uart
      - const: nuvoton,npcm750-uart
      - const: nvidia,tegra20-uart
      - const: nxp,lpc3220-uart
      - items:
          - enum:
              - exar,xr16l2552
              - exar,xr16l2551
              - exar,xr16l2550
          - const: ns8250
      - items:
          - enum:
              - altr,16550-FIFO32
              - altr,16550-FIFO64
              - altr,16550-FIFO128
              - fsl,16550-FIFO64
              - fsl,ns16550
              - andestech,uart16550
              - nxp,lpc1850-uart
              - opencores,uart16550-rtlsvn105
              - ti,da830-uart
          - const: ns16550a
      - items:
          - enum:
              - ns16750
              - cavium,octeon-3860-uart
              - xlnx,xps-uart16550-2.00.b
              - ralink,rt2880-uart
          - enum:
              - ns16550 # Deprecated, unless the FIFO really is broken
              - ns16550a
      - items:
          - enum:
              - nuvoton,npcm845-uart
          - const: nuvoton,npcm750-uart
      - items:
          - enum:
              - ralink,mt7620a-uart
              - ralink,rt3052-uart
              - ralink,rt3883-uart
          - const: ralink,rt2880-uart
          - enum:
              - ns16550 # Deprecated, unless the FIFO really is broken
              - ns16550a
      - items:
          - enum:
              - mediatek,mt7622-btif
              - mediatek,mt7623-btif
          - const: mediatek,mtk-btif
      - items:
          - enum:
              - mrvl,mmp-uart
              - spacemit,k1-uart
          - const: intel,xscale-uart
      - items:
          - enum:
              - nvidia,tegra30-uart
              - nvidia,tegra114-uart
              - nvidia,tegra124-uart
              - nvidia,tegra210-uart
              - nvidia,tegra186-uart
              - nvidia,tegra194-uart
              - nvidia,tegra234-uart
          - const: nvidia,tegra20-uart

  reg:
    maxItems: 1

  interrupts:
    maxItems: 1

  clock-frequency: true

  clocks:
    maxItems: 1

  resets:
    maxItems: 1

  current-speed:
    $ref: /schemas/types.yaml#/definitions/uint32
    description: The current active speed of the UART.

  reg-offset:
    $ref: /schemas/types.yaml#/definitions/uint32
    description: |
      Offset to apply to the mapbase from the start of the registers.

  reg-shift:
    description: Quantity to shift the register offsets by.

  reg-io-width:
    description: |
      The size (in bytes) of the IO accesses that should be performed on the
      device. There are some systems that require 32-bit accesses to the
      UART (e.g. TI davinci).

  used-by-rtas:
    type: boolean
    description: |
      Set to indicate that the port is in use by the OpenFirmware RTAS and
      should not be registered.

  no-loopback-test:
    type: boolean
    description: |
      Set to indicate that the port does not implement loopback test mode.

  fifo-size:
    $ref: /schemas/types.yaml#/definitions/uint32
    description: The fifo size of the UART.

  auto-flow-control:
    type: boolean
    description: |
      One way to enable automatic flow control support. The driver is
      allowed to detect support for the capability even without this
      property.

  tx-threshold:
    description: |
      Specify the TX FIFO low water indication for parts with programmable
      TX FIFO thresholds.

  overrun-throttle-ms:
    description: |
      How long to pause uart rx when input overrun is encountered.

  rts-gpios: true
  cts-gpios: true
  dtr-gpios: true
  dsr-gpios: true
  rng-gpios: true
  dcd-gpios: true

  aspeed,sirq-polarity-sense:
    $ref: /schemas/types.yaml#/definitions/phandle-array
    description: |
      Phandle to aspeed,ast2500-scu compatible syscon alongside register
      offset and bit number to identify how the SIRQ polarity should be
      configured. One possible data source is the LPC/eSPI mode bit. Only
      applicable to aspeed,ast2500-vuart.
    deprecated: true

  aspeed,lpc-io-reg:
    $ref: /schemas/types.yaml#/definitions/uint32-array
    maxItems: 1
    description: |
      The VUART LPC address.  Only applicable to aspeed,ast2500-vuart.

  aspeed,lpc-interrupts:
    $ref: /schemas/types.yaml#/definitions/uint32-array
    minItems: 2
    maxItems: 2
    description: |
      A 2-cell property describing the VUART SIRQ number and SIRQ
      polarity (IRQ_TYPE_LEVEL_LOW or IRQ_TYPE_LEVEL_HIGH).  Only
      applicable to aspeed,ast2500-vuart.

required:
  - reg
  - interrupts

unevaluatedProperties: false

examples:
  - |
    serial@80230000 {
        compatible = "ns8250";
        reg = <0x80230000 0x100>;
        interrupts = <10>;
        reg-shift = <2>;
        clock-frequency = <48000000>;
    };
  - |
    #include <dt-bindings/gpio/gpio.h>
    serial@49042000 {
        compatible = "andestech,uart16550", "ns16550a";
        reg = <0x49042000 0x400>;
        interrupts = <80>;
        clock-frequency = <48000000>;
        cts-gpios = <&gpio3 5 GPIO_ACTIVE_LOW>;
        rts-gpios = <&gpio3 6 GPIO_ACTIVE_LOW>;
        dtr-gpios = <&gpio1 12 GPIO_ACTIVE_LOW>;
        dsr-gpios = <&gpio1 13 GPIO_ACTIVE_LOW>;
        dcd-gpios = <&gpio1 14 GPIO_ACTIVE_LOW>;
        rng-gpios = <&gpio1 15 GPIO_ACTIVE_LOW>;
    };
  - |
    #include <dt-bindings/clock/aspeed-clock.h>
    #include <dt-bindings/interrupt-controller/irq.h>
    serial@1e787000 {
        compatible = "aspeed,ast2500-vuart";
        reg = <0x1e787000 0x40>;
        reg-shift = <2>;
        interrupts = <8>;
        clocks = <&syscon ASPEED_CLK_APB>;
        no-loopback-test;
        aspeed,lpc-io-reg = <0x3f8>;
        aspeed,lpc-interrupts = <4 IRQ_TYPE_LEVEL_LOW>;
    };

...
```

## Documentation/devicetree/bindings/serial/8250_omap.yaml
```yaml
# SPDX-License-Identifier: (GPL-2.0-only OR BSD-2-Clause)
%YAML 1.2
---
$id: http://devicetree.org/schemas/serial/8250_omap.yaml#
$schema: http://devicetree.org/meta-schemas/core.yaml#

title: Bindings for 8250 compliant UARTs on TI's OMAP2+ and K3 SoCs

maintainers:
  - Vignesh Raghavendra <vigneshr@ti.com>

allOf:
  - $ref: /schemas/serial/serial.yaml#
  - $ref: /schemas/serial/rs485.yaml#

properties:
  compatible:
    oneOf:
      - enum:
          - ti,am3352-uart
          - ti,am4372-uart
          - ti,am654-uart
          - ti,dra742-uart
          - ti,omap2-uart
          - ti,omap3-uart
          - ti,omap4-uart
      - items:
          - enum:
              - ti,am64-uart
              - ti,j721e-uart
          - const: ti,am654-uart

  ti,hwmods:
    description:
      Must be "uart<n>", n being the instance number (1-based)
      This property is applicable only on legacy platforms mainly omap2/3
      and ti81xx and should not be used on other platforms.
    $ref: /schemas/types.yaml#/definitions/string
    deprecated: true

  dmas:
    minItems: 1
    maxItems: 2

  dma-names:
    items:
      - const: tx
      - const: rx

  reg:
    maxItems: 1

  interrupts:
    minItems: 1
    maxItems: 2
    description:
      First entry is module IRQ required for normal IO operation.
      Second entry is optional and corresponds to system wakeup IRQ
      where supported.

  clocks:
    maxItems: 1

  clock-names:
    const: fclk

  rts-gpios: true
  cts-gpios: true
  dtr-gpios: true
  dsr-gpios: true
  rng-gpios: true
  dcd-gpios: true
  rs485-rts-delay: true
  rs485-rts-active-low: true
  rs485-rx-during-tx: true
  rs485-rts-active-high: true
  linux,rs485-enabled-at-boot-time: true
  rts-gpio: true
  power-domains: true
  clock-frequency: true
  current-speed: true

required:
  - compatible
  - reg
  - interrupts

additionalProperties: false

if:
  properties:
    compatible:
      oneOf:
        - const: ti,omap2-uart
        - const: ti,omap3-uart
        - const: ti,omap4-uart

then:
  properties:
    ti,hwmods:
      items:
        - pattern: "^uart([1-9])$"

else:
  properties:
    ti,hwmods: false

examples:
  - |
          serial@49042000 {
            compatible = "ti,omap3-uart";
            reg = <0x49042000 0x400>;
            interrupts = <80>;
            dmas = <&sdma 81 &sdma 82>;
            dma-names = "tx", "rx";
            ti,hwmods = "uart4";
            clock-frequency = <48000000>;
          };
```

## Documentation/devicetree/bindings/serial/actions,owl-uart.txt
```
Actions Semi Owl UART

Required properties:
- compatible :  "actions,s500-uart", "actions,owl-uart" for S500
                "actions,s900-uart", "actions,owl-uart" for S900
- reg        :  Offset and length of the register set for the device.
- interrupts :  Should contain UART interrupt.


Example:

		uart3: serial@b0126000 {
			compatible = "actions,s500-uart", "actions,owl-uart";
			reg = <0xb0126000 0x1000>;
			interrupts = <GIC_SPI 32 IRQ_TYPE_LEVEL_HIGH>;
		};
```

## Documentation/devicetree/bindings/serial/actions,owl-uart.yaml
```yaml
# SPDX-License-Identifier: (GPL-2.0-only OR BSD-2-Clause)
%YAML 1.2
---
$id: http://devicetree.org/schemas/serial/actions,owl-uart.yaml#
$schema: http://devicetree.org/meta-schemas/core.yaml#

title: Actions Semi Owl UART

maintainers:
  - Kanak Shilledar <kanakshilledar111@protonmail.com>

allOf:
  - $ref: serial.yaml

properties:
  compatible:
    items:
      - enum:
          - actions,s500-uart
          - actions,s900-uart
      - const: actions,owl-uart

  reg:
    maxItems: 1

  interrupts:
    maxItems: 1

  clocks:
    maxItems: 1

required:
  - compatible
  - reg
  - interrupts

unevaluatedProperties: false

examples:
  - |
    #include <dt-bindings/clock/actions,s500-cmu.h>
    #include <dt-bindings/interrupt-controller/arm-gic.h>
    uart0: serial@b0126000 {
        compatible = "actions,s500-uart", "actions,owl-uart";
        reg = <0xb0126000 0x1000>;
        clocks = <&cmu CLK_UART0>;
        interrupts = <GIC_SPI 32 IRQ_TYPE_LEVEL_HIGH>;
    };
```

## Documentation/devicetree/bindings/serial/altera_jtaguart.txt
```
Altera JTAG UART

Required properties:
- compatible : should be "ALTR,juart-1.0" <DEPRECATED>
- compatible : should be "altr,juart-1.0"
```

## Documentation/devicetree/bindings/serial/altera_uart.txt
```
Altera UART

Required properties:
- compatible : should be "ALTR,uart-1.0"

Optional properties:
- clock-frequency : frequency of the clock input to the UART
```

## Documentation/devicetree/bindings/serial/altr,juart-1.0.yaml
```yaml
# SPDX-License-Identifier: (GPL-2.0-only OR BSD-2-Clause)
%YAML 1.2
---
$id: http://devicetree.org/schemas/serial/altr,juart-1.0.yaml#
$schema: http://devicetree.org/meta-schemas/core.yaml#

title: Altera JTAG UART

maintainers:
  - Dinh Nguyen <dinguyen@kernel.org>

properties:
  compatible:
    const: altr,juart-1.0

required:
  - compatible

additionalProperties: false
```

## Documentation/devicetree/bindings/serial/altr,uart-1.0.yaml
```yaml
# SPDX-License-Identifier: (GPL-2.0-only OR BSD-2-Clause)
%YAML 1.2
---
$id: http://devicetree.org/schemas/serial/altr,uart-1.0.yaml#
$schema: http://devicetree.org/meta-schemas/core.yaml#

title: Altera UART

maintainers:
  - Dinh Nguyen <dinguyen@kernel.org>

allOf:
  - $ref: /schemas/serial/serial.yaml#

properties:
  compatible:
    const: altr,uart-1.0

  clock-frequency:
    description: Frequency of the clock input to the UART.

required:
  - compatible

unevaluatedProperties: false
```

## Documentation/devicetree/bindings/serial/amlogic,meson-uart.txt
```
Amlogic Meson SoC UART Serial Interface
=======================================

The Amlogic Meson SoC UART Serial Interface is present on a large range
of SoCs, and can be present either in the "Always-On" power domain or the
"Everything-Else" power domain.

The particularity of the "Always-On" Serial Interface is that the hardware
is active since power-on and does not need any clock gating and is usable
as very early serial console.

Required properties:
- compatible : compatible: value should be different for each SoC family as :
	- Meson6 : "amlogic,meson6-uart"
	- Meson8 : "amlogic,meson8-uart"
	- Meson8b : "amlogic,meson8b-uart"
	- GX (GXBB, GXL, GXM) : "amlogic,meson-gx-uart"
	eventually followed by : "amlogic,meson-ao-uart" if this UART interface
	is in the "Always-On" power domain.
- reg : offset and length of the register set for the device.
- interrupts : identifier to the device interrupt
- clocks : a list of phandle + clock-specifier pairs, one for each
	   entry in clock names.
- clock-names :
   * "xtal" for external xtal clock identifier
   * "pclk" for the bus core clock, either the clk81 clock or the gate clock
   * "baud" for the source of the baudrate generator, can be either the xtal
	or the pclk.

e.g.
uart_A: serial@84c0 {
	compatible = "amlogic,meson-gx-uart";
	reg = <0x0 0x84c0 0x0 0x14>;
	interrupts = <GIC_SPI 26 IRQ_TYPE_EDGE_RISING>;
	/* Use xtal as baud rate clock source */
	clocks = <&xtal>, <&clkc CLKID_UART0>, <&xtal>;
	clock-names = "xtal", "pclk", "baud";
};
```
