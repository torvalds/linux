## Documentation/devicetree/bindings/spi/brcm,spi-bcm-qspi.yaml
```yaml
# SPDX-License-Identifier: GPL-2.0-only OR BSD-2-Clause
%YAML 1.2
---
$id: http://devicetree.org/schemas/spi/brcm,spi-bcm-qspi.yaml#
$schema: http://devicetree.org/meta-schemas/core.yaml#

title: Broadcom SPI controller

maintainers:
  - Kamal Dasu <kdasu.kdev@gmail.com>
  - Rafał Miłecki <rafal@milecki.pl>

description: |
  The Broadcom SPI controller is a SPI master found on various SOCs, including
  BRCMSTB (BCM7XXX), Cygnus, NSP and NS2. The Broadcom Master SPI hw IP consists
  of:
    MSPI : SPI master controller can read and write to a SPI slave device
    BSPI : Broadcom SPI in combination with the MSPI hw IP provides acceleration
           for flash reads and be configured to do single, double, quad lane
           io with 3-byte and 4-byte addressing support.

  Supported Broadcom SoCs have one instance of MSPI+BSPI controller IP.
  MSPI master can be used without BSPI. BRCMSTB SoCs have an additional instance
  of a MSPI master without the BSPI to use with non flash slave devices that
  use SPI protocol.

allOf:
  - $ref: spi-controller.yaml#

properties:
  compatible:
    oneOf:
      - description: Second Instance of MSPI BRCMSTB SoCs
        items:
          - enum:
              - brcm,spi-bcm7425-qspi
              - brcm,spi-bcm7429-qspi
              - brcm,spi-bcm7435-qspi
              - brcm,spi-bcm7445-qspi
              - brcm,spi-bcm7216-qspi
              - brcm,spi-bcm7278-qspi
          - const: brcm,spi-bcm-qspi
          - const: brcm,spi-brcmstb-mspi
      - description: Second Instance of MSPI BRCMSTB SoCs
        items:
          - enum:
              - brcm,spi-brcmstb-qspi
              - brcm,spi-brcmstb-mspi
              - brcm,spi-nsp-qspi
              - brcm,spi-ns2-qspi
          - const: brcm,spi-bcm-qspi

  reg:
    minItems: 1
    maxItems: 5

  reg-names:
    minItems: 1
    items:
      - const: mspi
      - const: bspi
      - enum: [ intr_regs, intr_status_reg, cs_reg ]
      - enum: [ intr_regs, intr_status_reg, cs_reg ]
      - enum: [ intr_regs, intr_status_reg, cs_reg ]

  interrupts:
    minItems: 1
    maxItems: 7

  interrupt-names:
    oneOf:
      - minItems: 1
        items:
          - const: mspi_done
          - const: mspi_halted
          - const: spi_lr_fullness_reached
          - const: spi_lr_session_aborted
          - const: spi_lr_impatient
          - const: spi_lr_session_done
          - const: spi_lr_overread
      - const: spi_l1_intr

  clocks:
    maxItems: 1
    description: reference clock for this block

  native-endian:
    $ref: /schemas/types.yaml#/definitions/flag
    description: Defined when using BE SoC and device uses BE register read/write

unevaluatedProperties: false

required:
  - reg
  - reg-names
  - interrupts
  - interrupt-names

examples:
  - | # BRCMSTB SoC: SPI Master (MSPI+BSPI) for SPI-NOR access
    spi@f03e3400 {
        compatible = "brcm,spi-brcmstb-qspi", "brcm,spi-bcm-qspi";
        reg = <0xf03e3400 0x188>, <0xf03e3200 0x50>, <0xf03e0920 0x4>;
        reg-names = "mspi", "bspi", "cs_reg";
        interrupts = <0x5>, <0x6>, <0x1>, <0x2>, <0x3>, <0x4>, <0x0>;
        interrupt-parent = <&gic>;
        interrupt-names = "mspi_done",
                          "mspi_halted",
                          "spi_lr_fullness_reached",
                          "spi_lr_session_aborted",
                          "spi_lr_impatient",
                          "spi_lr_session_done",
                          "spi_lr_overread";
        clocks = <&hif_spi>;
        #address-cells = <0x1>;
        #size-cells = <0x0>;

        flash@0 {
            #size-cells = <0x2>;
            #address-cells = <0x2>;
            compatible = "m25p80";
            reg = <0x0>;
            spi-max-frequency = <0x2625a00>;
            spi-cpol;
            spi-cpha;
        };
    };
  - | # BRCMSTB SoC: MSPI master for any SPI device
    spi@f0416000 {
        clocks = <&upg_fixed>;
        compatible = "brcm,spi-brcmstb-mspi", "brcm,spi-bcm-qspi";
        reg = <0xf0416000 0x180>;
        reg-names = "mspi";
        interrupts = <0x14>;
        interrupt-parent = <&irq0_aon_intc>;
        interrupt-names = "mspi_done";
        #address-cells = <1>;
        #size-cells = <0>;
    };
  - | # iProc SoC
    #include <dt-bindings/interrupt-controller/irq.h>
    #include <dt-bindings/interrupt-controller/arm-gic.h>

    spi@18027200 {
        compatible = "brcm,spi-nsp-qspi", "brcm,spi-bcm-qspi";
        reg = <0x18027200 0x184>,
              <0x18027000 0x124>,
              <0x1811c408 0x004>,
              <0x180273a0 0x01c>;
        reg-names = "mspi", "bspi", "intr_regs", "intr_status_reg";
        interrupts = <GIC_SPI 77 IRQ_TYPE_LEVEL_HIGH>,
                     <GIC_SPI 78 IRQ_TYPE_LEVEL_HIGH>,
                     <GIC_SPI 72 IRQ_TYPE_LEVEL_HIGH>,
                     <GIC_SPI 73 IRQ_TYPE_LEVEL_HIGH>,
                     <GIC_SPI 74 IRQ_TYPE_LEVEL_HIGH>,
                     <GIC_SPI 75 IRQ_TYPE_LEVEL_HIGH>,
                     <GIC_SPI 76 IRQ_TYPE_LEVEL_HIGH>;
        interrupt-names = "mspi_done",
                          "mspi_halted",
                          "spi_lr_fullness_reached",
                          "spi_lr_session_aborted",
                          "spi_lr_impatient",
                          "spi_lr_session_done";
        clocks = <&iprocmed>;
        num-cs = <2>;
        #address-cells = <1>;
        #size-cells = <0>;
    };
  - | # NS2 SoC
    #include <dt-bindings/interrupt-controller/irq.h>
    #include <dt-bindings/interrupt-controller/arm-gic.h>

    spi@66470200 {
        compatible = "brcm,spi-ns2-qspi", "brcm,spi-bcm-qspi";
        reg = <0x66470200 0x184>,
              <0x66470000 0x124>,
              <0x67017408 0x004>,
              <0x664703a0 0x01c>;
        reg-names = "mspi", "bspi", "intr_regs", "intr_status_reg";
        interrupts = <GIC_SPI 419 IRQ_TYPE_LEVEL_HIGH>;
        interrupt-names = "spi_l1_intr";
        clocks = <&iprocmed>;
        num-cs = <2>;
        #address-cells = <1>;
        #size-cells = <0>;

        flash@0 {
            #address-cells = <1>;
            #size-cells = <1>;
            compatible = "m25p80";
            reg = <0x0>;
            spi-max-frequency = <12500000>;
            spi-cpol;
            spi-cpha;
        };
    };
```

## Documentation/devicetree/bindings/spi/cavium,octeon-3010-spi.yaml
```yaml
# SPDX-License-Identifier: (GPL-2.0-only OR BSD-2-Clause)
%YAML 1.2
---
$id: http://devicetree.org/schemas/spi/cavium,octeon-3010-spi.yaml#
$schema: http://devicetree.org/meta-schemas/core.yaml#

title: Cavium, Inc. OCTEON SoC SPI master controller

description:
  The Cavium OCTEON SPI controller is an SPI master controller found in
  OCTEON SoCs.

maintainers:
  - Rob Herring <robh@kernel.org>

allOf:
  - $ref: spi-controller.yaml#

properties:
  compatible:
    const: cavium,octeon-3010-spi

  reg:
    maxItems: 1

  interrupts:
    maxItems: 1

required:
  - compatible
  - reg
  - interrupts

unevaluatedProperties: false

examples:
  - |
    soc {
        #address-cells = <2>;
        #size-cells = <2>;

        spi@1070000001000 {
            compatible = "cavium,octeon-3010-spi";
            reg = <0x10700 0x00001000 0x0 0x100>;
            interrupts = <0 58>;
            #address-cells = <1>;
            #size-cells = <0>;

            eeprom@0 {
                compatible = "st,m95256", "atmel,at25";
                reg = <0>;
                spi-max-frequency = <5000000>;
                spi-cpha;
                spi-cpol;
                pagesize = <64>;
                size = <32768>;
                address-width = <16>;
            };
        };
    };
...
```

## Documentation/devicetree/bindings/spi/cdns,qspi-nor-peripheral-props.yaml
```yaml
# SPDX-License-Identifier: (GPL-2.0 OR BSD-2-Clause)
%YAML 1.2
---
$id: http://devicetree.org/schemas/spi/cdns,qspi-analr-peripheral-props.yaml#
$schema: http://devicetree.org/meta-schemas/core.yaml#

title: Peripheral-specific properties for the Cadence QSPI controller.

description:
  See spi-peripheral-props.yaml for more info.

maintainers:
  - Vaishnav Achath <vaishnav.a@ti.com>

properties:
  # cdns,qspi-analr.yaml
  cdns,read-delay:
    $ref: /schemas/types.yaml#/definitions/uint32
    description:
      Delay for read capture logic, in clock cycles.

  cdns,tshsl-ns:
    description:
      Delay in naanalseconds for the length that the master mode chip select
      outputs are de-asserted between transactions.

  cdns,tsd2d-ns:
    description:
      Delay in naanalseconds between one chip select being de-activated
      and the activation of aanalther.

  cdns,tchsh-ns:
    description:
      Delay in naanalseconds between last bit of current transaction and
      deasserting the device chip select (qspi_n_ss_out).

  cdns,tslch-ns:
    description:
      Delay in naanalseconds between setting qspi_n_ss_out low and
      first bit transfer.

additionalProperties: true
```

## Documentation/devicetree/bindings/spi/cdns,qspi-nor.yaml
```yaml
# SPDX-License-Identifier: (GPL-2.0 OR BSD-2-Clause)
%YAML 1.2
---
$id: http://devicetree.org/schemas/spi/cdns,qspi-nor.yaml#
$schema: http://devicetree.org/meta-schemas/core.yaml#

title: Cadence Quad SPI controller

maintainers:
  - Vaishnav Achath <vaishnav.a@ti.com>

allOf:
  - $ref: spi-controller.yaml#
  - if:
      properties:
        compatible:
          contains:
            const: xlnx,versal-ospi-1.0
    then:
      required:
        - power-domains
  - if:
      properties:
        compatible:
          contains:
            const: starfive,jh7110-qspi
    then:
      properties:
        resets:
          minItems: 2
          maxItems: 3

        reset-names:
          minItems: 2
          maxItems: 3
          items:
            enum: [ qspi, qspi-ocp, rstc_ref ]

    else:
      properties:
        resets:
          maxItems: 2

        reset-names:
          minItems: 1
          maxItems: 2
          items:
            enum: [ qspi, qspi-ocp ]

properties:
  compatible:
    oneOf:
      - items:
          - enum:
              - ti,k2g-qspi
              - ti,am654-ospi
              - intel,lgm-qspi
              - xlnx,versal-ospi-1.0
              - intel,socfpga-qspi
              - starfive,jh7110-qspi
          - const: cdns,qspi-nor
      - const: cdns,qspi-nor

  reg:
    items:
      - description: the controller register set
      - description: the controller data area

  interrupts:
    maxItems: 1

  clocks:
    maxItems: 1

  cdns,fifo-depth:
    description:
      Size of the data FIFO in words.
    $ref: /schemas/types.yaml#/definitions/uint32
    enum: [ 128, 256 ]
    default: 128

  cdns,fifo-width:
    $ref: /schemas/types.yaml#/definitions/uint32
    description:
      Bus width of the data FIFO in bytes.
    default: 4

  cdns,trigger-address:
    $ref: /schemas/types.yaml#/definitions/uint32
    description:
      32-bit indirect AHB trigger address.

  cdns,is-decoded-cs:
    type: boolean
    description:
      Flag to indicate whether decoder is used to select different chip select
      for different memory regions.

  cdns,rclk-en:
    type: boolean
    description:
      Flag to indicate that QSPI return clock is used to latch the read
      data rather than the QSPI clock. Make sure that QSPI return clock
      is populated on the board before using this property.

  power-domains:
    maxItems: 1

  resets:
    minItems: 2
    maxItems: 3

  reset-names:
    minItems: 2
    maxItems: 3
    items:
      enum: [ qspi, qspi-ocp, rstc_ref ]

required:
  - compatible
  - reg
  - interrupts
  - clocks
  - cdns,fifo-depth
  - cdns,fifo-width
  - cdns,trigger-address
  - '#address-cells'
  - '#size-cells'

unevaluatedProperties: false

examples:
  - |
    qspi: spi@ff705000 {
        compatible = "cdns,qspi-nor";
        #address-cells = <1>;
        #size-cells = <0>;
        reg = <0xff705000 0x1000>,
              <0xffa00000 0x1000>;
        interrupts = <0 151 4>;
        clocks = <&qspi_clk>;
        cdns,fifo-depth = <128>;
        cdns,fifo-width = <4>;
        cdns,trigger-address = <0x00000000>;
        resets = <&rst 0x1>, <&rst 0x2>;
        reset-names = "qspi", "qspi-ocp";

        flash@0 {
            compatible = "jedec,spi-nor";
            reg = <0x0>;
        };
    };
```

## Documentation/devicetree/bindings/spi/cdns,xspi.yaml
```yaml
# SPDX-License-Identifier: (GPL-2.0 OR BSD-2-Clause)
# Copyright 2020-21 Cadence
%YAML 1.2
---
$id: http://devicetree.org/schemas/spi/cdns,xspi.yaml#
$schema: http://devicetree.org/meta-schemas/core.yaml#

title: Cadence XSPI Controller

maintainers:
  - Parshuram Thombare <pthombar@cadence.com>

description: |
  The XSPI controller allows SPI protocol communication in
  single, dual, quad or octal wire transmission modes for
  read/write access to slaves such as SPI-NOR flash.

properties:
  compatible:
    enum:
      - cdns,xspi-nor
      - marvell,cn10-xspi-nor

  reg:
    items:
      - description: address and length of the controller register set
      - description: address and length of the Slave DMA data port
      - description: address and length of the auxiliary registers
      - description: address and length of the xfer registers
    minItems: 3

  reg-names:
    items:
      - const: io
      - const: sdma
      - const: aux
      - const: xfer
    minItems: 3

  interrupts:
    maxItems: 1

required:
  - compatible
  - reg
  - interrupts

allOf:
  - $ref: spi-controller.yaml#
  - if:
      properties:
        compatible:
          contains:
            enum:
              - marvell,cn10-xspi-nor
    then:
      properties:
        reg:
          minItems: 4
        reg-names:
          minItems: 4
    else:
      properties:
        reg:
          maxItems: 3
        reg-names:
          maxItems: 3

unevaluatedProperties: false

examples:
  - |
    #include <dt-bindings/interrupt-controller/irq.h>
    bus {
        #address-cells = <2>;
        #size-cells = <2>;

        xspi: spi@a0010000 {
            #address-cells = <1>;
            #size-cells = <0>;
            compatible = "cdns,xspi-nor";
            reg = <0x0 0xa0010000 0x0 0x1040>,
                  <0x0 0xb0000000 0x0 0x1000>,
                  <0x0 0xa0020000 0x0 0x100>;
            reg-names = "io", "sdma", "aux";
            interrupts = <0 90 IRQ_TYPE_LEVEL_HIGH>;
            interrupt-parent = <&gic>;

            flash@0 {
                compatible = "jedec,spi-nor";
                spi-max-frequency = <75000000>;
                reg = <0>;
            };

            flash@1 {
                compatible = "jedec,spi-nor";
                spi-max-frequency = <75000000>;
                reg = <1>;
            };
        };
    };
```
