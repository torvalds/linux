## Documentation/devicetree/bindings/spi/cirrus,ep9301-spi.yaml
```yaml
# SPDX-License-Identifier: (GPL-2.0-only OR BSD-2-Clause)
%YAML 1.2
---
$id: http://devicetree.org/schemas/spi/cirrus,ep9301-spi.yaml#
$schema: http://devicetree.org/meta-schemas/core.yaml#

title: EP93xx SoC SPI controller

maintainers:
  - Alexander Sverdlin <alexander.sverdlin@gmail.com>
  - Nikita Shubin <nikita.shubin@maquefel.me>

allOf:
  - $ref: spi-controller.yaml#

properties:
  compatible:
    oneOf:
      - const: cirrus,ep9301-spi
      - items:
          - enum:
              - cirrus,ep9302-spi
              - cirrus,ep9307-spi
              - cirrus,ep9312-spi
              - cirrus,ep9315-spi
          - const: cirrus,ep9301-spi

  reg:
    items:
      - description: SPI registers region

  interrupts:
    maxItems: 1

  clocks:
    items:
      - description: SPI Controller reference clock source

  dmas:
    items:
      - description: rx DMA channel
      - description: tx DMA channel

  dma-names:
    items:
      - const: rx
      - const: tx

required:
  - compatible
  - reg
  - interrupts
  - clocks

unevaluatedProperties: false

examples:
  - |
    #include <dt-bindings/gpio/gpio.h>
    #include <dt-bindings/clock/cirrus,ep9301-syscon.h>
    spi@808a0000 {
        compatible = "cirrus,ep9301-spi";
        reg = <0x808a0000 0x18>;
        interrupt-parent = <&vic1>;
        interrupts = <21>;
        clocks = <&syscon EP93XX_CLK_SPI>;
        dmas = <&dma1 10 2>, <&dma1 10 1>;
        dma-names = "rx", "tx";
        cs-gpios = <&gpio5 2 GPIO_ACTIVE_HIGH>;
    };
```

## Documentation/devicetree/bindings/spi/efm32-spi.txt
```
* Energy Micro EFM32 SPI

Required properties:
- #address-cells: see spi-bus.txt
- #size-cells: see spi-bus.txt
- compatible: should be "energymicro,efm32-spi"
- reg: Offset and length of the register set for the controller
- interrupts: pair specifying rx and tx irq
- clocks: phandle to the spi clock
- cs-gpios: see spi-bus.txt

Recommended properties :
- energymicro,location: Value to write to the ROUTE register's LOCATION
                        bitfield to configure the pinmux for the device, see
                        datasheet for values.
                        If this property is not provided, keeping what is
                        already configured in the hardware, so its either the
                        reset default 0 or whatever the bootloader did.

Example:

spi1: spi@4000c400 { /* USART1 */
	#address-cells = <1>;
	#size-cells = <0>;
	compatible = "energymicro,efm32-spi";
	reg = <0x4000c400 0x400>;
	interrupts = <15 16>;
	clocks = <&cmu 20>;
	cs-gpios = <&gpio 51 1>; // D3
	energymicro,location = <1>;

	ks8851@0 {
		compatible = "ks8851";
		spi-max-frequency = <6000000>;
		reg = <0>;
		interrupt-parent = <&boardfpga>;
		interrupts = <4>;
	};
};
```

## Documentation/devicetree/bindings/spi/faraday,ftssp010.yaml
```yaml
# SPDX-License-Identifier: (GPL-2.0-only OR BSD-2-Clause)
%YAML 1.2
---
$id: http://devicetree.org/schemas/spi/faraday,ftssp010.yaml#
$schema: http://devicetree.org/meta-schemas/core.yaml#

title: Faraday FTSSP010 SPI Controller

maintainers:
  - Linus Walleij <linusw@kernel.org>

properties:
  compatible:
    const: faraday,ftssp010

  interrupts:
    maxItems: 1

  reg:
    maxItems: 1

  cs-gpios: true

required:
  - compatible
  - interrupts
  - reg

allOf:
  - $ref: spi-controller.yaml#

unevaluatedProperties: false

examples:
  - |
    #include <dt-bindings/gpio/gpio.h>
    spi@4a000000 {
        compatible = "faraday,ftssp010";
        #address-cells = <1>;
        #size-cells = <0>;
        reg = <0x4a000000 0x1000>;
        interrupts = <0>;
    };
```

## Documentation/devicetree/bindings/spi/fsl,dspi-peripheral-props.yaml
```yaml
# SPDX-License-Identifier: (GPL-2.0 OR BSD-2-Clause)
%YAML 1.2
---
$id: http://devicetree.org/schemas/spi/fsl,dspi-peripheral-props.yaml#
$schema: http://devicetree.org/meta-schemas/core.yaml#

title: Peripheral-specific properties for Freescale DSPI controller

maintainers:
  - Vladimir Oltean <olteanv@gmail.com>

description:
  See spi-peripheral-props.yaml for more info.

properties:
  fsl,spi-cs-sck-delay:
    deprecated: true
    description:
      Delay in nanoseconds between activating chip select and the start of
      clock signal, at the start of a transfer.
    $ref: /schemas/types.yaml#/definitions/uint32

  fsl,spi-sck-cs-delay:
    deprecated: true
    description:
      Delay in nanoseconds between stopping the clock signal and
      deactivating chip select, at the end of a transfer.
    $ref: /schemas/types.yaml#/definitions/uint32

additionalProperties: true
```

## Documentation/devicetree/bindings/spi/fsl,dspi.yaml
```yaml
# SPDX-License-Identifier: (GPL-2.0-only OR BSD-2-Clause)
%YAML 1.2
---
$id: http://devicetree.org/schemas/spi/fsl,dspi.yaml#
$schema: http://devicetree.org/meta-schemas/core.yaml#

title: ARM Freescale DSPI controller

maintainers:
  - Frank Li <Frank.Li@nxp.com>

properties:
  compatible:
    oneOf:
      - enum:
          - fsl,vf610-dspi
          - fsl,ls1021a-v1.0-dspi
          - fsl,ls1012a-dspi
          - fsl,ls1028a-dspi
          - fsl,ls1043a-dspi
          - fsl,ls1046a-dspi
          - fsl,ls1088a-dspi
          - fsl,ls2080a-dspi
          - fsl,ls2085a-dspi
          - fsl,lx2160a-dspi
      - items:
          - enum:
              - fsl,ls1012a-dspi
              - fsl,ls1028a-dspi
              - fsl,ls1043a-dspi
              - fsl,ls1046a-dspi
              - fsl,ls1088a-dspi
          - const: fsl,ls1021a-v1.0-dspi
      - items:
          - const: fsl,ls2080a-dspi
          - const: fsl,ls2085a-dspi
      - items:
          - const: fsl,lx2160a-dspi
          - const: fsl,ls2085a-dspi

  reg:
    maxItems: 1

  interrupts:
    maxItems: 1

  clocks:
    maxItems: 1

  clock-names:
    items:
      - const: dspi

  dmas:
    items:
      - description: DMA controller phandle and request line for TX
      - description: DMA controller phandle and request line for RX

  dma-names:
    items:
      - const: tx
      - const: rx

  spi-num-chipselects:
    $ref: /schemas/types.yaml#/definitions/uint32
    description:
      The number of the chip native chipselect signals.
      cs-gpios don't count against this number.

  big-endian: true

  bus-num:
    $ref: /schemas/types.yaml#/definitions/uint32
    description: SoC-specific identifier for the SPI controller.

required:
  - compatible
  - reg
  - clocks
  - clock-names
  - spi-num-chipselects

allOf:
  - $ref: spi-controller.yaml#

unevaluatedProperties: false

examples:
  - |
    #include <dt-bindings/interrupt-controller/arm-gic.h>
    #include <dt-bindings/clock/vf610-clock.h>

    spi@4002c000 {
        compatible = "fsl,vf610-dspi";
        reg = <0x4002c000 0x1000>;
        #address-cells = <1>;
        #size-cells = <0>;
        interrupts = <GIC_SPI 67 IRQ_TYPE_LEVEL_HIGH>;
        clocks = <&clks VF610_CLK_DSPI0>;
        clock-names = "dspi";
        spi-num-chipselects = <5>;
        bus-num = <0>;
        pinctrl-names = "default";
        pinctrl-0 = <&pinctrl_dspi0_1>;
        big-endian;

        flash@0 {
                compatible = "jedec,spi-nor";
                reg = <0>;
                spi-max-frequency = <16000000>;
                spi-cpol;
                spi-cpha;
                spi-cs-setup-delay-ns = <100>;
                spi-cs-hold-delay-ns = <50>;
        };
    };
```

## Documentation/devicetree/bindings/spi/fsl,espi.yaml
```yaml
# SPDX-License-Identifier: (GPL-2.0-only OR BSD-2-Clause)
%YAML 1.2
---
$id: http://devicetree.org/schemas/spi/fsl,espi.yaml#
$schema: http://devicetree.org/meta-schemas/core.yaml#

title: Freescale eSPI (Enhanced Serial Peripheral Interface) controller

maintainers:
  - J. Neuschäfer <j.ne@posteo.net>

properties:
  compatible:
    const: fsl,mpc8536-espi

  reg:
    maxItems: 1

  interrupts:
    maxItems: 1

  fsl,espi-num-chipselects:
    $ref: /schemas/types.yaml#/definitions/uint32
    enum: [ 1, 4 ]
    description: The number of the chipselect signals.

  fsl,csbef:
    $ref: /schemas/types.yaml#/definitions/uint32
    minimum: 0
    maximum: 15
    description: Chip select assertion time in bits before frame starts

  fsl,csaft:
    $ref: /schemas/types.yaml#/definitions/uint32
    minimum: 0
    maximum: 15
    description: Chip select negation time in bits after frame ends

required:
  - compatible
  - reg
  - interrupts
  - fsl,espi-num-chipselects

allOf:
  - $ref: spi-controller.yaml#

unevaluatedProperties: false

examples:
  - |
    #include <dt-bindings/interrupt-controller/irq.h>

    spi@110000 {
        compatible = "fsl,mpc8536-espi";
        reg = <0x110000 0x1000>;
        #address-cells = <1>;
        #size-cells = <0>;
        interrupts = <53 IRQ_TYPE_EDGE_FALLING>;
        fsl,espi-num-chipselects = <4>;
        fsl,csbef = <1>;
        fsl,csaft = <1>;
    };

...
```

## Documentation/devicetree/bindings/spi/fsl,spi-fsl-qspi.yaml
```yaml
# SPDX-License-Identifier: (GPL-2.0-only OR BSD-2-Clause)
%YAML 1.2
---
$id: http://devicetree.org/schemas/spi/fsl,spi-fsl-qspi.yaml#
$schema: http://devicetree.org/meta-schemas/core.yaml#

title: Freescale Quad Serial Peripheral Interface (QuadSPI)

maintainers:
  - Han Xu <han.xu@nxp.com>

allOf:
  - $ref: spi-controller.yaml#

properties:
  compatible:
    oneOf:
      - enum:
          - fsl,vf610-qspi
          - fsl,imx6sx-qspi
          - fsl,imx7d-qspi
          - fsl,imx6ul-qspi
          - fsl,ls1021a-qspi
          - fsl,ls2080a-qspi
      - items:
          - enum:
              - fsl,ls1043a-qspi
          - const: fsl,ls1021a-qspi
      - items:
          - enum:
              - fsl,imx8mq-qspi
          - const: fsl,imx7d-qspi

  reg:
    items:
      - description: registers
      - description: memory mapping

  reg-names:
    items:
      - const: QuadSPI
      - const: QuadSPI-memory

  interrupts:
    maxItems: 1

  clocks:
    items:
      - description: SoC SPI qspi_en clock
      - description: SoC SPI qspi clock

  clock-names:
    items:
      - const: qspi_en
      - const: qspi

required:
  - compatible
  - reg
  - reg-names
  - interrupts
  - clocks
  - clock-names

unevaluatedProperties: false

examples:
  - |
    #include <dt-bindings/interrupt-controller/arm-gic.h>
    #include <dt-bindings/clock/fsl,qoriq-clockgen.h>

    soc {
        #address-cells = <2>;
        #size-cells = <2>;

        spi@1550000 {
            compatible = "fsl,ls1021a-qspi";
            reg = <0x0 0x1550000 0x0 0x100000>,
                  <0x0 0x40000000 0x0 0x10000000>;
            reg-names = "QuadSPI", "QuadSPI-memory";
            interrupts = <GIC_SPI 99 IRQ_TYPE_LEVEL_HIGH>;
            #address-cells = <1>;
            #size-cells = <0>;
            clocks = <&clockgen QORIQ_CLK_PLATFORM_PLL QORIQ_CLK_PLL_DIV(2)>,
                     <&clockgen QORIQ_CLK_PLATFORM_PLL QORIQ_CLK_PLL_DIV(2)>;
            clock-names = "qspi_en", "qspi";

            flash@0 {
                compatible = "jedec,spi-nor";
                spi-max-frequency = <50000000>;
                reg = <0>;
                spi-rx-bus-width = <4>;
                spi-tx-bus-width = <4>;
            };
        };
    };
```

## Documentation/devicetree/bindings/spi/fsl,spi.yaml
```yaml
# SPDX-License-Identifier: (GPL-2.0-only OR BSD-2-Clause)
%YAML 1.2
---
$id: http://devicetree.org/schemas/spi/fsl,spi.yaml#
$schema: http://devicetree.org/meta-schemas/core.yaml#

title: Freescale SPI (Serial Peripheral Interface) controller

maintainers:
  - J. Neuschäfer <j.ne@posteo.net>

properties:
  compatible:
    enum:
      - fsl,spi
      - aeroflexgaisler,spictrl

  reg:
    maxItems: 1

  cell-index:
    $ref: /schemas/types.yaml#/definitions/uint32
    description: |
      QE SPI subblock index.
      0: QE subblock SPI1
      1: QE subblock SPI2

  mode:
    description: SPI operation mode
    enum:
      - cpu
      - cpu-qe

  interrupts:
    maxItems: 1

  clock-frequency:
    description: input clock frequency to non FSL_SOC cores

  cs-gpios: true

  fsl,spisel_boot:
    $ref: /schemas/types.yaml#/definitions/flag
    description:
      For the MPC8306 and MPC8309, specifies that the SPISEL_BOOT signal is used
      as chip select for a slave device. Use reg = <number of gpios> in the
      corresponding child node, i.e. 0 if the cs-gpios property is not present.

required:
  - compatible
  - reg
  - mode
  - interrupts

allOf:
  - $ref: spi-controller.yaml#

unevaluatedProperties: false

examples:
  - |
    #include <dt-bindings/interrupt-controller/irq.h>

    spi@4c0 {
        compatible = "fsl,spi";
        reg = <0x4c0 0x40>;
        cell-index = <0>;
        interrupts = <82 0>;
        mode = "cpu";
        cs-gpios = <&gpio 18 IRQ_TYPE_EDGE_RISING          // device reg=<0>
                    &gpio 19 IRQ_TYPE_EDGE_RISING>;        // device reg=<1>
    };

...
```

## Documentation/devicetree/bindings/spi/fsl-imx-cspi.txt
```
* Freescale (Enhanced) Configurable Serial Peripheral Interface
  (CSPI/eCSPI) for i.MX

Required properties:
- compatible :
  - "fsl,imx1-cspi" for SPI compatible with the one integrated on i.MX1
  - "fsl,imx21-cspi" for SPI compatible with the one integrated on i.MX21
  - "fsl,imx27-cspi" for SPI compatible with the one integrated on i.MX27
  - "fsl,imx31-cspi" for SPI compatible with the one integrated on i.MX31
  - "fsl,imx35-cspi" for SPI compatible with the one integrated on i.MX35
  - "fsl,imx51-ecspi" for SPI compatible with the one integrated on i.MX51
  - "fsl,imx53-ecspi" for SPI compatible with the one integrated on i.MX53 and later Soc
  - "fsl,imx8mq-ecspi" for SPI compatible with the one integrated on i.MX8MQ
  - "fsl,imx8mm-ecspi" for SPI compatible with the one integrated on i.MX8MM
  - "fsl,imx8mn-ecspi" for SPI compatible with the one integrated on i.MX8MN
  - "fsl,imx8mp-ecspi" for SPI compatible with the one integrated on i.MX8MP
- reg : Offset and length of the register set for the device
- interrupts : Should contain CSPI/eCSPI interrupt
- clocks : Clock specifiers for both ipg and per clocks.
- clock-names : Clock names should include both "ipg" and "per"
See the clock consumer binding,
	Documentation/devicetree/bindings/clock/clock-bindings.txt

Recommended properties:
- cs-gpios : GPIOs to use as chip selects, see spi-bus.txt.  While the native chip
select lines can be used, they appear to always generate a pulse between each
word of a transfer.  Most use cases will require GPIO based chip selects to
generate a valid transaction.

Optional properties:
- num-cs :  Number of total chip selects, see spi-bus.txt.
- dmas: DMA specifiers for tx and rx dma. See the DMA client binding,
Documentation/devicetree/bindings/dma/dma.txt.
- dma-names: DMA request names, if present, should include "tx" and "rx".
- fsl,spi-rdy-drctl: Integer, representing the value of DRCTL, the register
controlling the SPI_READY handling. Note that to enable the DRCTL consideration,
the SPI_READY mode-flag needs to be set too.
Valid values are: 0 (disabled), 1 (edge-triggered burst) and 2 (level-triggered burst).

Obsolete properties:
- fsl,spi-num-chipselects : Contains the number of the chipselect

Example:

ecspi@70010000 {
	#address-cells = <1>;
	#size-cells = <0>;
	compatible = "fsl,imx51-ecspi";
	reg = <0x70010000 0x4000>;
	interrupts = <36>;
	cs-gpios = <&gpio3 24 0>, /* GPIO3_24 */
		   <&gpio3 25 0>; /* GPIO3_25 */
	dmas = <&sdma 3 7 1>, <&sdma 4 7 2>;
	dma-names = "rx", "tx";
	fsl,spi-rdy-drctl = <1>;
};
```
