## Documentation/devicetree/bindings/spi/fsl-imx-cspi.yaml
```yaml
# SPDX-License-Identifier: (GPL-2.0-only OR BSD-2-Clause)
%YAML 1.2
---
$id: http://devicetree.org/schemas/spi/fsl-imx-cspi.yaml#
$schema: http://devicetree.org/meta-schemas/core.yaml#

title: Freescale (Enhanced) Configurable Serial Peripheral Interface (CSPI/eCSPI) for i.MX

maintainers:
  - Shawn Guo <shawnguo@kernel.org>

allOf:
  - $ref: /schemas/spi/spi-controller.yaml#

properties:
  compatible:
    oneOf:
      - const: fsl,imx1-cspi
      - const: fsl,imx21-cspi
      - const: fsl,imx27-cspi
      - const: fsl,imx31-cspi
      - const: fsl,imx35-cspi
      - const: fsl,imx51-ecspi
      - const: fsl,imx53-ecspi
      - items:
          - enum:
              - fsl,imx25-cspi
              - fsl,imx50-cspi
              - fsl,imx51-cspi
              - fsl,imx53-cspi
          - const: fsl,imx35-cspi
      - items:
          - const: fsl,imx8mp-ecspi
          - const: fsl,imx6ul-ecspi
      - items:
          - enum:
              - fsl,imx50-ecspi
              - fsl,imx6q-ecspi
              - fsl,imx6sx-ecspi
              - fsl,imx6sl-ecspi
              - fsl,imx6sll-ecspi
              - fsl,imx6ul-ecspi
              - fsl,imx7d-ecspi
              - fsl,imx8mq-ecspi
              - fsl,imx8mm-ecspi
              - fsl,imx8mn-ecspi
          - const: fsl,imx51-ecspi

  reg:
    maxItems: 1

  interrupts:
    maxItems: 1

  clocks:
    items:
      - description: SoC SPI ipg clock
      - description: SoC SPI per clock

  clock-names:
    items:
      - const: ipg
      - const: per

  dmas:
    items:
      - description: DMA controller phandle and request line for RX
      - description: DMA controller phandle and request line for TX

  dma-names:
    items:
      - const: rx
      - const: tx

  fsl,spi-rdy-drctl:
    $ref: /schemas/types.yaml#/definitions/uint32
    description: |
      Integer, representing the value of DRCTL, the register controlling
      the SPI_READY handling. Note that to enable the DRCTL consideration,
      the SPI_READY mode-flag needs to be set too.
      Valid values are: 0 (disabled), 1 (edge-triggered burst) and 2 (level-triggered burst).
    enum: [0, 1, 2]

required:
  - compatible
  - reg
  - interrupts
  - clocks
  - clock-names

unevaluatedProperties: false

examples:
  - |
    #include <dt-bindings/clock/imx5-clock.h>

    spi@70010000 {
        #address-cells = <1>;
        #size-cells = <0>;
        compatible = "fsl,imx51-ecspi";
        reg = <0x70010000 0x4000>;
        interrupts = <36>;
        clocks = <&clks IMX5_CLK_ECSPI1_IPG_GATE>,
                 <&clks IMX5_CLK_ECSPI1_PER_GATE>;
        clock-names = "ipg", "per";
    };
```

## Documentation/devicetree/bindings/spi/fsl-spi.txt
```
* SPI (Serial Peripheral Interface)

Required properties:
- cell-index : QE SPI subblock index.
		0: QE subblock SPI1
		1: QE subblock SPI2
- compatible : should be "fsl,spi" or "aeroflexgaisler,spictrl".
- mode : the SPI operation mode, it can be "cpu" or "cpu-qe".
- reg : Offset and length of the register set for the device
- interrupts : <a b> where a is the interrupt number and b is a
  field that represents an encoding of the sense and level
  information for the interrupt.  This should be encoded based on
  the information in section 2) depending on the type of interrupt
  controller you have.
- clock-frequency : input clock frequency to non FSL_SOC cores

Optional properties:
- gpios : specifies the gpio pins to be used for chipselects.
  The gpios will be referred to as reg = <index> in the SPI child nodes.
  If unspecified, a single SPI device without a chip select can be used.

Example:
	spi@4c0 {
		cell-index = <0>;
		compatible = "fsl,spi";
		reg = <4c0 40>;
		interrupts = <82 0>;
		interrupt-parent = <700>;
		mode = "cpu";
		gpios = <&gpio 18 1	// device reg=<0>
			 &gpio 19 1>;	// device reg=<1>
	};


* eSPI (Enhanced Serial Peripheral Interface)

Required properties:
- compatible : should be "fsl,mpc8536-espi".
- reg : Offset and length of the register set for the device.
- interrupts : should contain eSPI interrupt, the device has one interrupt.
- fsl,espi-num-chipselects : the number of the chipselect signals.

Optional properties:
- fsl,csbef: chip select assertion time in bits before frame starts
- fsl,csaft: chip select negation time in bits after frame ends

Example:
	spi@110000 {
		#address-cells = <1>;
		#size-cells = <0>;
		compatible = "fsl,mpc8536-espi";
		reg = <0x110000 0x1000>;
		interrupts = <53 0x2>;
		interrupt-parent = <&mpic>;
		fsl,espi-num-chipselects = <4>;
		fsl,csbef = <1>;
		fsl,csaft = <1>;
	};
```

## Documentation/devicetree/bindings/spi/hpe,gxp-spifi.yaml
```yaml
# SPDX-License-Identifier: (GPL-2.0 OR BSD-2-Clause)
%YAML 1.2
---
$id: http://devicetree.org/schemas/spi/hpe,gxp-spifi.yaml#
$schema: http://devicetree.org/meta-schemas/core.yaml#

title: HPE GXP spi controller flash interface

maintainers:
  - Nick Hawkins <nick.hawkins@hpe.com>
  - Jean-Marie Verdun <verdun@hpe.com>

allOf:
  - $ref: spi-controller.yaml#

properties:
  compatible:
    const: hpe,gxp-spifi

  reg:
    items:
      - description: cfg registers
      - description: data registers
      - description: mapped memory

  interrupts:
    maxItems: 1

required:
  - compatible
  - reg
  - interrupts

unevaluatedProperties: false

examples:
  - |

    spi@200 {
      compatible = "hpe,gxp-spifi";
      reg = <0x200 0x80>, <0xc000 0x100>, <0x38000000 0x800000>;
      interrupts = <20>;
      interrupt-parent = <&vic0>;
      #address-cells = <1>;
      #size-cells = <0>;

      flash@0 {
        reg = <0>;
        compatible = "jedec,spi-nor";
      };

      flash@1 {
        reg = <1>;
        compatible = "jedec,spi-nor";
      };
    };
```

## Documentation/devicetree/bindings/spi/ibm,spi-fsi.yaml
```yaml
# SPDX-License-Identifier: (GPL-2.0 OR BSD-2-Clause)
%YAML 1.2
---
$id: http://devicetree.org/schemas/spi/ibm,spi-fsi.yaml#
$schema: http://devicetree.org/meta-schemas/core.yaml#

title: IBM FSI-attached SPI Controller

maintainers:
  - Eddie James <eajames@linux.ibm.com>

description:
  A SPI controller found on IBM Power processors, accessed over FSI from a
  service processor. This node will always be a child node of an ibm,fsi2spi
  node.

properties:
  compatible:
    enum:
      - ibm,spi-fsi

  reg:
    maxItems: 1

required:
  - compatible
  - reg

allOf:
  - $ref: spi-controller.yaml#

unevaluatedProperties: false

examples:
  - |
    fsi {
        #address-cells = <1>;
        #size-cells = <0>;

        spi@0 {
            compatible = "ibm,spi-fsi";
            reg = <0>;
            #address-cells = <1>;
            #size-cells = <0>;

            eeprom@0 {
                compatible = "atmel,at25";
                reg = <0>;
                size = <0x80000>;
                address-width = <24>;
                pagesize = <256>;
                spi-max-frequency = <1000000>;
            };
        };
    };
```

## Documentation/devicetree/bindings/spi/icpdas-lp8841-spi-rtc.txt
```
* ICP DAS LP-8841 SPI Controller for RTC

ICP DAS LP-8841 contains a DS-1302 RTC. RTC is connected to an IO
memory register, which acts as an SPI master device.

The device uses the standard MicroWire half-duplex transfer timing.
Master output is set on low clock and sensed by the RTC on the rising
edge. Master input is set by the RTC on the trailing edge and is sensed
by the master on low clock.

Required properties:

- #address-cells: should be 1

- #size-cells: should be 0

- compatible: should be "icpdas,lp8841-spi-rtc"

- reg: should provide IO memory address

Requirements to SPI slave nodes:

- There can be only one slave device.

- The spi slave node should claim the following flags which are
  required by the spi controller.

  - spi-3wire: The master itself has only 3 wire. It cannor work in
    full duplex mode.

  - spi-cs-high: DS-1302 has active high chip select line. The master
    doesn't support active low.

  - spi-lsb-first: DS-1302 requires least significant bit first
    transfers. The master only support this type of bit ordering.


Example:

spi@901c {
	#address-cells = <1>;
	#size-cells = <0>;
	compatible = "icpdas,lp8841-spi-rtc";
	reg = <0x901c 0x1>;

	rtc@0 {
		compatible = "maxim,ds1302";
		reg = <0>;
		spi-max-frequency = <500000>;
		spi-3wire;
		spi-lsb-first;
		spi-cs-high;
	};
};
```

## Documentation/devicetree/bindings/spi/ingenic,spi.yaml
```yaml
# SPDX-License-Identifier: (GPL-2.0-only OR BSD-2-Clause)
%YAML 1.2
---
$id: http://devicetree.org/schemas/spi/ingenic,spi.yaml#
$schema: http://devicetree.org/meta-schemas/core.yaml#

title: Ingenic SoCs SPI controller devicetree bindings

maintainers:
  - Artur Rojek <contact@artur-rojek.eu>
  - Paul Cercueil <paul@crapouillou.net>

allOf:
  - $ref: /schemas/spi/spi-controller.yaml#

properties:
  compatible:
    oneOf:
      - enum:
          - ingenic,jz4750-spi
          - ingenic,jz4775-spi
          - ingenic,jz4780-spi
          - ingenic,x1000-spi
          - ingenic,x2000-spi
      - items:
          - enum:
              - ingenic,jz4760-spi
              - ingenic,jz4770-spi
          - const: ingenic,jz4750-spi

  reg:
    maxItems: 1

  interrupts:
    maxItems: 1

  clocks:
    maxItems: 1

  dmas:
    maxItems: 2
    minItems: 2

  dma-names:
    items:
      - const: rx
      - const: tx

required:
  - compatible
  - reg
  - interrupts
  - clocks
  - dmas
  - dma-names

unevaluatedProperties: false

examples:
  - |
    #include <dt-bindings/clock/ingenic,jz4770-cgu.h>
    spi@10043000 {
      compatible = "ingenic,jz4770-spi", "ingenic,jz4750-spi";
      reg = <0x10043000 0x1c>;
      #address-cells = <1>;
      #size-cells = <0>;

      interrupt-parent = <&intc>;
      interrupts = <8>;

      clocks = <&cgu JZ4770_CLK_SSI0>;

      dmas = <&dmac1 23 0xffffffff>, <&dmac1 22 0xffffffff>;
      dma-names = "rx", "tx";
    };
```

## Documentation/devicetree/bindings/spi/jcore,spi.txt
```
J-Core SPI master

Required properties:

- compatible: Must be "jcore,spi2".

- reg: Memory region for registers.

- #address-cells: Must be 1.

- #size-cells: Must be 0.

Optional properties:

- clocks: If a phandle named "ref_clk" is present, SPI clock speed
  programming is relative to the frequency of the indicated clock.
  Necessary only if the input clock rate is something other than a
  fixed 50 MHz.

- clock-names: Clock names, one for each phandle in clocks.

See spi-bus.txt for additional properties not specific to this device.

Example:

spi@40 {
	compatible = "jcore,spi2";
	#address-cells = <1>;
	#size-cells = <0>;
	reg = <0x40 0x8>;
	spi-max-frequency = <25000000>;
	clocks = <&bus_clk>;
	clock-names = "ref_clk";
}
```

## Documentation/devicetree/bindings/spi/loongson,ls2k-spi.yaml
```yaml
# SPDX-License-Identifier: (GPL-2.0 OR BSD-2-Clause)
%YAML 1.2
---
$id: http://devicetree.org/schemas/spi/loongson,ls2k-spi.yaml#
$schema: http://devicetree.org/meta-schemas/core.yaml#

title: Loongson SPI controller

maintainers:
  - Yinbo Zhu <zhuyinbo@loongson.cn>

allOf:
  - $ref: /schemas/spi/spi-controller.yaml#

properties:
  compatible:
    oneOf:
      - enum:
          - loongson,ls2k1000-spi
      - items:
          - enum:
              - loongson,ls2k0500-spi
          - const: loongson,ls2k1000-spi

  reg:
    maxItems: 1

  clocks:
    maxItems: 1

required:
  - compatible
  - reg
  - clocks

unevaluatedProperties: false

examples:
  - |
    spi0: spi@1fff0220{
        compatible = "loongson,ls2k1000-spi";
        reg = <0x1fff0220 0x10>;
        clocks = <&clk 17>;
        #address-cells = <1>;
        #size-cells = <0>;
    };
```

## Documentation/devicetree/bindings/spi/marvell,armada-3700-spi.yaml
```yaml
# SPDX-License-Identifier: (GPL-2.0-only OR BSD-2-Clause)
%YAML 1.2
---
$id: http://devicetree.org/schemas/spi/marvell,armada-3700-spi.yaml#
$schema: http://devicetree.org/meta-schemas/core.yaml#

title: Marvell Armada 3700 SPI Controller

description:
  The SPI controller on Marvell Armada 3700 SoC.

maintainers:
  - Kousik Sanagavarapu <five231003@gmail.com>

allOf:
  - $ref: spi-controller.yaml#

properties:
  compatible:
    const: marvell,armada-3700-spi

  reg:
    maxItems: 1

  interrupts:
    maxItems: 1

  clocks:
    maxItems: 1

  num-cs:
    maxItems: 1

required:
  - compatible
  - reg
  - interrupts
  - clocks

unevaluatedProperties: false

examples:
  - |
    #include <dt-bindings/interrupt-controller/arm-gic.h>

    spi0: spi@10600 {
        compatible = "marvell,armada-3700-spi";
        #address-cells = <1>;
        #size-cells = <0>;
        reg = <0x10600 0x5d>;
        clocks = <&nb_perih_clk 7>;
        interrupts = <GIC_SPI 0 IRQ_TYPE_LEVEL_HIGH>;
        num-cs = <4>;
    };
...
```

## Documentation/devicetree/bindings/spi/marvell,mmp2-ssp.yaml
```yaml
# SPDX-License-Identifier: (GPL-2.0-only OR BSD-2-Clause)
# Copyright 2019,2020 Lubomir Rintel <lkundrak@v3.sk>
%YAML 1.2
---
$id: http://devicetree.org/schemas/spi/marvell,mmp2-ssp.yaml#
$schema: http://devicetree.org/meta-schemas/core.yaml#

title: PXA2xx SSP SPI Controller

maintainers:
  - Lubomir Rintel <lkundrak@v3.sk>

properties:
  compatible:
    enum:
      - marvell,mmp2-ssp
      - mrvl,ce4100-ssp
      - mvrl,pxa168-ssp
      - mrvl,pxa25x-ssp
      - mvrl,pxa25x-nssp
      - mrvl,pxa27x-ssp
      - mrvl,pxa3xx-ssp
      - mrvl,pxa910-ssp

  interrupts:
    maxItems: 1

  reg:
    maxItems: 1

  clocks:
    maxItems: 1

  dmas:
    items:
      - description: Receive DMA
      - description: Transmit DMA

  dma-names:
    items:
      - const: rx
      - const: tx

  ready-gpios:
    description: |
      GPIO used to signal a SPI master that the FIFO is filled and we're
      ready to service a transfer. Only useful in slave mode.
    maxItems: 1

required:
  - compatible
  - reg
  - interrupts
  - clocks

dependencies:
  ready-gpios: [ spi-slave ]

allOf:
  - $ref: spi-controller.yaml#
  - if:
      properties:
        compatible:
          contains:
            const: marvell,mmp2-ssp
    then:
      properties:
        dmas: false
        dma-names: false

unevaluatedProperties: false

examples:
  - |
    #include <dt-bindings/clock/marvell,mmp2.h>
    spi@d4035000 {
        compatible = "marvell,mmp2-ssp";
        #address-cells = <1>;
        #size-cells = <0>;
        reg = <0xd4035000 0x1000>;
        clocks = <&soc_clocks MMP2_CLK_SSP0>;
        interrupts = <0>;
    };

...
```
