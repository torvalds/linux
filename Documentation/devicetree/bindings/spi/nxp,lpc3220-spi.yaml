## Documentation/devicetree/bindings/spi/renesas,rspi.yaml
```yaml
# SPDX-License-Identifier: (GPL-2.0-only OR BSD-2-Clause)
%YAML 1.2
---
$id: http://devicetree.org/schemas/spi/renesas,rspi.yaml#
$schema: http://devicetree.org/meta-schemas/core.yaml#

title: Renesas (Quad) Serial Peripheral Interface (RSPI/QSPI)

maintainers:
  - Geert Uytterhoeven <geert+renesas@glider.be>

properties:
  compatible:
    oneOf:
      - items:
          - enum:
              - renesas,rspi-sh7757    # SH7757
          - const: renesas,rspi        # Legacy SH

      - items:
          - enum:
              - renesas,rspi-r7s72100  # RZ/A1H
              - renesas,rspi-r7s9210   # RZ/A2
          - const: renesas,rspi-rz     # RZ/A

      - items:
          - enum:
              - renesas,qspi-r8a7742   # RZ/G1H
              - renesas,qspi-r8a7743   # RZ/G1M
              - renesas,qspi-r8a7744   # RZ/G1N
              - renesas,qspi-r8a7745   # RZ/G1E
              - renesas,qspi-r8a77470  # RZ/G1C
              - renesas,qspi-r8a7790   # R-Car H2
              - renesas,qspi-r8a7791   # R-Car M2-W
              - renesas,qspi-r8a7792   # R-Car V2H
              - renesas,qspi-r8a7793   # R-Car M2-N
              - renesas,qspi-r8a7794   # R-Car E2
          - const: renesas,qspi        # R-Car Gen2 and RZ/G1

  reg:
    maxItems: 1

  interrupts:
    oneOf:
      - items:
          - description: A combined interrupt
      - items:
          - description: Error interrupt (SPEI)
          - description: Receive Interrupt (SPRI)
          - description: Transmit Interrupt (SPTI)

  interrupt-names:
    oneOf:
      - items:
          - const: mux
      - items:
          - const: error
          - const: rx
          - const: tx

  clocks:
    maxItems: 1

  power-domains:
    maxItems: 1

  resets:
    maxItems: 1

  dmas:
    minItems: 2
    maxItems: 4
    description:
      Must contain a list of pairs of references to DMA specifiers, one for
      transmission, and one for reception.

  dma-names:
    minItems: 2
    maxItems: 4
    items:
      enum:
        - tx
        - rx

  num-cs:
    description: |
      Total number of native chip selects.
      Hardware limitations related to chip selects:
        - When using GPIO chip selects, at least one native chip select must
          be left unused, as it will be driven anyway.
    minimum: 1
    maximum: 2
    default: 1

required:
  - compatible
  - reg
  - interrupts
  - clocks
  - power-domains
  - '#address-cells'
  - '#size-cells'

allOf:
  - $ref: spi-controller.yaml#
  - if:
      properties:
        compatible:
          contains:
            enum:
              - renesas,rspi-rz
    then:
      properties:
        interrupts:
          minItems: 3
      required:
        - interrupt-names

  - if:
      properties:
        compatible:
          contains:
            enum:
              - renesas,qspi
    then:
      required:
        - resets

unevaluatedProperties: false

examples:
  - |
    #include <dt-bindings/clock/r8a7791-cpg-mssr.h>
    #include <dt-bindings/interrupt-controller/arm-gic.h>
    #include <dt-bindings/power/r8a7791-sysc.h>

    qspi: spi@e6b10000 {
            compatible = "renesas,qspi-r8a7791", "renesas,qspi";
            reg = <0xe6b10000 0x2c>;
            interrupts = <GIC_SPI 184 IRQ_TYPE_LEVEL_HIGH>;
            clocks = <&cpg CPG_MOD 917>;
            dmas = <&dmac0 0x17>, <&dmac0 0x18>, <&dmac1 0x17>, <&dmac1 0x18>;
            dma-names = "tx", "rx", "tx", "rx";
            power-domains = <&sysc R8A7791_PD_ALWAYS_ON>;
            resets = <&cpg 917>;
            num-cs = <1>;
            #address-cells = <1>;
            #size-cells = <0>;
    };
```

## Documentation/devicetree/bindings/spi/renesas,rzn1-spi.txt
```
Renesas RZ/N1 SPI Controller

This controller is based on the Synopsys DW Synchronous Serial Interface and
inherits all properties defined in snps,dw-apb-ssi.txt except for the
compatible property.

Required properties:
- compatible : The device specific string followed by the generic RZ/N1 string.
   Therefore it must be one of:
   "renesas,r9a06g032-spi", "renesas,rzn1-spi"
   "renesas,r9a06g033-spi", "renesas,rzn1-spi"
```

## Documentation/devicetree/bindings/spi/renesas,rzv2h-rspi.yaml
```yaml
# SPDX-License-Identifier: (GPL-2.0-only OR BSD-2-Clause)
%YAML 1.2
---
$id: http://devicetree.org/schemas/spi/renesas,rzv2h-rspi.yaml#
$schema: http://devicetree.org/meta-schemas/core.yaml#

title: Renesas RZ/V2H(P) Renesas Serial Peripheral Interface (RSPI)

maintainers:
  - Fabrizio Castro <fabrizio.castro.jz@renesas.com>

properties:
  compatible:
    oneOf:
      - enum:
          - renesas,r9a09g057-rspi # RZ/V2H(P)
          - renesas,r9a09g077-rspi # RZ/T2H
      - items:
          - const: renesas,r9a09g056-rspi # RZ/V2N
          - const: renesas,r9a09g057-rspi
      - items:
          - const: renesas,r9a09g087-rspi # RZ/N2H
          - const: renesas,r9a09g077-rspi # RZ/T2H

  reg:
    maxItems: 1

  interrupts:
    items:
      - description: Idle Interrupt
      - description: Error Interrupt
      - description: Communication End Interrupt
      - description: Receive Buffer Full Interrupt
      - description: Transmit Buffer Empty Interrupt

  interrupt-names:
    items:
      - const: idle
      - const: error
      - const: end
      - const: rx
      - const: tx

  clocks:
    minItems: 2
    maxItems: 3

  clock-names:
    minItems: 2
    maxItems: 3

  resets:
    maxItems: 2

  reset-names:
    items:
      - const: presetn
      - const: tresetn

  dmas:
    maxItems: 2

  dma-names:
    items:
      - const: rx
      - const: tx

  power-domains:
    maxItems: 1

required:
  - compatible
  - reg
  - interrupts
  - interrupt-names
  - clocks
  - clock-names
  - power-domains
  - '#address-cells'
  - '#size-cells'

allOf:
  - $ref: spi-controller.yaml#
  - if:
      properties:
        compatible:
          contains:
            enum:
              - renesas,r9a09g057-rspi
    then:
      properties:
        clocks:
          minItems: 3

        clock-names:
          items:
            - const: pclk
            - const: pclk_sfr
            - const: tclk

      required:
        - resets
        - reset-names

  - if:
      properties:
        compatible:
          contains:
            enum:
              - renesas,r9a09g077-rspi
    then:
      properties:
        clocks:
          maxItems: 2

        clock-names:
          items:
            - const: pclk
            - const: pclkspi

        resets: false
        reset-names: false

unevaluatedProperties: false

examples:
  - |
    #include <dt-bindings/interrupt-controller/arm-gic.h>
    #include <dt-bindings/clock/renesas-cpg-mssr.h>
    spi@12800800 {
        compatible = "renesas,r9a09g057-rspi";

        reg = <0x12800800 0x400>;
        interrupts = <GIC_SPI 111 IRQ_TYPE_LEVEL_HIGH>,
                     <GIC_SPI 112 IRQ_TYPE_LEVEL_HIGH>,
                     <GIC_SPI 113 IRQ_TYPE_EDGE_RISING>,
                     <GIC_SPI 504 IRQ_TYPE_EDGE_RISING>,
                     <GIC_SPI 505 IRQ_TYPE_EDGE_RISING>;
        interrupt-names = "idle", "error", "end", "rx", "tx";
        clocks = <&cpg CPG_MOD 0x5a>,
                 <&cpg CPG_MOD 0x5b>,
                 <&cpg CPG_MOD 0x5c>;
        clock-names = "pclk", "pclk_sfr", "tclk";
        resets = <&cpg 0x7f>, <&cpg 0x80>;
        reset-names = "presetn", "tresetn";
        power-domains = <&cpg>;
        #address-cells = <1>;
        #size-cells = <0>;
    };
```

## Documentation/devicetree/bindings/spi/renesas,rzv2m-csi.yaml
```yaml
# SPDX-License-Identifier: (GPL-2.0-only OR BSD-2-Clause)
%YAML 1.2
---
$id: http://devicetree.org/schemas/spi/renesas,rzv2m-csi.yaml#
$schema: http://devicetree.org/meta-schemas/core.yaml#

title: Renesas RZ/V2M Clocked Serial Interface (CSI)

maintainers:
  - Fabrizio Castro <fabrizio.castro.jz@renesas.com>
  - Geert Uytterhoeven <geert+renesas@glider.be>

allOf:
  - $ref: spi-controller.yaml#

properties:
  compatible:
    const: renesas,rzv2m-csi

  reg:
    maxItems: 1

  interrupts:
    maxItems: 1

  clocks:
    items:
      - description: The clock used to generate the output clock (CSICLK)
      - description: Internal clock to access the registers (PCLK)

  clock-names:
    items:
      - const: csiclk
      - const: pclk

  resets:
    maxItems: 1

  power-domains:
    maxItems: 1

required:
  - compatible
  - reg
  - interrupts
  - clocks
  - clock-names
  - resets
  - power-domains
  - '#address-cells'
  - '#size-cells'

unevaluatedProperties: false

examples:
  - |
    #include <dt-bindings/interrupt-controller/arm-gic.h>
    #include <dt-bindings/clock/r9a09g011-cpg.h>
    csi4: spi@a4020200 {
        compatible = "renesas,rzv2m-csi";
        reg = <0xa4020200 0x80>;
        interrupts = <GIC_SPI 230 IRQ_TYPE_LEVEL_HIGH>;
        clocks = <&cpg CPG_MOD R9A09G011_CSI4_CLK>,
                 <&cpg CPG_MOD R9A09G011_CPERI_GRPH_PCLK>;
        clock-names = "csiclk", "pclk";
        resets = <&cpg R9A09G011_CSI_GPH_PRESETN>;
        power-domains = <&cpg>;
        #address-cells = <1>;
        #size-cells = <0>;
    };
```

## Documentation/devicetree/bindings/spi/renesas,sh-msiof.yaml
```yaml
# SPDX-License-Identifier: GPL-2.0
%YAML 1.2
---
$id: http://devicetree.org/schemas/spi/renesas,sh-msiof.yaml#
$schema: http://devicetree.org/meta-schemas/core.yaml#

title: Renesas MSIOF SPI controller

maintainers:
  - Geert Uytterhoeven <geert+renesas@glider.be>

allOf:
  - $ref: spi-controller.yaml#

properties:
  compatible:
    oneOf:
      - items:
          - const: renesas,msiof-sh73a0     # SH-Mobile AG5
          - const: renesas,sh-mobile-msiof  # generic SH-Mobile compatible
                                            # device
      - items:
          - enum:
              - renesas,msiof-r8a7742       # RZ/G1H
              - renesas,msiof-r8a7743       # RZ/G1M
              - renesas,msiof-r8a7744       # RZ/G1N
              - renesas,msiof-r8a7745       # RZ/G1E
              - renesas,msiof-r8a77470      # RZ/G1C
              - renesas,msiof-r8a7790       # R-Car H2
              - renesas,msiof-r8a7791       # R-Car M2-W
              - renesas,msiof-r8a7792       # R-Car V2H
              - renesas,msiof-r8a7793       # R-Car M2-N
              - renesas,msiof-r8a7794       # R-Car E2
          - const: renesas,rcar-gen2-msiof  # generic R-Car Gen2 and RZ/G1
                                            # compatible device
      - items:
          - enum:
              - renesas,msiof-r8a774a1      # RZ/G2M
              - renesas,msiof-r8a774b1      # RZ/G2N
              - renesas,msiof-r8a774c0      # RZ/G2E
              - renesas,msiof-r8a774e1      # RZ/G2H
              - renesas,msiof-r8a7795       # R-Car H3
              - renesas,msiof-r8a7796       # R-Car M3-W
              - renesas,msiof-r8a77961      # R-Car M3-W+
              - renesas,msiof-r8a77965      # R-Car M3-N
              - renesas,msiof-r8a77970      # R-Car V3M
              - renesas,msiof-r8a77980      # R-Car V3H
              - renesas,msiof-r8a77990      # R-Car E3
              - renesas,msiof-r8a77995      # R-Car D3
          - const: renesas,rcar-gen3-msiof  # generic R-Car Gen3 and RZ/G2
                                            # compatible device
      - items:
          - const: renesas,sh-msiof  # deprecated

  reg:
    minItems: 1
    maxItems: 2
    oneOf:
      - items:
          - description: CPU and DMA engine registers
      - items:
          - description: CPU registers
          - description: DMA engine registers

  interrupts:
    maxItems: 1

  clocks:
    maxItems: 1

  num-cs:
    description: |
      Total number of chip selects (default is 1).
      Up to 3 native chip selects are supported:
        0: MSIOF_SYNC
        1: MSIOF_SS1
        2: MSIOF_SS2
      Hardware limitations related to chip selects:
        - Native chip selects are always deasserted in between transfers
          that are part of the same message.  Use cs-gpios to work around
          this.
        - All slaves using native chip selects must use the same spi-cs-high
          configuration.  Use cs-gpios to work around this.
        - When using GPIO chip selects, at least one native chip select must
          be left unused, as it will be driven anyway.
    minimum: 1
    maximum: 3
    default: 1

  dmas:
    minItems: 2
    maxItems: 4

  dma-names:
    minItems: 2
    maxItems: 4
    items:
      enum: [ tx, rx ]

  renesas,dtdl:
    description: delay sync signal (setup) in transmit mode.
    $ref: /schemas/types.yaml#/definitions/uint32
    enum:
      - 0        # no bit delay
      - 50       # 0.5-clock-cycle delay
      - 100      # 1-clock-cycle delay
      - 150      # 1.5-clock-cycle delay
      - 200      # 2-clock-cycle delay

  renesas,syncdl:
    description: delay sync signal (hold) in transmit mode
    $ref: /schemas/types.yaml#/definitions/uint32
    enum:
      - 0        # no bit delay
      - 50       # 0.5-clock-cycle delay
      - 100      # 1-clock-cycle delay
      - 150      # 1.5-clock-cycle delay
      - 200      # 2-clock-cycle delay
      - 300      # 3-clock-cycle delay

  renesas,tx-fifo-size:
    # deprecated for soctype-specific bindings
    description: |
      Override the default TX fifo size.  Unit is words.  Ignored if 0.
    $ref: /schemas/types.yaml#/definitions/uint32
    maxItems: 1
    default: 64

  renesas,rx-fifo-size:
    # deprecated for soctype-specific bindings
    description: |
      Override the default RX fifo size.  Unit is words.  Ignored if 0.
    $ref: /schemas/types.yaml#/definitions/uint32
    maxItems: 1
    default: 64

required:
  - compatible
  - reg
  - interrupts
  - '#address-cells'
  - '#size-cells'

examples:
  - |
    #include <dt-bindings/clock/r8a7791-clock.h>
    #include <dt-bindings/interrupt-controller/irq.h>

    msiof0: spi@e6e20000 {
        compatible = "renesas,msiof-r8a7791", "renesas,rcar-gen2-msiof";
        reg = <0xe6e20000 0x0064>;
        interrupts = <0 156 IRQ_TYPE_LEVEL_HIGH>;
        clocks = <&mstp0_clks R8A7791_CLK_MSIOF0>;
        dmas = <&dmac0 0x51>, <&dmac0 0x52>;
        dma-names = "tx", "rx";
        #address-cells = <1>;
        #size-cells = <0>;
    };
```
