## Documentation/devicetree/bindings/spi/qcom,spi-qcom-qspi.yaml
```yaml
# SPDX-License-Identifier: (GPL-2.0 OR BSD-2-Clause)

%YAML 1.2
---
$id: "http://devicetree.org/schemas/spi/qcom,spi-qcom-qspi.yaml#"
$schema: "http://devicetree.org/meta-schemas/core.yaml#"

title: Qualcomm Quad Serial Peripheral Interface (QSPI)

maintainers:
  - Mukesh Savaliya <msavaliy@codeaurora.org>
  - Akash Asthana <akashast@codeaurora.org>

description: The QSPI controller allows SPI protocol communication in single,
  dual, or quad wire transmission modes for read/write access to slaves such
  as NOR flash.

allOf:
  - $ref: /spi/spi-controller.yaml#

properties:
  compatible:
    items:
      - const: qcom,sdm845-qspi
      - const: qcom,qspi-v1

  reg:
    maxItems: 1

  interrupts:
    maxItems: 1

  clock-names:
    items:
      - const: iface
      - const: core

  clocks:
    items:
      - description: AHB clock
      - description: QSPI core clock

  interconnects:
    minItems: 1
    maxItems: 2

  interconnect-names:
    minItems: 1
    items:
      - const: qspi-config
      - const: qspi-memory

required:
  - compatible
  - reg
  - interrupts
  - clock-names
  - clocks

unevaluatedProperties: false

examples:
  - |
    #include <dt-bindings/clock/qcom,gcc-sdm845.h>
    #include <dt-bindings/interrupt-controller/arm-gic.h>

    soc: soc {
        #address-cells = <2>;
        #size-cells = <2>;

        qspi: spi@88df000 {
            compatible = "qcom,sdm845-qspi", "qcom,qspi-v1";
            reg = <0 0x88df000 0 0x600>;
            #address-cells = <1>;
            #size-cells = <0>;
            interrupts = <GIC_SPI 82 IRQ_TYPE_LEVEL_HIGH>;
            clock-names = "iface", "core";
            clocks = <&gcc GCC_QSPI_CNOC_PERIPH_AHB_CLK>,
                         <&gcc GCC_QSPI_CORE_CLK>;

            flash@0 {
                compatible = "jedec,spi-nor";
                reg = <0>;
                spi-max-frequency = <25000000>;
                spi-tx-bus-width = <2>;
                spi-rx-bus-width = <2>;
            };

        };
    };
...
```

## Documentation/devicetree/bindings/spi/qcom,spi-qpic-snand.yaml
```yaml
# SPDX-License-Identifier: (GPL-2.0-only OR BSD-2-Clause)
%YAML 1.2
---
$id: http://devicetree.org/schemas/spi/qcom,spi-qpic-snand.yaml#
$schema: http://devicetree.org/meta-schemas/core.yaml#

title: Qualcomm QPIC NAND controller

maintainers:
  - Md sadre Alam <quic_mdalam@quicinc.com>

description:
  The QCOM QPIC-SPI-NAND flash controller is an extended version of
  the QCOM QPIC NAND flash controller. It can work both in serial
  and parallel mode. It supports typical SPI-NAND page cache
  operations in single, dual or quad IO mode with pipelined ECC
  encoding/decoding using the QPIC ECC HW engine.

allOf:
  - $ref: /schemas/spi/spi-controller.yaml#

properties:
  compatible:
    enum:
      - qcom,ipq9574-snand

  reg:
    maxItems: 1

  clocks:
    maxItems: 3

  clock-names:
    items:
      - const: core
      - const: aon
      - const: iom

  dmas:
    items:
      - description: tx DMA channel
      - description: rx DMA channel
      - description: cmd DMA channel

  dma-names:
    items:
      - const: tx
      - const: rx
      - const: cmd

required:
  - compatible
  - reg
  - clocks
  - clock-names

unevaluatedProperties: false

examples:
  - |
    #include <dt-bindings/clock/qcom,ipq9574-gcc.h>
    spi@79b0000 {
        compatible = "qcom,ipq9574-snand";
        reg = <0x1ac00000 0x800>;

        clocks = <&gcc GCC_QPIC_CLK>,
                 <&gcc GCC_QPIC_AHB_CLK>,
                 <&gcc GCC_QPIC_IO_MACRO_CLK>;
        clock-names = "core", "aon", "iom";

        #address-cells = <1>;
        #size-cells = <0>;

        flash@0 {
            compatible = "spi-nand";
            reg = <0>;
            #address-cells = <1>;
            #size-cells = <1>;
            nand-ecc-engine = <&qpic_nand>;
            nand-ecc-strength = <4>;
            nand-ecc-step-size = <512>;
        };
    };
```

## Documentation/devicetree/bindings/spi/qcom,spi-qup.txt
```
Qualcomm Universal Peripheral (QUP) Serial Peripheral Interface (SPI)

The QUP core is an AHB slave that provides a common data path (an output FIFO
and an input FIFO) for serial peripheral interface (SPI) mini-core.

SPI in master mode supports up to 50MHz, up to four chip selects, programmable
data path from 4 bits to 32 bits and numerous protocol variants.

Required properties:
- compatible:     Should contain "qcom,spi-qup-v2.1.1" or "qcom,spi-qup-v2.2.1"
- reg:            Should contain base register location and length
- interrupts:     Interrupt number used by this controller

- clocks:         Should contain the core clock and the AHB clock.
- clock-names:    Should be "core" for the core clock and "iface" for the
                  AHB clock.

- #address-cells: Number of cells required to define a chip select
                  address on the SPI bus. Should be set to 1.
- #size-cells:    Should be zero.

Optional properties:
- spi-max-frequency: Specifies maximum SPI clock frequency,
                     Units - Hz. Definition as per
                     Documentation/devicetree/bindings/spi/spi-bus.txt
- num-cs:	total number of chipselects
- cs-gpios:	should specify GPIOs used for chipselects.
		The gpios will be referred to as reg = <index> in the SPI child
		nodes.  If unspecified, a single SPI device without a chip
		select can be used.


SPI slave nodes must be children of the SPI master node and can contain
properties described in Documentation/devicetree/bindings/spi/spi-bus.txt

Example:

	spi_8: spi@f9964000 { /* BLSP2 QUP2 */

		compatible = "qcom,spi-qup-v2";
		#address-cells = <1>;
		#size-cells = <0>;
		reg = <0xf9964000 0x1000>;
		interrupts = <0 102 0>;
		spi-max-frequency = <19200000>;

		clocks = <&gcc GCC_BLSP2_QUP2_SPI_APPS_CLK>, <&gcc GCC_BLSP2_AHB_CLK>;
		clock-names = "core", "iface";

		pinctrl-names = "default";
		pinctrl-0 = <&spi8_default>;

		device@0 {
			compatible = "arm,pl022-dummy";
			#address-cells = <1>;
			#size-cells = <1>;
			reg = <0>; /* Chip select 0 */
			spi-max-frequency = <19200000>;
			spi-cpol;
		};

		device@1 {
			compatible = "arm,pl022-dummy";
			#address-cells = <1>;
			#size-cells = <1>;
			reg = <1>; /* Chip select 1 */
			spi-max-frequency = <9600000>;
			spi-cpha;
		};

		device@2 {
			compatible = "arm,pl022-dummy";
			#address-cells = <1>;
			#size-cells = <1>;
			reg = <2>; /* Chip select 2 */
			spi-max-frequency = <19200000>;
			spi-cpol;
			spi-cpha;
		};

		device@3 {
			compatible = "arm,pl022-dummy";
			#address-cells = <1>;
			#size-cells = <1>;
			reg = <3>; /* Chip select 3 */
			spi-max-frequency = <19200000>;
			spi-cpol;
			spi-cpha;
			spi-cs-high;
		};
	};
```

## Documentation/devicetree/bindings/spi/qcom,spi-qup.yaml
```yaml
# SPDX-License-Identifier: (GPL-2.0 OR BSD-2-Clause)
%YAML 1.2
---
$id: http://devicetree.org/schemas/spi/qcom,spi-qup.yaml#
$schema: http://devicetree.org/meta-schemas/core.yaml#

title: Qualcomm Universal Peripheral (QUP) Serial Peripheral Interface (SPI)

maintainers:
  - Andy Gross <agross@kernel.org>
  - Bjorn Andersson <bjorn.andersson@linaro.org>
  - Krzysztof Kozlowski <krzysztof.kozlowski@linaro.org>

description:
  The QUP core is an AHB slave that provides a common data path (an output FIFO
  and an input FIFO) for serial peripheral interface (SPI) mini-core.

  SPI in master mode supports up to 50MHz, up to four chip selects,
  programmable data path from 4 bits to 32 bits and numerous protocol variants.

allOf:
  - $ref: /schemas/spi/spi-controller.yaml#

properties:
  compatible:
    enum:
      - qcom,spi-qup-v1.1.1 # for 8660, 8960 and 8064
      - qcom,spi-qup-v2.1.1 # for 8974 and later
      - qcom,spi-qup-v2.2.1 # for 8974 v2 and later

  clocks:
    maxItems: 2

  clock-names:
    items:
      - const: core
      - const: iface

  dmas:
    maxItems: 2

  dma-names:
    items:
      - const: tx
      - const: rx

  interrupts:
    maxItems: 1

  reg:
    maxItems: 1

required:
  - compatible
  - clocks
  - clock-names
  - interrupts
  - reg

unevaluatedProperties: false

examples:
  - |
    #include <dt-bindings/clock/qcom,gcc-msm8996.h>
    #include <dt-bindings/interrupt-controller/arm-gic.h>

    spi@7575000 {
        compatible = "qcom,spi-qup-v2.2.1";
        reg = <0x07575000 0x600>;
        interrupts = <GIC_SPI 95 IRQ_TYPE_LEVEL_HIGH>;
        clocks = <&gcc GCC_BLSP1_QUP1_SPI_APPS_CLK>,
                 <&gcc GCC_BLSP1_AHB_CLK>;
        clock-names = "core", "iface";
        pinctrl-names = "default", "sleep";
        pinctrl-0 = <&blsp1_spi1_default>;
        pinctrl-1 = <&blsp1_spi1_sleep>;
        dmas = <&blsp1_dma 12>, <&blsp1_dma 13>;
        dma-names = "tx", "rx";
        #address-cells = <1>;
        #size-cells = <0>;
    };
```

## Documentation/devicetree/bindings/spi/ralink,mt7621-spi.yaml
```yaml
# SPDX-License-Identifier: (GPL-2.0-only OR BSD-2-Clause)
%YAML 1.2
---
$id: http://devicetree.org/schemas/spi/ralink,mt7621-spi.yaml#
$schema: http://devicetree.org/meta-schemas/core.yaml#

maintainers:
  - Sergio Paracuellos <sergio.paracuellos@gmail.com>

title: Mediatek MT7621/MT7628 SPI controller

allOf:
  - $ref: /schemas/spi/spi-controller.yaml#

properties:
  compatible:
    const: ralink,mt7621-spi

  reg:
    maxItems: 1

  clocks:
    maxItems: 1

  clock-names:
    const: spi

  resets:
    maxItems: 1

  reset-names:
    const: spi

required:
  - compatible
  - reg
  - resets
  - "#address-cells"
  - "#size-cells"

unevaluatedProperties: false

examples:
  - |
    #include <dt-bindings/clock/mt7621-clk.h>
    #include <dt-bindings/reset/mt7621-reset.h>

    spi@b00 {
      compatible = "ralink,mt7621-spi";
      reg = <0xb00 0x100>;
      clocks = <&sysc MT7621_CLK_SPI>;
      clock-names = "spi";
      resets = <&sysc MT7621_RST_SPI>;
      reset-names = "spi";

      #address-cells = <1>;
      #size-cells = <0>;

      pinctrl-names = "default";
      pinctrl-0 = <&spi_pins>;
    };
```

## Documentation/devicetree/bindings/spi/realtek,rtl-spi.yaml
```yaml
# SPDX-License-Identifier: (GPL-2.0-only OR BSD-2-Clause)
%YAML 1.2
---
$id: http://devicetree.org/schemas/spi/realtek,rtl-spi.yaml#
$schema: http://devicetree.org/meta-schemas/core.yaml#

title: Realtek RTL838x/RTL839x SPI controller

maintainers:
  - Bert Vermeulen <bert@biot.com>
  - Birger Koblitz <mail@birger-koblitz.de>

allOf:
  - $ref: "spi-controller.yaml#"

properties:
  compatible:
    oneOf:
      - const: realtek,rtl8380-spi
      - const: realtek,rtl8382-spi
      - const: realtek,rtl8391-spi
      - const: realtek,rtl8392-spi
      - const: realtek,rtl8393-spi

  reg:
    maxItems: 1

required:
  - compatible
  - reg

unevaluatedProperties: false

examples:
  - |
    spi: spi@1200 {
        compatible = "realtek,rtl8382-spi";
        reg = <0x1200 0x100>;
        #address-cells = <1>;
        #size-cells = <0>;
    };
```

## Documentation/devicetree/bindings/spi/realtek,rtl9301-snand.yaml
```yaml
# SPDX-License-Identifier: (GPL-2.0-only OR BSD-2-Clause)
%YAML 1.2
---
$id: http://devicetree.org/schemas/spi/realtek,rtl9301-snand.yaml#
$schema: http://devicetree.org/meta-schemas/core.yaml#

title: SPI-NAND Flash Controller for Realtek RTL9300 SoCs

maintainers:
  - Chris Packham <chris.packham@alliedtelesis.co.nz>

description:
  The Realtek RTL9300 SoCs have a built in SPI-NAND controller. It supports
  typical SPI-NAND page cache operations in single, dual or quad IO mode.

properties:
  compatible:
    oneOf:
      - items:
          - enum:
              - realtek,rtl9302b-snand
              - realtek,rtl9302c-snand
              - realtek,rtl9303-snand
          - const: realtek,rtl9301-snand
      - const: realtek,rtl9301-snand

  reg:
    maxItems: 1

  interrupts:
    maxItems: 1

  clocks:
    maxItems: 1

required:
  - compatible
  - reg
  - interrupts
  - clocks

allOf:
  - $ref: /schemas/spi/spi-controller.yaml#

unevaluatedProperties: false

examples:
  - |
    spi@1a400 {
      compatible = "realtek,rtl9302c-snand", "realtek,rtl9301-snand";
      reg = <0x1a400 0x44>;
      interrupt-parent = <&intc>;
      interrupts = <19>;
      clocks = <&lx_clk>;
      #address-cells = <1>;
      #size-cells = <0>;

      flash@0 {
        compatible = "spi-nand";
        reg = <0>;
      };
    };
```

## Documentation/devicetree/bindings/spi/renesas,hspi.yaml
```yaml
# SPDX-License-Identifier: GPL-2.0
%YAML 1.2
---
$id: http://devicetree.org/schemas/spi/renesas,hspi.yaml#
$schema: http://devicetree.org/meta-schemas/core.yaml#

title: Renesas HSPI

maintainers:
  - Geert Uytterhoeven <geert+renesas@glider.be>

allOf:
  - $ref: spi-controller.yaml#

properties:
  compatible:
    items:
      - enum:
          - renesas,hspi-r8a7778 # R-Car M1A
          - renesas,hspi-r8a7779 # R-Car H1
      - const: renesas,hspi

  reg:
    maxItems: 1

  interrupts:
    maxItems: 1

  clocks:
    maxItems: 1

  power-domains:
    maxItems: 1

required:
  - compatible
  - reg
  - interrupts
  - clocks
  - '#address-cells'
  - '#size-cells'

examples:
  - |
    #include <dt-bindings/clock/r8a7778-clock.h>
    #include <dt-bindings/interrupt-controller/irq.h>

    hspi0: spi@fffc7000 {
        compatible = "renesas,hspi-r8a7778", "renesas,hspi";
        reg = <0xfffc7000 0x18>;
        interrupts = <0 63 IRQ_TYPE_LEVEL_HIGH>;
        clocks = <&mstp0_clks R8A7778_CLK_HSPI>;
        power-domains = <&cpg_clocks>;
        #address-cells = <1>;
        #size-cells = <0>;
    };
```
