## Documentation/devicetree/bindings/spi/nxp,lpc3220-spi.yaml
```yaml
# SPDX-License-Identifier: (GPL-2.0-only OR BSD-2-Clause)
%YAML 1.2
---
$id: http://devicetree.org/schemas/spi/nxp,lpc3220-spi.yaml#
$schema: http://devicetree.org/meta-schemas/core.yaml#

title: NXP LPC3220 SPI controller

maintainers:
  - Frank Li <Frank.Li@nxp.com>

properties:
  compatible:
    enum:
      - nxp,lpc3220-spi

  reg:
    maxItems: 1

  clocks:
    maxItems: 1

allOf:
  - $ref: spi-controller.yaml#

unevaluatedProperties: false

required:
  - compatible
  - reg
  - clocks

examples:
  - |
    #include <dt-bindings/clock/lpc32xx-clock.h>

    spi@20088000 {
        compatible = "nxp,lpc3220-spi";
        reg = <0x20088000 0x1000>;
        clocks = <&clk LPC32XX_CLK_SPI1>;
        #address-cells = <1>;
        #size-cells = <0>;
    };
```

## Documentation/devicetree/bindings/spi/nxp,sc18is.yaml
```yaml
# SPDX-License-Identifier: (GPL-2.0-only OR BSD-2-Clause)
%YAML 1.2
---
$id: http://devicetree.org/schemas/spi/nxp,sc18is.yaml#
$schema: http://devicetree.org/meta-schemas/core.yaml#

title: NXP SC18IS602/SC18IS603 I2C to SPI bridge

maintainers:
  - Frank Li <Frank.Li@nxp.com>

properties:
  compatible:
    enum:
      - nxp,sc18is602
      - nxp,sc18is602b
      - nxp,sc18is603

  reg:
    maxItems: 1

  clock-frequency:
    $ref: /schemas/types.yaml#/definitions/uint32
    default: 7372000
    description:
      external oscillator clock frequency. The clock-frequency property is
      relevant and needed only if the chip has an external oscillator
      (SC18IS603).

allOf:
  - $ref: spi-controller.yaml#

unevaluatedProperties: false

required:
  - compatible
  - reg

examples:
  - |
    i2c {
        #address-cells = <1>;
        #size-cells = <0>;

        spi@28 {
            compatible = "nxp,sc18is603";
            reg = <0x28>;
            clock-frequency = <14744000>;
        };
    };
```

## Documentation/devicetree/bindings/spi/omap-spi.txt
```
OMAP2+ McSPI device

Required properties:
- compatible :
  - "ti,am654-mcspi" for AM654.
  - "ti,omap2-mcspi" for OMAP2 & OMAP3.
  - "ti,omap4-mcspi" for OMAP4+.
- ti,spi-num-cs : Number of chipselect supported  by the instance.
- ti,hwmods: Name of the hwmod associated to the McSPI
- ti,pindir-d0-out-d1-in: Select the D0 pin as output and D1 as
			  input. The default is D0 as input and
			  D1 as output.

Optional properties:
- dmas: List of DMA specifiers with the controller specific format
	as described in the generic DMA client binding. A tx and rx
	specifier is required for each chip select.
- dma-names: List of DMA request names. These strings correspond
	1:1 with the DMA specifiers listed in dmas. The string naming
	is to be "rxN" and "txN" for RX and TX requests,
	respectively, where N equals the chip select number.

Examples:

[hwmod populated DMA resources]

mcspi1: mcspi@1 {
    #address-cells = <1>;
    #size-cells = <0>;
    compatible = "ti,omap4-mcspi";
    ti,hwmods = "mcspi1";
    ti,spi-num-cs = <4>;
};

[generic DMA request binding]

mcspi1: mcspi@1 {
    #address-cells = <1>;
    #size-cells = <0>;
    compatible = "ti,omap4-mcspi";
    ti,hwmods = "mcspi1";
    ti,spi-num-cs = <2>;
    dmas = <&edma 42
	    &edma 43
	    &edma 44
	    &edma 45>;
    dma-names = "tx0", "rx0", "tx1", "rx1";
};
```

## Documentation/devicetree/bindings/spi/omap-spi.yaml
```yaml
# SPDX-License-Identifier: (GPL-2.0-only OR BSD-2-Clause)
%YAML 1.2
---
$id: http://devicetree.org/schemas/spi/omap-spi.yaml#
$schema: http://devicetree.org/meta-schemas/core.yaml#

title: SPI controller bindings for OMAP and K3 SoCs

maintainers:
  - Aswath Govindraju <a-govindraju@ti.com>

allOf:
  - $ref: spi-controller.yaml#

properties:
  compatible:
    oneOf:
      - items:
          - enum:
              - ti,am654-mcspi
              - ti,am4372-mcspi
          - const: ti,omap4-mcspi
      - items:
          - enum:
              - ti,omap2-mcspi
              - ti,omap4-mcspi

  reg:
    maxItems: 1

  interrupts:
    maxItems: 1

  clocks:
    maxItems: 1

  power-domains:
    maxItems: 1

  ti,spi-num-cs:
    $ref: /schemas/types.yaml#/definitions/uint32
    description: Number of chipselect supported  by the instance.
    minimum: 1
    maximum: 4

  ti,hwmods:
    $ref: /schemas/types.yaml#/definitions/string
    description:
      Must be "mcspi<n>", n being the instance number (1-based).
      This property is applicable only on legacy platforms mainly omap2/3
      and ti81xx and should not be used on other platforms.
    deprecated: true

  ti,pindir-d0-out-d1-in:
    description:
      Select the D0 pin as output and D1 as input. The default is D0
      as input and D1 as output.
    type: boolean

  dmas:
    description:
      List of DMA specifiers with the controller specific format as
      described in the generic DMA client binding. A tx and rx
      specifier is required for each chip select.
    minItems: 1
    maxItems: 8

  dma-names:
    description:
      List of DMA request names. These strings correspond 1:1 with
      the DMA sepecifiers listed in dmas. The string names is to be
      "rxN" and "txN" for RX and TX requests, respectively. Where N
      is the chip select number.
    minItems: 1
    maxItems: 8

required:
  - compatible
  - reg
  - interrupts

unevaluatedProperties: false

if:
  properties:
    compatible:
      enum:
        - ti,omap2-mcspi
        - ti,omap4-mcspi

then:
  properties:
    ti,hwmods:
      items:
        - pattern: "^mcspi([1-9])$"

else:
  properties:
    ti,hwmods: false

examples:
  - |
    #include <dt-bindings/interrupt-controller/irq.h>
    #include <dt-bindings/interrupt-controller/arm-gic.h>
    #include <dt-bindings/soc/ti,sci_pm_domain.h>

    spi@2100000 {
      compatible = "ti,am654-mcspi","ti,omap4-mcspi";
      reg = <0x2100000 0x400>;
      interrupts = <GIC_SPI 184 IRQ_TYPE_LEVEL_HIGH>;
      clocks = <&k3_clks 137 1>;
      power-domains = <&k3_pds 137 TI_SCI_PD_EXCLUSIVE>;
      #address-cells = <1>;
      #size-cells = <0>;
      dmas = <&main_udmap 0xc500>, <&main_udmap 0x4500>;
      dma-names = "tx0", "rx0";
    };
```

## Documentation/devicetree/bindings/spi/qca,ar934x-spi.yaml
```yaml
# SPDX-License-Identifier: GPL-2.0
%YAML 1.2
---
$id: http://devicetree.org/schemas/spi/qca,ar934x-spi.yaml#
$schema: http://devicetree.org/meta-schemas/core.yaml#

title: Qualcomm Atheros AR934x/QCA95xx SoC SPI controller

maintainers:
  - Chuanhong Guo <gch981213@gmail.com>

allOf:
  - $ref: spi-controller.yaml#

properties:
  compatible:
    const: qca,ar934x-spi

  reg:
    maxItems: 1

  clocks:
    maxItems: 1

required:
  - compatible
  - reg
  - clocks
  - '#address-cells'
  - '#size-cells'

examples:
  - |
    #include <dt-bindings/clock/ath79-clk.h>
    spi: spi@1f000000 {
        compatible = "qca,ar934x-spi";
        reg = <0x1f000000 0x1c>;
        clocks = <&pll ATH79_CLK_AHB>;
        #address-cells = <1>;
        #size-cells = <0>;
    };
```

## Documentation/devicetree/bindings/spi/qcom,sa8255p-geni-spi.yaml
```yaml
# SPDX-License-Identifier: (GPL-2.0 OR BSD-2-Clause)
%YAML 1.2
---
$id: http://devicetree.org/schemas/spi/qcom,sa8255p-geni-spi.yaml#
$schema: http://devicetree.org/meta-schemas/core.yaml#

title: GENI based Qualcomm Universal Peripheral (QUP) Serial Peripheral Interface (SPI)

maintainers:
  - Praveen Talari <praveen.talari@oss.qualcomm.com>

properties:
  compatible:
    oneOf:
      - const: qcom,sa8255p-geni-spi
      - items:
          - const: qcom,sa8797p-geni-spi
          - const: qcom,sa8255p-geni-spi

  reg:
    maxItems: 1

  dmas:
    maxItems: 2

  dma-names:
    items:
      - const: tx
      - const: rx

  interrupts:
    maxItems: 1

  power-domains:
    maxItems: 2

  power-domain-names:
    items:
      - const: power
      - const: perf

required:
  - compatible
  - reg
  - interrupts
  - power-domains
  - power-domain-names

allOf:
  - $ref: /schemas/spi/spi-controller.yaml#

unevaluatedProperties: false

examples:
  - |
    #include <dt-bindings/interrupt-controller/arm-gic.h>
    #include <dt-bindings/dma/qcom-gpi.h>

    spi@888000 {
        compatible = "qcom,sa8255p-geni-spi";
        reg = <0x888000 0x4000>;
        interrupts = <GIC_SPI 584 IRQ_TYPE_LEVEL_HIGH>;
        dmas = <&gpi_dma0 0 0 QCOM_GPI_SPI>,
               <&gpi_dma0 1 0 QCOM_GPI_SPI>;
        dma-names = "tx", "rx";
        power-domains = <&scmi0_pd 0>, <&scmi0_dvfs 0>;
        power-domain-names = "power", "perf";
    };
```

## Documentation/devicetree/bindings/spi/qcom,spi-geni-qcom.txt
```
GENI based Qualcomm Universal Peripheral (QUP) Serial Peripheral Interface (SPI)

The QUP v3 core is a GENI based AHB slave that provides a common data path
(an output FIFO and an input FIFO) for serial peripheral interface (SPI)
mini-core.

SPI in master mode supports up to 50MHz, up to four chip selects, programmable
data path from 4 bits to 32 bits and numerous protocol variants.

Required properties:
- compatible:		Must contain "qcom,geni-spi".
- reg:			Must contain SPI register location and length.
- interrupts:		Must contain SPI controller interrupts.
- clock-names:		Must contain "se".
- clocks:		Serial engine core clock needed by the device.
- #address-cells:	Must be <1> to define a chip select address on
			the SPI bus.
- #size-cells:		Must be <0>.

SPI Controller nodes must be child of GENI based Qualcomm Universal
Peripharal. Please refer GENI based QUP wrapper controller node bindings
described in Documentation/devicetree/bindings/soc/qcom/qcom,geni-se.yaml.

SPI slave nodes must be children of the SPI master node and conform to SPI bus
binding as described in Documentation/devicetree/bindings/spi/spi-bus.txt.

Example:
	spi0: spi@a84000 {
		compatible = "qcom,geni-spi";
		reg = <0xa84000 0x4000>;
		interrupts = <GIC_SPI 354 IRQ_TYPE_LEVEL_HIGH>;
		clock-names = "se";
		clocks = <&clock_gcc GCC_QUPV3_WRAP0_S0_CLK>;
		pinctrl-names = "default", "sleep";
		pinctrl-0 = <&qup_1_spi_2_active>;
		pinctrl-1 = <&qup_1_spi_2_sleep>;
		#address-cells = <1>;
		#size-cells = <0>;
	};
```

## Documentation/devicetree/bindings/spi/qcom,spi-geni-qcom.yaml
```yaml
# SPDX-License-Identifier: (GPL-2.0 OR BSD-2-Clause)
%YAML 1.2
---
$id: http://devicetree.org/schemas/spi/qcom,spi-geni-qcom.yaml#
$schema: http://devicetree.org/meta-schemas/core.yaml#

title: GENI based Qualcomm Universal Peripheral (QUP) Serial Peripheral Interface (SPI)

maintainers:
  - Andy Gross <agross@kernel.org>
  - Bjorn Andersson <bjorn.andersson@linaro.org>
  - Krzysztof Kozlowski <krzysztof.kozlowski@linaro.org>

description:
  The QUP v3 core is a GENI based AHB slave that provides a common data path
  (an output FIFO and an input FIFO) for serial peripheral interface (SPI)
  mini-core.

  SPI in master mode supports up to 50MHz, up to four chip selects,
  programmable data path from 4 bits to 32 bits and numerous protocol variants.

  SPI Controller nodes must be child of GENI based Qualcomm Universal
  Peripharal. Please refer GENI based QUP wrapper controller node bindings
  described in Documentation/devicetree/bindings/soc/qcom/qcom,geni-se.yaml.

allOf:
  - $ref: /schemas/spi/spi-controller.yaml#

properties:
  compatible:
    const: qcom,geni-spi

  clocks:
    maxItems: 1

  clock-names:
    const: se

  dmas:
    maxItems: 2

  dma-names:
    items:
      - const: tx
      - const: rx

  interconnects:
    minItems: 2
    maxItems: 3

  interconnect-names:
    minItems: 2
    items:
      - const: qup-core
      - const: qup-config
      - const: qup-memory

  interrupts:
    maxItems: 1

  operating-points-v2: true

  power-domains:
    maxItems: 1

  reg:
    maxItems: 1

required:
  - compatible
  - clocks
  - clock-names
  - interrupts
  - reg

unevaluatedProperties: false

examples:
  - |
    #include <dt-bindings/clock/qcom,gcc-sc7180.h>
    #include <dt-bindings/interconnect/qcom,sc7180.h>
    #include <dt-bindings/interrupt-controller/arm-gic.h>
    #include <dt-bindings/power/qcom-rpmpd.h>

    spi@880000 {
        compatible = "qcom,geni-spi";
        reg = <0x00880000 0x4000>;
        clock-names = "se";
        clocks = <&gcc GCC_QUPV3_WRAP0_S0_CLK>;
        pinctrl-names = "default";
        pinctrl-0 = <&qup_spi0_default>;
        interrupts = <GIC_SPI 601 IRQ_TYPE_LEVEL_HIGH>;
        #address-cells = <1>;
        #size-cells = <0>;
        power-domains = <&rpmhpd SC7180_CX>;
        operating-points-v2 = <&qup_opp_table>;
        interconnects = <&qup_virt MASTER_QUP_CORE_0 0 &qup_virt SLAVE_QUP_CORE_0 0>,
                        <&gem_noc MASTER_APPSS_PROC 0 &config_noc SLAVE_QUP_0 0>;
        interconnect-names = "qup-core", "qup-config";
    };

  - |
    #include <dt-bindings/dma/qcom-gpi.h>

    spi@884000 {
        compatible = "qcom,geni-spi";
        reg = <0x00884000 0x4000>;
        clock-names = "se";
        clocks = <&gcc GCC_QUPV3_WRAP0_S1_CLK>;
        dmas = <&gpi_dma0 0 1 QCOM_GPI_SPI>,
               <&gpi_dma0 1 1 QCOM_GPI_SPI>;
        dma-names = "tx", "rx";
        pinctrl-names = "default";
        pinctrl-0 = <&qup_spi1_default>;
        interrupts = <GIC_SPI 602 IRQ_TYPE_LEVEL_HIGH>;
        #address-cells = <1>;
        #size-cells = <0>;
    };
```

## Documentation/devicetree/bindings/spi/qcom,spi-qcom-qspi.txt
```
Qualcomm Quad Serial Peripheral Interface (QSPI)

The QSPI controller allows SPI protocol communication in single, dual, or quad
wire transmission modes for read/write access to slaves such as NOR flash.

Required properties:
- compatible:	An SoC specific identifier followed by "qcom,qspi-v1", such as
		"qcom,sdm845-qspi", "qcom,qspi-v1"
- reg:		Should contain the base register location and length.
- interrupts:	Interrupt number used by the controller.
- clocks:	Should contain the core and AHB clock.
- clock-names:	Should be "core" for core clock and "iface" for AHB clock.

SPI slave nodes must be children of the SPI master node and can contain
properties described in Documentation/devicetree/bindings/spi/spi-bus.txt

Example:

	qspi: spi@88df000 {
		compatible = "qcom,sdm845-qspi", "qcom,qspi-v1";
		reg = <0x88df000 0x600>;
		#address-cells = <1>;
		#size-cells = <0>;
		interrupts = <GIC_SPI 82 IRQ_TYPE_LEVEL_HIGH>;
		clock-names = "iface", "core";
		clocks = <&gcc GCC_QSPI_CNOC_PERIPH_AHB_CLK>,
			 <&gcc GCC_QSPI_CORE_CLK>;

		flash@0 {
			compatible = "jedec,spi-nor";
			reg = <0>;
			spi-max-frequency = <25000000>;
			spi-tx-bus-width = <2>;
			spi-rx-bus-width = <2>;
		};
	};
```
