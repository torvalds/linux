## Documentation/devicetree/bindings/spi/spi-rockchip-slave.yaml
```yaml
# SPDX-License-Identifier: GPL-2.0-only OR BSD-2-Clauseyy
%YAML 1.2
---
$id: http://devicetree.org/schemas/spi/spi-rockchip-slave.yaml#
$schema: http://devicetree.org/meta-schemas/core.yaml#

title: Rockchip SPI Slave Controller

description:
  The Rockchip SPI Slave controller is used to interface with SPI Master Controller.

allOf:
  - $ref: "spi-controller.yaml#"

maintainers:
  - Heiko Stuebner <heiko@sntech.de>

# Everything else is described in the common file
properties:
  compatible:
    oneOf:
      - const: rockchip,spi-slave

  reg:
    maxItems: 1

  interrupts:
    maxItems: 1

  clocks:
    items:
      - description: transfer-clock
      - description: peripheral clock

  clock-names:
    items:
      - const: spiclk
      - const: apb_pclk
      - const: sclk_in

  dmas:
    items:
      - description: TX DMA Channel
      - description: RX DMA Channel

  dma-names:
    items:
      - const: tx
      - const: rx

  rockchip,cs-inactive-disable:
    description: Add this property to disable the cs inactive interrupt for spi
      slave.
    type: boolean

  ready-gpios:
    description: GPIO spec for the spi slave ready signal.
    maxItems: 1

  rockchip,autosuspend-delay-ms:
    default: 0
    description: Set pm runtime autosuspend value in milliseconds.

  rockchip,sram:
    description: Specify sram buffer as SPI Slave DMA buffer.

required:
  - compatible
  - reg
  - interrupts
  - clocks
  - clock-names

unevaluatedProperties: false

examples:
  - |
    #include <dt-bindings/clock/rk3188-cru-common.h>
    #include <dt-bindings/interrupt-controller/arm-gic.h>
    #include <dt-bindings/interrupt-controller/irq.h>
    spi0: spi@ff110000 {
      compatible = "rockchip,spi-slave";
      reg = <0xff110000 0x1000>;
      interrupts = <GIC_SPI 44 IRQ_TYPE_LEVEL_HIGH>;
      clocks = <&cru CLK_SPI0>, <&cru PCLK_SPI0>, <&cru SCLK_IN_SPI0>;
      clock-names = "spiclk", "apb_pclk", "sclk_in";
      dmas = <&pdma1 11>, <&pdma1 12>;
      dma-names = "tx", "rx";
      #address-cells = <1>;
      #size-cells = <0>;
      ready-gpios = <&gpio1 RK_PD3 GPIO_ACTIVE_LOW>;
    };
```

## Documentation/devicetree/bindings/spi/spi-rockchip.txt
```
* Rockchip SPI Controller

The Rockchip SPI controller is used to interface with various devices such as flash
and display controllers using the SPI communication interface.

Required Properties:

- compatible: should be one of the following.
    "rockchip,px30-spi"   for px30   SoCs.
    "rockchip,rk3036-spi" for rk3036 SoCs.
    "rockchip,rk3066-spi" for rk3066 SoCs.
    "rockchip,rk3188-spi" for rk3188 SoCs.
    "rockchip,rk3228-spi" for rk3228 SoCs.
    "rockchip,rk3288-spi" for rk3288 SoCs.
    "rockchip,rk3368-spi" for rk3368 SoCs.
    "rockchip,rk3399-spi" for rk3399 SoCs.
- reg: physical base address of the controller and length of memory mapped
       region.
- interrupts: The interrupt number to the cpu. The interrupt specifier format
              depends on the interrupt controller.
- clocks: Must contain an entry for each entry in clock-names.
- clock-names: Shall be "spiclk" for the transfer-clock, and "apb_pclk" for
			   the peripheral clock.
- #address-cells: should be 1.
- #size-cells: should be 0.

Optional Properties:

- dmas: DMA specifiers for tx and rx dma. See the DMA client binding,
		Documentation/devicetree/bindings/dma/dma.txt
- dma-names: DMA request names should include "tx" and "rx" if present.
- rx-sample-delay-ns: nanoseconds to delay after the SCLK edge before sampling
		Rx data (may need to be fine tuned for high capacitance lines).
		No delay (0) by default.
- pinctrl-names: high_speed for speed is higher than 24MHz

Example:

	spi0: spi@ff110000 {
		compatible = "rockchip,rk3066-spi";
		reg = <0xff110000 0x1000>;
		dmas = <&pdma1 11>, <&pdma1 12>;
		dma-names = "tx", "rx";
		rx-sample-delay-ns = <10>;
		#address-cells = <1>;
		#size-cells = <0>;
		interrupts = <GIC_SPI 44 IRQ_TYPE_LEVEL_HIGH>;
		clocks = <&cru SCLK_SPI0>, <&cru PCLK_SPI0>;
		clock-names = "spiclk", "apb_pclk";
		pinctrl-names = "default", "high_speed";
		pinctrl-0 = <&spi0_clk &spi0_csn0 &spi0_csn1 &spi0_miso &spi0_mosi>;
		pinctrl-1 = <&spi0_clk_hs &spi0_csn0 &spi0_csn1 &spi0_miso_hs &spi0_mosi_hs>;
	};
```

## Documentation/devicetree/bindings/spi/spi-rockchip.yaml
```yaml
# SPDX-License-Identifier: GPL-2.0
%YAML 1.2
---
$id: http://devicetree.org/schemas/spi/spi-rockchip.yaml#
$schema: http://devicetree.org/meta-schemas/core.yaml#

title: Rockchip SPI Controller

description:
  The Rockchip SPI controller is used to interface with various devices such
  as flash and display controllers using the SPI communication interface.

allOf:
  - $ref: "spi-controller.yaml#"

maintainers:
  - Heiko Stuebner <heiko@sntech.de>

# Everything else is described in the common file
properties:
  compatible:
    oneOf:
      - const: rockchip,rk3036-spi
      - const: rockchip,rk3066-spi
      - const: rockchip,rk3228-spi
      - const: rockchip,rv1108-spi
      - items:
          - enum:
              - rockchip,px30-spi
              - rockchip,rk3188-spi
              - rockchip,rk3288-spi
              - rockchip,rk3308-spi
              - rockchip,rk3328-spi
              - rockchip,rk3368-spi
              - rockchip,rk3399-spi
          - const: rockchip,rk3066-spi

  reg:
    maxItems: 1

  interrupts:
    maxItems: 1

  clocks:
    items:
      - description: transfer-clock
      - description: peripheral clock

  clock-names:
    items:
      - const: spiclk
      - const: apb_pclk

  dmas:
    items:
      - description: TX DMA Channel
      - description: RX DMA Channel

  dma-names:
    items:
      - const: tx
      - const: rx

  rx-sample-delay-ns:
    default: 0
    description:
      Nano seconds to delay after the SCLK edge before sampling Rx data
      (may need to be fine tuned for high capacitance lines).
      If not specified 0 will be used.

  pinctrl-names:
    minItems: 1
    items:
      - const: default
      - const: sleep
    description:
      Names for the pin configuration(s); may be "default" or "sleep",
      where the "sleep" configuration may describe the state
      the pins should be in during system suspend.

required:
  - compatible
  - reg
  - interrupts
  - clocks
  - clock-names

examples:
  - |
    #include <dt-bindings/clock/rk3188-cru-common.h>
    #include <dt-bindings/interrupt-controller/arm-gic.h>
    #include <dt-bindings/interrupt-controller/irq.h>
    spi0: spi@ff110000 {
      compatible = "rockchip,rk3066-spi";
      reg = <0xff110000 0x1000>;
      interrupts = <GIC_SPI 44 IRQ_TYPE_LEVEL_HIGH>;
      clocks = <&cru SCLK_SPI0>, <&cru PCLK_SPI0>;
      clock-names = "spiclk", "apb_pclk";
      dmas = <&pdma1 11>, <&pdma1 12>;
      dma-names = "tx", "rx";
      pinctrl-0 = <&spi1_pins>;
      pinctrl-1 = <&spi1_sleep>;
      pinctrl-names = "default", "sleep";
      rx-sample-delay-ns = <10>;
      #address-cells = <1>;
      #size-cells = <0>;
    };
```

## Documentation/devicetree/bindings/spi/spi-rspi.txt
```
Device tree configuration for Renesas RSPI/QSPI driver

Required properties:
- compatible       : For Renesas Serial Peripheral Interface on legacy SH:
		     "renesas,rspi-<soctype>", "renesas,rspi" as fallback.
		     For Renesas Serial Peripheral Interface on RZ/A:
		     "renesas,rspi-<soctype>", "renesas,rspi-rz" as fallback.
		     For Quad Serial Peripheral Interface on R-Car Gen2 and
		     RZ/G1 devices:
		     "renesas,qspi-<soctype>", "renesas,qspi" as fallback.
		     Examples with soctypes are:
		        - "renesas,rspi-sh7757" (SH)
			- "renesas,rspi-r7s72100" (RZ/A1H)
			- "renesas,rspi-r7s9210" (RZ/A2)
			- "renesas,qspi-r8a7743" (RZ/G1M)
			- "renesas,qspi-r8a7744" (RZ/G1N)
			- "renesas,qspi-r8a7745" (RZ/G1E)
			- "renesas,qspi-r8a77470" (RZ/G1C)
			- "renesas,qspi-r8a7790" (R-Car H2)
			- "renesas,qspi-r8a7791" (R-Car M2-W)
			- "renesas,qspi-r8a7792" (R-Car V2H)
			- "renesas,qspi-r8a7793" (R-Car M2-N)
			- "renesas,qspi-r8a7794" (R-Car E2)
- reg              : Address start and address range size of the device
- interrupts       : A list of interrupt-specifiers, one for each entry in
		     interrupt-names.
		     If interrupt-names is not present, an interrupt specifier
		     for a single muxed interrupt.
- interrupt-names  : A list of interrupt names. Should contain (if present):
		       - "error" for SPEI,
		       - "rx" for SPRI,
		       - "tx" to SPTI,
		       - "mux" for a single muxed interrupt.
- num-cs	   : Number of chip selects. Some RSPI cores have more than 1.
- #address-cells   : Must be <1>
- #size-cells      : Must be <0>

Optional properties:
- clocks           : Must contain a reference to the functional clock.
- dmas             : Must contain a list of two references to DMA specifiers,
		     one for transmission, and one for reception.
- dma-names        : Must contain a list of two DMA names, "tx" and "rx".

Pinctrl properties might be needed, too.  See
Documentation/devicetree/bindings/pinctrl/renesas,*.

Examples:

	spi0: spi@e800c800 {
		compatible = "renesas,rspi-r7s72100", "renesas,rspi-rz";
		reg = <0xe800c800 0x24>;
		interrupts = <0 238 IRQ_TYPE_LEVEL_HIGH>,
			     <0 239 IRQ_TYPE_LEVEL_HIGH>,
			     <0 240 IRQ_TYPE_LEVEL_HIGH>;
		interrupt-names = "error", "rx", "tx";
		interrupt-parent = <&gic>;
		num-cs = <1>;
		#address-cells = <1>;
		#size-cells = <0>;
	};

	spi: spi@e6b10000 {
		compatible = "renesas,qspi-r8a7791", "renesas,qspi";
		reg = <0 0xe6b10000 0 0x2c>;
		interrupt-parent = <&gic>;
		interrupts = <0 184 IRQ_TYPE_LEVEL_HIGH>;
		clocks = <&mstp9_clks R8A7791_CLK_QSPI_MOD>;
		num-cs = <1>;
		#address-cells = <1>;
		#size-cells = <0>;
		dmas = <&dmac0 0x17>, <&dmac0 0x18>;
		dma-names = "tx", "rx";
	};
```

## Documentation/devicetree/bindings/spi/spi-samsung.txt
```
* Samsung SPI Controller

The Samsung SPI controller is used to interface with various devices such as flash
and display controllers using the SPI communication interface.

Required SoC Specific Properties:

- compatible: should be one of the following.
    - samsung,s3c2443-spi: for s3c2443, s3c2416 and s3c2450 platforms
    - samsung,s3c6410-spi: for s3c6410 platforms
    - samsung,s5pv210-spi: for s5pv210 and s5pc110 platforms
    - samsung,exynos5433-spi: for exynos5433 compatible controllers
    - samsung,exynos7-spi: for exynos7 platforms <DEPRECATED>

- reg: physical base address of the controller and length of memory mapped
  region.

- interrupts: The interrupt number to the cpu. The interrupt specifier format
  depends on the interrupt controller.

- dmas : Two or more DMA channel specifiers following the convention outlined
  in bindings/dma/dma.txt

- dma-names: Names for the dma channels. There must be at least one channel
  named "tx" for transmit and named "rx" for receive.

- clocks: specifies the clock IDs provided to the SPI controller; they are
  required for interacting with the controller itself, for synchronizing the bus
  and as I/O clock (the latter is required by exynos5433 and exynos7).

- clock-names: string names of the clocks in the 'clocks' property; for all the
  the devices the names must be "spi", "spi_busclkN" (where N is determined by
  "samsung,spi-src-clk"), while Exynos5433 should specify a third clock
  "spi_ioclk" for the I/O clock.

Required Board Specific Properties:

- #address-cells: should be 1.
- #size-cells: should be 0.

Optional Board Specific Properties:

- samsung,spi-src-clk: If the spi controller includes a internal clock mux to
  select the clock source for the spi bus clock, this property can be used to
  indicate the clock to be used for driving the spi bus clock. If not specified,
  the clock number 0 is used as default.

- num-cs: Specifies the number of chip select lines supported. If
  not specified, the default number of chip select lines is set to 1.

- cs-gpios: should specify GPIOs used for chipselects (see spi-bus.txt)

- no-cs-readback: the CS line is disconnected, therefore the device should not
  operate based on CS signalling.

SPI Controller specific data in SPI slave nodes:

- The spi slave nodes should provide the following information which is required
  by the spi controller.

  - samsung,spi-feedback-delay: The sampling phase shift to be applied on the
    miso line (to account for any lag in the miso line). The following are the
    valid values.

      - 0: No phase shift.
      - 1: 90 degree phase shift sampling.
      - 2: 180 degree phase shift sampling.
      - 3: 270 degree phase shift sampling.

Aliases:

- All the SPI controller nodes should be represented in the aliases node using
  the following format 'spi{n}' where n is a unique number for the alias.


Example:

- SoC Specific Portion:

	spi_0: spi@12d20000 {
		compatible = "samsung,exynos4210-spi";
		reg = <0x12d20000 0x100>;
		interrupts = <0 66 0>;
		dmas = <&pdma0 5
			&pdma0 4>;
		dma-names = "tx", "rx";
		#address-cells = <1>;
		#size-cells = <0>;
	};

- Board Specific Portion:

	spi_0: spi@12d20000 {
		#address-cells = <1>;
		#size-cells = <0>;
		pinctrl-names = "default";
		pinctrl-0 = <&spi0_bus>;
		cs-gpios = <&gpa2 5 0>;

		w25q80bw@0 {
			#address-cells = <1>;
			#size-cells = <1>;
			compatible = "w25x80";
			reg = <0>;
			spi-max-frequency = <10000>;

			controller-data {
				samsung,spi-feedback-delay = <0>;
			};

			partition@0 {
				label = "U-Boot";
				reg = <0x0 0x40000>;
				read-only;
			};

			partition@40000 {
				label = "Kernel";
				reg = <0x40000 0xc0000>;
			};
		};
	};
```

## Documentation/devicetree/bindings/spi/spi-sc18is602.txt
```
NXP SC18IS602/SCIS603

Required properties:
	- compatible : Should be one of
		"nxp,sc18is602"
		"nxp,sc18is602b"
		"nxp,sc18is603"
	- reg: I2C bus address

Optional properties:
	- clock-frequency : external oscillator clock frequency. If not
	  specified, the SC18IS602 default frequency (7372000) will be used.

The clock-frequency property is relevant and needed only if the chip has an
external oscillator (SC18IS603).

Example:

	sc18is603@28 {
		compatible = "nxp,sc18is603";
		reg = <0x28>;
		clock-frequency = <14744000>;
	}
```

## Documentation/devicetree/bindings/spi/spi-sg2044-nor.yaml
```yaml
# SPDX-License-Identifier: (GPL-2.0-only OR BSD-2-Clause)
%YAML 1.2
---
$id: http://devicetree.org/schemas/spi/spi-sg2044-nor.yaml#
$schema: http://devicetree.org/meta-schemas/core.yaml#

title: SG2044 SPI NOR controller

maintainers:
  - Longbin Li <looong.bin@gmail.com>

allOf:
  - $ref: spi-controller.yaml#

properties:
  compatible:
    const: sophgo,sg2044-spifmc-nor

  reg:
    maxItems: 1

  clocks:
    maxItems: 1

  interrupts:
    maxItems: 1

  resets:
    maxItems: 1

required:
  - compatible
  - reg
  - clocks
  - interrupts
  - resets

unevaluatedProperties: false

examples:
  - |
    #include <dt-bindings/interrupt-controller/irq.h>

    spi@1000000 {
      compatible = "sophgo,sg2044-spifmc-nor";
      reg = <0x1000000 0x4000000>;
      #address-cells = <1>;
      #size-cells = <0>;
      clocks = <&clk 0>;
      interrupts = <37 IRQ_TYPE_LEVEL_HIGH>;
      resets = <&rst 0>;
    };
```
