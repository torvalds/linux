## Documentation/devicetree/bindings/spi/mxs-spi.yaml
```yaml
# SPDX-License-Identifier: (GPL-2.0-only OR BSD-2-Clause)
%YAML 1.2
---
$id: http://devicetree.org/schemas/spi/mxs-spi.yaml#
$schema: http://devicetree.org/meta-schemas/core.yaml#

title: Freescale MX233/MX28 SSP/SPI

maintainers:
  - Marek Vasut <marex@denx.de>

allOf:
  - $ref: /schemas/spi/spi-controller.yaml#

properties:
  compatible:
    enum:
      - fsl,imx23-spi
      - fsl,imx28-spi

  reg:
    maxItems: 1

  interrupts:
    maxItems: 1

  dmas:
    maxItems: 1

  dma-names:
    const: rx-tx

  clock-frequency:
    description: input clock frequency to the SPI block in Hz.
    default: 160000000

required:
  - compatible
  - reg
  - interrupts
  - dmas
  - dma-names

unevaluatedProperties: false

examples:
  - |
    spi@80010000 {
        #address-cells = <1>;
        #size-cells = <0>;
        compatible = "fsl,imx28-spi";
        reg = <0x80010000 0x2000>;
        interrupts = <96>;
        dmas = <&dma_apbh 0>;
        dma-names = "rx-tx";
    };
```

## Documentation/devicetree/bindings/spi/nuvoton,npcm-fiu.txt
```
* Nuvoton FLASH Interface Unit (FIU) SPI Controller

NPCM FIU supports single, dual and quad communication interface.

The NPCM7XX supports three FIU modules,
FIU0 and FIUx supports two chip selects,
FIU3 support four chip select.

Required properties:
  - compatible : "nuvoton,npcm750-fiu" for the NPCM7XX BMC
  - #address-cells : should be 1.
  - #size-cells : should be 0.
  - reg : the first contains the register location and length,
          the second contains the memory mapping address and length
  - reg-names: Should contain the reg names "control" and "memory"
  - clocks : phandle of FIU reference clock.

Required properties in case the pins can be muxed:
  - pinctrl-names : a pinctrl state named "default" must be defined.
  - pinctrl-0 : phandle referencing pin configuration of the device.

Optional property:
  - nuvoton,spix-mode: enable spix-mode for an expansion bus to an ASIC or CPLD.

Aliases:
- All the FIU controller nodes should be represented in the aliases node using
  the following format 'fiu{n}' where n is a unique number for the alias.
  In the NPCM7XX BMC:
  		fiu0 represent fiu 0 controller
  		fiu1 represent fiu 3 controller
  		fiu2 represent fiu x controller

Example:
fiu3: spi@c00000000 {
	compatible = "nuvoton,npcm750-fiu";
	#address-cells = <1>;
	#size-cells = <0>;
	reg = <0xfb000000 0x1000>, <0x80000000 0x10000000>;
	reg-names = "control", "memory";
	clocks = <&clk NPCM7XX_CLK_AHB>;
	pinctrl-names = "default";
	pinctrl-0 = <&spi3_pins>;
	spi-nor@0 {
			...
	};
};
```

## Documentation/devicetree/bindings/spi/nuvoton,npcm-pspi.txt
```
Nuvoton NPCM Peripheral Serial Peripheral Interface(PSPI) controller driver

Nuvoton NPCM7xx SOC support two PSPI channels.

Required properties:
 - compatible : "nuvoton,npcm750-pspi" for NPCM7XX BMC
 - #address-cells : should be 1. see spi-bus.txt
 - #size-cells : should be 0. see spi-bus.txt
 - specifies physical base address and size of the register.
 - interrupts : contain PSPI interrupt.
 - clocks : phandle of PSPI reference clock.
 - clock-names: Should be "clk_apb5".
 - pinctrl-names : a pinctrl state named "default" must be defined.
 - pinctrl-0 : phandle referencing pin configuration of the device.
 - resets : phandle to the reset control for this device.
 - cs-gpios: Specifies the gpio pins to be used for chipselects.
            See: Documentation/devicetree/bindings/spi/spi-bus.txt

Optional properties:
- clock-frequency : Input clock frequency to the PSPI block in Hz.
		    Default is 25000000 Hz.

spi0: spi@f0200000 {
	compatible = "nuvoton,npcm750-pspi";
	reg = <0xf0200000 0x1000>;
	pinctrl-names = "default";
	pinctrl-0 = <&pspi1_pins>;
	#address-cells = <1>;
	#size-cells = <0>;
	interrupts = <GIC_SPI 31 IRQ_TYPE_LEVEL_HIGH>;
	clocks = <&clk NPCM7XX_CLK_APB5>;
	clock-names = "clk_apb5";
	resets = <&rstc NPCM7XX_RESET_IPSRST2 NPCM7XX_RESET_PSPI1>
	cs-gpios = <&gpio6 11 GPIO_ACTIVE_LOW>;
};
```

## Documentation/devicetree/bindings/spi/nuvoton,npcm-pspi.yaml
```yaml
# SPDX-License-Identifier: GPL-2.0-only OR BSD-2-Clause
%YAML 1.2
---
$id: http://devicetree.org/schemas/spi/nuvoton,npcm-pspi.yaml#
$schema: http://devicetree.org/meta-schemas/core.yaml#

title: Nuvoton NPCM Peripheral SPI (PSPI) Controller

maintainers:
  - Tomer Maimon <tmaimon77@gmail.com>

allOf:
  - $ref: spi-controller.yaml#

description:
  Nuvoton NPCM Peripheral Serial Peripheral Interface (PSPI) controller.
  Nuvoton NPCM7xx SOC supports two PSPI channels.
  Nuvoton NPCM8xx SOC support one PSPI channel.

properties:
  compatible:
    enum:
      - nuvoton,npcm750-pspi # Poleg NPCM7XX
      - nuvoton,npcm845-pspi # Arbel NPCM8XX

  reg:
    maxItems: 1

  interrupts:
    maxItems: 1

  clocks:
    maxItems: 1
    description: PSPI reference clock.

  clock-names:
    items:
      - const: clk_apb5

  resets:
    maxItems: 1

required:
  - compatible
  - reg
  - interrupts
  - clocks
  - clock-names
  - resets

unevaluatedProperties: false

examples:
  - |
    #include <dt-bindings/clock/nuvoton,npcm7xx-clock.h>
    #include <dt-bindings/interrupt-controller/arm-gic.h>
    #include <dt-bindings/reset/nuvoton,npcm7xx-reset.h>
    #include "dt-bindings/gpio/gpio.h"
    spi0: spi@f0200000 {
        compatible = "nuvoton,npcm750-pspi";
        reg = <0xf0200000 0x1000>;
        pinctrl-names = "default";
        pinctrl-0 = <&pspi1_pins>;
        #address-cells = <1>;
        #size-cells = <0>;
        interrupts = <GIC_SPI 31 IRQ_TYPE_LEVEL_HIGH>;
        clocks = <&clk NPCM7XX_CLK_APB5>;
        clock-names = "clk_apb5";
        resets = <&rstc NPCM7XX_RESET_IPSRST2 NPCM7XX_RESET_PSPI1>;
        cs-gpios = <&gpio6 11 GPIO_ACTIVE_LOW>;
    };
```

## Documentation/devicetree/bindings/spi/nuvoton,npcm750-fiu.yaml
```yaml
# SPDX-License-Identifier: GPL-2.0-only OR BSD-2-Clause
%YAML 1.2
---
$id: http://devicetree.org/schemas/spi/nuvoton,npcm750-fiu.yaml#
$schema: http://devicetree.org/meta-schemas/core.yaml#

title: Nuvoton NPCM Flash Interface Unit (FIU) SPI Controller

maintainers:
  - Tomer Maimon <tmaimon77@gmail.com>

allOf:
  - $ref: /schemas/spi/spi-controller.yaml#

description: |
  NPCM FIU supports single, dual and quad communication interface.

  The NPCM7XX supports three FIU modules:
    FIU0 and FIUx support two chip selects
    FIU3 supports four chip selects.

  The NPCM8XX supports four FIU modules:
    FIU0 and FIUx support two chip selects
    FIU1 and FIU3 support four chip selects.

  The FIU control register block is always required. The direct-mapped
  flash window is optional because the controller can still access flash
  through the UMA path when that mapping is not described.

  Alias convention:
    The '/aliases' node should define:
      For NPCM7xx:  fiu0=&fiu0; fiu1=&fiu3; fiu2=&fiux;
      For NPCM8xx:  fiu0=&fiu0; fiu1=&fiu3; fiu2=&fiux; fiu3=&fiu1;

properties:
  compatible:
    enum:
      - nuvoton,npcm750-fiu # Poleg NPCM7XX
      - nuvoton,npcm845-fiu # Arbel NPCM8XX

  reg:
    description:
      The first resource is the FIU control register block. An optional second
      resource describes the direct-mapped flash window used for direct
      read/write accesses.
    minItems: 1
    items:
      - description: FIU control registers
      - description: Memory-mapped flash contents

  reg-names:
    description:
      Resource names for the control registers and optional direct-mapped
      flash window.
    minItems: 1
    items:
      - const: control
      - const: memory

  clocks:
    maxItems: 1
    description: FIU reference clock.

  nuvoton,spix-mode:
    type: boolean
    description: Enable SPIX mode for an expansion bus to an ASIC or CPLD.

required:
  - compatible
  - reg
  - reg-names
  - clocks

unevaluatedProperties: false

examples:
  - |
    #include <dt-bindings/clock/nuvoton,npcm7xx-clock.h>
    spi@fb000000 {
        compatible = "nuvoton,npcm750-fiu";
        reg = <0xfb000000 0x1000>, <0x80000000 0x10000000>;
        reg-names = "control", "memory";
        #address-cells = <1>;
        #size-cells = <0>;
        clocks = <&clk NPCM7XX_CLK_SPI0>;

        flash@0 {
            compatible = "jedec,spi-nor";
            reg = <0>;
            #address-cells = <1>;
            #size-cells = <1>;
        };
    };
```

## Documentation/devicetree/bindings/spi/nuvoton,wpcm450-fiu.yaml
```yaml
# SPDX-License-Identifier: GPL-2.0-only OR BSD-2-Clause
%YAML 1.2
---
$id: http://devicetree.org/schemas/spi/nuvoton,wpcm450-fiu.yaml#
$schema: http://devicetree.org/meta-schemas/core.yaml#

title: Nuvoton WPCM450 Flash Interface Unit (FIU)

maintainers:
  - Jonathan Neuschäfer <j.neuschaefer@gmx.net>

allOf:
  - $ref: /schemas/spi/spi-controller.yaml#

properties:
  compatible:
    const: nuvoton,wpcm450-fiu

  reg:
    items:
      - description: FIU registers
      - description: Memory-mapped flash contents

  reg-names:
    items:
      - const: control
      - const: memory

  interrupts:
    maxItems: 1

  clocks:
    maxItems: 1

  nuvoton,shm:
    $ref: /schemas/types.yaml#/definitions/phandle
    description: a phandle to the SHM block (see ../arm/nuvoton,shm.yaml)

required:
  - compatible
  - reg
  - clocks

unevaluatedProperties: false

examples:
  - |
    spi@c8000000 {
      compatible = "nuvoton,wpcm450-fiu";
      reg = <0xc8000000 0x1000>, <0xc0000000 0x4000000>;
      #address-cells = <1>;
      #size-cells = <0>;
      reg-names = "control", "memory";
      clocks = <&clk 0>;
      nuvoton,shm = <&shm>;

      flash@0 {
        compatible = "jedec,spi-nor";
        reg = <0>;
      };
    };
```

## Documentation/devicetree/bindings/spi/nvidia,tegra114-spi.txt
```
NVIDIA Tegra114 SPI controller.

Required properties:
- compatible : For Tegra114, must contain "nvidia,tegra114-spi".
  Otherwise, must contain '"nvidia,<chip>-spi", "nvidia,tegra114-spi"' where
  <chip> is tegra124, tegra132, or tegra210.
- reg: Should contain SPI registers location and length.
- interrupts: Should contain SPI interrupts.
- clock-names : Must include the following entries:
  - spi
- resets : Must contain an entry for each entry in reset-names.
  See ../reset/reset.txt for details.
- reset-names : Must include the following entries:
  - spi
- dmas : Must contain an entry for each entry in clock-names.
  See ../dma/dma.txt for details.
- dma-names : Must include the following entries:
  - rx
  - tx
- clocks : Must contain an entry for each entry in clock-names.
  See ../clocks/clock-bindings.txt for details.

Recommended properties:
- spi-max-frequency: Definition as per
                     Documentation/devicetree/bindings/spi/spi-bus.txt
Optional properties:
- nvidia,tx-clk-tap-delay: Delays the clock going out to the external device
  with this tap value. This property is used to tune the outgoing data from
  Tegra SPI master with respect to outgoing Tegra SPI master clock.
  Tap values vary based on the platform design trace lengths from Tegra SPI
  to corresponding slave devices. Valid tap values are from 0 thru 63.
- nvidia,rx-clk-tap-delay: Delays the clock coming in from the external device
  with this tap value. This property is used to adjust the Tegra SPI master
  clock with respect to the data from the SPI slave device.
  Tap values vary based on the platform design trace lengths from Tegra SPI
  to corresponding slave devices. Valid tap values are from 0 thru 63.

Example:

spi@7000d600 {
	compatible = "nvidia,tegra114-spi";
	reg = <0x7000d600 0x200>;
	interrupts = <0 82 0x04>;
	spi-max-frequency = <25000000>;
	#address-cells = <1>;
	#size-cells = <0>;
	clocks = <&tegra_car 44>;
	clock-names = "spi";
	resets = <&tegra_car 44>;
	reset-names = "spi";
	dmas = <&apbdma 16>, <&apbdma 16>;
	dma-names = "rx", "tx";
	<spi-client>@<bus_num> {
		...
		...
		nvidia,rx-clk-tap-delay = <0>;
		nvidia,tx-clk-tap-delay = <16>;
		...
	};

};
```

## Documentation/devicetree/bindings/spi/nvidia,tegra114-spi.yaml
```yaml
# SPDX-License-Identifier: (GPL-2.0-only OR BSD-2-Clause)
%YAML 1.2
---
$id: http://devicetree.org/schemas/spi/nvidia,tegra114-spi.yaml#
$schema: http://devicetree.org/meta-schemas/core.yaml#

title: NVIDIA Tegra114 SPI controller

maintainers:
  - Thierry Reding <thierry.reding@gmail.com>
  - Jon Hunter <jonathanh@nvidia.com>

properties:
  compatible:
    oneOf:
      - const: nvidia,tegra114-spi
      - items:
          - enum:
              - nvidia,tegra210-spi
              - nvidia,tegra124-spi
          - const: nvidia,tegra114-spi

  reg:
    maxItems: 1

  interrupts:
    maxItems: 1

  clocks:
    items:
      - description: SPI module clock

  clock-names:
    items:
      - const: spi

  resets:
    items:
      - description: SPI module reset

  reset-names:
    items:
      - const: spi

  dmas:
    items:
      - description: DMA channel for the reception FIFO
      - description: DMA channel for the transmission FIFO

  dma-names:
    items:
      - const: rx
      - const: tx

  spi-max-frequency:
    description: Maximum SPI clocking speed of the controller in Hz.
    $ref: /schemas/types.yaml#/definitions/uint32

allOf:
  - $ref: spi-controller.yaml

unevaluatedProperties: false

required:
  - compatible
  - reg
  - interrupts
  - clocks
  - clock-names
  - resets
  - reset-names
  - dmas
  - dma-names

examples:
  - |
    spi@7000d600 {
        compatible = "nvidia,tegra114-spi";
        reg = <0x7000d600 0x200>;
        interrupts = <0 82 0x04>;
        clocks = <&tegra_car 44>;
        clock-names = "spi";
        resets = <&tegra_car 44>;
        reset-names = "spi";
        dmas = <&apbdma 16>, <&apbdma 16>;
        dma-names = "rx", "tx";

        spi-max-frequency = <25000000>;

        #address-cells = <1>;
        #size-cells = <0>;

        flash@0 {
            compatible = "jedec,spi-nor";
            reg = <0>;
            spi-max-frequency = <20000000>;
            nvidia,rx-clk-tap-delay = <0>;
            nvidia,tx-clk-tap-delay = <16>;
        };
    };
```

## Documentation/devicetree/bindings/spi/nvidia,tegra20-sflash.txt
```
NVIDIA Tegra20 SFLASH controller.

Required properties:
- compatible : should be "nvidia,tegra20-sflash".
- reg: Should contain SFLASH registers location and length.
- interrupts: Should contain SFLASH interrupts.
- clocks : Must contain one entry, for the module clock.
  See ../clocks/clock-bindings.txt for details.
- resets : Must contain an entry for each entry in reset-names.
  See ../reset/reset.txt for details.
- reset-names : Must include the following entries:
  - spi
- dmas : Must contain an entry for each entry in clock-names.
  See ../dma/dma.txt for details.
- dma-names : Must include the following entries:
  - rx
  - tx

Recommended properties:
- spi-max-frequency: Definition as per
                     Documentation/devicetree/bindings/spi/spi-bus.txt

Example:

spi@7000c380 {
	compatible = "nvidia,tegra20-sflash";
	reg = <0x7000c380 0x80>;
	interrupts = <0 39 0x04>;
	spi-max-frequency = <25000000>;
	#address-cells = <1>;
	#size-cells = <0>;
	clocks = <&tegra_car 43>;
	resets = <&tegra_car 43>;
	reset-names = "spi";
	dmas = <&apbdma 11>, <&apbdma 11>;
	dma-names = "rx", "tx";
};
```
