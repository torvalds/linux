## Documentation/devicetree/bindings/spi/mediatek,spi-mt65xx.yaml
```yaml
# SPDX-License-Identifier: (GPL-2.0-only OR BSD-2-Clause)
%YAML 1.2
---
$id: http://devicetree.org/schemas/spi/mediatek,spi-mt65xx.yaml#
$schema: http://devicetree.org/meta-schemas/core.yaml#

title: SPI Bus controller for MediaTek ARM SoCs

maintainers:
  - Leilk Liu <leilk.liu@mediatek.com>

allOf:
  - $ref: /schemas/spi/spi-controller.yaml#

properties:
  compatible:
    oneOf:
      - items:
          - enum:
              - mediatek,mt7629-spi
              - mediatek,mt8365-spi
          - const: mediatek,mt7622-spi
      - items:
          - enum:
              - mediatek,mt8516-spi
          - const: mediatek,mt2712-spi
      - items:
          - enum:
              - mediatek,mt6779-spi
              - mediatek,mt8186-spi
              - mediatek,mt8192-spi
              - mediatek,mt8195-spi
          - const: mediatek,mt6765-spi
      - items:
          - enum:
              - mediatek,mt7981-spi-ipm
              - mediatek,mt7986-spi-ipm
              - mediatek,mt8188-spi-ipm
          - const: mediatek,spi-ipm
      - items:
          - enum:
              - mediatek,mt2701-spi
              - mediatek,mt2712-spi
              - mediatek,mt6589-spi
              - mediatek,mt6765-spi
              - mediatek,mt6893-spi
              - mediatek,mt7622-spi
              - mediatek,mt8135-spi
              - mediatek,mt8173-spi
              - mediatek,mt8183-spi

  reg:
    maxItems: 1

  interrupts:
    maxItems: 1

  clocks:
    minItems: 3
    items:
      - description: clock used for the parent clock
      - description: clock used for the muxes clock
      - description: clock used for the clock gate
      - description: clock used for the AHB bus, this clock is optional

  clock-names:
    minItems: 3
    items:
      - const: parent-clk
      - const: sel-clk
      - const: spi-clk
      - const: hclk

  mediatek,pad-select:
    $ref: /schemas/types.yaml#/definitions/uint32-array
    minItems: 1
    maxItems: 4
    items:
      enum: [0, 1, 2, 3]
    description:
      specify which pins group(ck/mi/mo/cs) spi controller used.
      This is an array.

required:
  - compatible
  - reg
  - interrupts
  - clocks
  - clock-names
  - '#address-cells'
  - '#size-cells'

unevaluatedProperties: false

examples:
  - |
    #include <dt-bindings/clock/mt8173-clk.h>
    #include <dt-bindings/gpio/gpio.h>
    #include <dt-bindings/interrupt-controller/arm-gic.h>
    #include <dt-bindings/interrupt-controller/irq.h>

    spi@1100a000 {
      compatible = "mediatek,mt8173-spi";
      #address-cells = <1>;
      #size-cells = <0>;
      reg = <0x1100a000 0x1000>;
      interrupts = <GIC_SPI 110 IRQ_TYPE_LEVEL_LOW>;
      clocks = <&topckgen CLK_TOP_SYSPLL3_D2>,
               <&topckgen CLK_TOP_SPI_SEL>,
               <&pericfg CLK_PERI_SPI0>;
      clock-names = "parent-clk", "sel-clk", "spi-clk";
      cs-gpios = <&pio 105 GPIO_ACTIVE_LOW>, <&pio 72 GPIO_ACTIVE_LOW>;
      mediatek,pad-select = <1>, <0>;
    };
```

## Documentation/devicetree/bindings/spi/mediatek,spi-mtk-nor.yaml
```yaml
# SPDX-License-Identifier: (GPL-2.0-only OR BSD-2-Clause)
%YAML 1.2
---
$id: http://devicetree.org/schemas/spi/mediatek,spi-mtk-analr.yaml#
$schema: http://devicetree.org/meta-schemas/core.yaml#

title: Serial ANALR flash controller for MediaTek ARM SoCs

maintainers:
  - Bayi Cheng <bayi.cheng@mediatek.com>
  - Chuanhong Guo <gch981213@gmail.com>

description: |
  This spi controller support single, dual, or quad mode transfer for
  SPI ANALR flash. There should be only one spi slave device following
  generic spi bindings. It's analt recommended to use this controller
  for devices other than SPI ANALR flash due to limited transfer
  capability of this controller.

allOf:
  - $ref: /schemas/spi/spi-controller.yaml#

properties:
  compatible:
    oneOf:
      - enum:
          - mediatek,mt8173-analr
          - mediatek,mt8186-analr
          - mediatek,mt8192-analr
      - items:
          - enum:
              - mediatek,mt2701-analr
              - mediatek,mt2712-analr
              - mediatek,mt7622-analr
              - mediatek,mt7623-analr
              - mediatek,mt7629-analr
              - mediatek,mt8195-analr
          - const: mediatek,mt8173-analr
      - items:
          - enum:
              - mediatek,mt8188-analr
          - const: mediatek,mt8186-analr

  reg:
    maxItems: 1

  interrupts:
    maxItems: 1

  clocks:
    minItems: 2
    items:
      - description: clock used for spi bus
      - description: clock used for controller
      - description: clock used for analr dma bus. this depends on hardware
                     design, so this is optional.
      - description: clock used for controller axi slave bus.
                     this depends on hardware design, so it is optional.

  clock-names:
    minItems: 2
    items:
      - const: spi
      - const: sf
      - const: axi
      - const: axi_s

required:
  - compatible
  - reg
  - clocks
  - clock-names

unevaluatedProperties: false

examples:
  - |
    #include <dt-bindings/clock/mt8173-clk.h>

    soc {
      #address-cells = <2>;
      #size-cells = <2>;

      analr_flash: spi@1100d000 {
        compatible = "mediatek,mt8173-analr";
        reg = <0 0x1100d000 0 0xe0>;
        interrupts = <1>;
        clocks = <&pericfg CLK_PERI_SPI>, <&topckgen CLK_TOP_SPINFI_IFR_SEL>,
                 <&pericfg CLK_PERI_NFI>;
        clock-names = "spi", "sf", "axi";
        #address-cells = <1>;
        #size-cells = <0>;

        flash@0 {
          compatible = "jedec,spi-analr";
          reg = <0>;
        };
      };
    };
```

## Documentation/devicetree/bindings/spi/mediatek,spi-mtk-snfi.yaml
```yaml
# SPDX-License-Identifier: (GPL-2.0-only OR BSD-2-Clause)
%YAML 1.2
---
$id: http://devicetree.org/schemas/spi/mediatek,spi-mtk-snfi.yaml#
$schema: http://devicetree.org/meta-schemas/core.yaml#

title: SPI-NAND flash controller for MediaTek ARM SoCs

maintainers:
  - Chuanhong Guo <gch981213@gmail.com>

description: |
  The Mediatek SPI-NAND flash controller is an extended version of
  the Mediatek NAND flash controller. It can perform standard SPI
  instructions with one continuous write and one read for up-to 0xa0
  bytes. It also supports typical SPI-NAND page cache operations
  in single, dual or quad IO mode with pipelined ECC encoding/decoding
  using the accompanying ECC engine. There should be only one spi
  slave device following generic spi bindings.

allOf:
  - $ref: /schemas/spi/spi-controller.yaml#

properties:
  compatible:
    enum:
      - mediatek,mt7622-snand
      - mediatek,mt7629-snand

  reg:
    items:
      - description: core registers

  interrupts:
    items:
      - description: NFI interrupt

  clocks:
    items:
      - description: clock used for the controller
      - description: clock used for the SPI bus

  clock-names:
    items:
      - const: nfi_clk
      - const: pad_clk

  nand-ecc-engine:
    description: device-tree node of the accompanying ECC engine.
    $ref: /schemas/types.yaml#/definitions/phandle

required:
  - compatible
  - reg
  - interrupts
  - clocks
  - clock-names
  - nand-ecc-engine

unevaluatedProperties: false

examples:
  - |
    #include <dt-bindings/interrupt-controller/irq.h>
    #include <dt-bindings/interrupt-controller/arm-gic.h>
    #include <dt-bindings/clock/mt7622-clk.h>
    soc {
      #address-cells = <2>;
      #size-cells = <2>;
      snfi: spi@1100d000 {
        compatible = "mediatek,mt7622-snand";
        reg = <0 0x1100d000 0 0x1000>;
        interrupts = <GIC_SPI 96 IRQ_TYPE_LEVEL_LOW>;
        clocks = <&pericfg CLK_PERI_NFI_PD>, <&pericfg CLK_PERI_SNFI_PD>;
        clock-names = "nfi_clk", "pad_clk";
        nand-ecc-engine = <&bch>;
        #address-cells = <1>;
        #size-cells = <0>;

        flash@0 {
          compatible = "spi-nand";
          reg = <0>;
          spi-tx-bus-width = <4>;
          spi-rx-bus-width = <4>;
          nand-ecc-engine = <&snfi>;
        };
      };
    };
```

## Documentation/devicetree/bindings/spi/mediatek,spi-slave-mt27xx.yaml
```yaml
# SPDX-License-Identifier: (GPL-2.0-only OR BSD-2-Clause)
%YAML 1.2
---
$id: http://devicetree.org/schemas/spi/mediatek,spi-slave-mt27xx.yaml#
$schema: http://devicetree.org/meta-schemas/core.yaml#

title: SPI Slave controller for MediaTek ARM SoCs

maintainers:
  - Leilk Liu <leilk.liu@mediatek.com>

allOf:
  - $ref: "/schemas/spi/spi-controller.yaml#"

properties:
  compatible:
    enum:
      - mediatek,mt2712-spi-slave
      - mediatek,mt8195-spi-slave

  reg:
    maxItems: 1

  interrupts:
    maxItems: 1

  clocks:
    maxItems: 1

  clock-names:
    items:
      - const: spi

required:
  - compatible
  - reg
  - interrupts
  - clocks
  - clock-names

unevaluatedProperties: false

examples:
  - |
    #include <dt-bindings/clock/mt2712-clk.h>
    #include <dt-bindings/gpio/gpio.h>
    #include <dt-bindings/interrupt-controller/arm-gic.h>
    #include <dt-bindings/interrupt-controller/irq.h>

    spi@10013000 {
      compatible = "mediatek,mt2712-spi-slave";
      reg = <0x10013000 0x100>;
      interrupts = <GIC_SPI 283 IRQ_TYPE_LEVEL_LOW>;
      clocks = <&infracfg CLK_INFRA_AO_SPI1>;
      clock-names = "spi";
      assigned-clocks = <&topckgen CLK_TOP_SPISLV_SEL>;
      assigned-clock-parents = <&topckgen CLK_TOP_UNIVPLL1_D2>;
    };
```

## Documentation/devicetree/bindings/spi/microchip,mpfs-spi.yaml
```yaml
# SPDX-License-Identifier: (GPL-2.0-only OR BSD-2-Clause)
%YAML 1.2
---
$id: http://devicetree.org/schemas/spi/microchip,mpfs-spi.yaml#
$schema: http://devicetree.org/meta-schemas/core.yaml#

title: Microchip FPGA {Q,}SPI Controllers

description:
  SPI and QSPI controllers on Microchip PolarFire SoC and the "soft"/
  fabric IP cores they are based on

maintainers:
  - Conor Dooley <conor.dooley@microchip.com>

properties:
  compatible:
    oneOf:
      - items:
          - enum:
              - microchip,mpfs-qspi
              - microchip,pic64gx-qspi
          - const: microchip,coreqspi-rtl-v2
      - const: microchip,coreqspi-rtl-v2 # FPGA QSPI
      - items:
          - const: microchip,pic64gx-spi
          - const: microchip,mpfs-spi
      - const: microchip,mpfs-spi

  reg:
    maxItems: 1

  interrupts:
    maxItems: 1

  clock-names:
    maxItems: 1

  clocks:
    maxItems: 1

required:
  - compatible
  - reg
  - interrupts
  - clocks

allOf:
  - $ref: spi-controller.yaml#

  - if:
      properties:
        compatible:
          contains:
            const: microchip,mpfs-spi
    then:
      properties:
        num-cs:
          default: 1

  - if:
      properties:
        compatible:
          contains:
            const: microchip,mpfs-spi
      not:
        required:
          - cs-gpios
    then:
      properties:
        num-cs:
          maximum: 1

unevaluatedProperties: false

examples:
  - |
    #include "dt-bindings/clock/microchip,mpfs-clock.h"
    spi@20108000 {
        compatible = "microchip,mpfs-spi";
        reg = <0x20108000 0x1000>;
        clocks = <&clkcfg CLK_SPI0>;
        interrupt-parent = <&plic>;
        interrupts = <54>;
    };
...
```

## Documentation/devicetree/bindings/spi/microchip,spi-pic32.txt
```
Microchip PIC32 SPI Master controller

Required properties:
- compatible: Should be "microchip,pic32mzda-spi".
- reg: Address and length of register space for the device.
- interrupts: Should contain all three spi interrupts in sequence
              of <fault-irq>, <receive-irq>, <transmit-irq>.
- interrupt-names: Should be "fault", "rx", "tx" in order.
- clocks: Phandle of the clock generating SPI clock on the bus.
- clock-names: Should be "mck0".
- cs-gpios: Specifies the gpio pins to be used for chipselects.
            See: Documentation/devicetree/bindings/spi/spi-bus.txt

Optional properties:
- dmas: Two or more DMA channel specifiers following the convention outlined
        in Documentation/devicetree/bindings/dma/dma.txt
- dma-names: Names for the dma channels. There must be at least one channel
             named "spi-tx" for transmit and named "spi-rx" for receive.

Example:

spi1: spi@1f821000 {
        compatible = "microchip,pic32mzda-spi";
        reg = <0x1f821000 0x200>;
        interrupts = <109 IRQ_TYPE_LEVEL_HIGH>,
                     <110 IRQ_TYPE_LEVEL_HIGH>,
                     <111 IRQ_TYPE_LEVEL_HIGH>;
        interrupt-names = "fault", "rx", "tx";
        clocks = <&PBCLK2>;
        clock-names = "mck0";
        cs-gpios = <&gpio3 4 GPIO_ACTIVE_LOW>;
        dmas = <&dma 134>, <&dma 135>;
        dma-names = "spi-rx", "spi-tx";
};
```

## Documentation/devicetree/bindings/spi/mikrotik,rb4xx-spi.yaml
```yaml
# SPDX-License-Identifier: (GPL-2.0-only OR BSD-2-Clause)
%YAML 1.2
---
$id: http://devicetree.org/schemas/spi/mikrotik,rb4xx-spi.yaml#
$schema: http://devicetree.org/meta-schemas/core.yaml#

title: MikroTik RB4xx series SPI master

maintainers:
  - Gabor Juhos <juhosg@openwrt.org>
  - Bert Vermeulen <bert@biot.com>

allOf:
  - $ref: "spi-controller.yaml#"

properties:
  compatible:
    const: mikrotik,rb4xx-spi

  reg:
    maxItems: 1

required:
  - compatible
  - reg

unevaluatedProperties: false

examples:
  - |
    spi: spi@1f000000 {
        #address-cells = <1>;
        #size-cells = <0>;
        compatible = "mikrotik,rb4xx-spi";
        reg = <0x1f000000 0x10>;
    };

...
```

## Documentation/devicetree/bindings/spi/mxicy,mx25f0a-spi.yaml
```yaml
# SPDX-License-Identifier: (GPL-2.0-only OR BSD-2-Clause)
%YAML 1.2
---
$id: http://devicetree.org/schemas/spi/mxicy,mx25f0a-spi.yaml#
$schema: http://devicetree.org/meta-schemas/core.yaml#

title: Macronix SPI controller

maintainers:
  - Miquel Raynal <miquel.raynal@bootlin.com>

allOf:
  - $ref: spi-controller.yaml#

properties:
  compatible:
    const: mxicy,mx25f0a-spi

  reg:
    minItems: 2
    maxItems: 2

  reg-names:
    items:
      - const: regs
      - const: dirmap

  interrupts:
    maxItems: 1

  clocks:
    minItems: 3
    maxItems: 3

  clock-names:
    items:
      - const: send_clk
      - const: send_dly_clk
      - const: ps_clk

  nand-ecc-engine:
    description: NAND ECC engine used by the SPI controller in order to perform
      on-the-fly correction when using a SPI-NAND memory.
    $ref: /schemas/types.yaml#/definitions/phandle

required:
  - compatible
  - reg
  - reg-names
  - clocks
  - clock-names

unevaluatedProperties: false

examples:
  - |
    spi@43c30000 {
      compatible = "mxicy,mx25f0a-spi";
      reg = <0x43c30000 0x10000>, <0xa0000000 0x20000000>;
      reg-names = "regs", "dirmap";
      clocks = <&clkwizard 0>, <&clkwizard 1>, <&clkc 18>;
      clock-names = "send_clk", "send_dly_clk", "ps_clk";
      #address-cells = <1>;
      #size-cells = <0>;
    };
```

## Documentation/devicetree/bindings/spi/mxs-spi.txt
```
* Freescale MX233/MX28 SSP/SPI

Required properties:
- compatible: Should be "fsl,<soc>-spi", where soc is "imx23" or "imx28"
- reg: Offset and length of the register set for the device
- interrupts: Should contain SSP ERROR interrupt
- dmas: DMA specifier, consisting of a phandle to DMA controller node
  and SSP DMA channel ID.
  Refer to dma.txt and fsl-mxs-dma.txt for details.
- dma-names: Must be "rx-tx".

Optional properties:
- clock-frequency : Input clock frequency to the SPI block in Hz.
		    Default is 160000000 Hz.

Example:

ssp0: ssp@80010000 {
	#address-cells = <1>;
	#size-cells = <0>;
	compatible = "fsl,imx28-spi";
	reg = <0x80010000 0x2000>;
	interrupts = <96>;
	dmas = <&dma_apbh 0>;
	dma-names = "rx-tx";
};
```
