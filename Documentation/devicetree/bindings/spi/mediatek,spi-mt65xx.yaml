## Documentation/devicetree/bindings/spi/nvidia,tegra20-sflash.yaml
```yaml
# SPDX-License-Identifier: (GPL-2.0-only OR BSD-2-Clause)
%YAML 1.2
---
$id: http://devicetree.org/schemas/spi/nvidia,tegra20-sflash.yaml#
$schema: http://devicetree.org/meta-schemas/core.yaml#

title: NVIDIA Tegra20 SFLASH controller

maintainers:
  - Thierry Reding <thierry.reding@gmail.com>
  - Jon Hunter <jonathanh@nvidia.com>

properties:
  compatible:
    const: nvidia,tegra20-sflash

  reg:
    maxItems: 1

  interrupts:
    maxItems: 1

  clocks:
    items:
      - description: module clock

  resets:
    items:
      - description: module reset

  reset-names:
    items:
      - const: spi

  dmas:
    items:
      - description: DMA channel used for reception
      - description: DMA channel used for transmission

  dma-names:
    items:
      - const: rx
      - const: tx

  spi-max-frequency:
    description: Maximum SPI clocking speed of the controller in Hz.
    $ref: /schemas/types.yaml#/definitions/uint32

allOf:
  - $ref: spi-controller.yaml

unevaluatedProperties: false

required:
  - compatible
  - reg
  - interrupts
  - clocks
  - resets
  - reset-names
  - dmas
  - dma-names

examples:
  - |
    #include <dt-bindings/clock/tegra20-car.h>
    #include <dt-bindings/interrupt-controller/arm-gic.h>

    spi@7000c380 {
        compatible = "nvidia,tegra20-sflash";
        reg = <0x7000c380 0x80>;
        interrupts = <GIC_SPI 39 IRQ_TYPE_LEVEL_HIGH>;
        spi-max-frequency = <25000000>;
        #address-cells = <1>;
        #size-cells = <0>;
        clocks = <&tegra_car TEGRA20_CLK_SPI>;
        resets = <&tegra_car 43>;
        reset-names = "spi";
        dmas = <&apbdma 11>, <&apbdma 11>;
        dma-names = "rx", "tx";
    };
```

## Documentation/devicetree/bindings/spi/nvidia,tegra20-slink.txt
```
NVIDIA Tegra20/Tegra30 SLINK controller.

Required properties:
- compatible : should be "nvidia,tegra20-slink", "nvidia,tegra30-slink".
- reg: Should contain SLINK registers location and length.
- interrupts: Should contain SLINK interrupts.
- clocks : Must contain one entry, for the module clock.
  See ../clocks/clock-bindings.txt for details.
- resets : Must contain an entry for each entry in reset-names.
  See ../reset/reset.txt for details.
- reset-names : Must include the following entries:
  - spi
- dmas : Must contain an entry for each entry in clock-names.
  See ../dma/dma.txt for details.
- dma-names : Must include the following entries:
  - rx
  - tx

Recommended properties:
- spi-max-frequency: Definition as per
                     Documentation/devicetree/bindings/spi/spi-bus.txt

Example:

spi@7000d600 {
	compatible = "nvidia,tegra20-slink";
	reg = <0x7000d600 0x200>;
	interrupts = <0 82 0x04>;
	spi-max-frequency = <25000000>;
	#address-cells = <1>;
	#size-cells = <0>;
	clocks = <&tegra_car 44>;
	resets = <&tegra_car 44>;
	reset-names = "spi";
	dmas = <&apbdma 16>, <&apbdma 16>;
	dma-names = "rx", "tx";
};
```

## Documentation/devicetree/bindings/spi/nvidia,tegra20-slink.yaml
```yaml
# SPDX-License-Identifier: (GPL-2.0-only OR BSD-2-Clause)
%YAML 1.2
---
$id: http://devicetree.org/schemas/spi/nvidia,tegra20-slink.yaml#
$schema: http://devicetree.org/meta-schemas/core.yaml#

title: NVIDIA Tegra20/30 SLINK controller

maintainers:
  - Thierry Reding <thierry.reding@gmail.com>
  - Jon Hunter <jonathanh@nvidia.com>

properties:
  compatible:
    enum:
      - nvidia,tegra20-slink
      - nvidia,tegra30-slink

  reg:
    maxItems: 1

  interrupts:
    maxItems: 1

  clocks:
    items:
      - description: module clock

  resets:
    items:
      - description: module reset

  reset-names:
    items:
      - const: spi

  dmas:
    items:
      - description: DMA channel used for reception
      - description: DMA channel used for transmission

  dma-names:
    items:
      - const: rx
      - const: tx

  operating-points-v2:
    $ref: /schemas/types.yaml#/definitions/phandle

  power-domains:
    items:
      - description: phandle to the core power domain

  spi-max-frequency:
    description: Maximum SPI clocking speed of the controller in Hz.
    $ref: /schemas/types.yaml#/definitions/uint32

allOf:
  - $ref: spi-controller.yaml

unevaluatedProperties: false

required:
  - compatible
  - reg
  - interrupts
  - clocks
  - resets
  - reset-names
  - dmas
  - dma-names

examples:
  - |
    #include <dt-bindings/clock/tegra20-car.h>
    #include <dt-bindings/interrupt-controller/arm-gic.h>

    spi@7000d600 {
        compatible = "nvidia,tegra20-slink";
        reg = <0x7000d600 0x200>;
        interrupts = <GIC_SPI 82 IRQ_TYPE_LEVEL_HIGH>;
        spi-max-frequency = <25000000>;
        #address-cells = <1>;
        #size-cells = <0>;
        clocks = <&tegra_car TEGRA20_CLK_SBC2>;
        resets = <&tegra_car 44>;
        reset-names = "spi";
        dmas = <&apbdma 16>, <&apbdma 16>;
        dma-names = "rx", "tx";
    };
```

## Documentation/devicetree/bindings/spi/nvidia,tegra20-spi.txt
```
NVIDIA Tegra 2 SPI device

Required properties:
- compatible : should be "nvidia,tegra20-spi".
- gpios : should specify GPIOs used for chipselect.
```

## Documentation/devicetree/bindings/spi/nvidia,tegra210-quad-peripheral-props.yaml
```yaml
# SPDX-License-Identifier: (GPL-2.0 OR BSD-2-Clause)
%YAML 1.2
---
$id: http://devicetree.org/schemas/spi/nvidia,tegra210-quad-peripheral-props.yaml#
$schema: http://devicetree.org/meta-schemas/core.yaml#

title: Peripheral properties for Tegra Quad SPI Controller

maintainers:
  - Thierry Reding <thierry.reding@gmail.com>
  - Jonathan Hunter <jonathanh@nvidia.com>

properties:
  nvidia,tx-clk-tap-delay:
    description:
      Delays the clock going out to device with this tap value.
      Tap value varies based on platform design trace lengths from Tegra
      QSPI to corresponding slave device.
    $ref: /schemas/types.yaml#/definitions/uint32
    minimum: 0
    maximum: 31

  nvidia,rx-clk-tap-delay:
    description:
      Delays the clock coming in from the device with this tap value.
      Tap value varies based on platform design trace lengths from Tegra
      QSPI to corresponding slave device.
    $ref: /schemas/types.yaml#/definitions/uint32
    minimum: 0
    maximum: 255

additionalProperties: true
```

## Documentation/devicetree/bindings/spi/nvidia,tegra210-quad.yaml
```yaml
# SPDX-License-Identifier: (GPL-2.0 OR BSD-2-Clause)
%YAML 1.2
---
$id: http://devicetree.org/schemas/spi/nvidia,tegra210-quad.yaml#
$schema: http://devicetree.org/meta-schemas/core.yaml#

title: Tegra Quad SPI Controller

maintainers:
  - Thierry Reding <thierry.reding@gmail.com>
  - Jonathan Hunter <jonathanh@nvidia.com>

allOf:
  - $ref: "spi-controller.yaml#"

properties:
  compatible:
    enum:
      - nvidia,tegra210-qspi
      - nvidia,tegra186-qspi
      - nvidia,tegra194-qspi
      - nvidia,tegra234-qspi

  reg:
    maxItems: 1

  interrupts:
    maxItems: 1

  clock-names:
    items:
      - const: qspi
      - const: qspi_out

  clocks:
    maxItems: 2

  resets:
    maxItems: 1

  dmas:
    maxItems: 2

  dma-names:
    items:
      - const: rx
      - const: tx

patternProperties:
  "@[0-9a-f]+":
    type: object

    properties:
      spi-rx-bus-width:
        enum: [1, 2, 4]

      spi-tx-bus-width:
        enum: [1, 2, 4]

      nvidia,tx-clk-tap-delay:
        description:
          Delays the clock going out to device with this tap value.
          Tap value varies based on platform design trace lengths from Tegra
          QSPI to corresponding slave device.
        $ref: /schemas/types.yaml#/definitions/uint32
        minimum: 0
        maximum: 31

      nvidia,rx-clk-tap-delay:
        description:
          Delays the clock coming in from the device with this tap value.
          Tap value varies based on platform design trace lengths from Tegra
          QSPI to corresponding slave device.
        $ref: /schemas/types.yaml#/definitions/uint32
        minimum: 0
        maximum: 255

    required:
      - reg

required:
  - compatible
  - reg
  - interrupts
  - clock-names
  - clocks
  - resets

unevaluatedProperties: false

examples:
  - |
    #include <dt-bindings/clock/tegra210-car.h>
    #include <dt-bindings/reset/tegra210-car.h>
    #include <dt-bindings/interrupt-controller/arm-gic.h>
    spi@70410000 {
            compatible = "nvidia,tegra210-qspi";
            reg = <0x70410000 0x1000>;
            interrupts = <GIC_SPI 10 IRQ_TYPE_LEVEL_HIGH>;
            #address-cells = <1>;
            #size-cells = <0>;
            clocks = <&tegra_car TEGRA210_CLK_QSPI>,
                     <&tegra_car TEGRA210_CLK_QSPI_PM>;
            clock-names = "qspi", "qspi_out";
            resets = <&tegra_car 211>;
            dmas = <&apbdma 5>, <&apbdma 5>;
            dma-names = "rx", "tx";

            flash@0 {
                    compatible = "jedec,spi-nor";
                    reg = <0>;
                    spi-max-frequency = <104000000>;
                    spi-tx-bus-width = <2>;
                    spi-rx-bus-width = <2>;
                    nvidia,tx-clk-tap-delay = <0>;
                    nvidia,rx-clk-tap-delay = <0>;
            };
    };
```

## Documentation/devicetree/bindings/spi/nxp,imx94-xspi.yaml
```yaml
# SPDX-License-Identifier: (GPL-2.0-only OR BSD-2-Clause)
%YAML 1.2
---
$id: http://devicetree.org/schemas/spi/nxp,imx94-xspi.yaml#
$schema: http://devicetree.org/meta-schemas/core.yaml#

title: NXP External Serial Peripheral Interface (xSPI)

maintainers:
  - Haibo Chen <haibo.chen@nxp.com>
  - Han Xu <han.xu@nxp.com>

properties:
  compatible:
    oneOf:
      - enum:
          - nxp,imx94-xspi
      - items:
          - enum:
              - nxp,imx952-xspi
          - const: nxp,imx94-xspi

  reg:
    items:
      - description: registers address space
      - description: memory mapped address space

  reg-names:
    items:
      - const: base
      - const: mmap

  interrupts:
    items:
      - description: interrupt for EENV0
      - description: interrupt for EENV1
      - description: interrupt for EENV2
      - description: interrupt for EENV3
      - description: interrupt for EENV4

  clocks:
    items:
      - description: SPI serial clock

  clock-names:
    items:
      - const: per

required:
  - compatible
  - reg
  - reg-names
  - interrupts
  - clocks
  - clock-names

allOf:
  - $ref: spi-controller.yaml#

unevaluatedProperties: false

examples:
  - |
    #include <dt-bindings/interrupt-controller/arm-gic.h>

    soc {
        #address-cells = <2>;
        #size-cells = <2>;

        spi@42b90000 {
            compatible = "nxp,imx94-xspi";
            reg = <0x0 0x42b90000 0x0 0x50000>, <0x0 0x28000000 0x0 0x08000000>;
            reg-names = "base", "mmap";
            interrupts = <GIC_SPI 390 IRQ_TYPE_LEVEL_HIGH>,
                         <GIC_SPI 391 IRQ_TYPE_LEVEL_HIGH>,
                         <GIC_SPI 392 IRQ_TYPE_LEVEL_HIGH>,
                         <GIC_SPI 393 IRQ_TYPE_LEVEL_HIGH>,
                         <GIC_SPI 394 IRQ_TYPE_LEVEL_HIGH>;
            #address-cells = <1>;
            #size-cells = <0>;
            clocks = <&scmi_1>;
            clock-names = "per";

            flash@0 {
                compatible = "jedec,spi-nor";
                reg = <0>;
                spi-max-frequency = <200000000>;
                spi-rx-bus-width = <8>;
                spi-tx-bus-width = <8>;
            };
        };
    };
```
