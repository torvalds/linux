## Documentation/devicetree/bindings/spi/spi-synquacer.txt
```
* Socionext Synquacer HS-SPI bindings

Required Properties:
- compatible: should be "socionext,synquacer-spi"
- reg: physical base address of the controller and length of memory mapped
       region.
- interrupts: should contain the "spi_rx", "spi_tx" and "spi_fault" interrupts.
- clocks: core clock iHCLK. Optional rate clock iPCLK (default is iHCLK)
- clock-names: Shall be "iHCLK" and "iPCLK" respectively

Optional Properties:
- socionext,use-rtm: boolean, if required to use "retimed clock" for RX
- socionext,set-aces: boolean, if same active clock edges field to be set.

Example:

	spi0: spi@ff110000 {
		compatible = "socionext,synquacer-spi";
		reg = <0xff110000 0x1000>;
		interrupts = <GIC_SPI 160 IRQ_TYPE_LEVEL_HIGH>,
			     <GIC_SPI 161 IRQ_TYPE_LEVEL_HIGH>,
			     <GIC_SPI 162 IRQ_TYPE_LEVEL_HIGH>;
		clocks = <&clk_hsspi>;
		clock-names = "iHCLK";
		socionext,use-rtm;
		socionext,set-aces;
	};
```

## Documentation/devicetree/bindings/spi/spi-uniphier.txt
```
Socionext UniPhier SPI controller driver

UniPhier SoCs have SCSSI which supports SPI single channel.

Required properties:
 - compatible: should be "socionext,uniphier-scssi"
 - reg: address and length of the spi master registers
 - #address-cells: must be <1>, see spi-bus.txt
 - #size-cells: must be <0>, see spi-bus.txt
 - interrupts: a single interrupt specifier
 - pinctrl-names: should be "default"
 - pinctrl-0: pin control state for the default mode
 - clocks: a phandle to the clock for the device
 - resets: a phandle to the reset control for the device

Example:

spi0: spi@54006000 {
	compatible = "socionext,uniphier-scssi";
	reg = <0x54006000 0x100>;
	#address-cells = <1>;
	#size-cells = <0>;
	interrupts = <0 39 4>;
	pinctrl-names = "default";
	pinctrl-0 = <&pinctrl_spi0>;
	clocks = <&peri_clk 11>;
	resets = <&peri_rst 11>;
};
```

## Documentation/devicetree/bindings/spi/spi-xilinx.txt
```
Xilinx SPI controller Device Tree Bindings
-------------------------------------------------

Required properties:
- compatible		: Should be "xlnx,xps-spi-2.00.a", "xlnx,xps-spi-2.00.b" or "xlnx,axi-quad-spi-1.00.a"
- reg			: Physical base address and size of SPI registers map.
- interrupts		: Property with a value describing the interrupt
			  number.
- interrupt-parent	: Must be core interrupt controller

Optional properties:
- xlnx,num-ss-bits	: Number of chip selects used.

Example:
	axi_quad_spi@41e00000 {
			compatible = "xlnx,xps-spi-2.00.a";
			interrupt-parent = <&intc>;
			interrupts = <0 31 1>;
			reg = <0x41e00000 0x10000>;
			xlnx,num-ss-bits = <0x1>;
	};
```

## Documentation/devicetree/bindings/spi/spi-xilinx.yaml
```yaml
# SPDX-License-Identifier: (GPL-2.0-only OR BSD-2-Clause)
%YAML 1.2
---
$id: http://devicetree.org/schemas/spi/spi-xilinx.yaml#
$schema: http://devicetree.org/meta-schemas/core.yaml#

title: Xilinx SPI controller

maintainers:
  - Michal Simek <michal.simek@amd.com>

allOf:
  - $ref: spi-controller.yaml#

properties:
  compatible:
    enum:
      - xlnx,xps-spi-2.00.a
      - xlnx,xps-spi-2.00.b
      - xlnx,axi-quad-spi-1.00.a

  reg:
    maxItems: 1

  interrupts:
    maxItems: 1

  xlnx,num-ss-bits:
    description: Number of chip selects used.
    minimum: 1
    maximum: 32

  xlnx,num-transfer-bits:
    description: Number of bits per transfer. This will be 8 if not specified.
    enum: [8, 16, 32]
    default: 8

required:
  - compatible
  - reg
  - interrupts

unevaluatedProperties: false

examples:
  - |
    spi0: spi@41e00000 {
      compatible = "xlnx,xps-spi-2.00.a";
      interrupt-parent = <&intc>;
      interrupts = <0 31 1>;
      reg = <0x41e00000 0x10000>;
      xlnx,num-ss-bits = <0x1>;
      xlnx,num-transfer-bits = <32>;
    };
...
```

## Documentation/devicetree/bindings/spi/spi-xlp.txt
```
SPI Master controller for Netlogic XLP MIPS64 SOCs
==================================================

Currently this SPI controller driver is supported for the following
Netlogic XLP SoCs:
	XLP832, XLP316, XLP208, XLP980, XLP532

Required properties:
- compatible		: Should be "netlogic,xlp832-spi".
- #address-cells	: Number of cells required to define a chip select address
			  on the SPI bus.
- #size-cells		: Should be zero.
- reg			: Should contain register location and length.
- clocks		: Phandle of the spi clock
- interrupts		: Interrupt number used by this controller.

SPI slave nodes must be children of the SPI master node and can contain
properties described in Documentation/devicetree/bindings/spi/spi-bus.txt.

Example:

	spi: xlp_spi@3a100 {
		compatible = "netlogic,xlp832-spi";
		#address-cells = <1>;
		#size-cells = <0>;
		reg = <0 0x3a100 0x100>;
		clocks = <&spi_clk>;
		interrupts = <34>;
		interrupt-parent = <&pic>;

		spi_nor@1 {
			compatible = "spansion,s25sl12801";
			#address-cells = <1>;
			#size-cells = <1>;
			reg = <1>;	/* Chip Select */
			spi-max-frequency = <40000000>;
		};
};
```

## Documentation/devicetree/bindings/spi/spi-xtensa-xtfpga.txt
```
Cadence Xtensa XTFPGA platform SPI controller.

This simple SPI master controller is built into xtfpga bitstreams and is used
to control daughterboard audio codec.

Required properties:
- compatible: should be "cdns,xtfpga-spi".
- reg: physical base address of the controller and length of memory mapped
  region.
```

## Documentation/devicetree/bindings/spi/spi-zynq-qspi.txt
```
Xilinx Zynq QSPI controller Device Tree Bindings
-------------------------------------------------------------------

Required properties:
- compatible		: Should be "xlnx,zynq-qspi-1.0".
- reg			: Physical base address and size of QSPI registers map.
- interrupts		: Property with a value describing the interrupt
			  number.
- clock-names		: List of input clock names - "ref_clk", "pclk"
			  (See clock bindings for details).
- clocks		: Clock phandles (see clock bindings for details).

Optional properties:
- num-cs		: Number of chip selects used.

Example:
	qspi: spi@e000d000 {
		compatible = "xlnx,zynq-qspi-1.0";
		reg = <0xe000d000 0x1000>;
		interrupt-parent = <&intc>;
		interrupts = <0 19 4>;
		clock-names = "ref_clk", "pclk";
		clocks = <&clkc 10>, <&clkc 43>;
		num-cs = <1>;
	};
```

## Documentation/devicetree/bindings/spi/spi-zynqmp-qspi.txt
```
Xilinx Zynq UltraScale+ MPSoC GQSPI controller Device Tree Bindings
-------------------------------------------------------------------

Required properties:
- compatible		: Should be "xlnx,zynqmp-qspi-1.0".
- reg			: Physical base address and size of GQSPI registers map.
- interrupts		: Property with a value describing the interrupt
			  number.
- clock-names		: List of input clock names - "ref_clk", "pclk"
			  (See clock bindings for details).
- clocks		: Clock phandles (see clock bindings for details).

Optional properties:
- num-cs		: Number of chip selects used.

Example:
	qspi: spi@ff0f0000 {
		compatible = "xlnx,zynqmp-qspi-1.0";
		clock-names = "ref_clk", "pclk";
		clocks = <&misc_clk &misc_clk>;
		interrupts = <0 15 4>;
		interrupt-parent = <&gic>;
		num-cs = <1>;
		reg = <0x0 0xff0f0000 0x1000>,<0x0 0xc0000000 0x8000000>;
	};
```

## Documentation/devicetree/bindings/spi/spi-zynqmp-qspi.yaml
```yaml
# SPDX-License-Identifier: (GPL-2.0-only OR BSD-2-Clause)
%YAML 1.2
---
$id: http://devicetree.org/schemas/spi/spi-zynqmp-qspi.yaml#
$schema: http://devicetree.org/meta-schemas/core.yaml#

title: Xilinx Zynq UltraScale+ MPSoC GQSPI controller

maintainers:
  - Michal Simek <michal.simek@amd.com>

allOf:
  - $ref: spi-controller.yaml#

properties:
  compatible:
    enum:
      - xlnx,versal-qspi-1.0
      - xlnx,zynqmp-qspi-1.0

  reg:
    maxItems: 2

  interrupts:
    maxItems: 1

  clock-names:
    items:
      - const: ref_clk
      - const: pclk

  clocks:
    maxItems: 2

  iommus:
    maxItems: 1

  power-domains:
    maxItems: 1

required:
  - compatible
  - reg
  - interrupts
  - clock-names
  - clocks

unevaluatedProperties: false

examples:
  - |
    #include <dt-bindings/clock/xlnx-zynqmp-clk.h>
    soc {
      #address-cells = <2>;
      #size-cells = <2>;

      qspi: spi@ff0f0000 {
        compatible = "xlnx,zynqmp-qspi-1.0";
        clocks = <&zynqmp_clk QSPI_REF>, <&zynqmp_clk LPD_LSBUS>;
        clock-names = "ref_clk", "pclk";
        interrupts = <0 15 4>;
        interrupt-parent = <&gic>;
        reg = <0x0 0xff0f0000 0x0 0x1000>,
              <0x0 0xc0000000 0x0 0x8000000>;
      };
    };
```

## Documentation/devicetree/bindings/spi/spi_altera.txt
```
Altera SPI

Required properties:
- compatible : should be "ALTR,spi-1.0". <DEPRECATED>
- compatible : should be "altr,spi-1.0".
```

## Documentation/devicetree/bindings/spi/spi_atmel.txt
```
Atmel SPI device

Required properties:
- compatible : should be "atmel,at91rm9200-spi".
- reg: Address and length of the register set for the device
- interrupts: Should contain spi interrupt
- cs-gpios: chipselects (optional for SPI controller version >= 2 with the
  Chip Select Active After Transfer feature).
- clock-names: tuple listing input clock names.
	Required elements: "spi_clk"
- clocks: phandles to input clocks.

Optional properties:
- atmel,fifo-size: maximum number of data the RX and TX FIFOs can store for FIFO
  capable SPI controllers.

Example:

spi1: spi@fffcc000 {
	compatible = "atmel,at91rm9200-spi";
	reg = <0xfffcc000 0x4000>;
	interrupts = <13 4 5>;
	#address-cells = <1>;
	#size-cells = <0>;
	clocks = <&spi1_clk>;
	clock-names = "spi_clk";
	cs-gpios = <&pioB 3 0>;
	atmel,fifo-size = <32>;
	status = "okay";

	mmc-slot@0 {
		compatible = "mmc-spi-slot";
		reg = <0>;
		gpios = <&pioC 4 0>;	/* CD */
		spi-max-frequency = <25000000>;
	};
};
```

## Documentation/devicetree/bindings/spi/spi_nvidia.txt
```
NVIDIA Tegra 2 SPI device

Required properties:
- compatible : should be "nvidia,tegra250-spi".
- gpios : should specify GPIOs used for chipselect.
```

## Documentation/devicetree/bindings/spi/spi_oc_tiny.txt
```
OpenCores tiny SPI

Required properties:
- compatible : should be "opencores,tiny-spi-rtlsvn2".
- gpios : should specify GPIOs used for chipselect.
Optional properties:
- clock-frequency : input clock frequency to the core.
- baud-width: width, in bits, of the programmable divider used to scale
	the input clock to SCLK.

The clock-frequency and baud-width properties are needed only if the divider
is programmable. They are not needed if the divider is fixed.
```

## Documentation/devicetree/bindings/spi/spi_pl022.txt
```
ARM PL022 SPI controller

Required properties:
- compatible : "arm,pl022", "arm,primecell"
- reg : Offset and length of the register set for the device
- interrupts : Should contain SPI controller interrupt

Optional properties:
- num-cs : total number of chipselects
- cs-gpios : should specify GPIOs used for chipselects.
  The gpios will be referred to as reg = <index> in the SPI child nodes.
  If unspecified, a single SPI device without a chip select can be used.
- pl022,autosuspend-delay : delay in ms following transfer completion before
			    the runtime power management system suspends the
			    device. A setting of 0 indicates no delay and the
                            device will be suspended immediately
- pl022,rt : indicates the controller should run the message pump with realtime
             priority to minimise the transfer latency on the bus (boolean)
- dmas : Two or more DMA channel specifiers following the convention outlined
         in bindings/dma/dma.txt
- dma-names: Names for the dma channels, if present. There must be at
	     least one channel named "tx" for transmit and named "rx" for
             receive.


SPI slave nodes must be children of the SPI master node and can
contain the following properties.

- pl022,interface : interface type:
	0: SPI
	1: Texas Instruments Synchronous Serial Frame Format
	2: Microwire (Half Duplex)
- pl022,com-mode : polling, interrupt or dma
- pl022,rx-level-trig : Rx FIFO watermark level
- pl022,tx-level-trig : Tx FIFO watermark level
- pl022,ctrl-len : Microwire interface: Control length
- pl022,wait-state : Microwire interface: Wait state
- pl022,duplex : Microwire interface: Full/Half duplex


Example:

	spi@e0100000 {
		compatible = "arm,pl022", "arm,primecell";
		reg = <0xe0100000 0x1000>;
		#address-cells = <1>;
		#size-cells = <0>;
		interrupts = <0 31 0x4>;
		dmas = <&dma-controller 23 1>,
			<&dma-controller 24 0>;
		dma-names = "rx", "tx";

		m25p80@1 {
			compatible = "st,m25p80";
			reg = <1>;
			spi-max-frequency = <12000000>;
			spi-cpol;
			spi-cpha;
			pl022,hierarchy = <0>;
			pl022,interface = <0>;
			pl022,slave-tx-disable;
			pl022,com-mode = <0x2>;
			pl022,rx-level-trig = <0>;
			pl022,tx-level-trig = <0>;
			pl022,ctrl-len = <0x11>;
			pl022,wait-state = <0>;
			pl022,duplex = <0>;
		};
	};
	
```

## Documentation/devicetree/bindings/spi/sprd,sc9860-spi.yaml
```yaml
# SPDX-License-Identifier: GPL-2.0-only OR BSD-2-Clause
%YAML 1.2
---
$id: http://devicetree.org/schemas/spi/sprd,sc9860-spi.yaml#
$schema: http://devicetree.org/meta-schemas/core.yaml#

title: Spreadtrum SC9860 SPI Controller

maintainers:
  - Orson Zhai <orsonzhai@gmail.com>
  - Baolin Wang <baolin.wang7@gmail.com>
  - Chunyan Zhang <zhang.lyra@gmail.com>

properties:
  compatible:
    const: sprd,sc9860-spi

  reg:
    maxItems: 1

  interrupts:
    maxItems: 1

  clocks:
    items:
      - description: SPI clock
      - description: SPI source (parent) clock
      - description: SPI module enable clock

  clock-names:
    items:
      - const: spi
      - const: source
      - const: enable

  dmas:
    maxItems: 2

  dma-names:
    items:
      - const: rx_chn
      - const: tx_chn

required:
  - compatible
  - reg
  - interrupts
  - clocks
  - clock-names

allOf:
  - $ref: spi-controller.yaml#

unevaluatedProperties: false

examples:
  - |
    #include <dt-bindings/interrupt-controller/arm-gic.h>
    #include <dt-bindings/interrupt-controller/irq.h>

    spi@70a00000 {
      compatible = "sprd,sc9860-spi";
      reg = <0x70a00000 0x1000>;
      interrupts = <GIC_SPI 7 IRQ_TYPE_LEVEL_HIGH>;
      clocks = <&clk_spi0>, <&ext_26m>, <&clk_ap_apb_gates 5>;
      clock-names = "spi", "source", "enable";
      dmas = <&apdma 11 11>, <&apdma 12 12>;
      dma-names = "rx_chn", "tx_chn";
      #address-cells = <1>;
      #size-cells = <0>;
    };
...
```
