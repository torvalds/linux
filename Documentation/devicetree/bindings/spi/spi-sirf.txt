## Documentation/devicetree/bindings/spi/spi-sirf.txt
```
* CSR SiRFprimaII Serial Peripheral Interface

Required properties:
- compatible : Should be "sirf,prima2-spi"
- reg : Offset and length of the register set for the device
- interrupts : Should contain SPI interrupt
- resets: phandle to the reset controller asserting this device in
          reset
  See ../reset/reset.txt for details.
- dmas : Must contain an entry for each entry in clock-names.
  See ../dma/dma.txt for details.
- dma-names : Must include the following entries:
  - rx
  - tx
- clocks : Must contain an entry for each entry in clock-names.
  See ../clocks/clock-bindings.txt for details.

- #address-cells: Number of cells required to define a chip select
                  address on the SPI bus. Should be set to 1.
- #size-cells:    Should be zero.

Optional properties:
- spi-max-frequency: Specifies maximum SPI clock frequency,
                     Units - Hz. Definition as per
                     Documentation/devicetree/bindings/spi/spi-bus.txt
- cs-gpios:     should specify GPIOs used for chipselects.

Example:

spi0: spi@b00d0000 {
	compatible = "sirf,prima2-spi";
	reg = <0xb00d0000 0x10000>;
	interrupts = <15>;
	dmas = <&dmac1 9>,
		<&dmac1 4>;
	dma-names = "rx", "tx";
	#address-cells = <1>;
	#size-cells = <0>;
	clocks = <&clks 19>;
	resets = <&rstc 26>;
};
```

## Documentation/devicetree/bindings/spi/spi-slave-mt27xx.txt
```
Binding for MTK SPI Slave controller

Required properties:
- compatible: should be one of the following.
    - mediatek,mt2712-spi-slave: for mt2712 platforms
- reg: Address and length of the register set for the device.
- interrupts: Should contain spi interrupt.
- clocks: phandles to input clocks.
  It's clock gate, and should be <&infracfg CLK_INFRA_AO_SPI1>.
- clock-names: should be "spi" for the clock gate.

Optional properties:
- assigned-clocks: it's mux clock, should be <&topckgen CLK_TOP_SPISLV_SEL>.
- assigned-clock-parents: parent of mux clock.
  It's PLL, and should be one of the following.
   -  <&topckgen CLK_TOP_UNIVPLL1_D2>: specify parent clock 312MHZ.
				       It's the default one.
   -  <&topckgen CLK_TOP_UNIVPLL1_D4>: specify parent clock 156MHZ.
   -  <&topckgen CLK_TOP_UNIVPLL2_D4>: specify parent clock 104MHZ.
   -  <&topckgen CLK_TOP_UNIVPLL1_D8>: specify parent clock 78MHZ.

Example:
- SoC Specific Portion:
spis1: spi@10013000 {
	compatible = "mediatek,mt2712-spi-slave";
	reg = <0 0x10013000 0 0x100>;
	interrupts = <GIC_SPI 283 IRQ_TYPE_LEVEL_LOW>;
	clocks = <&infracfg CLK_INFRA_AO_SPI1>;
	clock-names = "spi";
	assigned-clocks = <&topckgen CLK_TOP_SPISLV_SEL>;
	assigned-clock-parents = <&topckgen CLK_TOP_UNIVPLL1_D2>;
};
```

## Documentation/devicetree/bindings/spi/spi-sprd-adi.txt
```
Spreadtrum ADI controller

ADI is the abbreviation of Anolog-Digital interface, which is used to access
analog chip (such as PMIC) from digital chip. ADI controller follows the SPI
framework for its hardware implementation is alike to SPI bus and its timing
is compatile to SPI timing.

ADI controller has 50 channels including 2 software read/write channels and
48 hardware channels to access analog chip. For 2 software read/write channels,
users should set ADI registers to access analog chip. For hardware channels,
we can configure them to allow other hardware components to use it independently,
which means we can just link one analog chip address to one hardware channel,
then users can access the mapped analog chip address by this hardware channel
triggered by hardware components instead of ADI software channels.

Thus we introduce one property named "sprd,hw-channels" to configure hardware
channels, the first value specifies the hardware channel id which is used to
transfer data triggered by hardware automatically, and the second value specifies
the analog chip address where user want to access by hardware components.

Since we have multi-subsystems will use unique ADI to access analog chip, when
one system is reading/writing data by ADI software channels, that should be under
one hardware spinlock protection to prevent other systems from reading/writing
data by ADI software channels at the same time, or two parallel routine of setting
ADI registers will make ADI controller registers chaos to lead incorrect results.
Then we need one hardware spinlock to synchronize between the multiple subsystems.

Required properties:
- compatible: Should be "sprd,sc9860-adi".
- reg: Offset and length of ADI-SPI controller register space.
- hwlocks: Reference to a phandle of a hwlock provider node.
- hwlock-names: Reference to hwlock name strings defined in the same order
	as the hwlocks, should be "adi".
- #address-cells: Number of cells required to define a chip select address
	on the ADI-SPI bus. Should be set to 1.
- #size-cells: Size of cells required to define a chip select address size
	on the ADI-SPI bus. Should be set to 0.

Optional properties:
- sprd,hw-channels: This is an array of channel values up to 49 channels.
	The first value specifies the hardware channel id which is used to
	transfer data triggered by hardware automatically, and the second
	value specifies the analog chip address where user want to access
	by hardware components.

SPI slave nodes must be children of the SPI controller node and can contain
properties described in Documentation/devicetree/bindings/spi/spi-bus.txt.

Example:
	adi_bus: spi@40030000 {
		compatible = "sprd,sc9860-adi";
		reg = <0 0x40030000 0 0x10000>;
		hwlocks = <&hwlock1 0>;
		hwlock-names = "adi";
		#address-cells = <1>;
		#size-cells = <0>;
		sprd,hw-channels = <30 0x8c20>;
	};
```

## Documentation/devicetree/bindings/spi/spi-sprd.txt
```
Spreadtrum SPI Controller

Required properties:
- compatible: Should be "sprd,sc9860-spi".
- reg: Offset and length of SPI controller register space.
- interrupts: Should contain SPI interrupt.
- clock-names: Should contain following entries:
	"spi" for SPI clock,
	"source" for SPI source (parent) clock,
	"enable" for SPI module enable clock.
- clocks: List of clock input name strings sorted in the same order
	as the clock-names property.
- #address-cells: The number of cells required to define a chip select
	address on the SPI bus. Should be set to 1.
- #size-cells: Should be set to 0.

Optional properties:
dma-names: Should contain names of the SPI used DMA channel.
dmas: Should contain DMA channels and DMA slave ids which the SPI used
	sorted in the same order as the dma-names property.

Example:
spi0: spi@70a00000{
	compatible = "sprd,sc9860-spi";
	reg = <0 0x70a00000 0 0x1000>;
	interrupts = <GIC_SPI 7 IRQ_TYPE_LEVEL_HIGH>;
	clock-names = "spi", "source","enable";
	clocks = <&clk_spi0>, <&ext_26m>, <&clk_ap_apb_gates 5>;
	dma-names = "rx_chn", "tx_chn";
	dmas = <&apdma 11 11>, <&apdma 12 12>;
	#address-cells = <1>;
	#size-cells = <0>;
};
```

## Documentation/devicetree/bindings/spi/spi-st-ssc.txt
```
STMicroelectronics SSC (SPI) Controller
---------------------------------------

Required properties:
- compatible	: "st,comms-ssc4-spi"
- reg		: Offset and length of the device's register set
- interrupts	: The interrupt specifier
- clock-names	: Must contain "ssc"
- clocks	: Must contain an entry for each name in clock-names
		    See ../clk/*
- pinctrl-names	: Uses "default", can use "sleep" if provided
		    See ../pinctrl/pinctrl-binding.txt

Optional properties:
- cs-gpios	: List of GPIO chip selects
		    See ../spi/spi-bus.txt

Child nodes represent devices on the SPI bus
  See ../spi/spi-bus.txt

Example:
	spi@9840000 {
		compatible	= "st,comms-ssc4-spi";
		reg		= <0x9840000 0x110>;
		interrupts	= <GIC_SPI 112 IRQ_TYPE_LEVEL_HIGH>;
		clocks		= <&clk_s_c0_flexgen CLK_EXT2F_A9>;
		clock-names	= "ssc";
		pinctrl-0	= <&pinctrl_spi0_default>;
		pinctrl-names	= "default";
		cs-gpios	= <&pio17 5 0>;
		#address-cells	= <1>;
		#size-cells	= <0>;

		st95hf@0{
			compatible		= "st,st95hf";
			reg			= <0>;
			spi-max-frequency	= <1000000>;
			interrupts		= <2 IRQ_TYPE_EDGE_FALLING>;
		};
	};
```

## Documentation/devicetree/bindings/spi/spi-stm32-qspi.txt
```
* STMicroelectronics Quad Serial Peripheral Interface(QSPI)

Required properties:
- compatible: should be "st,stm32f469-qspi"
- reg: the first contains the register location and length.
       the second contains the memory mapping address and length
- reg-names: should contain the reg names "qspi" "qspi_mm"
- interrupts: should contain the interrupt for the device
- clocks: the phandle of the clock needed by the QSPI controller
- A pinctrl must be defined to set pins in mode of operation for QSPI transfer

Optional properties:
- resets: must contain the phandle to the reset controller.

A spi flash (NOR/NAND) must be a child of spi node and could have some
properties. Also see jedec,spi-nor.txt.

Required properties:
- reg: chip-Select number (QSPI controller may connect 2 flashes)
- spi-max-frequency: max frequency of spi bus

Optional properties:
- spi-rx-bus-width: see ./spi-bus.txt for the description
- dmas: DMA specifiers for tx and rx dma. See the DMA client binding,
Documentation/devicetree/bindings/dma/dma.txt.
- dma-names: DMA request names should include "tx" and "rx" if present.

Example:

qspi: spi@a0001000 {
	compatible = "st,stm32f469-qspi";
	reg = <0xa0001000 0x1000>, <0x90000000 0x10000000>;
	reg-names = "qspi", "qspi_mm";
	interrupts = <91>;
	resets = <&rcc STM32F4_AHB3_RESET(QSPI)>;
	clocks = <&rcc 0 STM32F4_AHB3_CLOCK(QSPI)>;
	pinctrl-names = "default";
	pinctrl-0 = <&pinctrl_qspi0>;

	flash@0 {
		compatible = "jedec,spi-nor";
		reg = <0>;
		spi-rx-bus-width = <4>;
		spi-max-frequency = <108000000>;
		...
	};
};
```

## Documentation/devicetree/bindings/spi/spi-stm32.txt
```
STMicroelectronics STM32 SPI Controller

The STM32 SPI controller is used to communicate with external devices using
the Serial Peripheral Interface. It supports full-duplex, half-duplex and
simplex synchronous serial communication with external devices. It supports
from 4 to 32-bit data size. Although it can be configured as master or slave,
only master is supported by the driver.

Required properties:
- compatible: Should be one of:
  "st,stm32h7-spi"
  "st,stm32f4-spi"
- reg: Offset and length of the device's register set.
- interrupts: Must contain the interrupt id.
- clocks: Must contain an entry for spiclk (which feeds the internal clock
	  generator).
- #address-cells:  Number of cells required to define a chip select address.
- #size-cells: Should be zero.

Optional properties:
- resets: Must contain the phandle to the reset controller.
- A pinctrl state named "default" may be defined to set pins in mode of
  operation for SPI transfer.
- dmas: DMA specifiers for tx and rx dma. DMA fifo mode must be used. See the
  STM32 DMA bindings, Documentation/devicetree/bindings/dma/stm32-dma.txt.
- dma-names: DMA request names should include "tx" and "rx" if present.
- cs-gpios: list of GPIO chip selects. See the SPI bus bindings,
  Documentation/devicetree/bindings/spi/spi-bus.txt


Child nodes represent devices on the SPI bus
  See ../spi/spi-bus.txt

Optional properties:
- st,spi-midi-ns: Only for STM32H7, (Master Inter-Data Idleness) minimum time
		  delay in nanoseconds inserted between two consecutive data
		  frames.


Example:
	spi2: spi@40003800 {
		#address-cells = <1>;
		#size-cells = <0>;
		compatible = "st,stm32h7-spi";
		reg = <0x40003800 0x400>;
		interrupts = <36>;
		clocks = <&rcc SPI2_CK>;
		resets = <&rcc 1166>;
		dmas = <&dmamux1 0 39 0x400 0x01>,
		       <&dmamux1 1 40 0x400 0x01>;
		dma-names = "rx", "tx";
		pinctrl-0 = <&spi2_pins_b>;
		pinctrl-names = "default";
		cs-gpios = <&gpioa 11 0>;

		aardvark@0 {
			compatible = "totalphase,aardvark";
			reg = <0>;
			spi-max-frequency = <4000000>;
			st,spi-midi-ns = <4000>;
		};
	};
```

## Documentation/devicetree/bindings/spi/spi-sun4i.txt
```
Allwinner A10 SPI controller

Required properties:
- compatible: Should be "allwinner,sun4-a10-spi".
- reg: Should contain register location and length.
- interrupts: Should contain interrupt.
- clocks: phandle to the clocks feeding the SPI controller. Two are
          needed:
  - "ahb": the gated AHB parent clock
  - "mod": the parent module clock
- clock-names: Must contain the clock names described just above

Example:

spi1: spi@01c06000 {
	compatible = "allwinner,sun4i-a10-spi";
	reg = <0x01c06000 0x1000>;
	interrupts = <11>;
	clocks = <&ahb_gates 21>, <&spi1_clk>;
	clock-names = "ahb", "mod";
	#address-cells = <1>;
	#size-cells = <0>;
};
```

## Documentation/devicetree/bindings/spi/spi-sun6i.txt
```
Allwinner A31/H3 SPI controller

Required properties:
- compatible: Should be "allwinner,sun6i-a31-spi" or "allwinner,sun8i-h3-spi".
- reg: Should contain register location and length.
- interrupts: Should contain interrupt.
- clocks: phandle to the clocks feeding the SPI controller. Two are
          needed:
  - "ahb": the gated AHB parent clock
  - "mod": the parent module clock
- clock-names: Must contain the clock names described just above
- resets: phandle to the reset controller asserting this device in
          reset

Optional properties:
- dmas: DMA specifiers for rx and tx dma. See the DMA client binding,
	Documentation/devicetree/bindings/dma/dma.txt
- dma-names: DMA request names should include "rx" and "tx" if present.

Example:

spi1: spi@1c69000 {
	compatible = "allwinner,sun6i-a31-spi";
	reg = <0x01c69000 0x1000>;
	interrupts = <0 66 4>;
	clocks = <&ahb1_gates 21>, <&spi1_clk>;
	clock-names = "ahb", "mod";
	resets = <&ahb1_rst 21>;
};

spi0: spi@1c68000 {
	compatible = "allwinner,sun8i-h3-spi";
	reg = <0x01c68000 0x1000>;
	interrupts = <GIC_SPI 65 IRQ_TYPE_LEVEL_HIGH>;
	clocks = <&ccu CLK_BUS_SPI0>, <&ccu CLK_SPI0>;
	clock-names = "ahb", "mod";
	dmas = <&dma 23>, <&dma 23>;
	dma-names = "rx", "tx";
	pinctrl-names = "default";
	pinctrl-0 = <&spi0_pins>;
	resets = <&ccu RST_BUS_SPI0>;
	#address-cells = <1>;
	#size-cells = <0>;
};
```

## Documentation/devicetree/bindings/spi/spi-sunplus-sp7021.yaml
```yaml
# SPDX-License-Identifier: (GPL-2.0 OR BSD-2-Clause)
# Copyright (C) Sunplus Co., Ltd. 2021
%YAML 1.2
---
$id: http://devicetree.org/schemas/spi/spi-sunplus-sp7021.yaml#
$schema: http://devicetree.org/meta-schemas/core.yaml#

title: Sunplus sp7021 SPI controller

allOf:
  - $ref: spi-controller.yaml

maintainers:
  - Li-hao Kuo <lhjeff911@gmail.com>

properties:
  compatible:
    enum:
      - sunplus,sp7021-spi

  reg:
    items:
      - description: the SPI master registers
      - description: the SPI slave registers

  reg-names:
    items:
      - const: master
      - const: slave

  interrupt-names:
    items:
      - const: dma_w
      - const: master_risc
      - const: slave_risc

  interrupts:
    minItems: 3

  clocks:
    maxItems: 1

  resets:
    maxItems: 1

required:
  - compatible
  - reg
  - reg-names
  - interrupts
  - interrupt-names
  - clocks
  - resets
  - pinctrl-names
  - pinctrl-0

unevaluatedProperties: false

examples:
  - |
    #include <dt-bindings/interrupt-controller/irq.h>
    spi@9c002d80 {
        compatible = "sunplus,sp7021-spi";
        reg = <0x9c002d80 0x80>, <0x9c002e00 0x80>;
        reg-names = "master", "slave";
        interrupt-parent = <&intc>;
        interrupt-names = "dma_w",
                          "master_risc",
                          "slave_risc";
        interrupts = <144 IRQ_TYPE_LEVEL_HIGH>,
                     <146 IRQ_TYPE_LEVEL_HIGH>,
                     <145 IRQ_TYPE_LEVEL_HIGH>;
        clocks = <&clkc 0x32>;
        resets = <&rstc 0x22>;
        pinctrl-names = "default";
        pinctrl-0 = <&pins_spi0>;
    };
...
```
