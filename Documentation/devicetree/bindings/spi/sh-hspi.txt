## Documentation/devicetree/bindings/spi/spacemit,k1-spi.yaml
```yaml
# SPDX-License-Identifier: (GPL-2.0 OR BSD-2-Clause)
%YAML 1.2
---
$id: http://devicetree.org/schemas/spi/spacemit,k1-spi.yaml#
$schema: http://devicetree.org/meta-schemas/core.yaml#

title: SpacemiT K1 SoC Serial Peripheral Interface (SPI)

maintainers:
  - Alex Elder <elder@kernel.org>

description:
  The SpacemiT K1 SoC implements a SPI controller that has two 32-entry
  FIFOs, for transmit and receive.  Details are currently available in
  section 18.2.1 of the K1 User Manual, found in the SpacemiT Keystone
  K1 Documentation[1].  The controller transfers words using PIO.  DMA
  transfers are supported as well, if both TX and RX DMA channels are
  specified,

  [1] https://developer.spacemit.com/documentation

allOf:
  - $ref: /schemas/spi/spi-controller.yaml#

properties:
  compatible:
    const: spacemit,k1-spi

  reg:
    maxItems: 1

  clocks:
    items:
      - description: Core clock
      - description: Bus clock

  clock-names:
    items:
      - const: core
      - const: bus

  resets:
    maxItems: 1

  interrupts:
    maxItems: 1

  dmas:
    items:
      - description: RX DMA channel
      - description: TX DMA channel

  dma-names:
    items:
      - const: rx
      - const: tx

required:
  - compatible
  - reg
  - clocks
  - clock-names
  - resets
  - interrupts

unevaluatedProperties: false

examples:
  - |

    #include <dt-bindings/clock/spacemit,k1-syscon.h>
    spi@d401c000 {
        compatible = "spacemit,k1-spi";
        reg = <0xd401c000 0x30>;
        #address-cells = <1>;
        #size-cells = <0>;
        clocks = <&syscon_apbc CLK_SSP3>,
                 <&syscon_apbc CLK_SSP3_BUS>;
        clock-names = "core", "bus";
        resets = <&syscon_apbc RESET_SSP3>;
        interrupts = <55>;
        dmas = <&pdma 20>, <&pdma 19>;
        dma-names = "rx", "tx";
    };
```

## Documentation/devicetree/bindings/spi/spi-armada-3700.txt
```
* Marvell Armada 3700 SPI Controller

Required Properties:

- compatible: should be "marvell,armada-3700-spi"
- reg: physical base address of the controller and length of memory mapped
       region.
- interrupts: The interrupt number. The interrupt specifier format depends on
	      the interrupt controller and of its driver.
- clocks: Must contain the clock source, usually from the North Bridge clocks.
- num-cs: The number of chip selects that is supported by this SPI Controller
- #address-cells: should be 1.
- #size-cells: should be 0.

Example:

	spi0: spi@10600 {
		compatible = "marvell,armada-3700-spi";
		#address-cells = <1>;
		#size-cells = <0>;
		reg = <0x10600 0x5d>;
		clocks = <&nb_perih_clk 7>;
		interrupts = <GIC_SPI 0 IRQ_TYPE_LEVEL_HIGH>;
		num-cs = <4>;
	};
```

## Documentation/devicetree/bindings/spi/spi-ath79.txt
```
Binding for Qualcomm Atheros AR7xxx/AR9xxx SPI controller

Required properties:
- compatible: has to be "qca,<soc-type>-spi", "qca,ar7100-spi" as fallback.
- reg: Base address and size of the controllers memory area
- clocks: phandle to the AHB clock.
- clock-names: has to be "ahb".
- #address-cells: <1>, as required by generic SPI binding.
- #size-cells: <0>, also as required by generic SPI binding.

Child nodes as per the generic SPI binding.

Example:

	spi@1F000000 {
		compatible = "qca,ar9132-spi", "qca,ar7100-spi";
		reg = <0x1F000000 0x10>;

		clocks = <&pll 2>;
		clock-names = "ahb";

		#address-cells = <1>;
		#size-cells = <0>;
	};
```

## Documentation/devicetree/bindings/spi/spi-bcm63xx-hsspi.txt
```
Binding for Broadcom BCM6328 High Speed SPI controller

Required properties:
- compatible: must contain of "brcm,bcm6328-hsspi".
- reg: Base address and size of the controllers memory area.
- interrupts: Interrupt for the SPI block.
- clocks: phandles of the SPI clock and the PLL clock.
- clock-names: must be "hsspi", "pll".
- #address-cells: <1>, as required by generic SPI binding.
- #size-cells: <0>, also as required by generic SPI binding.

Optional properties:
- num-cs: some controllers have less than 8 cs signals. Defaults to 8
  if absent.

Child nodes as per the generic SPI binding.

Example:

	spi@10001000 {
		compatible = "brcm,bcm6328-hsspi";
		reg = <0x10001000 0x600>;

		interrupts = <29>;

		clocks = <&clkctl 9>, <&hsspi_pll>;
		clock-names = "hsspi", "pll";

		num-cs = <2>;

		#address-cells = <1>;
		#size-cells = <0>;
	};
```

## Documentation/devicetree/bindings/spi/spi-bcm63xx.txt
```
Binding for Broadcom BCM6348/BCM6358 SPI controller

Required properties:
- compatible: must contain one of "brcm,bcm6348-spi", "brcm,bcm6358-spi".
- reg: Base address and size of the controllers memory area.
- interrupts: Interrupt for the SPI block.
- clocks: phandle of the SPI clock.
- clock-names: has to be "spi".
- #address-cells: <1>, as required by generic SPI binding.
- #size-cells: <0>, also as required by generic SPI binding.

Optional properties:
- num-cs: some controllers have less than 8 cs signals. Defaults to 8
  if absent.

Child nodes as per the generic SPI binding.

Example:

	spi@10000800 {
		compatible = "brcm,bcm6368-spi", "brcm,bcm6358-spi";
		reg = <0x10000800 0x70c>;

		interrupts = <1>;

		clocks = <&clkctl 9>;
		clock-names = "spi";

		num-cs = <5>;

		#address-cells = <1>;
		#size-cells = <0>;
	};
```

## Documentation/devicetree/bindings/spi/spi-cadence-qspi.txt
```
* SPI driver for Cadence QSPI Controller

Required properties:
- compatible : Should be "cadence,qspi".
- reg : Contains two entries, each of which is a tuple consisting of a
	physical address and length.  The first entry is the address and
	length of the controller register set.  The second entry is the
	address and length of the QSPI Controller data area.
- interrupts : Unit interrupt specifier for the controller interrupt.
- master-ref-clk : Specifies the frequency of the controller input clock.
- ext-decoder : Value of 0 means no external chipselect decoder is
	connected, 1 means there is an external chipselect decoder connected.
- num-chipselect : Number of chip select lines.
- fifo-depth : Size of the data FIFO in bytes.
- bus-num : Number of the SPI bus to which the controller is connected.

Optional properties:
- enable-dma : boolean, if present, then DMA is used for reads and writes
- tx-dma-peri-id : peripheral request id for tx dma channel, required if enable-dma is present
- rx-dma-peri-id : peripheral request id for rx dma channel, required if enable-dma is present

Example:

	qspi: spi@ff705000 {
		compatible = "cadence,qspi";
		#address-cells = <1>;
		#size-cells = <0>;
		reg = <0xff705000 0x1000>,
			<0xffa00000 0x1000>;
		interrupts = <0 151 4>;
		master-ref-clk = <400000000>;
		ext-decoder = <0>;
		num-chipselect = <4>;
		fifo-depth = <128>;
		bus-num = <2>;
		enable-dma;
		tx-dma-peri-id = <24>;
		rx-dma-peri-id = <25>;
	}
```

## Documentation/devicetree/bindings/spi/spi-cadence.txt
```
Cadence SPI controller Device Tree Bindings
-------------------------------------------

Required properties:
- compatible		: Should be "cdns,spi-r1p6" or "xlnx,zynq-spi-r1p6".
- reg			: Physical base address and size of SPI registers map.
- interrupts		: Property with a value describing the interrupt
			  number.
- interrupt-parent	: Must be core interrupt controller
- clock-names		: List of input clock names - "ref_clk", "pclk"
			  (See clock bindings for details).
- clocks		: Clock phandles (see clock bindings for details).

Optional properties:
- num-cs		: Number of chip selects used.
			  If a decoder is used, this will be the number of
			  chip selects after the decoder.
- is-decoded-cs		: Flag to indicate whether decoder is used or not.

Example:

	spi@e0007000 {
		compatible = "xlnx,zynq-spi-r1p6";
		clock-names = "ref_clk", "pclk";
		clocks = <&clkc 26>, <&clkc 35>;
		interrupt-parent = <&intc>;
		interrupts = <0 49 4>;
		num-cs = <4>;
		is-decoded-cs = <0>;
		reg = <0xe0007000 0x1000>;
	} ;
```

## Documentation/devicetree/bindings/spi/spi-cadence.yaml
```yaml
# SPDX-License-Identifier: (GPL-2.0-only OR BSD-2-Clause)
%YAML 1.2
---
$id: http://devicetree.org/schemas/spi/spi-cadence.yaml#
$schema: http://devicetree.org/meta-schemas/core.yaml#

title: Cadence SPI controller

maintainers:
  - Michal Simek <michal.simek@amd.com>

allOf:
  - $ref: spi-controller.yaml#

properties:
  compatible:
    oneOf:
      - enum:
          - xlnx,zynq-spi-r1p6
      - items:
          - enum:
              - xlnx,zynqmp-spi-r1p6
              - xlnx,versal-net-spi-r1p6
          - const: cdns,spi-r1p6

  reg:
    maxItems: 1

  interrupts:
    maxItems: 1

  clock-names:
    items:
      - const: ref_clk
      - const: pclk

  clocks:
    maxItems: 2

  num-cs:
    description: |
      Number of chip selects used. If a decoder is used,
      this will be the number of chip selects after the
      decoder.
    $ref: /schemas/types.yaml#/definitions/uint32
    minimum: 1
    maximum: 4
    default: 4

  is-decoded-cs:
    description: |
      Flag to indicate whether decoder is used or not.
    $ref: /schemas/types.yaml#/definitions/uint32
    enum: [ 0, 1 ]
    default: 0

  power-domains:
    maxItems: 1

  label:
    description: Descriptive name of the SPI controller.

  resets:
    maxItems: 1

  reset-names:
    items:
      - const: spi

required:
  - compatible
  - reg
  - interrupts
  - clock-names
  - clocks

unevaluatedProperties: false

examples:
  - |
    spi@e0007000 {
      compatible = "xlnx,zynq-spi-r1p6";
      clock-names = "ref_clk", "pclk";
      clocks = <&clkc 26>, <&clkc 35>;
      interrupt-parent = <&intc>;
      interrupts = <0 49 4>;
      num-cs = <4>;
      is-decoded-cs = <0>;
      reg = <0xe0007000 0x1000>;
    };
...
```

## Documentation/devicetree/bindings/spi/spi-clps711x.txt
```
Serial Peripheral Interface on Cirrus Logic CL-PS71xx, EP72xx, EP73xx

Required properties
- #address-cells: must be <1>
- #size-cells: must be <0>
- compatible: should include "cirrus,ep7209-spi"
- reg: Address and length of one register range
- interrupts: one interrupt line
- clocks: One entry, refers to the SPI bus clock
- cs-gpios: Specifies the gpio pins to be used for chipselects.
	    See: Documentation/devicetree/bindings/spi/spi-bus.txt

An additional register is present in the system controller,
which is assumed to be in the same device tree, with and marked
as compatible with "cirrus,ep7209-syscon3".

Example:

spi@80000500 {
	#address-cells = <1>;
	#size-cells = <0>;
	compatible = "cirrus,ep7209-spi";
	reg = <0x80000500 0x4>;
	interrupts = <15>;
	clocks = <&clks CLPS711X_CLK_SPI>;
	status = "disabled";
};

syscon3: syscon@80002200 {
	compatible = "cirrus,ep7209-syscon3", "syscon";
	reg = <0x80002200 0x40>;
};
```

## Documentation/devicetree/bindings/spi/spi-controller.yaml
```yaml
# SPDX-License-Identifier: GPL-2.0
%YAML 1.2
---
$id: http://devicetree.org/schemas/spi/spi-controller.yaml#
$schema: http://devicetree.org/meta-schemas/core.yaml#

title: SPI Controller Common Properties

maintainers:
  - Mark Brown <broonie@kernel.org>

description: |
  SPI busses can be described with a node for the SPI controller device
  and a set of child nodes for each SPI slave on the bus. The system SPI
  controller may be described for use in SPI master mode or in SPI slave mode,
  but not for both at the same time.

properties:
  $nodename:
    pattern: "^spi(@.*|-([0-9]|[1-9][0-9]+))?$"

  "#address-cells":
    enum: [0, 1]

  "#size-cells":
    const: 0

  cs-gpios:
    description: |
      GPIOs used as chip selects.
      If that property is used, the number of chip selects will be
      increased automatically with max(cs-gpios, hardware chip selects).

      So if, for example, the controller has 4 CS lines, and the
      cs-gpios looks like this
        cs-gpios = <&gpio1 0 0>, <0>, <&gpio1 1 0>, <&gpio1 2 0>;

      Then it should be configured so that num_chipselect = 4, with
      the following mapping
        cs0 : &gpio1 0 0
        cs1 : native
        cs2 : &gpio1 1 0
        cs3 : &gpio1 2 0

      The second flag of a gpio descriptor can be GPIO_ACTIVE_HIGH (0)
      or GPIO_ACTIVE_LOW(1). Legacy device trees often use 0.

      There is a special rule set for combining the second flag of an
      cs-gpio with the optional spi-cs-high flag for SPI slaves.

      Each table entry defines how the CS pin is to be physically
      driven (not considering potential gpio inversions by pinmux):

      device node     | cs-gpio       | CS pin state active | Note
      ================+===============+=====================+=====
      spi-cs-high     | -             | H                   |
      -               | -             | L                   |
      spi-cs-high     | ACTIVE_HIGH   | H                   |
      -               | ACTIVE_HIGH   | L                   | 1
      spi-cs-high     | ACTIVE_LOW    | H                   | 2
      -               | ACTIVE_LOW    | L                   |

      Notes:
      1) Should print a warning about polarity inversion.
         Here it would be wise to avoid and define the gpio as
         ACTIVE_LOW.
      2) Should print a warning about polarity inversion
         because ACTIVE_LOW is overridden by spi-cs-high.
         Should be generally avoided and be replaced by
         spi-cs-high + ACTIVE_HIGH.

  fifo-depth:
    $ref: /schemas/types.yaml#/definitions/uint32
    description:
      Size of the RX and TX data FIFOs in bytes.

  rx-fifo-depth:
    $ref: /schemas/types.yaml#/definitions/uint32
    description:
      Size of the RX data FIFO in bytes.

  tx-fifo-depth:
    $ref: /schemas/types.yaml#/definitions/uint32
    description:
      Size of the TX data FIFO in bytes.

  num-cs:
    $ref: /schemas/types.yaml#/definitions/uint32
    description:
      Total number of chip selects.

  spi-slave:
    $ref: /schemas/types.yaml#/definitions/flag
    description:
      The SPI controller acts as a slave, instead of a master.

  slave:
    type: object

    properties:
      compatible:
        description:
          Compatible of the SPI device.

    required:
      - compatible

patternProperties:
  "^.*@[0-9a-f]+$":
    type: object
    $ref: spi-peripheral-props.yaml
    additionalProperties: true

    properties:
      spi-3wire:
        $ref: /schemas/types.yaml#/definitions/flag
        description:
          The device requires 3-wire mode.

      spi-cpha:
        $ref: /schemas/types.yaml#/definitions/flag
        description:
          The device requires shifted clock phase (CPHA) mode.

      spi-cpol:
        $ref: /schemas/types.yaml#/definitions/flag
        description:
          The device requires inverse clock polarity (CPOL) mode.

    required:
      - compatible
      - reg

dependencies:
  rx-fifo-depth: [ tx-fifo-depth ]
  tx-fifo-depth: [ rx-fifo-depth ]

allOf:
  - if:
      not:
        required:
          - spi-slave
    then:
      properties:
        "#address-cells":
          const: 1
    else:
      properties:
        "#address-cells":
          const: 0
  - not:
      required:
        - fifo-depth
        - rx-fifo-depth
  - not:
      required:
        - fifo-depth
        - tx-fifo-depth

additionalProperties: true

examples:
  - |
    spi@80010000 {
        #address-cells = <1>;
        #size-cells = <0>;
        compatible = "fsl,imx28-spi";
        reg = <0x80010000 0x2000>;
        interrupts = <96>;
        dmas = <&dma_apbh 0>;
        dma-names = "rx-tx";

        display@0 {
            compatible = "lg,lg4573";
            spi-max-frequency = <1000000>;
            reg = <0>;
        };

        sensor@1 {
            compatible = "bosch,bme680";
            spi-max-frequency = <100000>;
            reg = <1>;
        };

        flash@2 {
            compatible = "jedec,spi-nor";
            spi-max-frequency = <50000000>;
            reg = <2>, <3>;
            stacked-memories = /bits/ 64 <0x10000000 0x10000000>;
        };
    };
```
