## Documentation/devicetree/bindings/spi/ti_qspi.txt
```
TI QSPI controller.

Required properties:
- compatible : should be "ti,dra7xxx-qspi" or "ti,am4372-qspi".
- reg: Should contain QSPI registers location and length.
- reg-names: Should contain the resource reg names.
	- qspi_base: Qspi configuration register Address space
	- qspi_mmap: Memory mapped Address space
	- (optional) qspi_ctrlmod: Control module Address space
- interrupts: should contain the qspi interrupt number.
- #address-cells, #size-cells : Must be present if the device has sub-nodes
- ti,hwmods: Name of the hwmod associated to the QSPI

Recommended properties:
- spi-max-frequency: Definition as per
                     Documentation/devicetree/bindings/spi/spi-bus.txt

Optional properties:
- syscon-chipselects: Handle to system control region contains QSPI
		      chipselect register and offset of that register.

NOTE: TI QSPI controller requires different pinmux and IODelay
paramaters for Mode-0 and Mode-3 operations, which needs to be set up by
the bootloader (U-Boot). Default configuration only supports Mode-0
operation. Hence, "spi-cpol" and "spi-cpha" DT properties cannot be
specified in the slave nodes of TI QSPI controller without appropriate
modification to bootloader.

Example:

For am4372:
qspi: qspi@4b300000 {
	compatible = "ti,am4372-qspi";
	reg = <0x47900000 0x100>, <0x30000000 0x4000000>;
	reg-names = "qspi_base", "qspi_mmap";
	#address-cells = <1>;
	#size-cells = <0>;
	spi-max-frequency = <25000000>;
	ti,hwmods = "qspi";
};

For dra7xx:
qspi: qspi@4b300000 {
	compatible = "ti,dra7xxx-qspi";
	reg = <0x4b300000 0x100>,
	      <0x5c000000 0x4000000>,
	reg-names = "qspi_base", "qspi_mmap";
	syscon-chipselects = <&scm_conf 0x558>;
	#address-cells = <1>;
	#size-cells = <0>;
	spi-max-frequency = <48000000>;
	ti,hwmods = "qspi";
};
```

## Documentation/devicetree/bindings/spi/xlnx,zynq-qspi.yaml
```yaml
# SPDX-License-Identifier: (GPL-2.0-only OR BSD-2-Clause)
%YAML 1.2
---
$id: http://devicetree.org/schemas/spi/xlnx,zynq-qspi.yaml#
$schema: http://devicetree.org/meta-schemas/core.yaml#

title: Xilinx Zynq QSPI controller

description:
  The Xilinx Zynq QSPI controller is used to access multi-bit serial flash
  memory devices.

allOf:
  - $ref: "spi-controller.yaml#"

maintainers:
  - Michal Simek <michal.simek@xilinx.com>

# Everything else is described in the common file
properties:
  compatible:
    const: xlnx,zynq-qspi-1.0

  reg:
    maxItems: 1

  interrupts:
    maxItems: 1

  clocks:
    items:
      - description: reference clock
      - description: peripheral clock

  clock-names:
    items:
      - const: ref_clk
      - const: pclk

required:
  - compatible
  - reg
  - interrupts
  - clocks
  - clock-names

unevaluatedProperties: false

examples:
  - |
    spi@e000d000 {
        compatible = "xlnx,zynq-qspi-1.0";
        reg = <0xe000d000 0x1000>;
        interrupt-parent = <&intc>;
        interrupts = <0 19 4>;
        clock-names = "ref_clk", "pclk";
        clocks = <&clkc 10>, <&clkc 43>;
        num-cs = <1>;
    };
```

## Documentation/devicetree/bindings/spmi/apple,spmi.yaml
```yaml
# SPDX-License-Identifier: (GPL-2.0 OR BSD-2-Clause)
%YAML 1.2
---
$id: http://devicetree.org/schemas/spmi/apple,spmi.yaml#
$schema: http://devicetree.org/meta-schemas/core.yaml#

title: Apple SPMI controller

maintainers:
  - Sasha Finkelstein <fnkl.kernel@gmail.com>

description: A SPMI controller present on most Apple SoCs

allOf:
  - $ref: spmi.yaml#

properties:
  compatible:
    oneOf:
      - items:
          - enum:
              - apple,t6020-spmi
              - apple,t8012-spmi
              - apple,t8015-spmi
          - const: apple,t8103-spmi
      - items:
          - enum:
              # Do not add additional SoC to this list.
              - apple,t8103-spmi
              - apple,t6000-spmi
              - apple,t8112-spmi
          - const: apple,spmi

  reg:
    maxItems: 1

required:
  - compatible
  - reg

unevaluatedProperties: false

examples:
  - |
    #include <dt-bindings/spmi/spmi.h>

    spmi@920a1300 {
        compatible = "apple,t6000-spmi", "apple,spmi";
        reg = <0x920a1300 0x100>;
        #address-cells = <2>;
        #size-cells = <0>;

        pmic@f {
            reg = <0xf SPMI_USID>;
            /* PMIC-specific properties */
        };
    };
```

## Documentation/devicetree/bindings/spmi/hisilicon,hisi-spmi-controller.yaml
```yaml
# SPDX-License-Identifier: GPL-2.0
%YAML 1.2
---
$id: http://devicetree.org/schemas/spmi/hisilicon,hisi-spmi-controller.yaml#
$schema: http://devicetree.org/meta-schemas/core.yaml#

title: HiSilicon SPMI controller

maintainers:
  - Mauro Carvalho Chehab <mchehab+huawei@kernel.org>

description: |
  The HiSilicon SPMI BUS controller is found on some Kirin-based designs.
  It is a MIPI System Power Management (SPMI) controller.

  The PMIC part is provided by
  ./Documentation/devicetree/bindings/mfd/hisilicon,hi6421-spmi-pmic.yaml.

allOf:
  - $ref: spmi.yaml#

properties:

  $nodename:
    pattern: "spmi@[0-9a-f]"

  compatible:
    const: hisilicon,kirin970-spmi-controller

  reg:
    maxItems: 1

  hisilicon,spmi-channel:
    $ref: /schemas/types.yaml#/definitions/uint32
    description: |
      number of the Kirin 970 SPMI channel where the SPMI devices are connected.

required:
  - compatible
  - reg
  - hisilicon,spmi-channel

patternProperties:
  "@[0-9a-f]$":
    type: object

    description: |
      PMIC properties, which are specific to the used SPMI PMIC device(s).
      When used in combination with HiSilicon 6421v600, the properties
      are documented at
      drivers/staging/hikey9xx/hisilicon,hi6421-spmi-pmic.yaml.

unevaluatedProperties: false

examples:
  - |
    bus {
      #address-cells = <2>;
      #size-cells = <2>;

      spmi: spmi@fff24000 {
        compatible = "hisilicon,kirin970-spmi-controller";
        #address-cells = <2>;
        #size-cells = <0>;
        reg = <0x0 0xfff24000 0x0 0x1000>;
        hisilicon,spmi-channel = <2>;

        pmic@0 {
          reg = <0 0>;
          /* pmic properties */
        };
      };
    };
```

## Documentation/devicetree/bindings/spmi/mediatek,mt8196-spmi.yaml
```yaml
# SPDX-License-Identifier: (GPL-2.0 OR BSD-2-Clause)
%YAML 1.2
---
$id: http://devicetree.org/schemas/spmi/mediatek,mt8196-spmi.yaml#
$schema: http://devicetree.org/meta-schemas/core.yaml#

title: MediaTek MT8196 SPMI 2.0 Controller

maintainers:
  - Hsin-Hsiung Wang <hsin-hsiung.wang@mediatek.com>
  - AngeloGioacchino Del Regno <angelogioacchino.delregno@collabora.com>

description:
  The MediaTek MT8196 SoC features a SPMI version 2.0 compliant controller,
  with internal wrapping arbitration logic to allow for multiple on-chip
  devices to control up to two SPMI buses.
  The main arbiter also acts as an interrupt controller, arbitering also
  the interrupts coming from SPMI-connected devices into each of the nested
  interrupt controllers from any of the present SPMI buses.

properties:
  compatible:
    oneOf:
      - enum:
          - mediatek,mt8196-spmi
      - items:
          - enum:
              - mediatek,mt6991-spmi
          - const: mediatek,mt8196-spmi

  ranges: true

  '#address-cells':
    const: 1

  '#size-cells':
    const: 1

patternProperties:
  "^spmi@[a-f0-9]+$":
    type: object
    $ref: /schemas/spmi/spmi.yaml
    unevaluatedProperties: false

    properties:
      reg:
        items:
          - description: controller interface registers
          - description: spmi master controller registers

      reg-names:
        items:
          - const: pmif
          - const: spmimst

      clocks:
        items:
          - description: controller interface system clock
          - description: controller interface timer clock
          - description: spmi controller master clock

      clock-names:
        items:
          - const: pmif_sys_ck
          - const: pmif_tmr_ck
          - const: spmimst_clk_mux

      interrupts:
        maxItems: 1

      interrupt-names:
        const: rcs

      interrupt-controller: true

      "#interrupt-cells":
        const: 3
        description: |
          cell 1: slave ID for the requested interrupt (0-15)
          cell 2: the requested peripheral interrupt (0-7)
          cell 3: interrupt flags indicating level-sense information,
                  as defined in dt-bindings/interrupt-controller/irq.h
    required:
      - reg
      - reg-names
      - clocks
      - clock-names
      - interrupts
      - interrupt-names
      - interrupt-controller
      - "#interrupt-cells"

required:
  - compatible
  - ranges
  - '#address-cells'
  - '#size-cells'

additionalProperties: false

examples:
  - |
    #include <dt-bindings/interrupt-controller/arm-gic.h>

    soc {
      #address-cells = <2>;
      #size-cells = <2>;

      spmi-arbiter@1c018000 {
        compatible = "mediatek,mt8196-spmi";
        ranges = <0 0 0x1c018000 0x4900>;
        #address-cells = <1>;
        #size-cells = <1>;

        spmi@0 {
          reg = <0 0x900>, <0x4800 0x100>;
          reg-names = "pmif", "spmimst";
          interrupts-extended = <&pio 292 IRQ_TYPE_LEVEL_HIGH>;
          interrupt-names = "rcs";
          interrupt-controller;
          #interrupt-cells = <3>;
          clocks = <&pmif_sys>, <&pmif_tmr>, <&spmi_mst>;
          clock-names = "pmif_sys_ck", "pmif_tmr_ck", "spmimst_clk_mux";
        };

        spmi@2000 {
          reg = <0x2000 0x900>, <0x4000 0x100>;
          reg-names = "pmif", "spmimst";
          interrupts-extended = <&pio 291 IRQ_TYPE_LEVEL_HIGH>;
          interrupt-names = "rcs";
          interrupt-controller;
          #interrupt-cells = <3>;
          clocks = <&pmif_sys>, <&pmif_tmr>, <&spmi_mst>;
          clock-names = "pmif_sys_ck", "pmif_tmr_ck", "spmimst_clk_mux";
        };
      };
    };
...
```

## Documentation/devicetree/bindings/spmi/mtk,spmi-mtk-pmif.yaml
```yaml
# SPDX-License-Identifier: (GPL-2.0 OR BSD-2-Clause)
%YAML 1.2
---
$id: http://devicetree.org/schemas/spmi/mtk,spmi-mtk-pmif.yaml#
$schema: http://devicetree.org/meta-schemas/core.yaml#

title: Mediatek SPMI Controller

maintainers:
  - Hsin-Hsiung Wang <hsin-hsiung.wang@mediatek.com>

description: |+
  On MediaTek SoCs the PMIC is connected via SPMI and the controller allows
  for multiple SoCs to control a single SPMI master.

allOf:
  - $ref: "spmi.yaml"

properties:
  compatible:
    enum:
      - mediatek,mt6873-spmi
      - mediatek,mt8195-spmi

  reg:
    maxItems: 2

  reg-names:
    items:
      - const: pmif
      - const: spmimst

  clocks:
    minItems: 3
    maxItems: 3

  clock-names:
    items:
      - const: pmif_sys_ck
      - const: pmif_tmr_ck
      - const: spmimst_clk_mux

  assigned-clocks:
    maxItems: 1

  assigned-clock-parents:
    maxItems: 1

required:
  - compatible
  - reg
  - reg-names
  - clocks
  - clock-names

unevaluatedProperties: false

examples:
  - |
    #include <dt-bindings/clock/mt8192-clk.h>

    spmi: spmi@10027000 {
        compatible = "mediatek,mt6873-spmi";
        reg = <0x10027000 0xe00>,
              <0x10029000 0x100>;
        reg-names = "pmif", "spmimst";
        clocks = <&infracfg CLK_INFRA_PMIC_AP>,
                 <&infracfg CLK_INFRA_PMIC_TMR>,
                 <&topckgen CLK_TOP_SPMI_MST_SEL>;
        clock-names = "pmif_sys_ck",
                      "pmif_tmr_ck",
                      "spmimst_clk_mux";
        assigned-clocks = <&topckgen CLK_TOP_PWRAP_ULPOSC_SEL>;
        assigned-clock-parents = <&topckgen CLK_TOP_OSC_D10>;
    };
...
```

## Documentation/devicetree/bindings/spmi/qcom,glymur-spmi-pmic-arb.yaml
```yaml
# SPDX-License-Identifier: (GPL-2.0-only OR BSD-2-Clause)
%YAML 1.2
---
$id: http://devicetree.org/schemas/spmi/qcom,glymur-spmi-pmic-arb.yaml#
$schema: http://devicetree.org/meta-schemas/core.yaml#

title: Qualcomm Technologies, Inc. Glymur SPMI Controller (PMIC Arbiter v8)

maintainers:
  - David Collins <david.collins@oss.qualcomm.com>

description: |
  The Glymur SPMI PMIC Arbiter implements HW version 8 and it's an SPMI
  controller with wrapping arbitration logic to allow for multiple on-chip
  devices to control up to 4 SPMI separate buses.

  The PMIC Arbiter can also act as an interrupt controller, providing interrupts
  to slave devices.

allOf:
  - $ref: /schemas/spmi/qcom,spmi-pmic-arb-common.yaml

properties:
  compatible:
    oneOf:
      - items:
          - enum:
              - qcom,kaanapali-spmi-pmic-arb
          - const: qcom,glymur-spmi-pmic-arb
      - enum:
          - qcom,glymur-spmi-pmic-arb

  reg:
    items:
      - description: core registers
      - description: tx-channel per virtual slave registers
      - description: rx-channel (called observer) per virtual slave registers
      - description: channel to PMIC peripheral mapping registers

  reg-names:
    items:
      - const: core
      - const: chnls
      - const: obsrvr
      - const: chnl_map

  ranges: true

  '#address-cells':
    const: 2

  '#size-cells':
    const: 2

patternProperties:
  "^spmi@[a-f0-9]+$":
    type: object
    $ref: /schemas/spmi/spmi.yaml
    unevaluatedProperties: false

    properties:
      reg:
        items:
          - description: configuration registers
          - description: interrupt controller registers
          - description: channel owner EE mapping registers

      reg-names:
        items:
          - const: cnfg
          - const: intr
          - const: chnl_owner

      interrupts:
        maxItems: 1

      interrupt-names:
        const: periph_irq

      interrupt-controller: true

      '#interrupt-cells':
        const: 4
        description: |
          cell 1: slave ID for the requested interrupt (0-15)
          cell 2: peripheral ID for requested interrupt (0-255)
          cell 3: the requested peripheral interrupt (0-7)
          cell 4: interrupt flags indicating level-sense information,
                  as defined in dt-bindings/interrupt-controller/irq.h

required:
  - compatible
  - reg-names

unevaluatedProperties: false

examples:
  - |
    #include <dt-bindings/interrupt-controller/arm-gic.h>

    soc {
        #address-cells = <2>;
        #size-cells = <2>;

        arbiter@c400000 {
            compatible = "qcom,glymur-spmi-pmic-arb";
            reg = <0x0 0xc400000 0x0 0x3000>,
                  <0x0 0xc900000 0x0 0x400000>,
                  <0x0 0xc4c0000 0x0 0x400000>,
                  <0x0 0xc403000 0x0 0x8000>;
            reg-names = "core", "chnls", "obsrvr", "chnl_map";

            qcom,ee = <0>;
            qcom,channel = <0>;

            #address-cells = <2>;
            #size-cells = <2>;
            ranges;

            spmi@c426000 {
                reg = <0x0 0xc426000 0x0 0x4000>,
                      <0x0 0xc8c0000 0x0 0x10000>,
                      <0x0 0xc42a000 0x0 0x8000>;
                reg-names = "cnfg", "intr", "chnl_owner";

                interrupts-extended = <&pdc 1 IRQ_TYPE_LEVEL_HIGH>;
                interrupt-names = "periph_irq";
                interrupt-controller;
                #interrupt-cells = <4>;

                #address-cells = <2>;
                #size-cells = <0>;
            };

            spmi@c437000 {
                reg = <0x0 0xc437000 0x0 0x4000>,
                      <0x0 0xc8d0000 0x0 0x10000>,
                      <0x0 0xc43b000 0x0 0x8000>;
                reg-names = "cnfg", "intr", "chnl_owner";

                interrupts-extended = <&pdc 3 IRQ_TYPE_LEVEL_HIGH>;
                interrupt-names = "periph_irq";
                interrupt-controller;
                #interrupt-cells = <4>;

                #address-cells = <2>;
                #size-cells = <0>;
            };
        };
    };
```
