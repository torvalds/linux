## Documentation/devicetree/bindings/spmi/qcom,spmi-pmic-arb-common.yaml
```yaml
# SPDX-License-Identifier: (GPL-2.0-only OR BSD-2-Clause)
%YAML 1.2
---
$id: http://devicetree.org/schemas/spmi/qcom,spmi-pmic-arb-common.yaml#
$schema: http://devicetree.org/meta-schemas/core.yaml#

title: Qualcomm Technologies, Inc. SPMI Controller (common)

maintainers:
  - David Collins <david.collins@oss.qualcomm.com>

description: |
  This defines some common properties used to define Qualcomm SPMI controllers
  for PMIC arbiter.

properties:
  qcom,ee:
    $ref: /schemas/types.yaml#/definitions/uint32
    minimum: 0
    maximum: 5
    description:
      indicates the active Execution Environment identifier

  qcom,channel:
    $ref: /schemas/types.yaml#/definitions/uint32
    minimum: 0
    maximum: 5
    description:
      which of the PMIC Arb provided channels to use for accesses

required:
  - qcom,ee
  - qcom,channel

additionalProperties: true
```

## Documentation/devicetree/bindings/spmi/qcom,spmi-pmic-arb.txt
```
Qualcomm SPMI Controller (PMIC Arbiter)

The SPMI PMIC Arbiter is found on Snapdragon chipsets.  It is an SPMI
controller with wrapping arbitration logic to allow for multiple on-chip
devices to control a single SPMI master.

The PMIC Arbiter can also act as an interrupt controller, providing interrupts
to slave devices.

See Documentation/devicetree/bindings/spmi/spmi.yaml for the generic SPMI
controller binding requirements for child nodes.

See Documentation/devicetree/bindings/interrupt-controller/interrupts.txt for
generic interrupt controller binding documentation.

Required properties:
- compatible : should be "qcom,spmi-pmic-arb".
- reg-names  : must contain:
     "core" - core registers
     "intr" - interrupt controller registers
     "cnfg" - configuration registers
   Registers used only for V2 PMIC Arbiter:
     "chnls"  - tx-channel per virtual slave registers.
     "obsrvr" - rx-channel (called observer) per virtual slave registers.

- reg : address + size pairs describing the PMIC arb register sets; order must
        correspond with the order of entries in reg-names
- #address-cells : must be set to 2
- #size-cells : must be set to 0
- qcom,ee : indicates the active Execution Environment identifier (0-5)
- qcom,channel : which of the PMIC Arb provided channels to use for accesses (0-5)
- interrupts : interrupt list for the PMIC Arb controller, must contain a
               single interrupt entry for the peripheral interrupt
- interrupt-names : corresponding interrupt names for the interrupts
                    listed in the 'interrupts' property, must contain:
     "periph_irq" - summary interrupt for PMIC peripherals
- interrupt-controller : boolean indicator that the PMIC arbiter is an interrupt controller
- #interrupt-cells :  must be set to 4. Interrupts are specified as a 4-tuple:
    cell 1: slave ID for the requested interrupt (0-15)
    cell 2: peripheral ID for requested interrupt (0-255)
    cell 3: the requested peripheral interrupt (0-7)
    cell 4: interrupt flags indicating level-sense information, as defined in
            dt-bindings/interrupt-controller/irq.h

Example:

	spmi {
		compatible = "qcom,spmi-pmic-arb";
		reg-names = "core", "intr", "cnfg";
		reg = <0xfc4cf000 0x1000>,
		      <0xfc4cb000 0x1000>,
		      <0xfc4ca000 0x1000>;

		interrupt-names = "periph_irq";
		interrupts = <0 190 0>;

		qcom,ee = <0>;
		qcom,channel = <0>;

		#address-cells = <2>;
		#size-cells = <0>;

		interrupt-controller;
		#interrupt-cells = <4>;
	};
```

## Documentation/devicetree/bindings/spmi/qcom,spmi-pmic-arb.yaml
```yaml
# SPDX-License-Identifier: GPL-2.0-only
%YAML 1.2
---
$id: http://devicetree.org/schemas/spmi/qcom,spmi-pmic-arb.yaml#
$schema: http://devicetree.org/meta-schemas/core.yaml#

title: Qualcomm SPMI Controller (PMIC Arbiter)

maintainers:
  - Stephen Boyd <sboyd@kernel.org>

description: |
  The SPMI PMIC Arbiter is found on Snapdragon chipsets. It is an SPMI
  controller with wrapping arbitration logic to allow for multiple on-chip
  devices to control a single SPMI master.

  The PMIC Arbiter can also act as an interrupt controller, providing interrupts
  to slave devices.

allOf:
  - $ref: spmi.yaml

properties:
  compatible:
    const: qcom,spmi-pmic-arb

  reg:
    oneOf:
      - items: # V1
          - description: core registers
          - description: interrupt controller registers
          - description: configuration registers
      - items: # V2
          - description: core registers
          - description: tx-channel per virtual slave regosters
          - description: rx-channel (called observer) per virtual slave registers
          - description: interrupt controller registers
          - description: configuration registers

  reg-names:
    oneOf:
      - items:
          - const: core
          - const: intr
          - const: cnfg
      - items:
          - const: core
          - const: chnls
          - const: obsrvr
          - const: intr
          - const: cnfg

  interrupts:
    maxItems: 1

  interrupt-names:
    const: periph_irq

  interrupt-controller: true

  '#address-cells': true

  '#interrupt-cells':
    const: 4
    description: |
      cell 1: slave ID for the requested interrupt (0-15)
      cell 2: peripheral ID for requested interrupt (0-255)
      cell 3: the requested peripheral interrupt (0-7)
      cell 4: interrupt flags indicating level-sense information,
              as defined in dt-bindings/interrupt-controller/irq.h

  '#size-cells': true

  qcom,ee:
    $ref: /schemas/types.yaml#/definitions/uint32
    minimum: 0
    maximum: 5
    description: >
      indicates the active Execution Environment identifier

  qcom,channel:
    $ref: /schemas/types.yaml#/definitions/uint32
    minimum: 0
    maximum: 5
    description: >
      which of the PMIC Arb provided channels to use for accesses

  qcom,bus-id:
    $ref: /schemas/types.yaml#/definitions/uint32
    minimum: 0
    maximum: 1
    description: >
      SPMI bus instance. only applicable to PMIC arbiter version 7 and beyond.
      Supported values, 0 = primary bus, 1 = secondary bus
    deprecated: true

required:
  - compatible
  - reg-names
  - qcom,ee
  - qcom,channel

unevaluatedProperties: false

examples:
  - |
    spmi@fc4cf000 {
        compatible = "qcom,spmi-pmic-arb";
        reg-names = "core", "intr", "cnfg";
        reg = <0xfc4cf000 0x1000>,
              <0xfc4cb000 0x1000>,
              <0xfc4ca000 0x1000>;

        interrupt-names = "periph_irq";
        interrupts = <0 190 0>;

        qcom,ee = <0>;
        qcom,channel = <0>;

        #address-cells = <2>;
        #size-cells = <0>;

        interrupt-controller;
        #interrupt-cells = <4>;

        qcom,bus-id = <0>;
    };
```

## Documentation/devicetree/bindings/spmi/qcom,x1e80100-spmi-pmic-arb.yaml
```yaml
# SPDX-License-Identifier: (GPL-2.0-only OR BSD-2-Clause)
%YAML 1.2
---
$id: http://devicetree.org/schemas/spmi/qcom,x1e80100-spmi-pmic-arb.yaml#
$schema: http://devicetree.org/meta-schemas/core.yaml#

title: Qualcomm X1E80100 SPMI Controller (PMIC Arbiter v7)

maintainers:
  - Stephen Boyd <sboyd@kernel.org>

description: |
  The X1E80100 SPMI PMIC Arbiter implements HW version 7 and it's an SPMI
  controller with wrapping arbitration logic to allow for multiple on-chip
  devices to control up to 2 SPMI separate buses.

  The PMIC Arbiter can also act as an interrupt controller, providing interrupts
  to slave devices.

properties:
  compatible:
    const: qcom,x1e80100-spmi-pmic-arb

  reg:
    items:
      - description: core registers
      - description: tx-channel per virtual slave registers
      - description: rx-channel (called observer) per virtual slave registers

  reg-names:
    items:
      - const: core
      - const: chnls
      - const: obsrvr

  ranges: true

  '#address-cells':
    const: 2

  '#size-cells':
    const: 2

  qcom,ee:
    $ref: /schemas/types.yaml#/definitions/uint32
    minimum: 0
    maximum: 5
    description: >
      indicates the active Execution Environment identifier

  qcom,channel:
    $ref: /schemas/types.yaml#/definitions/uint32
    minimum: 0
    maximum: 5
    description: >
      which of the PMIC Arb provided channels to use for accesses

patternProperties:
  "^spmi@[a-f0-9]+$":
    type: object
    $ref: /schemas/spmi/spmi.yaml
    unevaluatedProperties: false

    properties:
      reg:
        items:
          - description: configuration registers
          - description: interrupt controller registers

      reg-names:
        items:
          - const: cnfg
          - const: intr

      interrupts:
        maxItems: 1

      interrupt-names:
        const: periph_irq

      interrupt-controller: true

      '#interrupt-cells':
        const: 4
        description: |
          cell 1: slave ID for the requested interrupt (0-15)
          cell 2: peripheral ID for requested interrupt (0-255)
          cell 3: the requested peripheral interrupt (0-7)
          cell 4: interrupt flags indicating level-sense information,
                  as defined in dt-bindings/interrupt-controller/irq.h

required:
  - compatible
  - reg-names
  - qcom,ee
  - qcom,channel

additionalProperties: false

examples:
  - |
    #include <dt-bindings/interrupt-controller/arm-gic.h>

    soc {
      #address-cells = <2>;
      #size-cells = <2>;

      spmi: arbiter@c400000 {
        compatible = "qcom,x1e80100-spmi-pmic-arb";
        reg = <0 0x0c400000 0 0x3000>,
              <0 0x0c500000 0 0x4000000>,
              <0 0x0c440000 0 0x80000>;
        reg-names = "core", "chnls", "obsrvr";

        qcom,ee = <0>;
        qcom,channel = <0>;

        #address-cells = <2>;
        #size-cells = <2>;
        ranges;

        spmi_bus0: spmi@c42d000 {
          reg = <0 0x0c42d000 0 0x4000>,
                <0 0x0c4c0000 0 0x10000>;
          reg-names = "cnfg", "intr";

          interrupt-names = "periph_irq";
          interrupts-extended = <&pdc 1 IRQ_TYPE_LEVEL_HIGH>;
          interrupt-controller;
          #interrupt-cells = <4>;

          #address-cells = <2>;
          #size-cells = <0>;
        };
      };
    };
```

## Documentation/devicetree/bindings/spmi/spmi.txt
```
System Power Management Interface (SPMI) Controller

This document defines a generic set of bindings for use by SPMI controllers.  A
controller is modelled in device tree as a node with zero or more child nodes,
each representing a unique slave on the bus.

Required properties:
- #address-cells : must be set to 2
- #size-cells : must be set to 0

Child nodes:

An SPMI controller node can contain zero or more child nodes representing slave
devices on the bus.  Child 'reg' properties are specified as an address, type
pair.  The address must be in the range 0-15 (4 bits).  The type must be one of
SPMI_USID (0) or SPMI_GSID (1) for Unique Slave ID or Group Slave ID respectively.
These are the identifiers "statically assigned by the system integrator", as
per the SPMI spec.

Each child node must have one and only one 'reg' entry of type SPMI_USID.

#include <dt-bindings/spmi/spmi.h>

	spmi@.. {
		compatible = "...";
		reg = <...>;

		#address-cells = <2>;
		#size-cells = <0>;

		child@0 {
			compatible = "...";
			reg = <0 SPMI_USID>;
		};

		child@7 {
			compatible = "...";
			reg = <7 SPMI_USID
			       3 SPMI_GSID>;
		};
	};
```

## Documentation/devicetree/bindings/spmi/spmi.yaml
```yaml
# SPDX-License-Identifier: GPL-2.0
%YAML 1.2
---
$id: http://devicetree.org/schemas/spmi/spmi.yaml#
$schema: http://devicetree.org/meta-schemas/core.yaml#

title: System Power Management Interface (SPMI) Controller

maintainers:
  - Stephen Boyd <sboyd@kernel.org>

description: |
  The System Power Management (SPMI) controller is a 2-wire bus defined
  by the MIPI Alliance for power management control to be used on SoC designs.

  SPMI controllers are modelled in device tree using a generic set of
  bindings defined here, plus any bus controller specific properties, if
  needed.

  Each SPMI controller has zero or more child nodes (up to 16 ones), each
  one representing an unique slave at the bus.

properties:
  $nodename:
    pattern: "^spmi@.*"

  "#address-cells":
    const: 2

  "#size-cells":
    const: 0

patternProperties:
  "@[0-9a-f]$":
    description: up to 16 child PMIC nodes
    type: object

    properties:
      reg:
        items:
          - minItems: 1
            items:
              - minimum: 0
                maximum: 0xf
              - enum: [ 0 ]
                description:
                  0 means user ID address. 1 is reserved for group ID
                  address.

    required:
      - reg

required:
  - reg

additionalProperties: true

examples:
  - |
    #include <dt-bindings/spmi/spmi.h>

    spmi@0 {
      reg = <0 0>;

      #address-cells = <2>;
      #size-cells = <0>;

      child@0 {
        reg = <0 SPMI_USID>;
      };

      child@7 {
        reg = <7 SPMI_USID>;
      };
    };
```
