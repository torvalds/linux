## Documentation/devicetree/bindings/spi/sprd,spi-adi.yaml
```yaml
# SPDX-License-Identifier: (GPL-2.0 OR BSD-2-Clause)
%YAML 1.2
---
$id: http://devicetree.org/schemas/spi/sprd,spi-adi.yaml#
$schema: http://devicetree.org/meta-schemas/core.yaml#

title: Spreadtrum ADI controller

maintainers:
  - Orson Zhai <orsonzhai@gmail.com>
  - Baolin Wang <baolin.wang7@gmail.com>
  - Chunyan Zhang <zhang.lyra@gmail.com>

description: |
  ADI is the abbreviation of Anolog-Digital interface, which is used to access
  analog chip (such as PMIC) from digital chip. ADI controller follows the SPI
  framework for its hardware implementation is alike to SPI bus and its timing
  is compatile to SPI timing.

  ADI controller has 50 channels including 2 software read/write channels and
  48 hardware channels to access analog chip. For 2 software read/write channels,
  users should set ADI registers to access analog chip. For hardware channels,
  we can configure them to allow other hardware components to use it independently,
  which means we can just link one analog chip address to one hardware channel,
  then users can access the mapped analog chip address by this hardware channel
  triggered by hardware components instead of ADI software channels.

  Thus we introduce one property named "sprd,hw-channels" to configure hardware
  channels, the first value specifies the hardware channel id which is used to
  transfer data triggered by hardware automatically, and the second value specifies
  the analog chip address where user want to access by hardware components.

  Since we have multi-subsystems will use unique ADI to access analog chip, when
  one system is reading/writing data by ADI software channels, that should be under
  one hardware spinlock protection to prevent other systems from reading/writing
  data by ADI software channels at the same time, or two parallel routine of setting
  ADI registers will make ADI controller registers chaos to lead incorrect results.
  Then we need one hardware spinlock to synchronize between the multiple subsystems.

  The new version ADI controller supplies multiple master channels for different
  subsystem accessing, that means no need to add hardware spinlock to synchronize,
  thus change the hardware spinlock support to be optional to keep backward
  compatibility.

allOf:
  - $ref: /schemas/spi/spi-controller.yaml#

properties:
  compatible:
    enum:
      - sprd,sc9860-adi
      - sprd,sc9863-adi
      - sprd,ums512-adi

  reg:
    maxItems: 1

  hwlocks:
    maxItems: 1

  hwlock-names:
    const: adi

  sprd,hw-channels:
    $ref: /schemas/types.yaml#/definitions/uint32-matrix
    description: A list of hardware channels
    minItems: 1
    maxItems: 48
    items:
      items:
        - description: The hardware channel id which is used to transfer data
            triggered by hardware automatically, channel id 0-1 are for software
            use, 2-49 are hardware channels.
          minimum: 2
          maximum: 49
        - description: The analog chip address where user want to access by
            hardware components.

required:
  - compatible
  - reg
  - '#address-cells'
  - '#size-cells'

unevaluatedProperties: false

examples:
  - |
    aon {
        #address-cells = <2>;
        #size-cells = <2>;

        adi_bus: spi@40030000 {
            compatible = "sprd,sc9860-adi";
            reg = <0 0x40030000 0 0x10000>;
            hwlocks = <&hwlock1 0>;
            hwlock-names = "adi";
            #address-cells = <1>;
            #size-cells = <0>;
            sprd,hw-channels = <30 0x8c20>;
        };
    };
...
```

## Documentation/devicetree/bindings/spi/sqi-pic32.txt
```
Microchip PIC32 Quad SPI controller
-----------------------------------
Required properties:
- compatible: Should be "microchip,pic32mzda-sqi".
- reg: Address and length of SQI controller register space.
- interrupts: Should contain SQI interrupt.
- clocks: Should contain phandle of two clocks in sequence, one that drives
          clock on SPI bus and other that drives SQI controller.
- clock-names: Should be "spi_ck" and "reg_ck" in order.

Example:
	sqi1: spi@1f8e2000 {
		compatible = "microchip,pic32mzda-sqi";
		reg = <0x1f8e2000 0x200>;
		clocks = <&rootclk REF2CLK>, <&rootclk PB5CLK>;
		clock-names = "spi_ck", "reg_ck";
		interrupts = <169 IRQ_TYPE_LEVEL_HIGH>;
	};
```

## Documentation/devicetree/bindings/spi/st,ssc-spi.yaml
```yaml
# SPDX-License-Identifier: (GPL-2.0-only OR BSD-2-Clause)
%YAML 1.2
---
$id: http://devicetree.org/schemas/spi/st,ssc-spi.yaml#
$schema: http://devicetree.org/meta-schemas/core.yaml#

title: STMicroelectronics SSC SPI Controller

description: |
  The STMicroelectronics SSC SPI controller can be found on STi platforms
  and it used to communicate with external devices using the
  Serial Peripheral Interface.

maintainers:
  - Patrice Chotard <patrice.chotard@foss.st.com>

allOf:
  - $ref: spi-controller.yaml#

properties:
  compatible:
    const: st,comms-ssc4-spi

  reg:
    maxItems: 1

  clocks:
    maxItems: 1

  clock-names:
    const: ssc

  interrupts:
    maxItems: 1

required:
  - compatible
  - reg
  - clocks
  - clock-names
  - interrupts

unevaluatedProperties: false

examples:
  - |
    #include <dt-bindings/interrupt-controller/arm-gic.h>
    #include <dt-bindings/clock/stih407-clks.h>
    spi@9840000 {
      compatible = "st,comms-ssc4-spi";
      reg = <0x9840000 0x110>;
      interrupts = <GIC_SPI 112 IRQ_TYPE_LEVEL_HIGH>;
      clocks = <&clk_s_c0_flexgen CLK_EXT2F_A9>;
      clock-names = "ssc";
      pinctrl-0 = <&pinctrl_spi0_default>;
      pinctrl-names = "default";
      #address-cells = <1>;
      #size-cells = <0>;
    };

...
```

## Documentation/devicetree/bindings/spi/st,stm32-qspi.yaml
```yaml
# SPDX-License-Identifier: (GPL-2.0-only OR BSD-2-Clause)
%YAML 1.2
---
$id: http://devicetree.org/schemas/spi/st,stm32-qspi.yaml#
$schema: http://devicetree.org/meta-schemas/core.yaml#

title: STMicroelectronics STM32 Quad Serial Peripheral Interface (QSPI)

maintainers:
  - Christophe Kerello <christophe.kerello@foss.st.com>
  - Patrice Chotard <patrice.chotard@foss.st.com>

allOf:
  - $ref: spi-controller.yaml#

properties:
  compatible:
    const: st,stm32f469-qspi

  reg:
    items:
      - description: registers
      - description: memory mapping

  reg-names:
    items:
      - const: qspi
      - const: qspi_mm

  clocks:
    maxItems: 1

  interrupts:
    maxItems: 1

  resets:
    maxItems: 1

  dmas:
    items:
      - description: tx DMA channel
      - description: rx DMA channel

  dma-names:
    items:
      - const: tx
      - const: rx

  access-controllers:
    minItems: 1
    maxItems: 2

required:
  - compatible
  - reg
  - reg-names
  - clocks
  - interrupts

unevaluatedProperties: false

examples:
  - |
    #include <dt-bindings/interrupt-controller/arm-gic.h>
    #include <dt-bindings/clock/stm32mp1-clks.h>
    #include <dt-bindings/reset/stm32mp1-resets.h>
    spi@58003000 {
      compatible = "st,stm32f469-qspi";
      reg = <0x58003000 0x1000>, <0x70000000 0x10000000>;
      reg-names = "qspi", "qspi_mm";
      interrupts = <GIC_SPI 92 IRQ_TYPE_LEVEL_HIGH>;
      dmas = <&mdma1 22 0x10 0x100002 0x0 0x0>,
             <&mdma1 22 0x10 0x100008 0x0 0x0>;
      dma-names = "tx", "rx";
      clocks = <&rcc QSPI_K>;
      resets = <&rcc QSPI_R>;

      #address-cells = <1>;
      #size-cells = <0>;

      flash@0 {
        compatible = "jedec,spi-nor";
        reg = <0>;
        spi-rx-bus-width = <4>;
        spi-max-frequency = <108000000>;
      };
    };

...
```

## Documentation/devicetree/bindings/spi/st,stm32-spi.yaml
```yaml
# SPDX-License-Identifier: (GPL-2.0-only OR BSD-2-Clause)
%YAML 1.2
---
$id: http://devicetree.org/schemas/spi/st,stm32-spi.yaml#
$schema: http://devicetree.org/meta-schemas/core.yaml#

title: STMicroelectronics STM32 SPI Controller

description: |
  The STM32 SPI controller is used to communicate with external devices using
  the Serial Peripheral Interface. It supports full-duplex, half-duplex and
  simplex synchronous serial communication with external devices. It supports
  from 4 to 32-bit data size.

maintainers:
  - Erwan Leray <erwan.leray@foss.st.com>
  - Fabrice Gasnier <fabrice.gasnier@foss.st.com>

allOf:
  - $ref: spi-controller.yaml#
  - if:
      properties:
        compatible:
          contains:
            const: st,stm32f4-spi

    then:
      properties:
        st,spi-midi-ns: false
        sram: false
        dmas:
          maxItems: 2
        dma-names:
          items:
            - const: rx
            - const: tx

  - if:
      properties:
        compatible:
          contains:
            const: st,stm32mp25-spi

    then:
      properties:
        sram: false
        dmas:
          maxItems: 2
        dma-names:
          items:
            - const: rx
            - const: tx

properties:
  compatible:
    enum:
      - st,stm32f4-spi
      - st,stm32f7-spi
      - st,stm32h7-spi
      - st,stm32mp25-spi

  reg:
    maxItems: 1

  clocks:
    maxItems: 1

  interrupts:
    maxItems: 1

  resets:
    maxItems: 1

  dmas:
    description: |
      DMA specifiers for tx and rx channels. DMA fifo mode must be used. See
      the STM32 DMA bindings Documentation/devicetree/bindings/dma/stm32/st,*dma.yaml
    minItems: 2
    items:
      - description: rx DMA channel
      - description: tx DMA channel
      - description: rxm2m MDMA channel

  dma-names:
    minItems: 2
    items:
      - const: rx
      - const: tx
      - const: rxm2m

  sram:
    $ref: /schemas/types.yaml#/definitions/phandle
    description: |
      Phandles to a reserved SRAM region which is used as temporary
      storage memory between DMA and MDMA engines.
      The region should be defined as child node of the AHB SRAM node
      as per the generic bindings in Documentation/devicetree/bindings/sram/sram.yaml

  access-controllers:
    minItems: 1
    maxItems: 2

required:
  - compatible
  - reg
  - clocks
  - interrupts

unevaluatedProperties: false

examples:
  - |
    #include <dt-bindings/interrupt-controller/arm-gic.h>
    #include <dt-bindings/clock/stm32mp1-clks.h>
    #include <dt-bindings/reset/stm32mp1-resets.h>
    spi@4000b000 {
        #address-cells = <1>;
        #size-cells = <0>;
        compatible = "st,stm32h7-spi";
        reg = <0x4000b000 0x400>;
        interrupts = <GIC_SPI 36 IRQ_TYPE_LEVEL_HIGH>;
        clocks = <&rcc SPI2_K>;
        resets = <&rcc SPI2_R>;
        dmas = <&dmamux1 0 39 0x400 0x05>,
               <&dmamux1 1 40 0x400 0x05>;
        dma-names = "rx", "tx";
        cs-gpios = <&gpioa 11 0>;
    };

...
```

## Documentation/devicetree/bindings/spi/st,stm32mp25-ospi.yaml
```yaml
# SPDX-License-Identifier: (GPL-2.0-only OR BSD-2-Clause)
%YAML 1.2
---
$id: http://devicetree.org/schemas/spi/st,stm32mp25-ospi.yaml#
$schema: http://devicetree.org/meta-schemas/core.yaml#

title: STMicroelectronics STM32 Octal Serial Peripheral Interface (OSPI)

maintainers:
  - Patrice Chotard <patrice.chotard@foss.st.com>

allOf:
  - $ref: spi-controller.yaml#

properties:
  compatible:
    const: st,stm32mp25-ospi

  reg:
    maxItems: 1

  memory-region:
    description:
      Memory region to be used for memory-map read access.
      In memory-mapped mode, read access are performed from the memory
      device using the direct mapping.
    maxItems: 1

  clocks:
    maxItems: 1

  interrupts:
    maxItems: 1

  resets:
    items:
      - description: phandle to OSPI block reset
      - description: phandle to delay block reset

  dmas:
    maxItems: 2

  dma-names:
    items:
      - const: tx
      - const: rx

  st,syscfg-dlyb:
    description: configure OCTOSPI delay block.
    $ref: /schemas/types.yaml#/definitions/phandle-array
    items:
      - description: phandle to syscfg
      - description: register offset within syscfg

  access-controllers:
    description: phandle to the rifsc device to check access right
      and in some cases, an additional phandle to the rcc device for
      secure clock control.
    items:
      - description: phandle to bus controller
      - description: phandle to clock controller
    minItems: 1

  power-domains:
    maxItems: 1

required:
  - compatible
  - reg
  - clocks
  - resets
  - interrupts
  - st,syscfg-dlyb

unevaluatedProperties: false

examples:
  - |
    #include <dt-bindings/clock/st,stm32mp25-rcc.h>
    #include <dt-bindings/interrupt-controller/arm-gic.h>
    #include <dt-bindings/reset/st,stm32mp25-rcc.h>

    spi@40430000 {
      compatible = "st,stm32mp25-ospi";
      reg = <0x40430000 0x400>;
      memory-region = <&mm_ospi1>;
      interrupts = <GIC_SPI 163 IRQ_TYPE_LEVEL_HIGH>;
      dmas = <&hpdma 2 0x62 0x00003121 0x0>,
             <&hpdma 2 0x42 0x00003112 0x0>;
      dma-names = "tx", "rx";
      clocks = <&scmi_clk CK_SCMI_OSPI1>;
      resets = <&scmi_reset RST_SCMI_OSPI1>, <&scmi_reset RST_SCMI_OSPI1DLL>;
      access-controllers = <&rifsc 74>;
      power-domains = <&CLUSTER_PD>;
      st,syscfg-dlyb = <&syscfg 0x1000>;

      #address-cells = <1>;
      #size-cells = <0>;

      flash@0 {
        compatible = "jedec,spi-nor";
        reg = <0>;
        spi-rx-bus-width = <4>;
        spi-max-frequency = <108000000>;
      };
    };
```

## Documentation/devicetree/bindings/spi/ti,qspi.yaml
```yaml
# SPDX-License-Identifier: (GPL-2.0-only OR BSD-2-Clause)
%YAML 1.2
---
$id: http://devicetree.org/schemas/spi/ti,qspi.yaml#
$schema: http://devicetree.org/meta-schemas/core.yaml#

title: TI QSPI controller

maintainers:
  - Kousik Sanagavarapu <five231003@gmail.com>

allOf:
  - $ref: spi-controller.yaml#

properties:
  compatible:
    enum:
      - ti,am4372-qspi
      - ti,dra7xxx-qspi

  reg:
    items:
      - description: base registers
      - description: mapped memory

  reg-names:
    items:
      - const: qspi_base
      - const: qspi_mmap

  clocks:
    maxItems: 1

  clock-names:
    items:
      - const: fck

  interrupts:
    maxItems: 1

  num-cs:
    minimum: 1
    maximum: 4
    default: 1

  ti,hwmods:
    description:
      Name of the hwmod associated to the QSPI.  This is for legacy
      platforms only.
    $ref: /schemas/types.yaml#/definitions/string
    deprecated: true

  syscon-chipselects:
    description:
      Handle to system control region containing QSPI chipselect register
      and offset of that register.
    $ref: /schemas/types.yaml#/definitions/phandle-array
    items:
      - items:
          - description: phandle to system control register
          - description: register offset

  spi-max-frequency:
    description: Maximum SPI clocking speed of the controller in Hz.
    $ref: /schemas/types.yaml#/definitions/uint32

required:
  - compatible
  - reg
  - reg-names
  - clocks
  - clock-names
  - interrupts

unevaluatedProperties: false

examples:
  - |
    #include <dt-bindings/clock/dra7.h>
    #include <dt-bindings/interrupt-controller/arm-gic.h>

    spi@4b300000 {
        compatible = "ti,dra7xxx-qspi";
        reg = <0x4b300000 0x100>,
              <0x5c000000 0x4000000>;
        reg-names = "qspi_base", "qspi_mmap";
        syscon-chipselects = <&scm_conf 0x558>;
        #address-cells = <1>;
        #size-cells = <0>;
        clocks = <&l4per2_clkctrl DRA7_L4PER2_QSPI_CLKCTRL 25>;
        clock-names = "fck";
        num-cs = <4>;
        spi-max-frequency = <48000000>;
        interrupts = <GIC_SPI 343 IRQ_TYPE_LEVEL_HIGH>;
    };
...
```
