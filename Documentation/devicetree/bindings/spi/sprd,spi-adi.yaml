## Documentation/devicetree/bindings/sram/allwinner,sun4i-a10-system-control.yaml
```yaml
# SPDX-License-Identifier: GPL-2.0+
%YAML 1.2
---
$id: http://devicetree.org/schemas/sram/allwinner,sun4i-a10-system-control.yaml#
$schema: http://devicetree.org/meta-schemas/core.yaml#

title: Allwinner A10 System Control

maintainers:
  - Chen-Yu Tsai <wens@csie.org>
  - Maxime Ripard <mripard@kernel.org>

description:
  The SRAM controller found on most Allwinner devices is represented
  by a regular node for the SRAM controller itself, with sub-nodes
  representing the SRAM handled by the SRAM controller.

properties:
  "#address-cells":
    const: 1

  "#size-cells":
    const: 1

  compatible:
    oneOf:
      - enum:
          - allwinner,sun4i-a10-sram-controller
          - allwinner,sun50i-a64-sram-controller
        deprecated: true
      - enum:
          - allwinner,sun4i-a10-system-control
          - allwinner,sun5i-a13-system-control
          - allwinner,sun8i-a23-system-control
          - allwinner,sun8i-h3-system-control
          - allwinner,sun20i-d1-system-control
          - allwinner,sun50i-a64-system-control
          - allwinner,sun50i-h5-system-control
          - allwinner,sun50i-h616-system-control
      - items:
          - enum:
              - allwinner,suniv-f1c100s-system-control
              - allwinner,sun7i-a20-system-control
              - allwinner,sun8i-r40-system-control
          - const: allwinner,sun4i-a10-system-control
      - items:
          - const: allwinner,sun8i-v3s-system-control
          - const: allwinner,sun8i-h3-system-control
      - items:
          - enum:
              - allwinner,sun50i-a100-system-control
              - allwinner,sun50i-h6-system-control
              - allwinner,sun55i-a523-system-control
          - const: allwinner,sun50i-a64-system-control

  reg:
    maxItems: 1

  ranges: true

patternProperties:
  "^regulators@[0-9a-f]+$":
    $ref: /schemas/regulator/allwinner,sun20i-d1-system-ldos.yaml#

  "^sram@[a-f0-9]+":
    $ref: /schemas/sram/sram.yaml#
    unevaluatedProperties: false

    patternProperties:
      "^sram-section?@[a-f0-9]+$":
        type: object
        additionalProperties: false

        properties:
          reg: true

          compatible:
            oneOf:
              - const: allwinner,sun4i-a10-sram-a3-a4
              - const: allwinner,sun4i-a10-sram-c1
              - const: allwinner,sun4i-a10-sram-d
              - const: allwinner,sun50i-a64-sram-c
              - items:
                  - enum:
                      - allwinner,sun5i-a13-sram-a3-a4
                      - allwinner,sun7i-a20-sram-a3-a4
                  - const: allwinner,sun4i-a10-sram-a3-a4
              - items:
                  - enum:
                      - allwinner,sun5i-a13-sram-c1
                      - allwinner,sun7i-a20-sram-c1
                      - allwinner,sun8i-a23-sram-c1
                      - allwinner,sun8i-h3-sram-c1
                      - allwinner,sun8i-r40-sram-c1
                      - allwinner,sun50i-a64-sram-c1
                      - allwinner,sun50i-h5-sram-c1
                      - allwinner,sun50i-h6-sram-c1
                  - const: allwinner,sun4i-a10-sram-c1
              - items:
                  - enum:
                      - allwinner,suniv-f1c100s-sram-d
                      - allwinner,sun5i-a13-sram-d
                      - allwinner,sun7i-a20-sram-d
                  - const: allwinner,sun4i-a10-sram-d
              - items:
                  - const: allwinner,sun50i-h6-sram-c
                  - const: allwinner,sun50i-a64-sram-c

required:
  - "#address-cells"
  - "#size-cells"
  - compatible
  - reg

additionalProperties: false

examples:
  - |
    system-control@1c00000 {
      compatible = "allwinner,sun4i-a10-system-control";
      reg = <0x01c00000 0x30>;
      #address-cells = <1>;
      #size-cells = <1>;
      ranges;

      sram_a: sram@0 {
        compatible = "mmio-sram";
        reg = <0x00000000 0xc000>;
        #address-cells = <1>;
        #size-cells = <1>;
        ranges = <0 0x00000000 0xc000>;

        emac_sram: sram-section@8000 {
          compatible = "allwinner,sun4i-a10-sram-a3-a4";
          reg = <0x8000 0x4000>;
        };
      };
    };

  - |
    syscon@3000000 {
      compatible = "allwinner,sun20i-d1-system-control";
      reg = <0x3000000 0x1000>;
      ranges;
      #address-cells = <1>;
      #size-cells = <1>;

      regulators@3000150 {
        compatible = "allwinner,sun20i-d1-system-ldos";
        reg = <0x3000150 0x4>;

        reg_ldoa: ldoa {
          regulator-min-microvolt = <1800000>;
          regulator-max-microvolt = <1800000>;
        };

        reg_ldob: ldob {
          regulator-name = "vcc-dram";
          regulator-min-microvolt = <1500000>;
          regulator-max-microvolt = <1500000>;
        };
      };
    };
```

## Documentation/devicetree/bindings/sram/milbeaut-smp-sram.txt
```
Milbeaut SRAM for smp bringup

Milbeaut SoCs use a part of the sram for the bringup of the secondary cores.
Once they get powered up in the bootloader, they stay at the specific part
of the sram.
Therefore the part needs to be added as the sub-node of mmio-sram.

Required sub-node properties:
- compatible : should be "socionext,milbeaut-smp-sram"

Example:

        sram: sram@0 {
                compatible = "mmio-sram";
                reg = <0x0 0x10000>;
                #address-cells = <1>;
                #size-cells = <1>;
                ranges = <0 0x0 0x10000>;

                smp-sram@f100 {
                        compatible = "socionext,milbeaut-smp-sram";
                        reg = <0xf100 0x20>;
                };
        };
```

## Documentation/devicetree/bindings/sram/qcom,imem.yaml
```yaml
# SPDX-License-Identifier: GPL-2.0-only OR BSD-2-Clause
%YAML 1.2
---
$id: http://devicetree.org/schemas/sram/qcom,imem.yaml#
$schema: http://devicetree.org/meta-schemas/core.yaml#

title: Qualcomm IMEM memory region

maintainers:
  - Bjorn Andersson <bjorn.andersson@linaro.org>

description:
  Qualcomm IMEM is dedicated memory region for various debug features and DMA
  transactions.

properties:
  compatible:
    items:
      - enum:
          - qcom,apq8064-imem
          - qcom,ipq5424-imem
          - qcom,msm8226-imem
          - qcom,msm8974-imem
          - qcom,msm8976-imem
          - qcom,qcs404-imem
          - qcom,qcs615-imem
          - qcom,qcs8300-imem
          - qcom,qdu1000-imem
          - qcom,sa8775p-imem
          - qcom,sar2130p-imem
          - qcom,sc7180-imem
          - qcom,sc7280-imem
          - qcom,sc8280xp-imem
          - qcom,sdm630-imem
          - qcom,sdm845-imem
          - qcom,sdx55-imem
          - qcom,sdx65-imem
          - qcom,sdx75-imem
          - qcom,sm6115-imem
          - qcom,sm6125-imem
          - qcom,sm6350-imem
          - qcom,sm6375-imem
          - qcom,sm7150-imem
          - qcom,sm8150-imem
          - qcom,sm8250-imem
          - qcom,sm8350-imem
          - qcom,sm8450-imem
          - qcom,sm8550-imem
          - qcom,sm8650-imem
          - qcom,sm8750-imem
          - qcom,x1e80100-imem
      - const: syscon
      - const: simple-mfd

  reg:
    maxItems: 1

  ranges: true

  '#address-cells':
    const: 1

  '#size-cells':
    const: 1

  reboot-mode:
    $ref: /schemas/power/reset/syscon-reboot-mode.yaml#

patternProperties:
  "^pil-reloc@[0-9a-f]+$":
    $ref: /schemas/remoteproc/qcom,pil-info.yaml#
    description: Peripheral image loader relocation region

required:
  - compatible
  - reg

additionalProperties: false

examples:
  - |
    soc {
        #address-cells = <2>;
        #size-cells = <2>;

        sram@146bf000 {
            compatible = "qcom,sdm845-imem", "syscon", "simple-mfd";
            reg = <0 0x146bf000 0 0x1000>;
            ranges = <0 0 0x146bf000 0x1000>;

            #address-cells = <1>;
            #size-cells = <1>;

            pil-reloc@94c {
                compatible = "qcom,pil-reloc-info";
                reg = <0x94c 0xc8>;
            };
        };
    };
```

## Documentation/devicetree/bindings/sram/qcom,ocmem.yaml
```yaml
# SPDX-License-Identifier: (GPL-2.0 OR BSD-2-Clause)
%YAML 1.2
---
$id: http://devicetree.org/schemas/sram/qcom,ocmem.yaml#
$schema: http://devicetree.org/meta-schemas/core.yaml#

title: On Chip Memory (OCMEM) that is present on some Qualcomm Snapdragon SoCs.

maintainers:
  - Brian Masney <masneyb@onstation.org>

description: |
  The On Chip Memory (OCMEM) is typically used by the GPU, camera/video, and
  audio components on some Snapdragon SoCs.

properties:
  compatible:
    enum:
      - qcom,msm8226-ocmem  # v1.1.0
      - qcom,msm8974-ocmem  # v1.4.0

  reg:
    items:
      - description: Control registers
      - description: OCMEM address range

  reg-names:
    items:
      - const: ctrl
      - const: mem

  clocks:
    minItems: 1
    items:
      - description: Core clock
      - description: Interface clock

  clock-names:
    minItems: 1
    items:
      - const: core
      - const: iface

  '#address-cells':
    const: 1

  '#size-cells':
    const: 1

  ranges:
    maxItems: 1

required:
  - compatible
  - reg
  - reg-names
  - clocks
  - clock-names
  - '#address-cells'
  - '#size-cells'
  - ranges

additionalProperties: false

allOf:
  - if:
      properties:
        compatible:
          contains:
            enum:
              - qcom,msm8974-ocmem
    then:
      properties:
        clocks:
          minItems: 2
        clock-names:
          minItems: 2
    else:
      properties:
        clocks:
          minItems: 1
        clock-names:
          minItems: 1

patternProperties:
  "-sram@[0-9a-f]+$":
    type: object
    additionalProperties: false
    description: A region of reserved memory.

    properties:
      reg:
        maxItems: 1

    required:
      - reg

examples:
  - |
    #include <dt-bindings/clock/qcom,rpmcc.h>
    #include <dt-bindings/clock/qcom,mmcc-msm8974.h>

    sram@fdd00000 {
        compatible = "qcom,msm8974-ocmem";

        reg = <0xfdd00000 0x2000>,
              <0xfec00000 0x180000>;
        reg-names = "ctrl",
                    "mem";

        clocks = <&rpmcc RPM_SMD_OCMEMGX_CLK>,
                 <&mmcc OCMEMCX_OCMEMNOC_CLK>;
        clock-names = "core",
                      "iface";

        #address-cells = <1>;
        #size-cells = <1>;
        ranges = <0 0xfec00000 0x100000>;

        gmu-sram@0 {
            reg = <0x0 0x100000>;
        };
    };
```

## Documentation/devicetree/bindings/sram/renesas,smp-sram.txt
```
* Renesas SMP SRAM

Renesas R-Car Gen2 and RZ/G1 SoCs need a small piece of SRAM for the jump stub
for secondary CPU bringup and CPU hotplug.
This memory is reserved by adding a child node to a "mmio-sram" node, cfr.
Documentation/devicetree/bindings/sram/sram.txt.

Required child node properties:
  - compatible: Must be "renesas,smp-sram",
  - reg: Address and length of the reserved SRAM.
    The full physical (bus) address must be aligned to a 256 KiB boundary.


Example:

	icram1:	sram@e63c0000 {
		compatible = "mmio-sram";
		reg = <0 0xe63c0000 0 0x1000>;
		#address-cells = <1>;
		#size-cells = <1>;
		ranges = <0 0 0xe63c0000 0x1000>;

		smp-sram@0 {
			compatible = "renesas,smp-sram";
			reg = <0 0x10>;
		};
	};
```
