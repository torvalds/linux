## Documentation/devicetree/bindings/embedded-controller/lenovo,thinkpad-t14s-ec.yaml
```yaml
# SPDX-License-Identifier: (GPL-2.0-only OR BSD-2-Clause)
%YAML 1.2
---
$id: http://devicetree.org/schemas/embedded-controller/lenovo,thinkpad-t14s-ec.yaml#
$schema: http://devicetree.org/meta-schemas/core.yaml#

title: Lenovo Thinkpad T14s Embedded Controller

maintainers:
  - Sebastian Reichel <sre@kernel.org>

description:
  The Qualcomm Snapdragon-based Lenovo Thinkpad T14s has an Embedded Controller
  (EC) which handles things such as keyboard backlight, LEDs or non-standard
  keys.

properties:
  compatible:
    const: lenovo,thinkpad-t14s-ec

  reg:
    const: 0x28

  interrupts:
    maxItems: 1

  wakeup-source: true

required:
  - compatible
  - reg
  - interrupts

additionalProperties: false

examples:
  - |+
    #include <dt-bindings/interrupt-controller/irq.h>
    i2c {
        #address-cells = <1>;
        #size-cells = <0>;

        embedded-controller@28 {
            compatible = "lenovo,thinkpad-t14s-ec";
            reg = <0x28>;
            interrupts-extended = <&tlmm 66 IRQ_TYPE_LEVEL_LOW>;
            wakeup-source;
        };
    };
...
```

## Documentation/devicetree/bindings/embedded-controller/lenovo,yoga-c630-ec.yaml
```yaml
# SPDX-License-Identifier: (GPL-2.0-only OR BSD-2-Clause)
%YAML 1.2
---
$id: http://devicetree.org/schemas/embedded-controller/lenovo,yoga-c630-ec.yaml#
$schema: http://devicetree.org/meta-schemas/core.yaml#

title: Lenovo Yoga C630 Embedded Controller.

maintainers:
  - Bjorn Andersson <andersson@kernel.org>

description:
  The Qualcomm Snapdragon-based Lenovo Yoga C630 has an Embedded Controller
  (EC) which handles things such as battery and USB Type-C. This binding
  describes the interface, on an I2C bus, to this EC.

properties:
  compatible:
    const: lenovo,yoga-c630-ec

  reg:
    const: 0x70

  '#address-cells':
    const: 1

  '#size-cells':
    const: 0

  interrupts:
    maxItems: 1

patternProperties:
  '^connector@[01]$':
    $ref: /schemas/connector/usb-connector.yaml#

    properties:
      reg:
        maxItems: 1

    unevaluatedProperties: false

required:
  - compatible
  - reg
  - interrupts

additionalProperties: false

examples:
  - |+
    #include <dt-bindings/interrupt-controller/irq.h>
    i2c1 {
        clock-frequency = <400000>;

        #address-cells = <1>;
        #size-cells = <0>;

        embedded-controller@70 {
            compatible = "lenovo,yoga-c630-ec";
            reg = <0x70>;

            interrupts-extended = <&tlmm 20 IRQ_TYPE_LEVEL_HIGH>;

            #address-cells = <1>;
            #size-cells = <0>;

            connector@0 {
                compatible = "usb-c-connector";
                reg = <0>;
                power-role = "source";
                data-role = "host";
            };

            connector@1 {
                compatible = "usb-c-connector";
                reg = <1>;
                power-role = "source";
                data-role = "host";
            };
        };
    };
...
```

## Documentation/devicetree/bindings/embedded-controller/microsoft,surface-rt-ec.yaml
```yaml
# SPDX-License-Identifier: (GPL-2.0-only OR BSD-2-Clause)
%YAML 1.2
---
$id: http://devicetree.org/schemas/embedded-controller/microsoft,surface-rt-ec.yaml#
$schema: http://devicetree.org/meta-schemas/core.yaml#

title: Microsoft Surface RT fuel gauge and charger EC

maintainers:
  - Jonas Schwöbel <jonasschwoebel@yahoo.de>
  - Svyatoslav Ryhel <clamor95@gmail.com>

description:
  An Embedded Controller used in Microsoft Surface RT for monitoring
  battery properties and charger status.

allOf:
  - $ref: /schemas/power/supply/power-supply.yaml#

properties:
  compatible:
    const: microsoft,surface-rt-ec

  reg:
    maxItems: 1

  interrupts:
    maxItems: 1

  enable-gpios:
    maxItems: 1

  monitored-battery: true

required:
  - compatible
  - reg
  - interrupts
  - enable-gpios

additionalProperties: false

examples:
  - |
    #include <dt-bindings/gpio/gpio.h>
    #include <dt-bindings/interrupt-controller/irq.h>

    i2c {
        #address-cells = <1>;
        #size-cells = <0>;

        embedded-controller@a {
            compatible = "microsoft,surface-rt-ec";
            reg = <0x0a>;

            interrupt-parent = <&gpio>;
            interrupts = <74 IRQ_TYPE_EDGE_RISING>;

            enable-gpios = <&gpio 88 GPIO_ACTIVE_HIGH>;
            monitored-battery = <&battery>;
        };
    };
...
```

## Documentation/devicetree/bindings/embedded-controller/qcom,hamoa-crd-ec.yaml
```yaml
# SPDX-License-Identifier: (GPL-2.0-only OR BSD-2-Clause)
%YAML 1.2
---
$id: http://devicetree.org/schemas/embedded-controller/qcom,hamoa-crd-ec.yaml#
$schema: http://devicetree.org/meta-schemas/core.yaml#

title: Qualcomm Hamoa Embedded Controller

maintainers:
  - Sibi Sankar <sibi.sankar@oss.qualcomm.com>
  - Anvesh Jain P <anvesh.p@oss.qualcomm.com>

description:
  Qualcomm Snapdragon based Hamoa/Purwa and Glymur reference devices have an
  EC running on different MCU chips. The EC handles things like fan control,
  temperature sensors, access to EC internal state changes.

properties:
  compatible:
    oneOf:
      - items:
          - enum:
              - qcom,glymur-crd-ec
              - qcom,hamoa-iot-evk-ec
          - const: qcom,hamoa-crd-ec
      - enum:
          - qcom,hamoa-crd-ec

  reg:
    const: 0x76

  interrupts:
    maxItems: 1

required:
  - compatible
  - reg
  - interrupts

additionalProperties: false

examples:
  - |
    #include <dt-bindings/interrupt-controller/irq.h>
    i2c {
        #address-cells = <1>;
        #size-cells = <0>;

        embedded-controller@76 {
            compatible = "qcom,hamoa-crd-ec";
            reg = <0x76>;

            interrupts-extended = <&tlmm 66 IRQ_TYPE_LEVEL_HIGH>;
        };
    };
...
```

## Documentation/devicetree/bindings/embedded-controller/traverse,ten64-controller.yaml
```yaml
# SPDX-License-Identifier: (GPL-2.0-only OR BSD-2-Clause)
%YAML 1.2
---
$id: http://devicetree.org/schemas/embedded-controller/traverse,ten64-controller.yaml#
$schema: http://devicetree.org/meta-schemas/core.yaml#

title: Traverse Ten64 board microcontroller

maintainers:
  - Mathew McBride <matt@traverse.com.au>

description: |
  The board microcontroller on the Ten64 board family is responsible for
  management of power sources on the board, as well as signalling the SoC
  to power on and reset.

properties:
  compatible:
    const: traverse,ten64-controller

  reg:
    const: 0x7e

required:
  - compatible
  - reg

additionalProperties: false

examples:
  - |
    i2c {
        #address-cells = <1>;
        #size-cells = <0>;

        board-controller@7e {
            compatible = "traverse,ten64-controller";
            reg = <0x7e>;
        };
    };
```

## Documentation/devicetree/bindings/example-schema.yaml
```yaml
# SPDX-License-Identifier: (GPL-2.0-only OR BSD-2-Clause)
# Copyright 2018 Linaro Ltd.
%YAML 1.2
---
# All the top-level keys are standard json-schema keywords except for
# 'maintainers' and 'select'

# $id is a unique identifier based on the filename. There may or may not be a
# file present at the URL.
$id: http://devicetree.org/schemas/example-schema.yaml#
# $schema is the meta-schema this schema should be validated with.
$schema: http://devicetree.org/meta-schemas/core.yaml#

title: An example schema annotated with jsonschema details

maintainers:
  - Rob Herring <robh@kernel.org>

description: |
  A more detailed multi-line description of the binding.

  Details about the hardware device and any links to datasheets can go here.

  Literal blocks are marked with the '|' at the beginning. The end is marked by
  indentation less than the first line of the literal block. Lines also cannot
  begin with a tab character.

select: false
  # 'select' is a schema applied to a DT node to determine if this binding
  # schema should be applied to the node. It is optional and by default the
  # possible compatible strings are extracted and used to match.

  # In this case, a 'false' schema will never match.

properties:
  # A dictionary of DT properties for this binding schema
  compatible:
    # More complicated schema can use oneOf (XOR), anyOf (OR), or allOf (AND)
    # to handle different conditions.
    # In this case, it's needed to handle a variable number of values as there
    # isn't another way to express a constraint of the last string value.
    # The boolean schema must be a list of schemas.
    oneOf:
      - items:
          # items is a list of possible values for the property. The number of
          # values is determined by the number of elements in the list.
          # Order in lists is significant, order in dicts is not
          # Must be one of the 1st enums followed by the 2nd enum
          #
          # Each element in items should be 'enum' or 'const'
          - enum:
              - vendor,soc4-ip
              - vendor,soc3-ip
              - vendor,soc2-ip
          - enum:
              - vendor,soc1-ip
        # additionalItems being false is implied
        # minItems/maxItems equal to 2 is implied
      - items:
          # 'const' is just a special case of an enum with a single possible value
          - const: vendor,soc1-ip

  reg:
    # The core schema already checks that reg values are numbers, so device
    # specific schema don't need to do those checks.
    # The description of each element defines the order and implicitly defines
    # the number of reg entries.
    items:
      - description: core registers
      - description: aux registers
    # minItems/maxItems equal to 2 is implied

  reg-names:
    # The core schema enforces this (*-names) is a string array
    items:
      - const: core
      - const: aux

  clocks:
    # Cases that have only a single entry just need to express that with maxItems
    maxItems: 1
    description: bus clock. A description is only needed for a single item if
      there's something unique to add.

  clock-names:
    items:
      - const: bus

  interrupts:
    # Either 1 or 2 interrupts can be present
    minItems: 1
    maxItems: 2
    items:
      - description: tx or combined interrupt
      - description: rx interrupt
    description:
      A variable number of interrupts warrants a description of what conditions
      affect the number of interrupts. Otherwise, descriptions on standard
      properties are not necessary.

  interrupt-names:
    # minItems must be specified here because the default would be 2
    minItems: 1
    maxItems: 2
    items:
      - const: tx irq
      - const: rx irq

  # Property names starting with '#' must be quoted
  '#interrupt-cells':
    # A simple case where the value must always be '2'.
    # The core schema handles that this must be a single integer.
    const: 2

  interrupt-controller: true
    # The core checks this is a boolean, so just have to list it here to be
    # valid for this binding.

  clock-frequency:
    # The type is set in the core schema. Per device schema only need to set
    # constraints on the possible values.
    minimum: 100
    maximum: 400000
    # The value that should be used if the property is not present
    default: 200

  foo-gpios:
    maxItems: 1
    description: A connection of the 'foo' gpio line.

  # *-supply is always a single phandle, so nothing more to define.
  foo-supply: true

  # Vendor specific properties
  #
  # Vendor specific properties have slightly different schema requirements than
  # common properties. They must have at least a type definition and
  # 'description'.
  vendor,int-property:
    description: Vendor specific properties must have a description
    $ref: /schemas/types.yaml#/definitions/uint32
    enum: [2, 4, 6, 8, 10]

  vendor,bool-property:
    description: Vendor specific properties must have a description. Boolean
      properties are one case where the json-schema 'type' keyword can be used
      directly.
    type: boolean

  vendor,string-array-property:
    description: Vendor specific properties should reference a type in the
      core schema.
    $ref: /schemas/types.yaml#/definitions/string-array
    items:
      - enum: [foo, bar]
      - enum: [baz, boo]

  vendor,property-in-standard-units-microvolt:
    description: Vendor specific properties having a standard unit suffix
      don't need a type.
    enum: [ 100, 200, 300 ]

  child-node:
    description: Child nodes are just another property from a json-schema
      perspective.
    type: object  # DT nodes are json objects
    properties:
      vendor,a-child-node-property:
        description: Child node properties have all the same schema
          requirements.
        type: boolean

    required:
      - vendor,a-child-node-property

# Describe the relationship between different properties
dependencies:
  # 'vendor,bool-property' is only allowed when 'vendor,string-array-property'
  # is present
  vendor,bool-property: [ 'vendor,string-array-property' ]
  # Expressing 2 properties in both orders means all of the set of properties
  # must be present or none of them.
  vendor,string-array-property: [ 'vendor,bool-property' ]

required:
  - compatible
  - reg
  - interrupts
  - interrupt-controller

# if/then schema can be used to handle conditions on a property affecting
# another property. A typical case is a specific 'compatible' value changes the
# constraints on other properties.
#
# For multiple 'if' schema, group them under an 'allOf'.
#
# If the conditionals become too unweldy, then it may be better to just split
# the binding into separate schema documents.
if:
  properties:
    compatible:
      contains:
        const: vendor,soc2-ip
then:
  required:
    - foo-supply

# Ideally, the schema should have this line otherwise any other properties
# present are allowed. There's a few common properties such as 'status' and
# 'pinctrl-*' which are added automatically by the tooling.
#
# This can't be used in cases where another schema is referenced
# (i.e. allOf: [{$ref: ...}]).
additionalProperties: false

examples:
  # Examples are now compiled with dtc and validated against the schemas
  #
  # Examples have a default #address-cells and #size-cells value of 1. This can
  # be overridden or an appropriate parent bus node should be shown (such as on
  # i2c buses).
  #
  # Any includes used have to be explicitly included.
  - |
    node@1000 {
          compatible = "vendor,soc4-ip", "vendor,soc1-ip";
          reg = <0x1000 0x80>,
                <0x3000 0x80>;
          reg-names = "core", "aux";
          interrupts = <10>;
          interrupt-controller;
    };
```
