## Documentation/devicetree/bindings/extcon/extcon-arizona.txt
```
Cirrus Logic Arizona class audio SoCs

These devices are audio SoCs with extensive digital capabilities and a range
of analogue I/O.

This document lists Extcon specific bindings, see the primary binding document:
  ../mfd/arizona.txt

Optional properties:

  - wlf,hpdet-channel : Headphone detection channel.
    ARIZONA_ACCDET_MODE_HPL or 1 - Headphone detect mode is set to HPDETL
    ARIZONA_ACCDET_MODE_HPR or 2 - Headphone detect mode is set to HPDETR
    If this node is not mentioned or if the value is unknown, then
    headphone detection mode is set to HPDETL.

  - wlf,use-jd2 : Use the additional JD input along with JD1 for dual pin jack
    detection.
  - wlf,use-jd2-nopull : Internal pull on JD2 is disabled when used for
    jack detection.
  - wlf,jd-invert : Invert the polarity of the jack detection switch

  - wlf,micd-software-compare : Use a software comparison to determine mic
    presence
  - wlf,micd-detect-debounce : Additional software microphone detection
    debounce specified in milliseconds.
  - wlf,micd-pol-gpio : GPIO specifier for the GPIO controlling the headset
    polarity if one exists.
  - wlf,micd-bias-start-time : Time allowed for MICBIAS to startup prior to
    performing microphone detection, specified as per the ARIZONA_MICD_TIME_XXX
    defines.
  - wlf,micd-rate : Delay between successive microphone detection measurements,
    specified as per the ARIZONA_MICD_TIME_XXX defines.
  - wlf,micd-dbtime : Microphone detection hardware debounces specified as the
    number of measurements to take, valid values being 2 and 4.
  - wlf,micd-timeout-ms : Timeout for microphone detection, specified in
    milliseconds.
  - wlf,micd-force-micbias : Force MICBIAS continuously on during microphone
    detection.
  - wlf,micd-configs : Headset polarity configurations (generally used for
    detection of CTIA / OMTP headsets), the field can be of variable length
    but should always be a multiple of 3 cells long, each three cell group
    represents one polarity configuration.
    The first cell defines the accessory detection pin, zero will use MICDET1
    and all other values will use MICDET2.
    The second cell represents the MICBIAS to be used.
    The third cell represents the value of the micd-pol-gpio pin.

  - wlf,gpsw : Settings for the general purpose switch, set as one of the
    ARIZONA_GPSW_XXX defines.

Example:

codec: wm8280@0 {
	compatible = "wlf,wm8280";
	reg = <0>;
	...

	wlf,use-jd2;
	wlf,use-jd2-nopull;
	wlf,jd-invert;

	wlf,micd-software-compare;
	wlf,micd-detect-debounce = <0>;
	wlf,micd-pol-gpio = <&codec 2 0>;
	wlf,micd-rate = <ARIZONA_MICD_TIME_8MS>;
	wlf,micd-dbtime = <4>;
	wlf,micd-timeout-ms = <100>;
	wlf,micd-force-micbias;
	wlf,micd-configs = <
		0 1 0 /* MICDET1 MICBIAS1 GPIO=low */
		1 2 1 /* MICDET2 MICBIAS2 GPIO=high */
	>;

	wlf,gpsw = <0>;
};
```

## Documentation/devicetree/bindings/extcon/extcon-fsa9480.txt
```
FAIRCHILD SEMICONDUCTOR FSA9480 MICROUSB SWITCH

The FSA9480 is a USB port accessory detector and switch. The FSA9480 is fully
controlled using I2C and enables USB data, stereo and mono audio, video,
microphone, and UART data to use a common connector port.

Required properties:
 - compatible : Must be "fcs,fsa9480"
 - reg : Specifies i2c slave address. Must be 0x25.
 - interrupts : Should contain one entry specifying interrupt signal of
   interrupt parent to which interrupt pin of the chip is connected.

 Example:
	musb@25 {
		compatible = "fcs,fsa9480";
		reg = <0x25>;
		interrupt-parent = <&gph2>;
		interrupts = <7 0>;
	};
```

## Documentation/devicetree/bindings/extcon/extcon-max3355.txt
```
Maxim Integrated MAX3355 USB OTG chip
-------------------------------------

MAX3355 integrates a charge pump and comparators to enable a system with an
integrated USB OTG dual-role transceiver to function as a USB OTG dual-role
device.

Required properties:
- compatible: should be "maxim,max3355";
- maxim,shdn-gpios: should contain a phandle and GPIO specifier for the GPIO pin
		    connected to the MAX3355's SHDN# pin;
- id-gpios: should contain a phandle and GPIO specifier for the GPIO pin
	    connected to the MAX3355's ID_OUT pin.

Example:

	usb-otg {
		compatible = "maxim,max3355";
		maxim,shdn-gpios = <&gpio2 4 GPIO_ACTIVE_LOW>;
		id-gpios = <&gpio5 31 GPIO_ACTIVE_HIGH>;
	};
```

## Documentation/devicetree/bindings/extcon/extcon-palmas.txt
```
EXTCON FOR PALMAS/TWL CHIPS

PALMAS USB COMPARATOR
Required Properties:
 - compatible: should contain one of:
   * "ti,palmas-usb-vid".
   * "ti,twl6035-usb-vid".
   * "ti,palmas-usb" (DEPRECATED - use "ti,palmas-usb-vid").
   * "ti,twl6035-usb" (DEPRECATED - use "ti,twl6035-usb-vid").

Optional Properties:
 - ti,wakeup : To enable the wakeup comparator in probe
 - ti,enable-id-detection: Perform ID detection. If id-gpio is specified
		it performs id-detection using GPIO else using OTG core.
 - ti,enable-vbus-detection: Perform VBUS detection.
 - id-gpio: gpio for GPIO ID detection. See gpio binding.
 - debounce-delay-ms: debounce delay for GPIO ID pin in milliseconds.

palmas-usb {
       compatible = "ti,twl6035-usb", "ti,palmas-usb";
       ti,wakeup;
};
```

## Documentation/devicetree/bindings/extcon/extcon-ptn5150.txt
```
* PTN5150 CC (Configuration Channel) Logic device

PTN5150 is a small thin low power CC logic chip supporting the USB Type-C
connector application with CC control logic detection and indication functions.
It is interfaced to the host controller using an I2C interface.

Required properties:
- compatible: should be "nxp,ptn5150"
- reg: specifies the I2C slave address of the device
- int-gpio: should contain a phandle and GPIO specifier for the GPIO pin
	connected to the PTN5150's INTB pin.
- vbus-gpio: should contain a phandle and GPIO specifier for the GPIO pin which
	is used to control VBUS.
- pinctrl-names : a pinctrl state named "default" must be defined.
- pinctrl-0 : phandle referencing pin configuration of interrupt and vbus
	control.

Example:
	ptn5150@1d {
		compatible = "nxp,ptn5150";
		reg = <0x1d>;
		int-gpio = <&msmgpio 78 GPIO_ACTIVE_HIGH>;
		vbus-gpio = <&msmgpio 148 GPIO_ACTIVE_HIGH>;
		pinctrl-names = "default";
		pinctrl-0 = <&ptn5150_default>;
		status = "okay";
	};
```

## Documentation/devicetree/bindings/extcon/extcon-ptn5150.yaml
```yaml
# SPDX-License-Identifier: GPL-2.0-only OR BSD-2-Clause
%YAML 1.2
---
$id: http://devicetree.org/schemas/extcon/extcon-ptn5150.yaml#
$schema: http://devicetree.org/meta-schemas/core.yaml#

title: PTN5150 CC (Configuration Channel) Logic device

maintainers:
  - Krzysztof Kozlowski <krzk@kernel.org>

description: |
  PTN5150 is a small thin low power CC logic chip supporting the USB Type-C
  connector application with CC control logic detection and indication
  functions.  It is interfaced to the host controller using an I2C interface.

properties:
  compatible:
    const: nxp,ptn5150

  int-gpios:
    maxItems: 1
    deprecated: true
    description:
      GPIO pin (input) connected to the PTN5150's INTB pin.
      Use "interrupts" instead.

  interrupts:
    maxItems: 1

  reg:
    maxItems: 1

  vbus-gpios:
    maxItems: 1
    description:
      GPIO pin (output) used to control VBUS. If skipped, no such control
      takes place.

required:
  - compatible
  - interrupts
  - reg

additionalProperties: false

examples:
  - |
    #include <dt-bindings/gpio/gpio.h>
    #include <dt-bindings/interrupt-controller/irq.h>
    i2c {
        #address-cells = <1>;
        #size-cells = <0>;

        ptn5150@1d {
            compatible = "nxp,ptn5150";
            reg = <0x1d>;
            interrupt-parent = <&msmgpio>;
            interrupts = <78 IRQ_TYPE_LEVEL_HIGH>;
            vbus-gpios = <&msmgpio 148 GPIO_ACTIVE_HIGH>;
        };
    };
```

## Documentation/devicetree/bindings/extcon/extcon-rt8973a.txt
```
* Richtek RT8973A - Micro USB Switch device

The Richtek RT8973A is Micro USB Switch with OVP and I2C interface. The RT8973A
is a USB port accessory detector and switch that is optimized to protect low
voltage system from abnormal high input voltage (up to 28V) and supports high
speed USB operation. Also, RT8973A support 'auto-configuration' mode.
If auto-configuration mode is enabled, RT8973A would control internal h/w patch
for USB D-/D+ switching.

Required properties:
- compatible: Should be "richtek,rt8973a-muic"
- reg: Specifies the I2C slave address of the MUIC block. It should be 0x14
- interrupts: Interrupt specifiers for detection interrupt sources.

Example:

	rt8973a@14 {
		compatible = "richtek,rt8973a-muic";
		interrupt-parent = <&gpx1>;
		interrupts = <5 0>;
		reg = <0x14>;
	};
```

## Documentation/devicetree/bindings/extcon/extcon-sm5502.txt
```
* SM5502 MUIC (Micro-USB Interface Controller) device

The Silicon Mitus SM5502 is a MUIC (Micro-USB Interface Controller) device
which can detect the state of external accessory when external accessory is
attached or detached and button is pressed or released. It is interfaced to
the host controller using an I2C interface.

Required properties:
- compatible: Should be "siliconmitus,sm5502-muic"
- reg: Specifies the I2C slave address of the MUIC block. It should be 0x25
- interrupts: Interrupt specifiers for detection interrupt sources.

Example:

	sm5502@25 {
		compatible = "siliconmitus,sm5502-muic";
		interrupt-parent = <&gpx1>;
		interrupts = <5 0>;
		reg = <0x25>;
	};
```

## Documentation/devicetree/bindings/extcon/extcon-twl.txt
```
EXTCON FOR TWL CHIPS

PALMAS USB COMPARATOR
Required Properties:
 - compatible : Should be "ti,palmas-usb" or "ti,twl6035-usb"
 - vbus-supply : phandle to the regulator device tree node.

Optional Properties:
 - ti,wakeup : To enable the wakeup comparator in probe

palmas-usb {
       compatible = "ti,twl6035-usb", "ti,palmas-usb";
       vbus-supply = <&smps10_reg>;
       ti,wakeup;
};
```

## Documentation/devicetree/bindings/extcon/extcon-usb-gpio.txt
```
USB GPIO Extcon device

This is a virtual device used to generate USB cable states from the USB ID pin
connected to a GPIO pin.

Required properties:
- compatible: Should be "linux,extcon-usb-gpio"

Either one of id-gpio or vbus-gpio must be present. Both can be present as well.
- id-gpio: gpio for USB ID pin. See gpio binding.
- vbus-gpio: gpio for USB VBUS pin.

Example: Examples of extcon-usb-gpio node in dra7-evm.dts as listed below:
	extcon_usb1 {
		compatible = "linux,extcon-usb-gpio";
		id-gpio = <&gpio6 1 GPIO_ACTIVE_HIGH>;
	}

	&omap_dwc3_1 {
		extcon = <&extcon_usb1>;
	};
```

## Documentation/devicetree/bindings/extcon/extcon-usbc-cros-ec.txt
```
ChromeOS EC USB Type-C cable and accessories detection

On ChromeOS systems with USB Type C ports, the ChromeOS Embedded Controller is
able to detect the state of external accessories such as display adapters
or USB devices when said accessories are attached or detached.

The node for this device must be under a cros-ec node like google,cros-ec-spi
or google,cros-ec-i2c.

Required properties:
- compatible:		Should be "google,extcon-usbc-cros-ec".
- google,usb-port-id:	Specifies the USB port ID to use.

Example:
	cros-ec@0 {
		compatible = "google,cros-ec-i2c";

		...

		extcon {
			compatible = "google,extcon-usbc-cros-ec";
			google,usb-port-id = <0>;
		};
	}
```

## Documentation/devicetree/bindings/extcon/extcon-usbc-cros-ec.yaml
```yaml
# SPDX-License-Identifier: (GPL-2.0-only OR BSD-2-Clause)
%YAML 1.2
---
$id: http://devicetree.org/schemas/extcon/extcon-usbc-cros-ec.yaml#
$schema: http://devicetree.org/meta-schemas/core.yaml#

title: ChromeOS EC USB Type-C cable and accessories detection

maintainers:
  - Benson Leung <bleung@chromium.org>
  - Enric Balletbo i Serra <enric.balletbo@collabora.com>

description: |
  On ChromeOS systems with USB Type C ports, the ChromeOS Embedded Controller is
  able to detect the state of external accessories such as display adapters
  or USB devices when said accessories are attached or detached.
  The node for this device must be under a cros-ec node like google,cros-ec-spi
  or google,cros-ec-i2c.

properties:
  compatible:
    const: google,extcon-usbc-cros-ec

  google,usb-port-id:
    $ref: /schemas/types.yaml#/definitions/uint32
    description: the port id
    minimum: 0
    maximum: 255

required:
  - compatible
  - google,usb-port-id

additionalProperties: false

examples:
  - |
    spi0 {
        #address-cells = <1>;
        #size-cells = <0>;
        cros-ec@0 {
            compatible = "google,cros-ec-spi";
            reg = <0>;

            usbc_extcon0: extcon0 {
                compatible = "google,extcon-usbc-cros-ec";
                google,usb-port-id = <0>;
            };

            usbc_extcon1: extcon1 {
                compatible = "google,extcon-usbc-cros-ec";
                google,usb-port-id = <1>;
            };
        };
    };
```

## Documentation/devicetree/bindings/extcon/extcon-usbc-tusb320.yaml
```yaml
# SPDX-License-Identifier: (GPL-2.0-only OR BSD-2-Clause)
%YAML 1.2
---
$id: http://devicetree.org/schemas/extcon/extcon-usbc-tusb320.yaml#
$schema: http://devicetree.org/meta-schemas/core.yaml#

title: TI TUSB320 USB Type-C CC Logic controller

maintainers:
  - Michael Auchter <michael.auchter@ni.com>

properties:
  compatible:
    enum:
      - ti,tusb320
      - ti,tusb320l

  reg:
    maxItems: 1

  interrupts:
    maxItems: 1

required:
  - compatible
  - reg
  - interrupts

additionalProperties: false

examples:
  - |
    i2c0 {
        #address-cells = <1>;
        #size-cells = <0>;
        tusb320@61 {
            compatible = "ti,tusb320";
            reg = <0x61>;
            interrupt-parent = <&gpio>;
            interrupts = <27 1>;
        };
    };
...
```

## Documentation/devicetree/bindings/extcon/fcs,fsa880.yaml
```yaml
# SPDX-License-Identifier: (GPL-2.0-only OR BSD-2-Clause)
%YAML 1.2
---
$id: http://devicetree.org/schemas/extcon/fcs,fsa880.yaml#
$schema: http://devicetree.org/meta-schemas/core.yaml#

title: Fairchild Semiconductor FSA880, FSA9480 and compatibles

maintainers:
  - Linus Walleij <linus.walleij@linaro.org>

description:
  The FSA880 and FSA9480 are USB port accessory detectors and switches.
  The switch is fully controlled using I2C and enables USB data, stereo
  and mono audio, video, microphone, and UART data to use a common
  connector port. Compatible switches exist from other manufacturers.

properties:
  compatible:
    enum:
      - fcs,fsa880
      - fcs,fsa9480
      - ti,tsu6111

  reg:
    maxItems: 1
    description: The I2C address for an FSA880 compatible device is
      usually 0x25.

  interrupts:
    maxItems: 1

required:
  - compatible
  - reg
  - interrupts

additionalProperties: false

examples:
  - |
    #include <dt-bindings/interrupt-controller/irq.h>
    i2c {
        #address-cells = <1>;
        #size-cells = <0>;
        usb-switch@25 {
            compatible = "fcs,fsa880";
            reg = <0x25>;
            interrupt-parent = <&gpio>;
            interrupts = <1 IRQ_TYPE_EDGE_FALLING>;
        };
    };
```

## Documentation/devicetree/bindings/extcon/linux,extcon-usb-gpio.yaml
```yaml
# SPDX-License-Identifier: (GPL-2.0-only OR BSD-2-Clause)
%YAML 1.2
---
$id: http://devicetree.org/schemas/extcon/linux,extcon-usb-gpio.yaml#
$schema: http://devicetree.org/meta-schemas/core.yaml#

title: USB GPIO Extcon device

maintainers:
  - Frank Li <Frank.Li@nxp.com>

description:
  This is a virtual device used to generate USB cable states from the USB ID pin
  connected to a GPIO pin.

properties:
  compatible:
    const: linux,extcon-usb-gpio

  id-gpios:
    description: gpio for USB ID pin. See gpio binding.
  vbus-gpios:
    description: gpio for USB VBUS pin.

required:
  - compatible

additionalProperties: false

examples:
  - |
    #include <dt-bindings/gpio/gpio.h>

    extcon_usb1 {
        compatible = "linux,extcon-usb-gpio";
        id-gpios = <&gpio6 1 GPIO_ACTIVE_HIGH>;
    };
```
