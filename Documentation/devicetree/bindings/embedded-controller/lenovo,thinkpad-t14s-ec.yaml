## Documentation/devicetree/bindings/extcon/maxim,max14526.yaml
```yaml
# SPDX-License-Identifier: (GPL-2.0-only OR BSD-2-Clause)
%YAML 1.2
---
$id: http://devicetree.org/schemas/extcon/maxim,max14526.yaml#
$schema: http://devicetree.org/meta-schemas/core.yaml#

title: Maxim MAX14526 MicroUSB Integrated Circuit (MUIC)

maintainers:
  - Svyatoslav Ryhel <clamor95@gmail.com>

properties:
  compatible:
    const: maxim,max14526

  reg:
    maxItems: 1

  interrupts:
    maxItems: 1

  connector:
    $ref: /schemas/connector/usb-connector.yaml#

  port:
    $ref: /schemas/graph.yaml#/properties/port

required:
  - compatible
  - reg
  - interrupts
  - connector
  - port

unevaluatedProperties: false

examples:
  - |
    #include <dt-bindings/gpio/gpio.h>
    #include <dt-bindings/interrupt-controller/irq.h>

    i2c {
        #address-cells = <1>;
        #size-cells = <0>;

        muic@44 {
            compatible = "maxim,max14526";
            reg = <0x44>;

            interrupt-parent = <&gpio>;
            interrupts = <72 IRQ_TYPE_EDGE_FALLING>;

            connector {
                compatible = "usb-b-connector";
                label = "micro-USB";
                type = "micro";
            };

            port {
                #address-cells = <1>;
                #size-cells = <0>;

                muic_to_charger: endpoint@0 {
                    reg = <0>;
                    remote-endpoint = <&charger_input>;
                };

                muic_to_usb: endpoint@1 {
                    reg = <1>;
                    remote-endpoint = <&usb_input>;
                };

                muic_to_mhl: endpoint@2 {
                    reg = <2>;
                    remote-endpoint = <&mhl_input>;
                };
            };
        };
    };
...
```

## Documentation/devicetree/bindings/extcon/maxim,max77843.yaml
```yaml
# SPDX-License-Identifier: GPL-2.0-only OR BSD-2-Clause
%YAML 1.2
---
$id: http://devicetree.org/schemas/extcon/maxim,max77843.yaml#
$schema: http://devicetree.org/meta-schemas/core.yaml#

title: Maxim MAX77843 MicroUSB and Companion Power Management IC Extcon

maintainers:
  - Chanwoo Choi <cw00.choi@samsung.com>
  - Krzysztof Kozlowski <krzk@kernel.org>

description: |
  This is a part of device tree bindings for Maxim MAX77843 MicroUSB
  Integrated Circuit (MUIC).

  See also Documentation/devicetree/bindings/mfd/maxim,max77843.yaml for
  additional information and example.

properties:
  compatible:
    const: maxim,max77843-muic

  connector:
    $ref: /schemas/connector/usb-connector.yaml#

  ports:
    $ref: /schemas/graph.yaml#/properties/ports
    description:
      Any connector to the data bus of this controller should be modelled using
      the OF graph bindings specified
    properties:
      port:
        $ref: /schemas/graph.yaml#/properties/port

required:
  - compatible
  - connector

additionalProperties: false
```

## Documentation/devicetree/bindings/extcon/qcom,pm8941-misc.txt
```
Qualcomm's PM8941 USB ID Extcon device

Some Qualcomm PMICs have a "misc" module that can be used to detect when
the USB ID pin has been pulled low or high.

PROPERTIES

- compatible:
    Usage: required
    Value type: <string>
    Definition: Should contain "qcom,pm8941-misc";

- reg:
    Usage: required
    Value type: <u32>
    Definition: Should contain the offset to the misc address space

- interrupts:
    Usage: required
    Value type: <prop-encoded-array>
    Definition: Should contain the usb id interrupt

- interrupt-names:
    Usage: required
    Value type: <stringlist>
    Definition: Should contain the string "usb_id" for the usb id interrupt

Example:

	pmic {
		usb_id: misc@900 {
			compatible = "qcom,pm8941-misc";
			reg = <0x900>;
			interrupts = <0x0 0x9 0 IRQ_TYPE_EDGE_BOTH>;
			interrupt-names = "usb_id";
		};
	}

	usb-controller {
		extcon = <&usb_id>;
	};
```

## Documentation/devicetree/bindings/extcon/qcom,pm8941-misc.yaml
```yaml
# SPDX-License-Identifier: (GPL-2.0-only OR BSD-2-Clause)
%YAML 1.2
---
$id: http://devicetree.org/schemas/extcon/qcom,pm8941-misc.yaml#
$schema: http://devicetree.org/meta-schemas/core.yaml#

title: Qualcomm Technologies, Inc. PM8941 USB ID Extcon device

maintainers:
  - Guru Das Srinagesh <quic_gurus@quicinc.com>

description: |
  Some Qualcomm PMICs have a "misc" module that can be used to detect when
  the USB ID pin has been pulled low or high.

properties:
  compatible:
    items:
      - const: qcom,pm8941-misc

  reg:
    maxItems: 1

  interrupts:
    minItems: 1
    maxItems: 2

  interrupt-names:
    minItems: 1
    anyOf:
      - items:
          - const: usb_id
          - const: usb_vbus
      - items:
          - const: usb_id
      - items:
          - const: usb_vbus
required:
  - compatible
  - reg
  - interrupts
  - interrupt-names

additionalProperties: false

examples:
  - |
    #include <dt-bindings/interrupt-controller/irq.h>

    pmic {
            #address-cells = <1>;
            #size-cells = <0>;
            interrupt-controller;
            #interrupt-cells = <4>;

            usb_id: usb-detect@900 {
                    compatible = "qcom,pm8941-misc";
                    reg = <0x900>;
                    interrupts = <0x0 0x9 0 IRQ_TYPE_EDGE_BOTH>;
                    interrupt-names = "usb_id";
            };
    };

    usb-controller {
           extcon = <&usb_id>;
    };
```
