## Documentation/devicetree/bindings/extcon/richtek,rt8973a-muic.yaml
```yaml
# SPDX-License-Identifier: GPL-2.0-only OR BSD-2-Clause
%YAML 1.2
---
$id: http://devicetree.org/schemas/extcon/richtek,rt8973a-muic.yaml#
$schema: http://devicetree.org/meta-schemas/core.yaml#

title: Richtek RT8973A MUIC

maintainers:
  - Chanwoo Choi <cw00.choi@samsung.com>

description:
  The Richtek RT8973A is Micro USB Switch with OVP and I2C interface. The RT8973A
  is a USB port accessory detector and switch that is optimized to protect low
  voltage system from abnormal high input voltage (up to 28V) and supports high
  speed USB operation. Also, RT8973A support 'auto-configuration' mode.
  If auto-configuration mode is enabled, RT8973A would control internal h/w patch
  for USB D-/D+ switching.

properties:
  compatible:
    const: richtek,rt8973a-muic

  reg:
    maxItems: 1

  interrupts:
    maxItems: 1

required:
  - compatible
  - reg
  - interrupts

additionalProperties: false

examples:
  - |
    #include <dt-bindings/interrupt-controller/irq.h>
    i2c {
        #address-cells = <1>;
        #size-cells = <0>;
        usb-switch@14 {
          compatible = "richtek,rt8973a-muic";
          reg = <0x14>;
          interrupt-parent = <&gpio>;
          interrupts = <1 IRQ_TYPE_EDGE_FALLING>;
        };
    };
```

## Documentation/devicetree/bindings/extcon/samsung,s2mu005-muic.yaml
```yaml
# SPDX-License-Identifier: (GPL-2.0-only OR BSD-2-Clause)
%YAML 1.2
---
$id: http://devicetree.org/schemas/extcon/samsung,s2mu005-muic.yaml#
$schema: http://devicetree.org/meta-schemas/core.yaml#

title: MUIC Device for Samsung S2M series PMICs

maintainers:
  - Kaustabh Chakraborty <kauschluss@disroot.org>

description: |
  The Samsung S2M series PMIC MUIC device is a USB port accessory
  detector. It reports multiple states depending on the ID-GND
  resistance measured by an internal ADC.

  This is a part of device tree bindings for S2M and S5M family of Power
  Management IC (PMIC).

  See also Documentation/devicetree/bindings/mfd/samsung,s2mps11.yaml for
  additional information and example.

properties:
  compatible:
    enum:
      - samsung,s2mu005-muic

  connector:
    $ref: /schemas/connector/usb-connector.yaml#

  port:
    $ref: /schemas/graph.yaml#/properties/port
    description: Port connecting to the USB controller or PHY.

required:
  - compatible
  - connector
  - port

additionalProperties: false
```

## Documentation/devicetree/bindings/extcon/siliconmitus,sm5502-muic.yaml
```yaml
# SPDX-License-Identifier: (GPL-2.0-only OR BSD-2-Clause)
%YAML 1.2
---
$id: http://devicetree.org/schemas/extcon/siliconmitus,sm5502-muic.yaml#
$schema: http://devicetree.org/meta-schemas/core.yaml#

title: SM5502/SM5504 MUIC (Micro-USB Interface Controller) device

maintainers:
  - Chanwoo Choi <cw00.choi@samsung.com>

description:
  The Silicon Mitus SM5502 is a MUIC (Micro-USB Interface Controller) device
  which can detect the state of external accessory when external accessory is
  attached or detached and button is pressed or released. It is interfaced to
  the host controller using an I2C interface.

properties:
  compatible:
    enum:
      - siliconmitus,sm5502-muic
      - siliconmitus,sm5504-muic

  reg:
    maxItems: 1
    description: I2C slave address of the device. Usually 0x25 for SM5502,
      0x14 for SM5504.

  interrupts:
    maxItems: 1

required:
  - compatible
  - reg
  - interrupts

additionalProperties: false

examples:
  - |
    #include <dt-bindings/interrupt-controller/irq.h>
    i2c {
        #address-cells = <1>;
        #size-cells = <0>;

        extcon@25 {
                compatible = "siliconmitus,sm5502-muic";
                reg = <0x25>;
                interrupt-parent = <&msmgpio>;
                interrupts = <12 IRQ_TYPE_EDGE_FALLING>;
        };
    };
```

## Documentation/devicetree/bindings/extcon/wlf,arizona.yaml
```yaml
# SPDX-License-Identifier: GPL-2.0-only OR BSD-2-Clause
%YAML 1.2
---
$id: http://devicetree.org/schemas/extcon/wlf,arizona.yaml#
$schema: http://devicetree.org/meta-schemas/core.yaml#

title: Cirrus Logic/Wolfson Microelectronics Arizona class audio SoCs

maintainers:
  - patches@opensource.cirrus.com

description: |
  These devices are audio SoCs with extensive digital capabilities and a
  range of analogue I/O.

  This document lists Extcon specific bindings, see the primary binding
  document ../mfd/arizona.yaml

properties:
  wlf,hpdet-channel:
    description:
      Headphone detection channel.  ARIZONA_ACCDET_MODE_HPL/1 sets the
      headphone detect mode to HPDETL, ARIZONA_ACCDET_MODE_HPR/2 sets it
      to HPDETR.  If this node is not included or if the value is unknown,
      then headphone detection mode is set to HPDETL.
    $ref: "/schemas/types.yaml#/definitions/uint32"
    minimum: 1
    maximum: 2

  wlf,use-jd2:
    description:
      Use the additional JD input along with JD1 for dual pin jack detection.
    type: boolean

  wlf,use-jd2-nopull:
    description:
      Internal pull on JD2 is disabled when used for jack detection.
    type: boolean

  wlf,jd-invert:
    description:
      Invert the polarity of the jack detection switch.
    type: boolean

  wlf,micd-software-compare:
    description:
      Use a software comparison to determine mic presence.
    type: boolean

  wlf,micd-detect-debounce:
    description:
      Additional software microphone detection debounce specified in
      milliseconds.
    $ref: "/schemas/types.yaml#/definitions/uint32"

  wlf,micd-pol-gpio:
    description:
      GPIO specifier for the GPIO controlling the headset polarity if one
      exists.
    maxItems: 1

  wlf,micd-bias-start-time:
    description:
      Time allowed for MICBIAS to startup prior to performing microphone
      detection, specified as per the ARIZONA_MICD_TIME_XXX defines.
    $ref: "/schemas/types.yaml#/definitions/uint32"
    minimum: 0
    maximum: 12

  wlf,micd-rate:
    description:
      Delay between successive microphone detection measurements, specified
      as per the ARIZONA_MICD_TIME_XXX defines.
    $ref: "/schemas/types.yaml#/definitions/uint32"
    minimum: 0
    maximum: 12

  wlf,micd-dbtime:
    description:
      Microphone detection hardware debounces specified as the number of
      measurements to take.
    $ref: "/schemas/types.yaml#/definitions/uint32"
    enum: [2, 4]

  wlf,micd-timeout-ms:
    description:
      Timeout for microphone detection, specified in milliseconds.

  wlf,micd-force-micbias:
    description:
      Force MICBIAS continuously on during microphone detection.
    type: boolean

  wlf,micd-configs:
    description:
      Headset polarity configurations (generally used for detection of
      CTIA / OMTP headsets), the field can be of variable length but
      should always be a multiple of 3 cells long, each three cell group
      represents one polarity configuration.
    $ref: "/schemas/types.yaml#/definitions/uint32-matrix"
    items:
      items:
        - description:
            The first cell defines the accessory detection pin, zero
            will use MICDET1 and 0x2000 will use MICDET2.
          enum: [ 0, 0x2000 ]
        - description:
            The second cell represents the MICBIAS to be used. Zero
            will use MICVDD, 1-3 will use MICBIASx.
          minimum: 0
          maximum: 3
        - description:
            The third cell represents the value of the micd-pol-gpio
            pin.
          minimum: 0
          maximum: 1

  wlf,gpsw:
    description:
      Settings for the general purpose switch, set as one of the
      ARIZONA_GPSW_XXX defines.
    $ref: "/schemas/types.yaml#/definitions/uint32"
    minimum: 0
    maximum: 3

additionalProperties: true
```

## Documentation/devicetree/bindings/fb/fsl_ipuv3_fb.txt
```
* FSL IPUv3 Display/FB

The FSL IPUv3 is Image Processing Unit version 3, a part of video and graphics
subsystem in an application processor. The goal of the IPU is to provide
comprehensive support for the flow of data from an image sensor or/and to a
display device.

Two IPU units are on the imx6q SOC while only one IPU unit on the imx6dl SOC.
Each IPU unit has two display interfaces.

Required properties for IPU:
- bypass_reset :Bypass reset to avoid display channel being.
  stopped by probe since it may start to work in bootloader: 0 or 1.
- compatible : should be "fsl,imx6q-ipu".
- reg : the register address range.
- interrupts : the error and sync interrupts request.
- clocks : the clock sources that it depends on.
- clock-names:  the related clock names.
- resets : IPU reset specifier.  See reset.txt and fsl,imx-src.txt in
  Documentation/devicetree/bindings/reset/ for details.

Required properties for fb:
- compatible : should be "fsl,mxc_sdc_fb".
- disp_dev : display device: "ldb", "lcd", "hdmi", "mipi_dsi".
- mode_str : "CLAA-WVGA" for lcd, "TRULY-WVGA" for TRULY mipi_dsi lcd panel,
  "1920x1080M@60" for hdmi.
- default_bpp : default bits per pixel: 8/16/24/32
- int_clk : use internal clock as pixel clock: 0 or 1
- late_init : to avoid display channel being re-initialized
  as we've probably setup the channel in bootloader: 0 or 1
- interface_pix_fmt : display interface pixel format as below:
	RGB666		IPU_PIX_FMT_RGB666
	RGB565		IPU_PIX_FMT_RGB565
	RGB24		IPU_PIX_FMT_RGB24
	BGR24		IPU_PIX_FMT_BGR24
	GBR24		IPU_PIX_FMT_GBR24
	YUV444		IPU_PIX_FMT_YUV444
	YUYV		IPU_PIX_FMT_YUYV
	UYVY		IPU_PIX_FMT_UYVY
	YVYV		IPU_PIX_FMT_YVYU
	VYUY		IPU_PIX_FMT_VYUY

Required properties for display:
- compatible : should be "fsl,lcd" for lcd panel
- reg : the register address range if necessary to have.
- interrupts : the error and sync interrupts if necessary to have.
- clocks : the clock sources that it depends on if necessary to have.
- clock-names: the related clock names if necessary to have.
- ipu_id : ipu id for the first display device: 0 or 1
- disp_id : display interface id for the first display interface: 0 or 1
- default_ifmt : save as above display interface pixel format for lcd
- pinctrl-names : should be "default"
- pinctrl-0 : should be pinctrl_ipu1_1 or pinctrl_ipu2_1, which depends on the
  IPU connected.
- gpr : the mux controller for the display engine's display interfaces and the display encoder
	(only valid for mipi dsi now).
- disp-power-on-supply : the regulator to control display panel's power.
			(only valid for mipi dsi now).
- resets : the gpio pin to reset the display device(only valid for mipi display panel now).
- lcd_panel : the video mode name for the display device(only valid for mipi display panel now).
- dev_id : the display engine's identity within the system, which intends to replace ipu_id
	   (only valid for mipi dsi now).

Example for IPU:
		ipu1: ipu@02400000 {
			compatible = "fsl,imx6q-ipu";
			reg = <0x02400000 0x400000>;
			interrupts = <0 6 0x4 0 5 0x4>;
			clocks = <&clks 130>, <&clks 131>, <&clks 132>,
				 <&clks 39>, <&clks 40>,
				 <&clks 135>, <&clks 136>;
			clock-names = "bus", "di0", "di1",
				      "di0_sel", "di1_sel",
				      "ldb_di0", "ldb_di1";
			resets = <&src 2>;
			bypass_reset = <0>;
		};

Example for fb:
		fb0 {
			compatible = "fsl,mxc_sdc_fb";
			disp_dev = "ldb";
			interface_pix_fmt = "RGB666";
			mode_str ="LDB-XGA";
			default_bpp = <16>;
			int_clk = <0>;
			late_init = <0>;
			status = "okay";
		};

Example for mipi dsi display:
		mipi_dsi: mipi@021e0000 {
			compatible = "fsl,imx6q-mipi-dsi";
			reg = <0x021e0000 0x4000>;
			interrupts = <0 102 0x04>;
			gpr = <&gpr>;
			clocks = <&clks 138>, <&clks 204>;
			clock-names = "mipi_pllref_clk", "mipi_cfg_clk";
			dev_id = <0>;
			disp_id = <0>;
			lcd_panel = "TRULY-WVGA";
			disp-power-on-supply = <&reg_mipi_dsi_pwr_on>
			resets = <&mipi_dsi_reset>;
			status = "okay";
		};
```

## Documentation/devicetree/bindings/fb/mxsfb.txt
```
* Freescale MXS LCD Interface (LCDIF)

Required properties:
- compatible: Should be "fsl,<chip>-lcdif".  Supported chips include
  imx23 and imx28.
- reg: Address and length of the register set for lcdif
- interrupts: Should contain lcdif interrupts
- display : phandle to display node (see below for details)

* display node

Required properties:
- bits-per-pixel : <16> for RGB565, <32> for RGB888/666.
- bus-width : number of data lines.  Could be <8>, <16>, <18> or <24>.

Required sub-node:
- display-timings : Refer to binding doc display-timing.txt for details.

Examples:

lcdif@80030000 {
	compatible = "fsl,imx28-lcdif";
	reg = <0x80030000 2000>;
	interrupts = <38 86>;

	display: display {
		bits-per-pixel = <32>;
		bus-width = <24>;

		display-timings {
			native-mode = <&timing0>;
			timing0: timing0 {
				clock-frequency = <33500000>;
				hactive = <800>;
				vactive = <480>;
				hfront-porch = <164>;
				hback-porch = <89>;
				hsync-len = <10>;
				vback-porch = <23>;
				vfront-porch = <10>;
				vsync-len = <10>;
				hsync-active = <0>;
				vsync-active = <0>;
				de-active = <1>;
				pixelclk-active = <0>;
			};
		};
	};
};
```

## Documentation/devicetree/bindings/fb/sm501fb.txt
```
* SM SM501

The SM SM501 is a LCD controller, with proper hardware, it can also
drive DVI monitors.

Required properties:
- compatible : should be "smi,sm501".
- reg : contain two entries:
    - First entry: System Configuration register
    - Second entry: IO space (Display Controller register)
- interrupts : SMI interrupt to the cpu should be described here.
- interrupt-parent : the phandle for the interrupt controller that
  services interrupts for this device.

Optional properties:
- mode : select a video mode:
    <xres>x<yres>[-<bpp>][@<refresh>]
- edid : verbatim EDID data block describing attached display.
  Data from the detailed timing descriptor will be used to
  program the display controller.
- little-endian: available on big endian systems, to
  set different foreign endian.
- big-endian: available on little endian systems, to
  set different foreign endian.

Example for MPC5200:
	display@1,0 {
		compatible = "smi,sm501";
		reg = <1 0x00000000 0x00800000
		       1 0x03e00000 0x00200000>;
		interrupts = <1 1 3>;
		mode = "640x480-32@60";
		edid = [edid-data];
	};
```

## Documentation/devicetree/bindings/firmware/amlogic,meson-gxbb-sm.yaml
```yaml
# SPDX-License-Identifier: (GPL-2.0-only OR BSD-2-Clause)
%YAML 1.2
---
$id: http://devicetree.org/schemas/firmware/amlogic,meson-gxbb-sm.yaml#
$schema: http://devicetree.org/meta-schemas/core.yaml#

title: Amlogic Secure Monitor (SM)

description:
  In the Amlogic SoCs the Secure Monitor code is used to provide access to the
  NVMEM, enable JTAG, set USB boot, etc...

maintainers:
  - Neil Armstrong <neil.armstrong@linaro.org>

properties:
  compatible:
    oneOf:
      - const: amlogic,meson-gxbb-sm
      - items:
          - const: amlogic,meson-gx-sm
          - const: amlogic,meson-gxbb-sm

  power-controller:
    type: object
    $ref: /schemas/power/amlogic,meson-sec-pwrc.yaml#

required:
  - compatible

additionalProperties: false

examples:
  - |
    firmware {
        secure-monitor {
            compatible = "amlogic,meson-gxbb-sm";
        };
    };
```
