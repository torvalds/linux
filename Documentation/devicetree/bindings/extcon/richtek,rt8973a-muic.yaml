## Documentation/devicetree/bindings/firmware/intel,ixp4xx-network-processing-engine.yaml
```yaml
# SPDX-License-Identifier: (GPL-2.0 OR BSD-2-Clause)
# Copyright 2019 Linaro Ltd.
%YAML 1.2
---
$id: http://devicetree.org/schemas/firmware/intel,ixp4xx-network-processing-engine.yaml#
$schema: http://devicetree.org/meta-schemas/core.yaml#

title: Intel IXP4xx Network Processing Engine

maintainers:
  - Linus Walleij <linus.walleij@linaro.org>

description: |
  On the IXP4xx SoCs, the Network Processing Engine (NPE) is a small
  processor that can load a firmware to perform offloading of networking
  and crypto tasks. It also manages the MDIO bus to the ethernet PHYs
  on the IXP4xx platform. All IXP4xx platforms have three NPEs at
  consecutive memory locations. They are all included in the same
  device node since they are not independent of each other.

properties:
  compatible:
    oneOf:
      - items:
          - const: intel,ixp4xx-network-processing-engine

  reg:
    items:
      - description: NPE0 (NPE-A) register range
      - description: NPE1 (NPE-B) register range
      - description: NPE2 (NPE-C) register range

  crypto:
    $ref: /schemas/crypto/intel,ixp4xx-crypto.yaml#
    type: object
    description: Optional node for the embedded crypto engine, the node
      should be named with the instance number of the NPE engine used for
      the crypto engine.

  "#address-cells":
    const: 1

  "#size-cells":
    const: 0

patternProperties:
  hss@[0-9]+$:
    $ref: /schemas/net/intel,ixp4xx-hss.yaml#
    type: object
    description: Optional node for the High Speed Serial link (HSS), the
      node should be named with the instance number of the NPE engine
      used for the HSS.

required:
  - compatible
  - reg

additionalProperties: false

examples:
  - |
    #include <dt-bindings/gpio/gpio.h>

    npe: npe@c8006000 {
         compatible = "intel,ixp4xx-network-processing-engine";
         reg = <0xc8006000 0x1000>, <0xc8007000 0x1000>, <0xc8008000 0x1000>;
         #address-cells = <1>;
         #size-cells = <0>;

         hss@0 {
             compatible = "intel,ixp4xx-hss";
             reg = <0>;
             intel,npe-handle = <&npe 0>;
             intel,queue-chl-rxtrig = <&qmgr 12>;
             intel,queue-chl-txready = <&qmgr 34>;
             intel,queue-pkt-rx = <&qmgr 13>;
             intel,queue-pkt-tx = <&qmgr 14>, <&qmgr 15>, <&qmgr 16>, <&qmgr 17>;
             intel,queue-pkt-rxfree = <&qmgr 18>, <&qmgr 19>, <&qmgr 20>, <&qmgr 21>;
             intel,queue-pkt-txdone = <&qmgr 22>;
             cts-gpios = <&gpio0 10 GPIO_ACTIVE_LOW>;
             rts-gpios = <&gpio0 14 GPIO_ACTIVE_LOW>;
             dcd-gpios = <&gpio0 6 GPIO_ACTIVE_LOW>;
             dtr-gpios = <&gpio_74 2 GPIO_ACTIVE_LOW>;
             clk-internal-gpios = <&gpio_74 0 GPIO_ACTIVE_HIGH>;
         };

         crypto {
             compatible = "intel,ixp4xx-crypto";
             intel,npe-handle = <&npe 2>;
             queue-rx = <&qmgr 30>;
             queue-txready = <&qmgr 29>;
         };
    };
...
```

## Documentation/devicetree/bindings/firmware/intel,stratix10-svc.txt
```
Intel Service Layer Driver for Stratix10 SoC
============================================
Intel Stratix10 SoC is composed of a 64 bit quad-core ARM Cortex A53 hard
processor system (HPS) and Secure Device Manager (SDM). When the FPGA is
configured from HPS, there needs to be a way for HPS to notify SDM the
location and size of the configuration data. Then SDM will get the
configuration data from that location and perform the FPGA configuration.

To meet the whole system security needs and support virtual machine requesting
communication with SDM, only the secure world of software (EL3, Exception
Layer 3) can interface with SDM. All software entities running on other
exception layers must channel through the EL3 software whenever it needs
service from SDM.

Intel Stratix10 service layer driver, running at privileged exception level
(EL1, Exception Layer 1), interfaces with the service providers and provides
the services for FPGA configuration, QSPI, Crypto and warm reset. Service layer
driver also manages secure monitor call (SMC) to communicate with secure monitor
code running in EL3.

Required properties:
-------------------
The svc node has the following mandatory properties, must be located under
the firmware node.

- compatible: "intel,stratix10-svc" or "intel,agilex-svc"
- method: smc or hvc
        smc - Secure Monitor Call
        hvc - Hypervisor Call
- memory-region:
	phandle to the reserved memory node. See
	Documentation/devicetree/bindings/reserved-memory/reserved-memory.txt
	for details

Example:
-------

	reserved-memory {
                #address-cells = <2>;
                #size-cells = <2>;
                ranges;

                service_reserved: svcbuffer@0 {
                        compatible = "shared-dma-pool";
                        reg = <0x0 0x0 0x0 0x1000000>;
                        alignment = <0x1000>;
                        no-map;
                };
        };

	firmware {
		svc {
			compatible = "intel,stratix10-svc";
			method = "smc";
			memory-region = <&service_reserved>;
		};
	};
```

## Documentation/devicetree/bindings/firmware/intel,stratix10-svc.yaml
```yaml
# SPDX-License-Identifier: (GPL-2.0-only OR BSD-2-Clause)
%YAML 1.2
---
$id: http://devicetree.org/schemas/firmware/intel,stratix10-svc.yaml#
$schema: http://devicetree.org/meta-schemas/core.yaml#

title: Intel Service Layer Driver for Stratix10 SoC

maintainers:
  - Dinh Nguyen <dinguyen@kernel.org>
  - Mahesh Rao <mahesh.rao@altera.com>

description: >
  Intel Stratix10 SoC is composed of a 64 bit quad-core ARM Cortex A53 hard
  processor system (HPS) and Secure Device Manager (SDM). When the FPGA is
  configured from HPS, there needs to be a way for HPS to notify SDM the
  location and size of the configuration data. Then SDM will get the
  configuration data from that location and perform the FPGA configuration.

  To meet the whole system security needs and support virtual machine requesting
  communication with SDM, only the secure world of software (EL3, Exception
  Layer 3) can interface with SDM. All software entities running on other
  exception layers must channel through the EL3 software whenever it needs
  service from SDM.

  Intel Stratix10 service layer driver, running at privileged exception level
  (EL1, Exception Layer 1), interfaces with the service providers and provides
  the services for FPGA configuration, QSPI, Crypto and warm reset. Service layer
  driver also manages secure monitor call (SMC) to communicate with secure monitor
  code running in EL3.

properties:
  compatible:
    enum:
      - intel,stratix10-svc
      - intel,agilex-svc

  method:
    description: |
      Supervisory call method to be used to communicate with the
      secure service layer.
      Permitted values are:
      - "smc" : SMC #0, following the SMCCC
      - "hvc" : HVC #0, following the SMCCC

    $ref: /schemas/types.yaml#/definitions/string-array
    enum:
      - smc
      - hvc

  memory-region:
    maxItems: 1
    description:
      reserved memory region for the service layer driver to
      communicate with the secure device manager.

  fpga-mgr:
    $ref: /schemas/fpga/intel,stratix10-soc-fpga-mgr.yaml
    description: Optional child node for fpga manager to perform fabric configuration.

required:
  - compatible
  - method
  - memory-region

additionalProperties: false

examples:
  - |
    reserved-memory {
      #address-cells = <2>;
      #size-cells = <2>;

      service_reserved: svcbuffer@0 {
              compatible = "shared-dma-pool";
              reg = <0x0 0x0 0x0 0x1000000>;
              alignment = <0x1000>;
              no-map;
      };
    };

    firmware {
      svc {
        compatible = "intel,stratix10-svc";
        method = "smc";
        memory-region = <&service_reserved>;

        fpga-mgr {
          compatible = "intel,stratix10-soc-fpga-mgr";
        };
      };
    };
```

## Documentation/devicetree/bindings/firmware/meson/meson_sm.txt
```
* Amlogic Secure Monitor

In the Amlogic SoCs the Secure Monitor code is used to provide access to the
NVMEM, enable JTAG, set USB boot, etc...

Required properties for the secure monitor node:
- compatible: Should be "amlogic,meson-gxbb-sm"

Example:

	firmware {
		sm: secure-monitor {
			compatible = "amlogic,meson-gxbb-sm";
		};
	};
```

## Documentation/devicetree/bindings/firmware/nvidia,tegra186-bpmp.txt
```
NVIDIA Tegra Boot and Power Management Processor (BPMP)

The BPMP is a specific processor in Tegra chip, which is designed for
booting process handling and offloading the power management, clock
management, and reset control tasks from the CPU. The binding document
defines the resources that would be used by the BPMP firmware driver,
which can create the interprocessor communication (IPC) between the CPU
and BPMP.

Required properties:
- name : Should be bpmp
- compatible
    Array of strings
    One of:
    - "nvidia,tegra186-bpmp"
- mboxes : The phandle of mailbox controller and the mailbox specifier.
- shmem : List of the phandle of the TX and RX shared memory area that
	  the IPC between CPU and BPMP is based on.
- #clock-cells : Should be 1.
- #power-domain-cells : Should be 1.
- #reset-cells : Should be 1.

This node is a mailbox consumer. See the following files for details of
the mailbox subsystem, and the specifiers implemented by the relevant
provider(s):

- .../mailbox/mailbox.txt
- .../mailbox/nvidia,tegra186-hsp.txt

This node is a clock, power domain, and reset provider. See the following
files for general documentation of those features, and the specifiers
implemented by this node:

- .../clock/clock-bindings.txt
- <dt-bindings/clock/tegra186-clock.h>
- ../power/power_domain.txt
- <dt-bindings/power/tegra186-powergate.h>
- .../reset/reset.txt
- <dt-bindings/reset/tegra186-reset.h>

The BPMP implements some services which must be represented by separate nodes.
For example, it can provide access to certain I2C controllers, and the I2C
bindings represent each I2C controller as a device tree node. Such nodes should
be nested directly inside the main BPMP node.

Software can determine whether a child node of the BPMP node represents a device
by checking for a compatible property. Any node with a compatible property
represents a device that can be instantiated. Nodes without a compatible
property may be used to provide configuration information regarding the BPMP
itself, although no such configuration nodes are currently defined by this
binding.

The BPMP firmware defines no single global name-/numbering-space for such
services. Put another way, the numbering scheme for I2C buses is distinct from
the numbering scheme for any other service the BPMP may provide (e.g. a future
hypothetical SPI bus service). As such, child device nodes will have no reg
property, and the BPMP node will have no #address-cells or #size-cells property.

The shared memory bindings for BPMP
-----------------------------------

The shared memory area for the IPC TX and RX between CPU and BPMP are
predefined and work on top of sysram, which is an SRAM inside the chip.

See ".../sram/sram.txt" for the bindings.

Example:

hsp_top0: hsp@03c00000 {
	...
	#mbox-cells = <2>;
};

sysram@30000000 {
	compatible = "nvidia,tegra186-sysram", "mmio-sram";
	reg = <0x0 0x30000000 0x0 0x50000>;
	#address-cells = <2>;
	#size-cells = <2>;
	ranges = <0 0x0 0x0 0x30000000 0x0 0x50000>;

	cpu_bpmp_tx: shmem@4e000 {
		compatible = "nvidia,tegra186-bpmp-shmem";
		reg = <0x0 0x4e000 0x0 0x1000>;
		label = "cpu-bpmp-tx";
		pool;
	};

	cpu_bpmp_rx: shmem@4f000 {
		compatible = "nvidia,tegra186-bpmp-shmem";
		reg = <0x0 0x4f000 0x0 0x1000>;
		label = "cpu-bpmp-rx";
		pool;
	};
};

bpmp {
	compatible = "nvidia,tegra186-bpmp";
	mboxes = <&hsp_top0 TEGRA_HSP_MBOX_TYPE_DB TEGRA_HSP_DB_MASTER_BPMP>;
	shmem = <&cpu_bpmp_tx &cpu_bpmp_rx>;
	#clock-cells = <1>;
	#power-domain-cells = <1>;
	#reset-cells = <1>;

	i2c {
		compatible = "...";
		...
	};
};
```
