## Documentation/devicetree/bindings/firmware/arm,scpi.yaml
```yaml
# SPDX-License-Identifier: (GPL-2.0 OR BSD-2-Clause)
# Copyright 2021 ARM Ltd.
%YAML 1.2
---
$id: http://devicetree.org/schemas/firmware/arm,scpi.yaml#
$schema: http://devicetree.org/meta-schemas/core.yaml#

title: System Control and Power Interface (SCPI) Message Protocol bindings

maintainers:
  - Sudeep Holla <sudeep.holla@arm.com>

description: |
  Firmware implementing the SCPI described in ARM document number ARM DUI
  0922B ("ARM Compute Subsystem SCP: Message Interface Protocols")[0] can be
  used by Linux to initiate various system control and power operations.

  This binding is intended to define the interface the firmware implementing
  the SCPI provide for OSPM in the device tree.

  [0] http://infocenter.arm.com/help/topic/com.arm.doc.dui0922b/index.html

properties:
  $nodename:
    const: scpi

  compatible:
    description:
      SCPI compliant firmware complying to SCPI v1.0 and above OR
      SCPI compliant firmware complying to all unversioned releases
      prior to SCPI v1.0
    oneOf:
      - const: arm,scpi               # SCPI v1.0 and above
      - const: arm,scpi-pre-1.0       # Unversioned SCPI before v1.0
      - items:
          - enum:
              - amlogic,meson-gxbb-scpi
          - const: arm,scpi-pre-1.0

  mboxes:
    description:
      List of phandle and mailbox channel specifiers. All the channels reserved
      by remote SCP firmware for use by SCPI message protocol should be
      specified in any order.
    minItems: 1

  shmem:
    description:
      List of phandle pointing to the shared memory(SHM) area between the
      processors using these mailboxes for IPC, one for each mailbox SHM can
      be any memory reserved for the purpose of this communication between the
      processors.
    minItems: 1

  power-controller:
    type: object
    description:
      This sub-node represents SCPI power domain controller.

    properties:
      compatible:
        const: arm,scpi-power-domains

      '#power-domain-cells':
        const: 1

      num-domains:
        $ref: /schemas/types.yaml#/definitions/uint32
        description:
          Total number of power domains provided by SCPI. This is needed as
          the SCPI message protocol lacks a mechanism to query this
          information at runtime.

    required:
      - compatible
      - '#power-domain-cells'
      - num-domains

    additionalProperties: false

  sensors:
    type: object
    description: |
      This sub-node represents SCPI sensors controller.

    properties:
      compatible:
        oneOf:
          - const: arm,scpi-sensors
          - items:
              - enum:
                  - amlogic,meson-gxbb-scpi-sensors
              - const: arm,scpi-sensors

      '#thermal-sensor-cells':
        const: 1

    required:
      - compatible
      - '#thermal-sensor-cells'

    additionalProperties: false

  clocks:
    type: object
    description:
      This is the container node. Each sub-node represents one of the types
      of clock controller - indexed or full range.

    properties:
      compatible:
        const: arm,scpi-clocks

    patternProperties:
      "^clocks-[0-9a-f]+$":
        type: object
        description: |
          This sub-node represents one of the types of clock controller
          - indexed or full range.

          "arm,scpi-dvfs-clocks" - all the clocks that are variable and index
          based. These clocks don't provide an entire range of values between
          the limits but only discrete points within the range. The firmware
          provides the mapping for each such operating frequency and the index
          associated with it. The firmware also manages the voltage scaling
          appropriately with the clock scaling.

          "arm,scpi-variable-clocks" - all the clocks that are variable and
          provide full range within the specified range. The firmware provides
          the range of values within a specified range.

        properties:
          compatible:
            enum:
              - arm,scpi-dvfs-clocks
              - arm,scpi-variable-clocks

          '#clock-cells':
            const: 1

          clock-output-names: true

          clock-indices:
            $ref: /schemas/types.yaml#/definitions/uint32-array
            description:
              The identifying number for the clocks(i.e.clock_id) in the node.
              It can be non linear and hence provide the mapping of identifiers
              into the clock-output-names array.

        required:
          - compatible
          - '#clock-cells'
          - clock-output-names
          - clock-indices

        additionalProperties: false

    required:
      - compatible

    additionalProperties: false

additionalProperties: false

required:
  - compatible
  - mboxes
  - shmem

examples:
  - |
    firmware {
        scpi {
            compatible = "arm,scpi";
            mboxes = <&mhuA 1>;
            shmem = <&cpu_scp_hpri>; /* HP-NonSecure */

            scpi_devpd: power-controller {
                compatible = "arm,scpi-power-domains";
                num-domains = <2>;
                #power-domain-cells = <1>;
            };

            clocks {
                compatible = "arm,scpi-clocks";

                scpi_dvfs: clocks-0 {
                    compatible = "arm,scpi-dvfs-clocks";
                    #clock-cells = <1>;
                    clock-indices = <0>, <1>, <2>;
                    clock-output-names = "atlclk", "aplclk","gpuclk";
                };

                scpi_clk: clocks-1 {
                    compatible = "arm,scpi-variable-clocks";
                    #clock-cells = <1>;
                    clock-indices = <3>, <4>;
                    clock-output-names = "pxlclk0", "pxlclk1";
                };
            };

            scpi_sensors: sensors {
                compatible = "arm,scpi-sensors";
                #thermal-sensor-cells = <1>;
            };

        };
    };

    soc {
        #address-cells = <2>;
        #size-cells = <2>;

        sram@50000000 {
            compatible = "mmio-sram";
            reg = <0x0 0x50000000 0x0 0x10000>;

            #address-cells = <1>;
            #size-cells = <1>;
            ranges = <0 0x0 0x50000000 0x10000>;

            cpu_scp_lpri: scp-sram-section@0 {
                compatible = "arm,scp-shmem";
                reg = <0x0 0x200>;
            };

            cpu_scp_hpri: scp-sram-section@200 {
                compatible = "arm,scp-shmem";
                reg = <0x200 0x200>;
            };
        };
    };

  - |
    firmware {
        scpi {
            compatible = "amlogic,meson-gxbb-scpi", "arm,scpi-pre-1.0";
            mboxes = <&mailbox 1 &mailbox 2>;
            shmem = <&cpu_scp_lpri>, <&cpu_scp_hpri>;

            scpi_sensors1: sensors {
                compatible = "amlogic,meson-gxbb-scpi-sensors", "arm,scpi-sensors";
                #thermal-sensor-cells = <1>;
            };
        };
    };
...
```

## Documentation/devicetree/bindings/firmware/brcm,kona-smc.yaml
```yaml
# SPDX-License-Identifier: GPL-2.0-only OR BSD-2-Clause
%YAML 1.2
---
$id: http://devicetree.org/schemas/firmware/brcm,kona-smc.yaml#
$schema: http://devicetree.org/meta-schemas/core.yaml#

title: Broadcom Kona family Secure Monitor bounce buffer

description:
  A bounce buffer used for non-secure to secure communications.

maintainers:
  - Florian Fainelli <f.fainelli@gmail.com>

properties:
  compatible:
    items:
      - enum:
          - brcm,bcm11351-smc
          - brcm,bcm21664-smc
          - brcm,bcm23550-smc
      - const: brcm,kona-smc

  reg:
    maxItems: 1

required:
  - compatible
  - reg

additionalProperties: false

examples:
  - |
    smc@3404c000 {
        compatible = "brcm,bcm11351-smc", "brcm,kona-smc";
        reg = <0x3404c000 0x400>; /* 1 KiB in SRAM */
    };
...
```

## Documentation/devicetree/bindings/firmware/coreboot.txt
```
COREBOOT firmware information

The device tree node to communicate the location of coreboot's memory-resident
bookkeeping structures to the kernel. Since coreboot itself cannot boot a
device-tree-based kernel (yet), this node needs to be inserted by a
second-stage bootloader (a coreboot "payload").

Required properties:
 - compatible: Should be "coreboot"
 - reg: Address and length of the following two memory regions, in order:
	1.) The coreboot table. This is a list of variable-sized descriptors
	that contain various compile- and run-time generated firmware
	parameters. It is identified by the magic string "LBIO" in its first
	four bytes.
	See coreboot's src/commonlib/include/commonlib/coreboot_tables.h for
	details.
	2.) The CBMEM area. This is a downward-growing memory region used by
	coreboot to dynamically allocate data structures that remain resident.
	It may or may not include the coreboot table as one of its members. It
	is identified by a root node descriptor with the magic number
	0xc0389481 that resides in the topmost 8 bytes of the area.
	See coreboot's src/include/imd.h for details.

Example:
	firmware {
		ranges;

		coreboot {
			compatible = "coreboot";
			reg = <0xfdfea000 0x264>,
			      <0xfdfea000 0x16000>;
		}
	};
```

## Documentation/devicetree/bindings/firmware/cznic,turris-mox-rwtm.txt
```
Turris Mox rWTM firmware driver

Required properties:
 - compatible		: Should be "cznic,turris-mox-rwtm"
 - mboxes		: Must contain a reference to associated mailbox

This device tree node should be used on Turris Mox, or potentially another A3700
compatible device running the Mox's rWTM firmware in the secure processor (for
example it is possible to flash this firmware into EspressoBin).

Example:

	firmware {
		turris-mox-rwtm {
			compatible = "cznic,turris-mox-rwtm";
			mboxes = <&rwtm 0>;
			status = "okay";
		};
	};
```

## Documentation/devicetree/bindings/firmware/cznic,turris-mox-rwtm.yaml
```yaml
# SPDX-License-Identifier: (GPL-2.0-only OR BSD-2-Clause)
%YAML 1.2
---
$id: http://devicetree.org/schemas/firmware/cznic,turris-mox-rwtm.yaml#
$schema: http://devicetree.org/meta-schemas/core.yaml#

title: CZ.NIC Turris Mox rWTM firmware

maintainers:
  - Marek Behún <kabel@kernel.org>

description:
  This device tree node should be used on Turris Mox, or potentially another
  A3700 compatible device running the Mox's rWTM firmware in the secure
  processor (for example it is possible to flash this firmware into
  EspressoBin).

properties:
  compatible:
    oneOf:
      - items:
          - const: marvell,armada-3700-rwtm-firmware
          - const: cznic,turris-mox-rwtm
      - const: marvell,armada-3700-rwtm-firmware

  mboxes:
    maxItems: 1

required:
  - compatible
  - mboxes

additionalProperties: false

examples:
  - |
    turris-mox-rwtm {
        compatible = "marvell,armada-3700-rwtm-firmware", "cznic,turris-mox-rwtm";
        mboxes = <&rwtm 0>;
    };
```

## Documentation/devicetree/bindings/firmware/cznic,turris-omnia-mcu.yaml
```yaml
# SPDX-License-Identifier: (GPL-2.0 OR BSD-2-Clause)
%YAML 1.2
---
$id: http://devicetree.org/schemas/firmware/cznic,turris-omnia-mcu.yaml#
$schema: http://devicetree.org/meta-schemas/core.yaml#

title: CZ.NIC's Turris Omnia MCU

maintainers:
  - Marek Behún <kabel@kernel.org>

description:
  The MCU on Turris Omnia acts as a system controller providing additional
  GPIOs, interrupts, watchdog, system power off and wakeup configuration.

properties:
  compatible:
    const: cznic,turris-omnia-mcu

  reg:
    description: MCU I2C slave address
    maxItems: 1

  interrupts:
    maxItems: 1

  interrupt-controller: true

  '#interrupt-cells':
    const: 2
    description: |
      The first cell specifies the interrupt number (0 to 63), the second cell
      specifies interrupt type (which can be one of IRQ_TYPE_EDGE_RISING,
      IRQ_TYPE_EDGE_FALLING or IRQ_TYPE_EDGE_BOTH).
      The interrupt numbers correspond sequentially to GPIO numbers, taking the
      GPIO banks into account:
        IRQ number   GPIO bank   GPIO pin within bank
           0 - 15      0           0 - 15
          16 - 47      1           0 - 31
          48 - 63      2           0 - 15
      There are several exceptions:
        IRQ number   meaning
          11           LED panel brightness changed by button press
          13           TRNG entropy ready
          14           ECDSA message signature computation done

  gpio-controller: true

  '#gpio-cells':
    const: 3
    description:
      The first cell is bank number (0, 1 or 2), the second cell is pin number
      within the bank (0 to 15 for banks 0 and 2, 0 to 31 for bank 1), and the
      third cell specifies consumer flags.

required:
  - compatible
  - reg
  - interrupts
  - interrupt-controller
  - gpio-controller

additionalProperties: false

examples:
  - |
    #include <dt-bindings/interrupt-controller/irq.h>

    i2c {
        #address-cells = <1>;
        #size-cells = <0>;

        system-controller@2a {
            compatible = "cznic,turris-omnia-mcu";
            reg = <0x2a>;

            interrupt-parent = <&gpio1>;
            interrupts = <11 IRQ_TYPE_NONE>;

            gpio-controller;
            #gpio-cells = <3>;

            interrupt-controller;
            #interrupt-cells = <2>;
        };
    };
```
