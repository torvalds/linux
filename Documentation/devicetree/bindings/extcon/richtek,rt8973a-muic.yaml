## Documentation/devicetree/bindings/firmware/fsl,scu.yaml
```yaml
# SPDX-License-Identifier: (GPL-2.0-only OR BSD-2-Clause)
%YAML 1.2
---
$id: http://devicetree.org/schemas/firmware/fsl,scu.yaml#
$schema: http://devicetree.org/meta-schemas/core.yaml#

title: NXP i.MX System Controller Firmware (SCFW)

maintainers:
  - Dong Aisheng <aisheng.dong@nxp.com>

description:
  The System Controller Firmware (SCFW) is a low-level system function
  which runs on a dedicated Cortex-M core to provide power, clock, and
  resource management. It exists on some i.MX8 processors. e.g. i.MX8QM
  (QM, QP), and i.MX8QX (QXP, DX).
  The AP communicates with the SC using a multi-ported MU module found
  in the LSIO subsystem. The current definition of this MU module provides
  5 remote AP connections to the SC to support up to 5 execution environments
  (TZ, HV, standard Linux, etc.). The SC side of this MU module interfaces
  with the LSIO DSC IP bus. The SC firmware will communicate with this MU
  using the MSI bus.

properties:
  compatible:
    const: fsl,imx-scu

  clock-controller:
    description:
      Clock controller node that provides the clocks controlled by the SCU
    $ref: /schemas/clock/fsl,scu-clk.yaml

  ocotp:
    description:
      OCOTP controller node provided by the SCU
    $ref: /schemas/nvmem/fsl,scu-ocotp.yaml

  keys:
    description:
      Keys provided by the SCU
    $ref: /schemas/input/fsl,scu-key.yaml

  mboxes:
    description:
      A list of phandles of TX MU channels followed by a list of phandles of
      RX MU channels. The list may include at the end one more optional MU
      channel for general interrupt. The number of expected tx and rx
      channels is 1 TX and 1 RX channels if MU instance is "fsl,imx8-mu-scu"
      compatible, 4 TX and 4 RX channels otherwise. All MU channels must be
      within the same MU instance. Cross instances are not allowed. The MU
      instance can only be one of LSIO MU0~M4 for imx8qxp and imx8qm. Users
      need to ensure that one is used that does not conflict with other
      execution environments such as ATF.
    oneOf:
      - items:
          - description: TX0 MU channel
          - description: RX0 MU channel
      - items:
          - description: TX0 MU channel
          - description: RX0 MU channel
          - description: optional MU channel for general interrupt
      - items:
          - description: TX0 MU channel
          - description: TX1 MU channel
          - description: TX2 MU channel
          - description: TX3 MU channel
          - description: RX0 MU channel
          - description: RX1 MU channel
          - description: RX2 MU channel
          - description: RX3 MU channel
      - items:
          - description: TX0 MU channel
          - description: TX1 MU channel
          - description: TX2 MU channel
          - description: TX3 MU channel
          - description: RX0 MU channel
          - description: RX1 MU channel
          - description: RX2 MU channel
          - description: RX3 MU channel
          - description: optional MU channel for general interrupt

  mbox-names:
    oneOf:
      - items:
          - const: tx0
          - const: rx0
      - items:
          - const: tx0
          - const: rx0
          - const: gip3
      - items:
          - const: tx0
          - const: tx1
          - const: tx2
          - const: tx3
          - const: rx0
          - const: rx1
          - const: rx2
          - const: rx3
      - items:
          - const: tx0
          - const: tx1
          - const: tx2
          - const: tx3
          - const: rx0
          - const: rx1
          - const: rx2
          - const: rx3
          - const: gip3

  pinctrl:
    description:
      Pin controller provided by the SCU
    $ref: /schemas/pinctrl/fsl,scu-pinctrl.yaml

  power-controller:
    description:
      Power domains controller node that provides the power domains
      controlled by the SCU
    $ref: /schemas/power/fsl,scu-pd.yaml

  rtc:
    description:
      RTC controller provided by the SCU
    $ref: /schemas/rtc/fsl,scu-rtc.yaml

  thermal-sensor:
    description:
      Thermal sensor provided by the SCU
    $ref: /schemas/thermal/fsl,scu-thermal.yaml

  watchdog:
    description:
      Watchdog controller provided by the SCU
    $ref: /schemas/watchdog/fsl,scu-wdt.yaml

required:
  - compatible
  - mbox-names
  - mboxes

additionalProperties: false

examples:
  - |
    #include <dt-bindings/firmware/imx/rsrc.h>
    #include <dt-bindings/input/input.h>
    #include <dt-bindings/pinctrl/pads-imx8qxp.h>

    firmware {
        system-controller {
            compatible = "fsl,imx-scu";
            mbox-names = "tx0", "tx1", "tx2", "tx3",
                         "rx0", "rx1", "rx2", "rx3",
                         "gip3";
            mboxes = <&lsio_mu1 0 0 &lsio_mu1 0 1 &lsio_mu1 0 2 &lsio_mu1 0 3
                      &lsio_mu1 1 0 &lsio_mu1 1 1 &lsio_mu1 1 2 &lsio_mu1 1 3
                      &lsio_mu1 3 3>;

            clock-controller {
                compatible = "fsl,imx8qxp-clk", "fsl,scu-clk";
                #clock-cells = <2>;
            };

            pinctrl {
                compatible = "fsl,imx8qxp-iomuxc";

                pinctrl_lpuart0: lpuart0grp {
                    fsl,pins = <
                        IMX8QXP_UART0_RX_ADMA_UART0_RX   0x06000020
                        IMX8QXP_UART0_TX_ADMA_UART0_TX   0x06000020
                    >;
                };
            };

            ocotp {
                compatible = "fsl,imx8qxp-scu-ocotp";
                #address-cells = <1>;
                #size-cells = <1>;

                fec_mac0: mac@2c4 {
                    reg = <0x2c4 6>;
                };
            };

            power-controller {
                compatible = "fsl,imx8qxp-scu-pd", "fsl,scu-pd";
                #power-domain-cells = <1>;
            };

            rtc {
                compatible = "fsl,imx8qxp-sc-rtc";
            };

            keys {
                compatible = "fsl,imx8qxp-sc-key", "fsl,imx-sc-key";
                linux,keycodes = <KEY_POWER>;
            };

            watchdog {
                compatible = "fsl,imx8qxp-sc-wdt", "fsl,imx-sc-wdt";
                timeout-sec = <60>;
            };

            thermal-sensor {
                compatible = "fsl,imx8qxp-sc-thermal", "fsl,imx-sc-thermal";
                #thermal-sensor-cells = <1>;
            };
        };
    };
```

## Documentation/devicetree/bindings/firmware/google,gs101-acpm-ipc.yaml
```yaml
# SPDX-License-Identifier: (GPL-2.0-only OR BSD-2-Clause)
# Copyright 2024 Linaro Ltd.
%YAML 1.2
---
$id: http://devicetree.org/schemas/firmware/google,gs101-acpm-ipc.yaml#
$schema: http://devicetree.org/meta-schemas/core.yaml#

title: Samsung Exynos ACPM mailbox protocol

maintainers:
  - Tudor Ambarus <tudor.ambarus@linaro.org>

description: |
  ACPM (Alive Clock and Power Manager) is a firmware that operates on the
  APM (Active Power Management) module that handles overall power management
  activities. ACPM and masters regard each other as independent hardware
  component and communicate with each other using mailbox messages and
  shared memory.

  This binding is intended to define the interface the firmware implementing
  ACPM provides for OSPM in the device tree.

properties:
  compatible:
    const: google,gs101-acpm-ipc

  "#clock-cells":
    const: 1
    description:
      Clocks that are variable and index based. These clocks don't provide
      an entire range of values between the limits but only discrete points
      within the range. The firmware also manages the voltage scaling
      appropriately with the clock scaling. The argument is the ID of the
      clock contained by the firmware messages.

  mboxes:
    maxItems: 1

  pmic:
    deprecated: true
    description: Child node describing the main PMIC.
    type: object
    additionalProperties: true

    properties:
      compatible:
        const: samsung,s2mpg10-pmic

  pmic-1:
    description: Child node describing the main PMIC.
    type: object
    additionalProperties: true

    properties:
      compatible:
        const: samsung,s2mpg10-pmic

  pmic-2:
    description: Child node describing the sub PMIC.
    type: object
    additionalProperties: true

    properties:
      compatible:
        const: samsung,s2mpg11-pmic

  shmem:
    description:
      List of phandle pointing to the shared memory (SHM) area. The memory
      contains channels configuration data and the TX/RX ring buffers that
      are used for passing messages to/from the ACPM firmware.
    maxItems: 1

required:
  - compatible
  - "#clock-cells"
  - mboxes
  - shmem

additionalProperties: false

examples:
  - |
    #include <dt-bindings/gpio/gpio.h>
    #include <dt-bindings/interrupt-controller/irq.h>
    #include <dt-bindings/regulator/samsung,s2mpg10-regulator.h>

    power-management {
        compatible = "google,gs101-acpm-ipc";
        #clock-cells = <1>;
        mboxes = <&ap2apm_mailbox>;
        shmem = <&apm_sram>;

        pmic-1 {
            compatible = "samsung,s2mpg10-pmic";
            interrupts-extended = <&gpa0 6 IRQ_TYPE_LEVEL_LOW>;

            vinl3m-supply = <&buck8m>;

            regulators {
                ldo1m {
                    regulator-name = "vdd_ldo1";
                    regulator-min-microvolt = <700000>;
                    regulator-max-microvolt = <1300000>;
                    regulator-always-on;
                };

                ldo20m {
                    regulator-name = "vdd_dmics";
                    regulator-min-microvolt = <700000>;
                    regulator-max-microvolt = <1300000>;
                    regulator-always-on;
                    samsung,ext-control = <S2MPG10_EXTCTRL_LDO20M_EN2>;
                };

                buck8m {
                    regulator-name = "vdd_mif";
                    regulator-min-microvolt = <450000>;
                    regulator-max-microvolt = <1300000>;
                    regulator-always-on;
                    regulator-boot-on;
                };
            };
        };

        pmic-2 {
            compatible = "samsung,s2mpg11-pmic";
            interrupts-extended = <&gpa0 7 IRQ_TYPE_LEVEL_LOW>;

            vinl1s-supply = <&buck8m>;
            vinl2s-supply = <&buck6s>;

            regulators {
                buckd {
                    regulator-name = "vcc_ufs";
                    regulator-ramp-delay = <6250>;
                    enable-gpios = <&gpp0 1 GPIO_ACTIVE_HIGH>;
                    samsung,ext-control = <S2MPG11_EXTCTRL_UFS_EN>;
                };
            };
        };
    };
```

## Documentation/devicetree/bindings/firmware/gunyah-hypervisor.yaml
```yaml
# SPDX-License-Identifier: (GPL-2.0 OR BSD-2-Clause)
%YAML 1.2
---
$id: http://devicetree.org/schemas/firmware/gunyah-hypervisor.yaml#
$schema: http://devicetree.org/meta-schemas/core.yaml#

title: Gunyah Hypervisor

maintainers:
  - Prakruthi Deepak Heragu <quic_pheragu@quicinc.com>
  - Elliot Berman <quic_eberman@quicinc.com>

description: |+
  Gunyah virtual machines use this information to determine the capability IDs
  of the message queues used to communicate with the Gunyah Resource Manager.
  See also: https://github.com/quic/gunyah-resource-manager/blob/develop/src/vm_creation/dto_construct.c

properties:
  compatible:
    const: gunyah-hypervisor

  "#address-cells":
    description: Number of cells needed to represent 64-bit capability IDs.
    const: 2

  "#size-cells":
    description: must be 0, because capability IDs are not memory address
                  ranges and do not have a size.
    const: 0

patternProperties:
  "^gunyah-resource-mgr(@.*)?":
    type: object
    description:
      Resource Manager node which is required to communicate to Resource
      Manager VM using Gunyah Message Queues.

    properties:
      compatible:
        const: gunyah-resource-manager

      reg:
        items:
          - description: Gunyah capability ID of the TX message queue
          - description: Gunyah capability ID of the RX message queue

      interrupts:
        items:
          - description: Interrupt for the TX message queue
          - description: Interrupt for the RX message queue

    additionalProperties: false

    required:
      - compatible
      - reg
      - interrupts

additionalProperties: false

required:
  - compatible
  - "#address-cells"
  - "#size-cells"

examples:
  - |
    #include <dt-bindings/interrupt-controller/arm-gic.h>

    hypervisor {
        #address-cells = <2>;
        #size-cells = <0>;
        compatible = "gunyah-hypervisor";

        gunyah-resource-mgr@0 {
            compatible = "gunyah-resource-manager";
            interrupts = <GIC_SPI 3 IRQ_TYPE_EDGE_RISING>, /* TX full IRQ */
                         <GIC_SPI 4 IRQ_TYPE_EDGE_RISING>; /* RX empty IRQ */
            reg = <0x00000000 0x00000000>, <0x00000000 0x00000001>;
                  /* TX, RX cap ids */
        };
    };
```
