## Documentation/devicetree/bindings/phy/phy-rockchip-inno-usb2.yaml
```yaml
# SPDX-License-Identifier: GPL-2.0
%YAML 1.2
---
$id: http://devicetree.org/schemas/phy/phy-rockchip-inno-usb2.yaml#
$schema: http://devicetree.org/meta-schemas/core.yaml#

title: Rockchip USB2.0 phy with inno IP block

maintainers:
  - Heiko Stuebner <heiko@sntech.de>

properties:
  compatible:
    enum:
      - rockchip,px30-usb2phy
      - rockchip,rk1808-usb2phy
      - rockchip,rk3128-usb2phy
      - rockchip,rk3228-usb2phy
      - rockchip,rk3308-usb2phy
      - rockchip,rk3328-usb2phy
      - rockchip,rk3366-usb2phy
      - rockchip,rk3368-usb2phy
      - rockchip,rk3399-usb2phy
      - rockchip,rk3568-usb2phy
      - rockchip,rk3588-usb2phy
      - rockchip,rv1106-usb2phy
      - rockchip,rv1108-usb2phy

  reg:
    maxItems: 1

  clock-output-names:
    description:
      The usb 480m output clock name.

  "#clock-cells":
    const: 0

  "#phy-cells":
    const: 0

  clocks:
    maxItems: 1

  clock-names:
    const: phyclk

  assigned-clocks:
    description:
      Phandle of the usb 480m clock.

  assigned-clock-parents:
    description:
      Parent of the usb 480m clock.
      Select between usb-phy output 480m and xin24m.
      Refer to clk/clock-bindings.txt for generic clock consumer properties.

  extcon:
    description:
      Phandle to the extcon device providing the cable state for the otg phy.

  wakeup-source:
    description:
      Enable USB irq wakeup when suspend.
      Only work when suspend wakeup-config is not work.

  rockchip,usbgrf:
    $ref: /schemas/types.yaml#/definitions/phandle
    description:
      Phandle to the syscon managing the 'usb general register files'.
      When set the driver will request its phandle as one companion-grf
      for some special SoCs (e.g rv1108).

  rockchip,usbctrl-grf:
    $ref: /schemas/types.yaml#/definitions/phandle
    description:
      Phandle to the syscon managing the 'usb ctrl general register files'.
      When set the driver will request its phandle as the
      usb controller grf for some SoCs (e.g rk3588).

  rockchip,u2phy-tuning:
    $ref: /schemas/types.yaml#/definitions/flag
    description: when set, tuning u2phy to improve usb2 SI.

  host-port:
    type: object
    additionalProperties: false

    properties:
      "#phy-cells":
        const: 0

      interrupts:
        description: host linestate interrupt

      interrupt-names:
        const: linestate

      phy-supply:
        description:
          Phandle to a regulator that provides power to VBUS.
          See ./phy-bindings.txt for details.

    required:
      - "#phy-cells"
      - interrupts
      - interrupt-names

  otg-port:
    type: object
    additionalProperties: false

    properties:
      "#phy-cells":
        const: 0

      interrupts:
        minItems: 1
        maxItems: 3

      interrupt-names:
        oneOf:
          - const: linestate
          - const: otg-mux
          - items:
              - const: otg-bvalid
              - const: otg-id
              - const: linestate

      phy-supply:
        description:
          Phandle to a regulator that provides power to VBUS.
          See ./phy-bindings.txt for details.

      vbus-supply:
        description:
          Phandle to a fixed-regulator that provides power to VBUS.

      rockchip,utmi-bypass-uart:
        $ref: /schemas/types.yaml#/definitions/flag
        description: when set, indicates that support usb to bypass uart
          feature. This property can only be added in debug stage.

      rockchip,utmi-avalid:
        $ref: /schemas/types.yaml#/definitions/flag
        description: when set, the usb2 phy will use avalid status bit to
          get vbus status. If not, it will use bvalid status bit to get vbus
          status by default.

     rockchip,vbus-always-on:
       $ref: /schemas/types.yaml#/definitions/flag
       description: when set, indicates that the otg vbus is always powered on.

     rockchip,low-power-mode:
       $ref: /schemas/types.yaml#/definitions/flag
       description: when set, the port will enter low power state when suspend.

     rockchip,typec-vbus-det:
       $ref: /schemas/types.yaml#/definitions/flag
       description: when set, check the vbus status from grf con for Type-C
         interface. It's used when the vbusdet pin is always pulled up.

     rockchip,sel-pipe-phystatus:
       $ref: /schemas/types.yaml#/definitions/flag
       description: when set, select the pipe phy status from grf for usb
         controller. It's used when the usb3 phy is disabled, and it needs
         to combine with the usbctrl-grf.

     rockchip,dis-u2-susphy:
       $ref: /schemas/types.yaml#/definitions/flag
       description: when set, disable the usb2 phy enter suspend automatically.

    required:
      - "#phy-cells"
      - interrupts
      - interrupt-names

required:
  - compatible
  - reg
  - clock-output-names
  - "#clock-cells"
  - "#phy-cells"
  - host-port
  - otg-port

additionalProperties: false

examples:
  - |
    #include <dt-bindings/clock/rk3399-cru.h>
    #include <dt-bindings/interrupt-controller/arm-gic.h>
    #include <dt-bindings/interrupt-controller/irq.h>
    u2phy0: usb2-phy@e450 {
      compatible = "rockchip,rk3399-usb2phy";
      reg = <0xe450 0x10>;
      clocks = <&cru SCLK_USB2PHY0_REF>;
      clock-names = "phyclk";
      clock-output-names = "clk_usbphy0_480m";
      #clock-cells = <0>;
      #phy-cells = <0>;

      u2phy0_host: host-port {
        #phy-cells = <0>;
        interrupts = <GIC_SPI 27 IRQ_TYPE_LEVEL_HIGH 0>;
        interrupt-names = "linestate";
      };

      u2phy0_otg: otg-port {
        #phy-cells = <0>;
        interrupts = <GIC_SPI 103 IRQ_TYPE_LEVEL_HIGH 0>,
                     <GIC_SPI 104 IRQ_TYPE_LEVEL_HIGH 0>,
                     <GIC_SPI 106 IRQ_TYPE_LEVEL_HIGH 0>;
        interrupt-names = "otg-bvalid", "otg-id", "linestate";
      };
    };
```

## Documentation/devicetree/bindings/phy/phy-rockchip-inno-usb3.txt
```
ROCKCHIP USB 3.0 PHY WITH INNO IP BLOCK

Required properties (phy (parent) node):
 - compatible:	should be one of the listed compatibles:
   * "rockchip,rk3328-u3phy"
   * "rockchip,rk322xh-u3phy"
 - reg : the base address of USB 3.0 PHY.
 - rockchip,u3phygrf : phandle to the syscon managing the
		       "USB 3.0 PHY general register files".
 - interrupts : specify an interrupt for each entry in interrupt-names.
 - interrupt-names : a list which shall be the following entries:
   * "linestate" : for the host/otg linestate interrupt
 - clocks : phandle + clock specifier for the phy clocks.
 - clock-names :
   * "u3phy-otg" for USB 3.0 PHY utmi
   * "u3phy-pipe" for USB 3.0 PHY pipe
 - resets : a list of phandle + reset specifier pairs
 - reset-names :
   * "u3phy-u2-por" for the USB 2.0 logic of USB 3.0 PHY
   * "u3phy-u3-por" for the USB 3.0 logic of USB 3.0 PHY
   * "u3phy-pipe-mac" for the USB 3.0 PHY pipe MAC
   * "u3phy-utmi-mac" for the USB 3.0 PHY utmi MAC
   * "u3phy-utmi-apb" for the USB 3.0 PHY utmi apb
   * "u3phy-pipe-apb" for the USB 3.0 PHY pipe apb

Optional properties:
 - vbus-supply: regulator phandle for vbus power source.

Required nodes : a sub-node is required for USB 3.0 or USB 2.0 the phy provides.
		 The sub-node name is used to identify phy type, and shall be
		 the following entries:
	* "u3phy_utmi" : USB 2.0 utmi phy.
	* "u3phy_pipe" : USB 3.0 pipe phy.

Required properties (port (child) node):
 - reg : address and length of the register set for the port.
 - #phy-cells : must be 0. See ./phy-bindings.txt for details.

Optional properties for utmi node:
 - rockchip,odt-val-tuning : specify 45ohm ODT tuning value.

Optional properties for pipe node:
 - rockchip,refclk-25m-quirk : phy reference clock changed to 25m quirk.

Example:

usb3phy_grf: syscon@ff460000 {
	compatible = "rockchip,usb3phy-grf", "syscon";
	reg = <0x0 0xff460000 0x0 0x1000>;
};

...

u3phy: usb3-phy@ff470000 {
	compatible = "rockchip,rk3328-u3phy";
	reg = <0x0 0xff470000 0x0 0x0>;
	rockchip,u3phygrf = <&usb3phy_grf>;
	interrupts = <GIC_SPI 77 IRQ_TYPE_LEVEL_HIGH>;
	interrupt-names = "linestate";
	clocks = <&cru PCLK_USB3PHY_OTG>, <&cru PCLK_USB3PHY_PIPE>;
	clock-names = "u3phy-otg", "u3phy-pipe";
	resets = <&cru SRST_USB3PHY_U2>,
		 <&cru SRST_USB3PHY_U3>,
		 <&cru SRST_USB3PHY_PIPE>,
		 <&cru SRST_USB3OTG_UTMI>,
		 <&cru SRST_USB3PHY_OTG_P>,
		 <&cru SRST_USB3PHY_PIPE_P>;
	reset-names = "u3phy-u2-por", "u3phy-u3-por",
		      "u3phy-pipe-mac", "u3phy-utmi-mac",
		      "u3phy-utmi-apb", "u3phy-pipe-apb";
	#address-cells = <2>;
	#size-cells = <2>;
	ranges;

	u3phy_utmi: utmi@ff470000 {
		reg = <0x0 0xff470000 0x0 0x8000>;
		#phy-cells = <0>;
	};

	u3phy_pipe: pipe@ff478000 {
		reg = <0x0 0xff478000 0x0 0x8000>;
		#phy-cells = <0>;
	};
};
```

## Documentation/devicetree/bindings/phy/phy-rockchip-inno-video-combo-phy.txt
```
ROCKCHIP MIPI/LVDS/TTL VIDEO COMBO PHY WITH INNO IP BLOCK

Required properties:
 - compatible : must be one of:
	"rockchip,px30-video-phy",
	"rockchip,rk3128-video-phy",
	"rockchip,rk3368-video-phy";
 - reg : the address offset of register for phy and host configuration.
 - #phy-cells : must be 0. See ./phy-bindings.txt for details.
 - clocks: must include clock specifiers corresponding to entries in the
	   clock-names property. See ../clocks/clock-bindings.txt for details.
 - clock-names: list of clock names sorted in the same order as the clocks
		property. Must contain "ref", "pclk_phy", "pclk_host".
 - #clock-cells : from common clock binding; shall be set to 0.
 - resets : phandle to the reset of phy apb clock.
 - reset-names : should be "rst".
 - power-domains: Must contain a reference to the PM domain, if available.

Example:

	video_phy: video-phy@ff2e0000 {
		compatible = "rockchip,px30-video-phy";
		reg = <0x0 0xff2e0000 0x0 0x10000>,
		      <0x0 0xff450000 0x0 0x10000>;
		clocks = <&pmucru SCLK_MIPIDSIPHY_REF>,
			 <&cru PCLK_MIPIDSIPHY>, <&cru PCLK_MIPI_DSI>;
		clock-names = "ref", "pclk_phy", "pclk_host";
		#clock-cells = <0>;
		resets = <&cru SRST_MIPIDSIPHY_P>;
		reset-names = "rst";
		power-domains = <&power PX30_PD_VO>;
		#phy-cells = <0>;
		status = "disabled";
	};
```

## Documentation/devicetree/bindings/phy/phy-rockchip-inno-video-phy.txt
```
ROCKCHIP RK3288 LVDS/TTL VIDEO PHY WITH INNO IP BLOCK

Required properties:
 - compatible : "rockchip,rk3288-video-phy";
 - reg : the address offset of register for phy configuration.
 - #phy-cells : must be 0. See ./phy-bindings.txt for details.
 - clocks: must include clock specifiers corresponding to entries in the
	   clock-names property. See ../clocks/clock-bindings.txt for details.
 - clock-names: list of clock names sorted in the same order as the clocks
		property. Must contain "pclk".
 - resets : Must contain an entry for each entry in reset-names.
	    See ../reset/reset.txt for details.
 - reset-names : should be "rst".
 - power-domains: Must contain a reference to the PM domain, if available.

Example:

	video_phy: video-phy@ff96c000 {
		compatible = "rockchip,rk3288-video-phy";
		reg = <0x0 0xff96c000 0x0 0x4000>;
		clocks = <&cru PCLK_LVDS_PHY>;
		clock-names = "pclk";
		resets = <&cru SRST_LVDS_PHY>;
		reset-names = "rst";
		power-domains = <&power RK3288_PD_VIO>;
		#phy-cells = <0>;
		status = "disabled";
	};
```

## Documentation/devicetree/bindings/phy/phy-rockchip-naneng-combphy.txt
```
ROCKCHIP COMBO PHY WITH NANENG IP BLOCK

Required properties (phy (parent) node):
 - compatible : should be one of the listed compatibles:
	* "rockchip,rk3568-naneng-combphy"
 - reg : the address offset of grf for combo-phy configuration.
 - rockchip,pipe-grf : phandle to the syscon managing the "pipe general register files"
 - rockchip,pipe-phy-grf: phandle to the syscon managing the "phy general register files"
 - clocks : phandle + phy specifier pair, for the input clocks of phy.
 - clock-names : input clocks name of phy.
 - resets : phandle + reset specifier pairs.
 - reset-names : reset names of phy.
 - #clock-cells : should be 1.

Optional properties:
 - assigned-clocks : phandle of refclk.
 - assigned-clock-parents : parent of clk_xxx_osc or clk_xxx_div.
		 Refer to clk/clock-bindings.txt for generic clock
		 consumer properties.
 - rockchip,dis-u3otg0-port: when set, disable the u3 root port of otg0 host.
 - rockchip,dis-u3otg1-port: when set, disable the u3 root port of otg1 host.

Example:

combphy0: phy@fe820000 {
	compatible = "rockchip,rk3568-naneng-combphy";
	reg = <0x0 0xfe820000 0x0 0x100>;
	#phy-cells = <1>;
	clocks = <&pmucru CLK_PCIEPHY0_REF>, <&cru PCLK_PIPEPHY0>;
	clock-names = "refclk", "apbclk";
	resets = <&cru SRST_P_PIPEPHY0>, <&cru SRST_PIPEPHY0>;
	reset-names = "combphy-apb", "combphy";
	rockchip,pipe-grf = <&pipegrf>;
	rockchip,pipe-phy-grf = <&pipe_phy_grf0>;
	status = "disabled";
};
```

## Documentation/devicetree/bindings/phy/phy-rockchip-naneng-combphy.yaml
```yaml
# SPDX-License-Identifier: (GPL-2.0-only OR BSD-2-Clause)
%YAML 1.2
---
$id: http://devicetree.org/schemas/phy/phy-rockchip-naneng-combphy.yaml#
$schema: http://devicetree.org/meta-schemas/core.yaml#

title: Rockchip SoC Naneng Combo Phy

maintainers:
  - Heiko Stuebner <heiko@sntech.de>

properties:
  compatible:
    enum:
      - rockchip,rk3568-naneng-combphy

  reg:
    maxItems: 1

  clocks:
    items:
      - description: reference clock
      - description: apb clock
      - description: pipe clock

  clock-names:
    items:
      - const: ref
      - const: apb
      - const: pipe

  resets:
    items:
      - description: exclusive PHY reset line

  rockchip,enable-ssc:
    type: boolean
    description:
      The option SSC can be enabled for U3, SATA and PCIE.
      Most commercially available platforms use SSC to reduce EMI.

  rockchip,ext-refclk:
    type: boolean
    description:
      Many PCIe connections, especially backplane connections,
      require a synchronous reference clock between the two link partners.
      To achieve this a common clock source, referred to as REFCLK in
      the PCI Express Card Electromechanical Specification,
      should be used by both ends of the PCIe link.
      In PCIe mode one can choose to use an internal or an external reference
      clock.
      By default the internal clock is selected. The PCIe PHY provides a 100MHz
      differential clock output(optional with SSC) for system applications.
      When selecting this option an externally 100MHz differential
      reference clock needs to be provided to the PCIe PHY.

  rockchip,pipe-grf:
    $ref: /schemas/types.yaml#/definitions/phandle
    description:
      Some additional phy settings are accessed through GRF regs.

  rockchip,pipe-phy-grf:
    $ref: /schemas/types.yaml#/definitions/phandle
    description:
      Some additional pipe settings are accessed through GRF regs.

  "#phy-cells":
    const: 1

required:
  - compatible
  - reg
  - clocks
  - clock-names
  - resets
  - rockchip,pipe-grf
  - rockchip,pipe-phy-grf
  - "#phy-cells"

additionalProperties: false

examples:
  - |
    #include <dt-bindings/clock/rk3568-cru.h>

    pipegrf: syscon@fdc50000 {
      compatible = "rockchip,rk3568-pipe-grf", "syscon";
      reg = <0xfdc50000 0x1000>;
    };

    pipe_phy_grf0: syscon@fdc70000 {
      compatible = "rockchip,rk3568-pipe-phy-grf", "syscon";
      reg = <0xfdc70000 0x1000>;
    };

    combphy0: phy@fe820000 {
      compatible = "rockchip,rk3568-naneng-combphy";
      reg = <0xfe820000 0x100>;
      clocks = <&pmucru CLK_PCIEPHY0_REF>,
               <&cru PCLK_PIPEPHY0>,
               <&cru PCLK_PIPE>;
      clock-names = "ref", "apb", "pipe";
      assigned-clocks = <&pmucru CLK_PCIEPHY0_REF>;
      assigned-clock-rates = <100000000>;
      resets = <&cru SRST_PIPEPHY0>;
      rockchip,pipe-grf = <&pipegrf>;
      rockchip,pipe-phy-grf = <&pipe_phy_grf0>;
      #phy-cells = <1>;
    };
```
