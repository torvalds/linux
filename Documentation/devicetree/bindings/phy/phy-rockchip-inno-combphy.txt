## Documentation/devicetree/bindings/phy/phy-rockchip-inno-combphy.txt
```
ROCKCHIP PCIE/USB3 COMBPHY WITH INNO IP BLOCK

Required properties:
 - compatible: Should be one of the listed compatibles:
	       "rockchip,rk1808-combphy"
 - reg: Should be the address space for COMBPHY registers.
 - #phy-cells: Should be 1. The cell number is used to select the
	       phy mode as defined in <dt-bindings/phy/phy.h>,
	       <&combphy PHY_TYPE_USB3> for USB3 PHY
	       <&combphy PHY_TYPE_PCIE> for PCIE PHY
 - clocks: The phandle to clock provider and clock specifier pair.
 - clock-names: Must be "refclk", the reference clock of COMBPHY.
 - resets: The phandle to reset controller and reset specifier pair.
 - reset-names: The string reset names, must be:
		"otg-rst", "combphy-por",
		"combphy-apb", "combphy-pipe".
 - rockchip,combphygrf: The grf for COMBPHY configuration and state
			registers.

Refer to phy/phy-bindings.txt for the generic PHY binding properties.
Optional properties:
 - assigned-clocks: The phandle of COMBPHY reference clock.
 - assigned-clock-rates: The COMBPHY reference clock frequency,
			 the default clock frequency is 24MHz,
			 can be set to 25000000 or 50000000.

Examples:

combphy_grf: syscon@fe018000 {
	compatible = "rockchip,usb3phy-grf", "syscon";
	reg = <0x0 0xfe018000 0x0 0x8000>;
};

combphy: phy@ff380000 {
	compatible = "rockchip,rk1808-combphy";
	reg = <0x0 0xff380000 0x0 0x10000>;
	#phy-cells = <1>;
	clocks = <&cru SCLK_PCIEPHY_REF>;
	clock-names = "refclk";
	assigned-clocks = <&cru SCLK_PCIEPHY_REF>;
	assigned-clock-rates = <25000000>;
	resets = <&cru SRST_USB3_OTG_A>, <&cru SRST_PCIEPHY_POR>,
		 <&cru SRST_PCIEPHY_P>, <&cru SRST_PCIEPHY_PIPE>;
	reset-names = "otg-rst", "combphy-por",
		      "combphy-apb", "combphy-pipe";
	rockchip,combphygrf = <&combphy_grf>;
	status = "disabled";
};
```

## Documentation/devicetree/bindings/phy/phy-rockchip-inno-hdmi-phy.txt
```
ROCKCHIP HDMI PHY WITH INNO IP BLOCK

Required properties:
 - compatible : "rockchip,rk3228-hdmi-phy",
		"rockchip,rk3328-hdmi-phy";
 - reg : the address offset of register for hdmi phy configuration.
 - #phy-cells : must be 0. See ./phy-bindings.txt for details.
 - clocks and clock-names:
	- the "sysclk" clock is required by the phy module, used to system
	  control and register configuration
	- the "refclk" clock is reference crystal oscillator clock input
	  to PLL
 - #clock-cells: should be 0.
 - clock-output-names : shall be the corresponding names of the outputs.
 - rockchip,phy-table: the parameter table of hdmi phy configuration.

Example:

	hdmi_phy: hdmi-phy@12030000 {
		compatible = "rockchip,rk3228-hdmi-phy";
		reg = <0x12030000 0x10000>;
		#phy-cells = <0>;
		clocks = <&cru PCLK_HDMI_PHY>, <&xin24m>;
		clock-names = "sysclk", "refclk";
		#clock-cells = <0>;
		clock-output-names = "hdmiphy_phy";
		rockchip,phy-table =
			<165000000 0x07 0x0a 0x0a 0x0a 0x00 0x00 0x08
				   0x08 0x08 0x00 0xac 0xcc 0xcc 0xcc>,
			<340000000 0x0b 0x0d 0x0d 0x0d 0x07 0x15 0x08
				   0x08 0x08 0x3f 0xac 0xcc 0xcd 0xdd>,
			<594000000 0x10 0x1a 0x1a 0x1a 0x07 0x15 0x08
				   0x08 0x08 0x00 0xac 0xcc 0xcc 0xcc>;
		status = "disabled";
	};

Then the PHY can be used in other nodes such as:

	hdmi: hdmi@200a0000 {
		compatible = "rockchip,rk3228-dw-hdmi";
		...
		phys = <&hdmi_phy>;
		phy-names = "hdmi_phy";
		...
	};
```

## Documentation/devicetree/bindings/phy/phy-rockchip-inno-hdmi.txt
```
ROCKCHIP HDMI PHY WITH INNO IP BLOCK

Required properties:
 - compatible : should be one of the listed compatibles:
	* "rockchip,rk3228-hdmi-phy",
	* "rockchip,rk3328-hdmi-phy";
 - reg : Address and length of the hdmi phy control register set
 - clocks : phandle + clock specifier for the phy clocks
 - clock-names : string, clock name, must contain "sysclk" for system
	  control and register configuration, "refoclk" for crystal-
	  oscillator reference PLL clock input and "refpclk" for pclk-
	  based refeference PLL clock input.
 - #clock-cells: should be 0.
 - clock-output-names : shall be the name for the output clock.
 - interrupts : phandle + interrupt specified for the hdmiphy interrupt
 - #phy-cells : must be 0. See ./phy-bindings.txt for details.

Optional properties for rk3328-hdmi-phy:
 - nvmem-cells = phandle + nvmem specifier for the cpu-version efuse
 - nvmem-cell-names : "cpu-version" to read the chip version, required
	  for adjustment to some frequency settings

Example:
	hdmi_phy: hdmi-phy@12030000 {
		compatible = "rockchip,rk3228-hdmi-phy";
		reg = <0x12030000 0x10000>;
		#phy-cells = <0>;
		clocks = <&cru PCLK_HDMI_PHY>, <&xin24m>, <&cru DCLK_HDMIPHY>;
		clock-names = "sysclk", "refoclk", "refpclk";
		#clock-cells = <0>;
		clock-output-names = "hdmi_phy";
		status = "disabled";
	};

Then the PHY can be used in other nodes such as:

	hdmi: hdmi@200a0000 {
		compatible = "rockchip,rk3228-dw-hdmi";
		...
		phys = <&hdmi_phy>;
		phy-names = "hdmi";
		...
	};
```

## Documentation/devicetree/bindings/phy/phy-rockchip-inno-mipi-dphy.txt
```
ROCKCHIP MIPI DPHY WITH INNO IP BLOCK

Required properties:
 - compatible : must be one of:
	"rockchip,rk1808-mipi-dphy";
	"rockchip,rv1126-mipi-dphy";
 - reg : the address offset of register for mipi-dphy configuration.
 - #phy-cells : must be 0. See ./phy-bindings.txt for details.
 - clocks and clock-names:
	- the "pclk" clock is required by the phy module, used to register
	  configuration
	- the "ref" clock is used to get the rate of the reference clock
	  provided to the PHY module
 - clock-output-names: from common clock binding.
	See ../clocks/clock-bindings.txt for details.
 - #clock-cells : from common clock binding; shall be set to 0.
 - resets : phandle to the reset of MIPI DSI PHY APB clock.
 - reset-names : should be "apb".

Example:
	mipi_dphy: mipi-dphy@ff370000 {
		compatible = "rockchip,rk1808-mipi-dphy";
		reg = <0x0 0xff370000 0x0 0x500>;
		clocks = <&cru SCLK_MIPIDSIPHY_REF>, <&cru PCLK_MIPIDSIPHY>;
		clock-names = "ref", "pclk";
		clock-output-names = "mipi_dphy_pll";
		#clock-cells = <0>;
		resets = <&cru SRST_MIPIDSIPHY_P>;
		reset-names = "apb";
		#phy-cells = <0>;
		rockchip,grf = <&grf>;
		status = "disabled";
	};
```

## Documentation/devicetree/bindings/phy/phy-rockchip-inno-usb2.txt
```
ROCKCHIP USB2.0 PHY WITH INNO IP BLOCK

Required properties (phy (parent) node):
 - compatible : should be one of the listed compatibles:
	* "rockchip,px30-usb2phy"
	* "rockchip,rk3128-usb2phy"
	* "rockchip,rk3228-usb2phy"
	* "rockchip,rk3308-usb2phy"
	* "rockchip,rk3328-usb2phy"
	* "rockchip,rk3366-usb2phy"
	* "rockchip,rk3368-usb2phy"
	* "rockchip,rk3399-usb2phy"
	* "rockchip,rk3568-usb2phy"
	* "rockchip,rv1108-usb2phy"
 - reg : the address offset of grf for usb-phy configuration.
 - #clock-cells : should be 0.
 - clock-output-names : specify the 480m output clock name.

Optional properties:
 - clocks : phandle + phy specifier pair, for the input clock of phy.
 - clock-names : input clock name of phy, must be "phyclk".
 - assigned-clocks : phandle of usb 480m clock.
 - assigned-clock-parents : parent of usb 480m clock, select between
		 usb-phy output 480m and xin24m.
		 Refer to clk/clock-bindings.txt for generic clock
		 consumer properties.
 - rockchip,usbgrf : phandle to the syscon managing the "usb general
		 register files". When set driver will request its
		 phandle as one companion-grf for some special SoCs
		 (e.g RV1108).
 - rockchip,u2phy-tuning: when set, tuning u2phy to improve usb2 SI.
 - vbus-supply: regulator phandle for vbus power source.
 - wakeup-source: enable USB irq wakeup when suspend.
		  only work when suspend wakeup-config is not work.

Required nodes : a sub-node is required for each port the phy provides.
		 The sub-node name is used to identify host or otg port,
		 and shall be the following entries:
	* "otg-port" : the name of otg port.
	* "host-port" : the name of host port.

Required properties (port (child) node):
 - #phy-cells : must be 0. See ./phy-bindings.txt for details.
 - interrupts : specify an interrupt for each entry in interrupt-names.
 - interrupt-names : a list which should be one of the following cases:
	Regular case:
	* "otg-id" : for the otg id interrupt.
	* "otg-bvalid" : for the otg vbus interrupt.
	* "linestate" : for the host/otg linestate interrupt.
	Some SoCs use one interrupt with the above muxed together, so for these
	* "otg-mux" : otg-port interrupt, which mux otg-id/otg-bvalid/linestate
		to one.

Optional properties:
 - phy-supply : phandle to a regulator that provides power to VBUS.
		See ./phy-bindings.txt for details.
 - rockchip,bypass-uart: when set, indicates that support usb to
		bypass uart feature.
		note: this property can only be added in debug stage.
 - rockchip,utmi-avalid : when set, the usb2 phy will use avalid
		status bit to get vbus status. If not, it will use
		bvalid status bit to get vbus status by default.
 - rockchip,vbus-always-on: when set, indicates that the otg vbus
		is always powered on.
 - rockchip,low-power-mode: when set, the port will enter low power
		state when suspend.

Example:

grf: syscon@ff770000 {
	compatible = "rockchip,rk3366-grf", "syscon", "simple-mfd";
	#address-cells = <1>;
	#size-cells = <1>;

...

	u2phy: usb2-phy@700 {
		compatible = "rockchip,rk3366-usb2phy";
		reg = <0x700 0x2c>;
		#clock-cells = <0>;
		clock-output-names = "sclk_otgphy0_480m";

		u2phy_otg: otg-port {
			#phy-cells = <0>;
			interrupts = <GIC_SPI 93 IRQ_TYPE_LEVEL_HIGH>,
				     <GIC_SPI 94 IRQ_TYPE_LEVEL_HIGH>,
				     <GIC_SPI 95 IRQ_TYPE_LEVEL_HIGH>;
			interrupt-names = "otg-id", "otg-bvalid", "linestate";
		};

		u2phy_host: host-port {
			#phy-cells = <0>;
			interrupts = <GIC_SPI 96 IRQ_TYPE_LEVEL_HIGH>;
			interrupt-names = "linestate";
		};
	};
};

Required properties (usb2phy grf node):
 - compatible : should be one of the listed compatibles:
		"rockchip,px30-usb2phy-grf", "syscon", "simple-mfd";
		"rockchip,rk1808-usb2phy-grf", "syscon", "simple-mfd";
		"rockchip,rk3308-usb2phy-grf", "syscon", "simple-mfd";
		"rockchip,rk3328-usb2phy-grf", "syscon", "simple-mfd";
		"rockchip,rk3568-usb2phy-grf", "syscon";
 - reg : the address offset of grf for usb-phy configuration.
 - #address-cells : should be 1.
 - #size-cells : should be 1.

Required nodes : a sub-node is required for the phy provides.
		 The sub-node name is used to identify each phy,
		 and shall be the following entries:

Example:

usb2phy_grf: syscon@ff450000 {
	compatible = "rockchip,rk3328-usb2phy-grf", "syscon",
		     "simple-mfd";
	reg = <0x0 0xff450000 0x0 0x10000>;
	#address-cells = <1>;
	#size-cells = <1>;

	u2phy: usb2-phy@100 {
		compatible = "rockchip,rk3328-usb2phy";
		reg = <0x100 0x10>;
		clocks = <&xin24m>;
		clock-names = "phyclk";
		#clock-cells = <0>;
		assigned-clocks = <&cru USB480M>;
		assigned-clock-parents = <&u2phy>;
		clock-output-names = "usb480m_phy";
		status = "disabled";

		u2phy_host: host-port {
			#phy-cells = <0>;
			interrupts = <GIC_SPI 62 IRQ_TYPE_LEVEL_HIGH>;
			interrupt-names = "linestate";
			status = "disabled";
		};
	};
};
```
