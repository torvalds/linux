## Documentation/devicetree/bindings/phy/phy-stm32-usbphyc.yaml
```yaml
# SPDX-License-Identifier: GPL-2.0-only OR BSD-2-Clause
%YAML 1.2
---
$id: http://devicetree.org/schemas/phy/phy-stm32-usbphyc.yaml#
$schema: http://devicetree.org/meta-schemas/core.yaml#

title: STMicroelectronics STM32 USB HS PHY controller binding

description:

  The STM32 USBPHYC block contains a dual port High Speed UTMI+ PHY and a UTMI
  switch. It controls PHY configuration and status, and the UTMI+ switch that
  selects either OTG or HOST controller for the second PHY port. It also sets
  PLL configuration.

  USBPHYC
  |_ PLL
  |
  |_ PHY port#1 _________________ HOST controller
  |                   __                 |
  |                  / 1|________________|
  |_ PHY port#2 ----|   |________________
  |                  \_0|                |
  |_ UTMI switch_______|          OTG controller

maintainers:
  - Amelie Delaunay <amelie.delaunay@foss.st.com>

properties:
  compatible:
    const: st,stm32mp1-usbphyc

  reg:
    maxItems: 1

  clocks:
    maxItems: 1

  resets:
    maxItems: 1

  "#address-cells":
    const: 1

  "#size-cells":
    const: 0

  vdda1v1-supply:
    description: regulator providing 1V1 power supply to the PLL block

  vdda1v8-supply:
    description: regulator providing 1V8 power supply to the PLL block

  '#clock-cells':
    description: number of clock cells for ck_usbo_48m consumer
    const: 0

#Required child nodes:

patternProperties:
  "^usb-phy@[0|1]$":
    type: object
    description:
      Each port the controller provides must be represented as a sub-node.

    properties:
      reg:
        description: phy port index.
        maxItems: 1

      phy-supply:
        description: regulator providing 3V3 power supply to the PHY.

      "#phy-cells":
        enum: [ 0x0, 0x1 ]

      connector:
        type: object
        $ref: /schemas/connector/usb-connector.yaml
        properties:
          vbus-supply: true

      # It can be necessary to adjust the PHY settings to compensate parasitics, which can be due
      # to USB connector/receptacle, routing, ESD protection component,... Here is the list of
      # all optional parameters to tune the interface of the PHY (HS for High-Speed, FS for Full-
      # Speed, LS for Low-Speed)

      st,current-boost-microamp:
        description: Current boosting in uA
        enum: [ 1000, 2000 ]

      st,no-lsfs-fb-cap:
        description: Disables the LS/FS feedback capacitor
        type: boolean

      st,decrease-hs-slew-rate:
        description: Decreases the HS driver slew rate by 10%
        type: boolean

      st,tune-hs-dc-level:
        description: |
          Tunes the HS driver DC level
          - <0> normal level
          - <1> increases the level by 5 to 7 mV
          - <2> increases the level by 10 to 14 mV
          - <3> decreases the level by 5 to 7 mV
        $ref: /schemas/types.yaml#/definitions/uint32
        minimum: 0
        maximum: 3
        default: 0

      st,enable-fs-rftime-tuning:
        description: Enables the FS rise/fall tuning option
        type: boolean

      st,enable-hs-rftime-reduction:
        description: Enables the HS rise/fall reduction feature
        type: boolean

      st,trim-hs-current:
        description: |
          Controls HS driver current trimming for choke compensation
          - <0> = 18.87 mA target current / nominal + 0%
          - <1> = 19.165 mA target current / nominal + 1.56%
          - <2> = 19.46 mA target current / nominal + 3.12%
          - <3> = 19.755 mA target current / nominal + 4.68%
          - <4> = 20.05 mA target current / nominal + 6.24%
          - <5> = 20.345 mA target current / nominal + 7.8%
          - <6> = 20.64 mA target current / nominal + 9.36%
          - <7> = 20.935 mA target current / nominal + 10.92%
          - <8> = 21.23 mA target current / nominal + 12.48%
          - <9> = 21.525 mA target current / nominal + 14.04%
          - <10> = 21.82 mA target current / nominal + 15.6%
          - <11> = 22.115 mA target current / nominal + 17.16%
          - <12> = 22.458 mA target current / nominal + 19.01%
          - <13> = 22.755 mA target current / nominal + 20.58%
          - <14> = 23.052 mA target current / nominal + 22.16%
          - <15> = 23.348 mA target current / nominal + 23.73%
        $ref: /schemas/types.yaml#/definitions/uint32
        minimum: 0
        maximum: 15
        default: 0

      st,trim-hs-impedance:
        description: |
          Controls HS driver impedance tuning for choke compensation
          - <0> = no impedance offset
          - <1> = reduce the impedance by 2 ohms
          - <2> = reduce the impedance by 4 ohms
          - <3> = reduce the impedance by 6 ohms
        $ref: /schemas/types.yaml#/definitions/uint32
        minimum: 0
        maximum: 3
        default: 0

      st,tune-squelch-level:
        description: |
          Tunes the squelch DC threshold value
          - <0> = no shift in threshold
          - <1> = threshold shift by +7 mV
          - <2> = threshold shift by -5 mV
          - <3> = threshold shift by +14 mV
        $ref: /schemas/types.yaml#/definitions/uint32
        minimum: 0
        maximum: 3
        default: 0

      st,enable-hs-rx-gain-eq:
        description: Enables the HS Rx gain equalizer
        type: boolean

      st,tune-hs-rx-offset:
        description: |
          Adjusts the HS Rx offset
          - <0> = no offset
          - <1> = offset of +5 mV
          - <2> = offset of +10 mV
          - <3> = offset of -5 mV
        $ref: /schemas/types.yaml#/definitions/uint32
        minimum: 0
        maximum: 3
        default: 0

      st,no-hs-ftime-ctrl:
        description: Disables the HS fall time control of single ended signals during pre-emphasis
        type: boolean

      st,no-lsfs-sc:
        description: Disables the short circuit protection in LS/FS driver
        type: boolean

      st,enable-hs-tx-staggering:
        description: Enables the basic staggering in HS Tx mode
        type: boolean

    allOf:
      - if:
          properties:
            reg:
              const: 0
        then:
          properties:
            "#phy-cells":
              const: 0
        else:
          properties:
            "#phy-cells":
              const: 1
              description:
                The value is used to select UTMI switch output.
                0 for OTG controller and 1 for Host controller.

    required:
      - reg
      - phy-supply
      - "#phy-cells"

    additionalProperties: false

required:
  - compatible
  - reg
  - clocks
  - "#address-cells"
  - "#size-cells"
  - vdda1v1-supply
  - vdda1v8-supply
  - usb-phy@0
  - usb-phy@1

additionalProperties: false

examples:
  - |
    #include <dt-bindings/clock/stm32mp1-clks.h>
    #include <dt-bindings/reset/stm32mp1-resets.h>
    usbphyc: usbphyc@5a006000 {
        compatible = "st,stm32mp1-usbphyc";
        reg = <0x5a006000 0x1000>;
        clocks = <&rcc USBPHY_K>;
        resets = <&rcc USBPHY_R>;
        vdda1v1-supply = <&reg11>;
        vdda1v8-supply = <&reg18>;
        #address-cells = <1>;
        #size-cells = <0>;
        #clock-cells = <0>;

        usbphyc_port0: usb-phy@0 {
            reg = <0>;
            phy-supply = <&vdd_usb>;
            #phy-cells = <0>;
            st,tune-hs-dc-level = <2>;
            st,enable-fs-rftime-tuning;
            st,enable-hs-rftime-reduction;
            st,trim-hs-current = <15>;
            st,trim-hs-impedance = <1>;
            st,tune-squelch-level = <3>;
            st,tune-hs-rx-offset = <2>;
            st,no-lsfs-sc;
            connector {
                compatible = "usb-a-connector";
                vbus-supply = <&vbus_sw>;
            };
        };

        usbphyc_port1: usb-phy@1 {
            reg = <1>;
            phy-supply = <&vdd_usb>;
            #phy-cells = <1>;
            st,tune-hs-dc-level = <2>;
            st,enable-fs-rftime-tuning;
            st,enable-hs-rftime-reduction;
            st,trim-hs-current = <15>;
            st,trim-hs-impedance = <1>;
            st,tune-squelch-level = <3>;
            st,tune-hs-rx-offset = <2>;
            st,no-lsfs-sc;
        };
    };
...
```

## Documentation/devicetree/bindings/phy/phy-tegra194-p2u.txt
```
NVIDIA Tegra194 P2U binding

Tegra194 has two PHY bricks namely HSIO (High Speed IO) and NVHS (NVIDIA High
Speed) each interfacing with 12 and 8 P2U instances respectively.
A P2U instance is a glue logic between Synopsys DesignWare Core PCIe IP's PIPE
interface and PHY of HSIO/NVHS bricks. Each P2U instance represents one PCIe
lane.

Required properties:
- compatible: For Tegra19x, must contain "nvidia,tegra194-p2u".
- reg: Should be the physical address space and length of respective each P2U
       instance.
- reg-names: Must include the entry "ctl".

Required properties for PHY port node:
- #phy-cells: Defined by generic PHY bindings.  Must be 0.

Refer to phy/phy-bindings.txt for the generic PHY binding properties.

Example:

p2u_hsio_0: phy@3e10000 {
	compatible = "nvidia,tegra194-p2u";
	reg = <0x03e10000 0x10000>;
	reg-names = "ctl";

	#phy-cells = <0>;
};
```

## Documentation/devicetree/bindings/phy/phy-tegra194-p2u.yaml
```yaml
# SPDX-License-Identifier: (GPL-2.0 OR BSD-2-Clause)
%YAML 1.2
---
$id: "http://devicetree.org/schemas/phy/phy-tegra194-p2u.yaml#"
$schema: "http://devicetree.org/meta-schemas/core.yaml#"

title: NVIDIA Tegra194 & Tegra234 P2U

maintainers:
  - Thierry Reding <treding@nvidia.com>

description: >
  Tegra194 has two PHY bricks namely HSIO (High Speed IO) and NVHS (NVIDIA High
  Speed) each interfacing with 12 and 8 P2U instances respectively.
  Tegra234 has three PHY bricks namely HSIO, NVHS and GBE (Gigabit Ethernet)
  each interfacing with 8, 8 and 8 P2U instances respectively.
  A P2U instance is a glue logic between Synopsys DesignWare Core PCIe IP's PIPE
  interface and PHY of HSIO/NVHS/GBE bricks. Each P2U instance represents one
  PCIe lane.

properties:
  compatible:
    enum:
      - nvidia,tegra194-p2u
      - nvidia,tegra234-p2u

  reg:
    maxItems: 1
    description: Should be the physical address space and length of respective each P2U instance.

  reg-names:
    items:
      - const: ctl

  nvidia,skip-sz-protect-en:
    description: Should be present if two PCIe retimers are present between
      the root port and its immediate downstream device.
    type: boolean

  '#phy-cells':
    const: 0

additionalProperties: false

examples:
  - |
    p2u_hsio_0: phy@3e10000 {
        compatible = "nvidia,tegra194-p2u";
        reg = <0x03e10000 0x10000>;
        reg-names = "ctl";

        #phy-cells = <0>;
    };
```

## Documentation/devicetree/bindings/phy/pistachio-usb-phy.txt
```
IMG Pistachio USB PHY
=====================

Required properties:
--------------------
 - compatible: Must be "img,pistachio-usb-phy".
 - #phy-cells: Must be 0.  See ./phy-bindings.txt for details.
 - clocks: Must contain an entry for each entry in clock-names.
   See ../clock/clock-bindings.txt for details.
 - clock-names: Must include "usb_phy".
 - img,cr-top: Must contain a phandle to the CR_TOP syscon node.
 - img,refclk: Indicates the reference clock source for the USB PHY.
   See <dt-bindings/phy/phy-pistachio-usb.h> for a list of valid values.

Optional properties:
--------------------
 - phy-supply: USB VBUS supply.  Must supply 5.0V.

Example:
--------
usb_phy: usb-phy {
	compatible = "img,pistachio-usb-phy";
	clocks = <&clk_core CLK_USB_PHY>;
	clock-names = "usb_phy";
	phy-supply = <&usb_vbus>;
	img,refclk = <REFCLK_CLK_CORE>;
	img,cr-top = <&cr_top>;
	#phy-cells = <0>;
};
```

## Documentation/devicetree/bindings/phy/pxa1928-usb-phy.txt
```
* Marvell PXA1928 USB and HSIC PHYs

Required properties:
- compatible: "marvell,pxa1928-usb-phy" or "marvell,pxa1928-hsic-phy"
- reg: base address and length of the registers
- clocks - A single clock. From common clock binding.
- #phys-cells: should be 0. From common phy binding.
- resets: reference to the reset controller

Example:

	usbphy: phy@7000 {
		compatible = "marvell,pxa1928-usb-phy";
		reg = <0x7000 0xe0>;
		clocks = <&apmu_clocks PXA1928_CLK_USB>;
		#phy-cells = <0>;
	};
```

## Documentation/devicetree/bindings/phy/qca,ar7100-usb-phy.yaml
```yaml
# SPDX-License-Identifier: (GPL-2.0-only OR BSD-2-Clause)
%YAML 1.2
---
$id: http://devicetree.org/schemas/phy/qca,ar7100-usb-phy.yaml#
$schema: http://devicetree.org/meta-schemas/core.yaml#

title: Atheros AR71XX/9XXX USB PHY

maintainers:
  - Alban Bedel <albeu@free.fr>

properties:
  compatible:
    items:
      - const: qca,ar7100-usb-phy

  reset-names:
    description: Names of reset lines in order.
    minItems: 1
    items:
      - const: phy
      - const: suspend-override

  resets:
    description: References to the reset controllers.
    minItems: 1
    items:
      - description: Reset controller for phy
      - description: Reset controller for suspend-override

  '#phy-cells':
    const: 0

required:
  - compatible
  - reset-names
  - resets
  - '#phy-cells'

additionalProperties: false

examples:
  - |
    usb-phy {
        compatible = "qca,ar7100-usb-phy";
        reset-names = "phy", "suspend-override";
        resets = <&rst 4>, <&rst 3>;
        #phy-cells = <0>;
    };
```

## Documentation/devicetree/bindings/phy/qcom,edp-phy.yaml
```yaml
# SPDX-License-Identifier: (GPL-2.0 OR BSD-2-Clause)

%YAML 1.2
---
$id: http://devicetree.org/schemas/phy/qcom,edp-phy.yaml#
$schema: http://devicetree.org/meta-schemas/core.yaml#

title: Qualcomm eDP PHY

maintainers:
  - Bjorn Andersson <bjorn.andersson@linaro.org>

description:
  The Qualcomm eDP PHY is found in a number of Qualcomm platform and provides
  the physical interface for Embedded Display Port.

properties:
  compatible:
    enum:
      - qcom,sa8775p-edp-phy
      - qcom,sc7280-edp-phy
      - qcom,sc8180x-edp-phy
      - qcom,sc8280xp-dp-phy
      - qcom,sc8280xp-edp-phy
      - qcom,x1e80100-dp-phy

  reg:
    items:
      - description: PHY base register block
      - description: tx0 register block
      - description: tx1 register block
      - description: PLL register block

  clocks:
    maxItems: 2

  clock-names:
    items:
      - const: aux
      - const: cfg_ahb

  "#clock-cells":
    const: 1

  "#phy-cells":
    const: 0

  power-domains:
    maxItems: 1

  vdda-phy-supply: true
  vdda-pll-supply: true

required:
  - compatible
  - reg
  - clocks
  - clock-names
  - "#clock-cells"
  - "#phy-cells"

additionalProperties: false

examples:
  - |
    phy@aec2a00 {
      compatible = "qcom,sc8180x-edp-phy";
      reg = <0x0aec2a00 0x1c0>,
            <0x0aec2200 0xa0>,
            <0x0aec2600 0xa0>,
            <0x0aec2000 0x19c>;

      clocks = <&dispcc 0>, <&dispcc 1>;
      clock-names = "aux", "cfg_ahb";

      #clock-cells = <1>;
      #phy-cells = <0>;

      vdda-phy-supply = <&vdd_a_edp_0_1p2>;
      vdda-pll-supply = <&vdd_a_edp_0_0p9>;
    };
...
```
