## Documentation/devicetree/bindings/phy/rockchip-mipi-dphy-rx0.yaml
```yaml
# SPDX-License-Identifier: (GPL-2.0+ OR MIT)
%YAML 1.2
---
$id: http://devicetree.org/schemas/phy/rockchip-mipi-dphy-rx0.yaml#
$schema: http://devicetree.org/meta-schemas/core.yaml#

title: Rockchip SoC MIPI RX0 D-PHY

maintainers:
  - Helen Koike <helen.koike@collabora.com>
  - Ezequiel Garcia <ezequiel@collabora.com>

description: |
  The Rockchip SoC has a MIPI D-PHY bus with an RX0 entry which connects to
  the ISP1 (Image Signal Processing unit v1.0) for CSI cameras.

properties:
  compatible:
    const: rockchip,rk3399-mipi-dphy-rx0

  clocks:
    items:
      - description: MIPI D-PHY ref clock
      - description: MIPI D-PHY RX0 cfg clock
      - description: Video in/out general register file clock

  clock-names:
    items:
      - const: dphy-ref
      - const: dphy-cfg
      - const: grf

  '#phy-cells':
    const: 0

  power-domains:
    description: Video in/out power domain.
    maxItems: 1

required:
  - compatible
  - clocks
  - clock-names
  - '#phy-cells'
  - power-domains

additionalProperties: false

examples:
  - |

    /*
     * MIPI D-PHY RX0 use registers in "general register files", it
     * should be a child of the GRF.
     *
     * grf: syscon@ff770000 {
     *  compatible = "rockchip,rk3399-grf", "syscon", "simple-mfd";
     *  ...
     * };
     */

    #include <dt-bindings/clock/rk3399-cru.h>
    #include <dt-bindings/power/rk3399-power.h>

    mipi_dphy_rx0: mipi-dphy-rx0 {
        compatible = "rockchip,rk3399-mipi-dphy-rx0";
        clocks = <&cru SCLK_MIPIDPHY_REF>,
                 <&cru SCLK_DPHY_RX0_CFG>,
                 <&cru PCLK_VIO_GRF>;
        clock-names = "dphy-ref", "dphy-cfg", "grf";
        power-domains = <&power RK3399_PD_VIO>;
        #phy-cells = <0>;
    };
```

## Documentation/devicetree/bindings/phy/rockchip-pcie-phy.txt
```
Rockchip PCIE PHY
-----------------------

Required properties:
 - compatible: rockchip,rk3399-pcie-phy
 - #phy-cells: must be 0
 - clocks: Must contain an entry in clock-names.
	See ../clocks/clock-bindings.txt for details.
 - clock-names: Must be "refclk"
 - resets: Must contain an entry in reset-names.
	See ../reset/reset.txt for details.
 - reset-names: Must be "phy"

Example:

grf: syscon@ff770000 {
	compatible = "rockchip,rk3399-grf", "syscon", "simple-mfd";
	#address-cells = <1>;
	#size-cells = <1>;

	...

	pcie_phy: pcie-phy {
		compatible = "rockchip,rk3399-pcie-phy";
		#phy-cells = <0>;
		clocks = <&cru SCLK_PCIEPHY_REF>;
		clock-names = "refclk";
		resets = <&cru SRST_PCIEPHY>;
		reset-names = "phy";
	};
};
```

## Documentation/devicetree/bindings/phy/rockchip-usb-phy.txt
```
ROCKCHIP USB2 PHY

Required properties:
 - compatible: matching the soc type, one of
     "rockchip,rk3066a-usb-phy"
     "rockchip,rk3188-usb-phy"
     "rockchip,rk3288-usb-phy"
 - #address-cells: should be 1
 - #size-cells: should be 0

Deprecated properties:
 - rockchip,grf : phandle to the syscon managing the "general
   register files" - phy should be a child of the GRF instead

Sub-nodes:
Each PHY should be represented as a sub-node.

Sub-nodes
required properties:
- #phy-cells: should be 0
- reg: PHY configure reg address offset in GRF
		"0x320" - for PHY attach to OTG controller
		"0x334" - for PHY attach to HOST0 controller
		"0x348" - for PHY attach to HOST1 controller

Optional Properties:
- clocks : phandle + clock specifier for the phy clocks
- clock-names: string, clock name, must be "phyclk"
- #clock-cells: for users of the phy-pll, should be 0

Example:

grf: syscon@ff770000 {
	compatible = "rockchip,rk3288-grf", "syscon", "simple-mfd";

...

	usbphy: phy {
		compatible = "rockchip,rk3288-usb-phy";
		#address-cells = <1>;
		#size-cells = <0>;

		usbphy0: usb-phy0 {
			#phy-cells = <0>;
			reg = <0x320>;
		};
	};
};
```

## Documentation/devicetree/bindings/phy/rockchip-usb-phy.yaml
```yaml
# SPDX-License-Identifier: GPL-2.0
%YAML 1.2
---
$id: http://devicetree.org/schemas/phy/rockchip-usb-phy.yaml#
$schema: http://devicetree.org/meta-schemas/core.yaml#

title: Rockchip USB2.0 phy

maintainers:
  - Heiko Stuebner <heiko@sntech.de>

properties:
  compatible:
    enum:
      - rockchip,rk3066a-usb-phy
      - rockchip,rk3188-usb-phy
      - rockchip,rk3288-usb-phy

  "#address-cells":
    const: 1

  "#size-cells":
    const: 0

required:
  - compatible
  - "#address-cells"
  - "#size-cells"

additionalProperties: false

patternProperties:
  "usb-phy@[0-9a-f]+$":
    type: object

    properties:
      reg:
        maxItems: 1

      "#phy-cells":
        const: 0

      clocks:
        maxItems: 1

      clock-names:
        const: phyclk

      "#clock-cells":
        const: 0

      resets:
        maxItems: 1

      reset-names:
        const: phy-reset

      vbus-supply:
        description: phandle for vbus power source

    required:
      - reg
      - "#phy-cells"

    additionalProperties: false

examples:
  - |
    usbphy: usbphy {
      compatible = "rockchip,rk3288-usb-phy";
      #address-cells = <1>;
      #size-cells = <0>;

      usbphy0: usb-phy@320 {
        reg = <0x320>;
        #phy-cells = <0>;
      };
    };
```

## Documentation/devicetree/bindings/phy/samsung,dp-video-phy.yaml
```yaml
# SPDX-License-Identifier: GPL-2.0-only OR BSD-2-Clause
%YAML 1.2
---
$id: http://devicetree.org/schemas/phy/samsung,dp-video-phy.yaml#
$schema: http://devicetree.org/meta-schemas/core.yaml#

title: Samsung Exynos SoC DisplayPort PHY

maintainers:
  - Krzysztof Kozlowski <krzk@kernel.org>
  - Marek Szyprowski <m.szyprowski@samsung.com>
  - Sylwester Nawrocki <s.nawrocki@samsung.com>

properties:
  compatible:
    enum:
      - samsung,exynos5250-dp-video-phy
      - samsung,exynos5420-dp-video-phy

  "#phy-cells":
    const: 0

  samsung,pmu-syscon:
    $ref: /schemas/types.yaml#/definitions/phandle
    description:
      Phandle to PMU system controller interface.

required:
  - compatible
  - "#phy-cells"
  - samsung,pmu-syscon

additionalProperties: false

examples:
  - |
    phy {
        compatible = "samsung,exynos5420-dp-video-phy";
        samsung,pmu-syscon = <&pmu_system_controller>;
        #phy-cells = <0>;
    };
```

## Documentation/devicetree/bindings/phy/samsung,exynos-hdmi-phy.yaml
```yaml
# SPDX-License-Identifier: (GPL-2.0-only OR BSD-2-Clause)
%YAML 1.2
---
$id: http://devicetree.org/schemas/phy/samsung,exyanals-hdmi-phy.yaml#
$schema: http://devicetree.org/meta-schemas/core.yaml#

title: Samsung Exyanals SoC HDMI PHY

maintainers:
  - Inki Dae <inki.dae@samsung.com>
  - Seung-Woo Kim <sw0312.kim@samsung.com>
  - Kyungmin Park <kyungmin.park@samsung.com>
  - Krzysztof Kozlowski <krzk@kernel.org>

properties:
  compatible:
    oneOf:
      - enum:
          - samsung,exyanals4210-hdmiphy
          - samsung,exyanals4212-hdmiphy
      - const: samsung,exyanals5-hdmiphy
        deprecated: true

  reg:
    maxItems: 1

required:
  - compatible
  - reg

additionalProperties: false

examples:
  - |
    i2c {
        #address-cells = <1>;
        #size-cells = <0>;

        hdmi-phy@38 {
            compatible = "samsung,exyanals4210-hdmiphy";
            reg = <0x38>;
        };
    };
```

## Documentation/devicetree/bindings/phy/samsung,exynos-pcie-phy.yaml
```yaml
# SPDX-License-Identifier: GPL-2.0-only OR BSD-2-Clause
%YAML 1.2
---
$id: http://devicetree.org/schemas/phy/samsung,exynos-pcie-phy.yaml#
$schema: http://devicetree.org/meta-schemas/core.yaml#

title: Samsung SoC series PCIe PHY Device Tree Bindings

maintainers:
  - Marek Szyprowski <m.szyprowski@samsung.com>
  - Jaehoon Chung <jh80.chung@samsung.com>

properties:
  "#phy-cells":
    const: 0

  compatible:
    const: samsung,exynos5433-pcie-phy

  reg:
    maxItems: 1

  samsung,pmu-syscon:
    $ref: '/schemas/types.yaml#/definitions/phandle'
    description: phandle for PMU system controller interface, used to
                 control PMU registers bits for PCIe PHY

  samsung,fsys-sysreg:
    $ref: '/schemas/types.yaml#/definitions/phandle'
    description: phandle for FSYS sysreg interface, used to control
                 sysreg registers bits for PCIe PHY

required:
  - "#phy-cells"
  - compatible
  - reg
  - samsung,pmu-syscon
  - samsung,fsys-sysreg

additionalProperties: false

examples:
  - |
    pcie_phy: pcie-phy@15680000 {
        compatible = "samsung,exynos5433-pcie-phy";
        reg = <0x15680000 0x1000>;
        samsung,pmu-syscon = <&pmu_system_controller>;
        samsung,fsys-sysreg = <&syscon_fsys>;
        #phy-cells = <0>;
    };
...
```
