## Documentation/devicetree/bindings/phy/renesas,r8a779f0-ether-serdes.yaml
```yaml
# SPDX-License-Identifier: (GPL-2.0-only OR BSD-2-Clause)
%YAML 1.2
---
$id: http://devicetree.org/schemas/phy/renesas,r8a779f0-ether-serdes.yaml#
$schema: http://devicetree.org/meta-schemas/core.yaml#

title: Renesas Ethernet SERDES

maintainers:
  - Yoshihiro Shimoda <yoshihiro.shimoda.uh@renesas.com>

properties:
  compatible:
    const: renesas,r8a779f0-ether-serdes

  reg:
    maxItems: 1

  clocks:
    maxItems: 1

  resets:
    maxItems: 1

  power-domains:
    maxItems: 1

  '#phy-cells':
    description: Port number of SERDES.
    const: 1

required:
  - compatible
  - reg
  - clocks
  - resets
  - power-domains
  - '#phy-cells'

additionalProperties: false

examples:
  - |
    #include <dt-bindings/clock/r8a779f0-cpg-mssr.h>
    #include <dt-bindings/power/r8a779f0-sysc.h>

    phy@e6444000 {
        compatible = "renesas,r8a779f0-ether-serdes";
        reg = <0xe6444000 0xc00>;
        clocks = <&cpg CPG_MOD 1506>;
        power-domains = <&sysc R8A779F0_PD_ALWAYS_ON>;
        resets = <&cpg 1506>;
        #phy-cells = <1>;
    };
```

## Documentation/devicetree/bindings/phy/renesas,rcar-gen2-usb-phy.yaml
```yaml
# SPDX-License-Identifier: (GPL-2.0-only OR BSD-2-Clause)
%YAML 1.2
---
$id: http://devicetree.org/schemas/phy/renesas,rcar-gen2-usb-phy.yaml#
$schema: http://devicetree.org/meta-schemas/core.yaml#

title: Renesas R-Car Gen2 USB PHY

maintainers:
  - Yoshihiro Shimoda <yoshihiro.shimoda.uh@renesas.com>

properties:
  compatible:
    items:
      - enum:
          - renesas,usb-phy-r8a7742      # RZ/G1H
          - renesas,usb-phy-r8a7743      # RZ/G1M
          - renesas,usb-phy-r8a7744      # RZ/G1N
          - renesas,usb-phy-r8a7745      # RZ/G1E
          - renesas,usb-phy-r8a77470     # RZ/G1C
          - renesas,usb-phy-r8a7790      # R-Car H2
          - renesas,usb-phy-r8a7791      # R-Car M2-W
          - renesas,usb-phy-r8a7794      # R-Car E2
      - const: renesas,rcar-gen2-usb-phy # R-Car Gen2 or RZ/G1

  reg:
    maxItems: 1

  '#address-cells':
    const: 1

  '#size-cells':
    const: 0

  clocks:
    maxItems: 1

  clock-names:
    items:
      - const: usbhs

  power-domains:
    maxItems: 1

  resets:
    maxItems: 1

patternProperties:
  "^usb-phy@[02]$":
    type: object
    description: Subnode corresponding to a USB channel.

    properties:
      reg:
        description: FIXME RZ/G1C supports channel 0 only
        enum: [0, 2]

      '#phy-cells':
        description: |
          The phandle's argument in the PHY specifier is the USB controller
          selector for the USB channel.
          For RZ/G1C:
            - 0 for EHCI/OHCI
            - 1 for HS-USB
          For all other SoCS:
            - 0 for PCI EHCI/OHCI
            - 1 for HS-USB (channel 0) or xHCI (channel 2)
        const: 1

    required:
      - reg
      - '#phy-cells'

    additionalProperties: false

required:
  - compatible
  - reg
  - '#address-cells'
  - '#size-cells'
  - clocks
  - clock-names
  - resets
  - power-domains
  - usb-phy@0

if:
  properties:
    compatible:
      contains:
        const: renesas,usb-phy-r8a77470
then:
  properties:
    usb-phy@2: false
else:
  required:
    - usb-phy@2

additionalProperties: false

examples:
  - |
    #include <dt-bindings/clock/r8a7790-cpg-mssr.h>
    #include <dt-bindings/power/r8a7790-sysc.h>
    usb-phy-controller@e6590100 {
        compatible = "renesas,usb-phy-r8a7790", "renesas,rcar-gen2-usb-phy";
        reg = <0xe6590100 0x100>;
        #address-cells = <1>;
        #size-cells = <0>;
        clocks = <&cpg CPG_MOD 704>;
        clock-names = "usbhs";
        power-domains = <&sysc R8A7790_PD_ALWAYS_ON>;
        resets = <&cpg 704>;

        usb0: usb-phy@0 {
            reg = <0>;
            #phy-cells = <1>;
        };
        usb2: usb-phy@2 {
            reg = <2>;
            #phy-cells = <1>;
        };
    };
```

## Documentation/devicetree/bindings/phy/renesas,rcar-gen3-pcie-phy.yaml
```yaml
# SPDX-License-Identifier: (GPL-2.0-only OR BSD-2-Clause)
%YAML 1.2
---
$id: http://devicetree.org/schemas/phy/renesas,rcar-gen3-pcie-phy.yaml#
$schema: http://devicetree.org/meta-schemas/core.yaml#

title: Renesas R-Car Generation 3 PCIe PHY

maintainers:
  - Sergei Shtylyov <sergei.shtylyov@gmail.com>

properties:
  compatible:
    const: renesas,r8a77980-pcie-phy

  reg:
    maxItems: 1

  clocks:
    maxItems: 1

  power-domains:
    maxItems: 1

  resets:
    maxItems: 1

  '#phy-cells':
    const: 0

required:
  - compatible
  - reg
  - clocks
  - power-domains
  - resets
  - '#phy-cells'

additionalProperties: false

examples:
  - |
    #include <dt-bindings/clock/r8a77980-cpg-mssr.h>
    #include <dt-bindings/power/r8a77980-sysc.h>

    pcie-phy@e65d0000 {
            compatible = "renesas,r8a77980-pcie-phy";
            reg = <0xe65d0000 0x8000>;
            #phy-cells = <0>;
            clocks = <&cpg CPG_MOD 319>;
            power-domains = <&sysc R8A77980_PD_ALWAYS_ON>;
            resets = <&cpg 319>;
    };
```

## Documentation/devicetree/bindings/phy/renesas,rzg3e-usb3-phy.yaml
```yaml
# SPDX-License-Identifier: (GPL-2.0-only OR BSD-2-Clause)
%YAML 1.2
---
$id: http://devicetree.org/schemas/phy/renesas,rzg3e-usb3-phy.yaml#
$schema: http://devicetree.org/meta-schemas/core.yaml#

title: Renesas RZ/G3E USB 3.0 PHY

maintainers:
  - Biju Das <biju.das.jz@bp.renesas.com>

properties:
  compatible:
    const: renesas,r9a09g047-usb3-phy

  reg:
    maxItems: 1

  clocks:
    items:
      - description: APB bus clock
      - description: USB 2.0 PHY reference clock
      - description: USB 3.0 PHY reference clock

  clock-names:
    items:
      - const: pclk
      - const: core
      - const: ref_alt_clk_p

  power-domains:
    maxItems: 1

  resets:
    maxItems: 1

  '#phy-cells':
    const: 0

required:
  - compatible
  - reg
  - clocks
  - clock-names
  - power-domains
  - resets
  - '#phy-cells'

additionalProperties: false

examples:
  - |
    #include <dt-bindings/clock/renesas,r9a09g047-cpg.h>

    usb-phy@15870000 {
        compatible = "renesas,r9a09g047-usb3-phy";
        reg = <0x15870000 0x10000>;
        clocks = <&cpg CPG_MOD 0xb0>, <&cpg CPG_CORE 13>, <&cpg CPG_CORE 12>;
        clock-names = "pclk", "core", "ref_alt_clk_p";
        power-domains = <&cpg>;
        resets = <&cpg 0xaa>;
        #phy-cells = <0>;
    };
```

## Documentation/devicetree/bindings/phy/renesas,usb2-phy.yaml
```yaml
# SPDX-License-Identifier: (GPL-2.0-only OR BSD-2-Clause)
%YAML 1.2
---
$id: http://devicetree.org/schemas/phy/renesas,usb2-phy.yaml#
$schema: http://devicetree.org/meta-schemas/core.yaml#

title: Renesas R-Car generation 3 USB 2.0 PHY

maintainers:
  - Yoshihiro Shimoda <yoshihiro.shimoda.uh@renesas.com>

properties:
  compatible:
    oneOf:
      - items:
          - const: renesas,usb2-phy-r8a77470 # RZ/G1C

      - items:
          - enum:
              - renesas,usb2-phy-r7s9210  # RZ/A2
              - renesas,usb2-phy-r8a774a1 # RZ/G2M
              - renesas,usb2-phy-r8a774b1 # RZ/G2N
              - renesas,usb2-phy-r8a774c0 # RZ/G2E
              - renesas,usb2-phy-r8a774e1 # RZ/G2H
              - renesas,usb2-phy-r8a7795  # R-Car H3
              - renesas,usb2-phy-r8a7796  # R-Car M3-W
              - renesas,usb2-phy-r8a77961 # R-Car M3-W+
              - renesas,usb2-phy-r8a77965 # R-Car M3-N
              - renesas,usb2-phy-r8a77990 # R-Car E3
              - renesas,usb2-phy-r8a77995 # R-Car D3
          - const: renesas,rcar-gen3-usb2-phy

  reg:
    maxItems: 1

  clocks:
    minItems: 1
    maxItems: 2

  clock-names:
    minItems: 1
    items:
      - const: fck
      - const: usb_x1

  '#phy-cells':
    enum: [0, 1]  # and 0 is deprecated.
    description: |
      The phandle's argument in the PHY specifier is the INT_STATUS bit of
      controller.
      - 1 = USBH_INTA (OHCI)
      - 2 = USBH_INTB (EHCI)
      - 3 = UCOM_INT (OTG and BC)

  interrupts:
    maxItems: 1

  power-domains:
    maxItems: 1

  resets:
    minItems: 1
    items:
      - description: reset of USB 2.0 host side
      - description: reset of USB 2.0 peripheral side

  vbus-supply:
    description: |
      Phandle to a regulator that provides power to the VBUS. This regulator
      will be managed during the PHY power on/off sequence.

  renesas,no-otg-pins:
    $ref: /schemas/types.yaml#/definitions/flag
    description: |
      specify when a board does not provide proper otg pins.

  dr_mode: true

if:
  properties:
    compatible:
      contains:
        const: renesas,usb2-phy-r7s9210
then:
  required:
    - clock-names

required:
  - compatible
  - reg
  - clocks
  - '#phy-cells'

additionalProperties: false

examples:
  - |
    #include <dt-bindings/clock/r8a7795-cpg-mssr.h>
    #include <dt-bindings/interrupt-controller/arm-gic.h>
    #include <dt-bindings/power/r8a7795-sysc.h>

    usb-phy@ee080200 {
        compatible = "renesas,usb2-phy-r8a7795", "renesas,rcar-gen3-usb2-phy";
        reg = <0xee080200 0x700>;
        interrupts = <GIC_SPI 108 IRQ_TYPE_LEVEL_HIGH>;
        clocks = <&cpg CPG_MOD 703>;
        #phy-cells = <1>;
    };

    usb-phy@ee0a0200 {
        compatible = "renesas,usb2-phy-r8a7795", "renesas,rcar-gen3-usb2-phy";
        reg = <0xee0a0200 0x700>;
        clocks = <&cpg CPG_MOD 702>;
        #phy-cells = <1>;
    };
```

## Documentation/devicetree/bindings/phy/renesas,usb3-phy.yaml
```yaml
# SPDX-License-Identifier: (GPL-2.0-only OR BSD-2-Clause)
%YAML 1.2
---
$id: http://devicetree.org/schemas/phy/renesas,usb3-phy.yaml#
$schema: http://devicetree.org/meta-schemas/core.yaml#

title: Renesas R-Car generation 3 USB 3.0 PHY

maintainers:
  - Yoshihiro Shimoda <yoshihiro.shimoda.uh@renesas.com>

properties:
  compatible:
    items:
      - enum:
          - renesas,r8a774a1-usb3-phy # RZ/G2M
          - renesas,r8a774b1-usb3-phy # RZ/G2N
          - renesas,r8a774e1-usb3-phy # RZ/G2H
          - renesas,r8a7795-usb3-phy  # R-Car H3
          - renesas,r8a7796-usb3-phy  # R-Car M3-W
          - renesas,r8a77961-usb3-phy # R-Car M3-W+
          - renesas,r8a77965-usb3-phy # R-Car M3-N
      - const: renesas,rcar-gen3-usb3-phy

  reg:
    maxItems: 1

  clocks:
    minItems: 2
    maxItems: 3

  clock-names:
    # If you want to use the ssc, the clock-frequency of usb_extal
    # must not be 0.
    minItems: 2
    items:
      - const: usb3-if # The funcional clock
      - const: usb3s_clk # The usb3's external clock
      - const: usb_extal # The usb2's external clock

  '#phy-cells':
    # see phy-bindings.txt in the same directory
    const: 0

  power-domains:
    maxItems: 1

  resets:
    maxItems: 1

  renesas,ssc-range:
    description: |
      Enable/disable spread spectrum clock (ssc). 0 or the property doesn't
      exist means disabling the ssc. The actual value will be -<value> ppm.
    $ref: /schemas/types.yaml#/definitions/uint32
    enum: [ 0, 4003, 4492, 4980 ]

required:
  - compatible
  - reg
  - clocks
  - clock-names
  - '#phy-cells'

additionalProperties: false

examples:
  - |
    #include <dt-bindings/clock/r8a7795-cpg-mssr.h>
    #include <dt-bindings/power/r8a7795-sysc.h>

    usb-phy@e65ee000 {
        compatible = "renesas,r8a7795-usb3-phy", "renesas,rcar-gen3-usb3-phy";
        reg = <0xe65ee000 0x90>;
        clocks = <&cpg CPG_MOD 328>, <&usb3s0_clk>, <&usb_extal>;
        clock-names = "usb3-if", "usb3s_clk", "usb_extal";
        #phy-cells = <0>;
    };
```

## Documentation/devicetree/bindings/phy/rockchip,pcie3-phy.yaml
```yaml
# SPDX-License-Identifier: (GPL-2.0-only OR BSD-2-Clause)
%YAML 1.2
---
$id: http://devicetree.org/schemas/phy/rockchip,pcie3-phy.yaml#
$schema: http://devicetree.org/meta-schemas/core.yaml#

title: Rockchip PCIe v3 phy

maintainers:
  - Heiko Stuebner <heiko@sntech.de>

properties:
  compatible:
    enum:
      - rockchip,rk3568-pcie3-phy

  reg:
    maxItems: 1

  clocks:
    minItems: 3
    maxItems: 3

  clock-names:
    items:
      - const: refclk_m
      - const: refclk_n
      - const: pclk

  data-lanes:
    description: which lanes (by position) should be mapped to which
      controller (value). 0 means lane disabled, higher value means used.
      (controller-number +1 )
    $ref: /schemas/types.yaml#/definitions/uint32-array
    minItems: 2
    maxItems: 16
    items:
      minimum: 0
      maximum: 16

  "#phy-cells":
    const: 0

  resets:
    maxItems: 1

  reset-names:
    const: phy

  rockchip,phy-grf:
    $ref: /schemas/types.yaml#/definitions/phandle
    description: phandle to the syscon managing the phy "general register files"

  rockchip,pipe-grf:
    $ref: /schemas/types.yaml#/definitions/phandle
    description: phandle to the syscon managing the pipe "general register files"

required:
  - compatible
  - reg
  - rockchip,phy-grf
  - "#phy-cells"

additionalProperties: false

examples:
  - |
    #include <dt-bindings/clock/rk3568-cru.h>
    pcie30phy: phy@fe8c0000 {
      compatible = "rockchip,rk3568-pcie3-phy";
      reg = <0xfe8c0000 0x20000>;
      #phy-cells = <0>;
      clocks = <&pmucru CLK_PCIE30PHY_REF_M>,
               <&pmucru CLK_PCIE30PHY_REF_N>,
               <&cru PCLK_PCIE30PHY>;
      clock-names = "refclk_m", "refclk_n", "pclk";
      resets = <&cru SRST_PCIE30PHY>;
      reset-names = "phy";
      rockchip,phy-grf = <&pcie30_phy_grf>;
    };
```

## Documentation/devicetree/bindings/phy/rockchip,px30-dsi-dphy.yaml
```yaml
# SPDX-License-Identifier: (GPL-2.0 OR BSD-2-Clause)
%YAML 1.2
---
$id: http://devicetree.org/schemas/phy/rockchip,px30-dsi-dphy.yaml#
$schema: http://devicetree.org/meta-schemas/core.yaml#

title: Rockchip MIPI DPHY with additional LVDS/TTL modes

maintainers:
  - Heiko Stuebner <heiko@sntech.de>

properties:
  "#phy-cells":
    const: 0

  compatible:
    enum:
      - rockchip,px30-dsi-dphy
      - rockchip,rk3128-dsi-dphy
      - rockchip,rk3368-dsi-dphy
      - rockchip,rk3568-dsi-dphy

  reg:
    maxItems: 1

  clocks:
    items:
      - description: PLL reference clock
      - description: Module clock

  clock-names:
    items:
      - const: ref
      - const: pclk

  power-domains:
    maxItems: 1
    description: phandle to the associated power domain

  resets:
    items:
      - description: exclusive PHY reset line

  reset-names:
    items:
      - const: apb

required:
  - "#phy-cells"
  - compatible
  - reg
  - clocks
  - clock-names
  - resets
  - reset-names

additionalProperties: false

examples:
  - |
    dsi_dphy: phy@ff2e0000 {
        compatible = "rockchip,px30-dsi-dphy";
        reg = <0xff2e0000 0x10000>;
        clocks = <&pmucru 13>, <&cru 12>;
        clock-names = "ref", "pclk";
        resets = <&cru 12>;
        reset-names = "apb";
        #phy-cells = <0>;
    };

...
```
