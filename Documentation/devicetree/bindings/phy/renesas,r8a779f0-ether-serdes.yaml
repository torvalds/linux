## Documentation/devicetree/bindings/phy/rockchip,rk3228-hdmi-phy.yaml
```yaml
# SPDX-License-Identifier: (GPL-2.0-only OR BSD-2-Clause)
%YAML 1.2
---
$id: http://devicetree.org/schemas/phy/rockchip,rk3228-hdmi-phy.yaml#
$schema: http://devicetree.org/meta-schemas/core.yaml#

title: Rockchip HDMI PHY with Innosilicon IP block

maintainers:
  - Heiko Stuebner <heiko@sntech.de>

properties:
  compatible:
    enum:
      - rockchip,rk3228-hdmi-phy
      - rockchip,rk3328-hdmi-phy

  reg:
    maxItems: 1

  clocks:
    maxItems: 3

  clock-names:
    items:
      - const: sysclk
      - const: refoclk
      - const: refpclk

  clock-output-names:
    description:
      The hdmiphy output clock name, that gets fed back to the CRU.

  "#clock-cells":
    const: 0

  interrupts:
    maxItems: 1

  nvmem-cells:
    maxItems: 1
    description: A phandle + nvmem specifier for the cpu-version efuse
      for adjustment to some frequency settings, depending on cpu-version

  nvmem-cell-names:
    items:
      - const: cpu-version

  '#phy-cells':
    const: 0

required:
  - compatible
  - reg
  - clocks
  - clock-names
  - clock-output-names
  - '#clock-cells'
  - '#phy-cells'

allOf:
  - if:
      properties:
        compatible:
          contains:
            const: rockchip,rk3228-hdmi-phy

    then:
      properties:
        interrupts: false

  - if:
      properties:
        compatible:
          contains:
            const: rockchip,rk3328-hdmi-phy

    then:
      required:
        - interrupts

additionalProperties: false

examples:
  - |

    #include <dt-bindings/clock/rk3228-cru.h>
    hdmi_phy: phy@12030000 {
      compatible = "rockchip,rk3228-hdmi-phy";
      reg = <0x12030000 0x10000>;
      #phy-cells = <0>;
      clocks = <&cru PCLK_HDMI_PHY>, <&xin24m>, <&cru DCLK_HDMI_PHY>;
      clock-names = "sysclk", "refoclk", "refpclk";
      #clock-cells = <0>;

      clock-output-names = "hdmi_phy";
    };
```

## Documentation/devicetree/bindings/phy/rockchip,rk3288-dp-phy.yaml
```yaml
# SPDX-License-Identifier: GPL-2.0
%YAML 1.2
---
$id: http://devicetree.org/schemas/phy/rockchip,rk3288-dp-phy.yaml#
$schema: http://devicetree.org/meta-schemas/core.yaml#

title: Rockchip specific extensions to the Analogix Display Port PHY

maintainers:
  - Heiko Stuebner <heiko@sntech.de>

properties:
  compatible:
    const: rockchip,rk3288-dp-phy

  clocks:
    maxItems: 1

  clock-names:
    const: 24m

  "#phy-cells":
    const: 0

required:
  - compatible
  - clocks
  - clock-names
  - "#phy-cells"

additionalProperties: false

examples:
  - |
    #include <dt-bindings/clock/rk3288-cru.h>
    edp-phy {
      compatible = "rockchip,rk3288-dp-phy";
      clocks = <&cru SCLK_EDP_24M>;
      clock-names = "24m";
      #phy-cells = <0>;
    };
```

## Documentation/devicetree/bindings/phy/rockchip,rk3399-emmc-phy.yaml
```yaml
# SPDX-License-Identifier: GPL-2.0-only
%YAML 1.2
---
$id: http://devicetree.org/schemas/phy/rockchip,rk3399-emmc-phy.yaml#
$schema: http://devicetree.org/meta-schemas/core.yaml#

title: Rockchip EMMC PHY

maintainers:
  - Heiko Stuebner <heiko@sntech.de>

properties:
  compatible:
    const: rockchip,rk3399-emmc-phy

  reg:
    maxItems: 1

  clocks:
    maxItems: 1

  clock-names:
    const: emmcclk

  drive-impedance-ohm:
    $ref: /schemas/types.yaml#/definitions/uint32
    description:
      Specifies the drive impedance in Ohm.
    enum: [33, 40, 50, 66, 100]
    default: 50

  rockchip,enable-strobe-pulldown:
    type: boolean
    description: |
      Enable internal pull-down for the strobe
      line.  If not set, pull-down is not used.

  rockchip,output-tapdelay-select:
    $ref: /schemas/types.yaml#/definitions/uint32
    description:
      Specifies the phyctrl_otapdlysec register.
    default: 0x4
    maximum: 0xf

  "#phy-cells":
    const: 0

required:
  - compatible
  - reg
  - "#phy-cells"

additionalProperties: false

examples:
  - |
    phy@f780 {
      compatible = "rockchip,rk3399-emmc-phy";
      reg = <0xf780 0x20>;
      clocks = <&sdhci>;
      clock-names = "emmcclk";
      drive-impedance-ohm = <50>;
      #phy-cells = <0>;
    };
```

## Documentation/devicetree/bindings/phy/rockchip,rk3399-pcie-phy.yaml
```yaml
# SPDX-License-Identifier: GPL-2.0
%YAML 1.2
---
$id: http://devicetree.org/schemas/phy/rockchip,rk3399-pcie-phy.yaml#
$schema: http://devicetree.org/meta-schemas/core.yaml#

title: Rockchip RK3399 PCIE PHY

maintainers:
  - Heiko Stuebner <heiko@sntech.de>

properties:
  compatible:
    const: rockchip,rk3399-pcie-phy

  '#phy-cells':
    oneOf:
      - const: 0
        deprecated: true
      - const: 1
        description: One lane per phy mode

  clocks:
    maxItems: 1

  clock-names:
    const: refclk

  resets:
    maxItems: 1

  reset-names:
    const: phy

required:
  - compatible
  - '#phy-cells'
  - clocks
  - clock-names
  - resets
  - reset-names

additionalProperties: false

...
```

## Documentation/devicetree/bindings/phy/rockchip,rk3399-typec-phy.yaml
```yaml
# SPDX-License-Identifier: GPL-2.0
%YAML 1.2
---
$id: http://devicetree.org/schemas/phy/rockchip,rk3399-typec-phy.yaml#
$schema: http://devicetree.org/meta-schemas/core.yaml#

title: Rockchip Type-C PHY

maintainers:
  - Heiko Stuebner <heiko@sntech.de>

properties:
  compatible:
    const: rockchip,rk3399-typec-phy

  reg:
    maxItems: 1

  clocks:
    maxItems: 2

  clock-names:
    items:
      - const: tcpdcore
      - const: tcpdphy-ref

  extcon: true

  power-domains:
    maxItems: 1

  resets:
    maxItems: 3

  reset-names:
    items:
      - const: uphy
      - const: uphy-pipe
      - const: uphy-tcphy

  rockchip,grf:
    $ref: /schemas/types.yaml#/definitions/phandle
    description:
      Phandle to the syscon managing the "general register files" (GRF).

  dp-port:
    type: object
    additionalProperties: false

    properties:
      '#phy-cells':
        const: 0

      port:
        $ref: /schemas/graph.yaml#/properties/port
        description: Connection to USB Type-C connector

    required:
      - '#phy-cells'

  usb3-port:
    type: object
    additionalProperties: false

    properties:
      '#phy-cells':
        const: 0

      orientation-switch: true

      port:
        $ref: /schemas/graph.yaml#/properties/port
        description: Connection to USB Type-C connector SS port

    required:
      - '#phy-cells'

required:
  - compatible
  - reg
  - clocks
  - clock-names
  - resets
  - reset-names
  - dp-port
  - usb3-port

additionalProperties: false

examples:
  - |
    #include <dt-bindings/clock/rk3399-cru.h>

    phy@ff7c0000 {
        compatible = "rockchip,rk3399-typec-phy";
        reg = <0xff7c0000 0x40000>;
        rockchip,grf = <&grf>;
        extcon = <&fusb0>;
        clocks = <&cru SCLK_UPHY0_TCPDCORE>,
           <&cru SCLK_UPHY0_TCPDPHY_REF>;
        clock-names = "tcpdcore", "tcpdphy-ref";
        resets = <&cru SRST_UPHY0>,
                 <&cru SRST_UPHY0_PIPE_L00>,
                 <&cru SRST_P_UPHY0_TCPHY>;
        reset-names = "uphy", "uphy-pipe", "uphy-tcphy";

        dp-port {
            #phy-cells = <0>;
        };

        usb3-port {
            #phy-cells = <0>;
        };
    };

...
```

## Documentation/devicetree/bindings/phy/rockchip,rk3588-hdptx-phy.yaml
```yaml
# SPDX-License-Identifier: (GPL-2.0-only OR BSD-2-Clause)
%YAML 1.2
---
$id: http://devicetree.org/schemas/phy/rockchip,rk3588-hdptx-phy.yaml#
$schema: http://devicetree.org/meta-schemas/core.yaml#

title: Rockchip SoC HDMI/eDP Transmitter Combo PHY

maintainers:
  - Cristian Ciocaltea <cristian.ciocaltea@collabora.com>

properties:
  compatible:
    oneOf:
      - enum:
          - rockchip,rk3588-hdptx-phy
      - items:
          - enum:
              - rockchip,rk3576-hdptx-phy
          - const: rockchip,rk3588-hdptx-phy

  reg:
    maxItems: 1

  clocks:
    items:
      - description: Reference clock
      - description: APB clock

  clock-names:
    items:
      - const: ref
      - const: apb

  "#clock-cells":
    const: 0

  "#phy-cells":
    const: 0

  resets:
    minItems: 4
    maxItems: 7

  reset-names:
    minItems: 4
    maxItems: 7

  rockchip,grf:
    $ref: /schemas/types.yaml#/definitions/phandle
    description: Some PHY related data is accessed through GRF regs.

required:
  - compatible
  - reg
  - clocks
  - clock-names
  - "#phy-cells"
  - resets
  - reset-names
  - rockchip,grf

allOf:
  - if:
      properties:
        compatible:
          contains:
            enum:
              - rockchip,rk3576-hdptx-phy
    then:
      properties:
        resets:
          minItems: 4
          maxItems: 4
        reset-names:
          items:
            - const: apb
            - const: init
            - const: cmn
            - const: lane
    else:
      properties:
        resets:
          minItems: 7
          maxItems: 7
        reset-names:
          items:
            - const: phy
            - const: apb
            - const: init
            - const: cmn
            - const: lane
            - const: ropll
            - const: lcpll

additionalProperties: false

examples:
  - |
    #include <dt-bindings/clock/rockchip,rk3588-cru.h>
    #include <dt-bindings/reset/rockchip,rk3588-cru.h>

    soc {
      #address-cells = <2>;
      #size-cells = <2>;

      phy@fed60000 {
        compatible = "rockchip,rk3588-hdptx-phy";
        reg = <0x0 0xfed60000 0x0 0x2000>;
        clocks = <&cru CLK_USB2PHY_HDPTXRXPHY_REF>, <&cru PCLK_HDPTX0>;
        clock-names = "ref", "apb";
        #phy-cells = <0>;
        resets = <&cru SRST_HDPTX0>, <&cru SRST_P_HDPTX0>,
                 <&cru SRST_HDPTX0_INIT>, <&cru SRST_HDPTX0_CMN>,
                 <&cru SRST_HDPTX0_LANE>, <&cru SRST_HDPTX0_ROPLL>,
                 <&cru SRST_HDPTX0_LCPLL>;
        reset-names = "phy", "apb", "init", "cmn", "lane", "ropll", "lcpll";
        rockchip,grf = <&hdptxphy_grf>;
      };
    };
```

## Documentation/devicetree/bindings/phy/rockchip,rk3588-mipi-dcphy.yaml
```yaml
# SPDX-License-Identifier: (GPL-2.0-only OR BSD-2-Clause)
%YAML 1.2
---
$id: http://devicetree.org/schemas/phy/rockchip,rk3588-mipi-dcphy.yaml#
$schema: http://devicetree.org/meta-schemas/core.yaml#

title: Rockchip MIPI D-/C-PHY with Samsung IP block

maintainers:
  - Guochun Huang <hero.huang@rock-chips.com>
  - Heiko Stuebner <heiko@sntech.de>

properties:
  compatible:
    enum:
      - rockchip,rk3576-mipi-dcphy
      - rockchip,rk3588-mipi-dcphy

  reg:
    maxItems: 1

  "#phy-cells":
    const: 1
    description: |
      Argument is mode to operate in. Supported modes are:
        - PHY_TYPE_DPHY
        - PHY_TYPE_CPHY
      See include/dt-bindings/phy/phy.h for constants.

  clocks:
    maxItems: 2

  clock-names:
    items:
      - const: pclk
      - const: ref

  resets:
    maxItems: 4

  reset-names:
    items:
      - const: m_phy
      - const: apb
      - const: grf
      - const: s_phy

  rockchip,grf:
    $ref: /schemas/types.yaml#/definitions/phandle
    description:
      Phandle to the syscon managing the 'mipi dcphy general register files'.

required:
  - compatible
  - reg
  - clocks
  - clock-names
  - resets
  - reset-names
  - "#phy-cells"

additionalProperties: false

examples:
  - |
    #include <dt-bindings/clock/rockchip,rk3588-cru.h>
    #include <dt-bindings/reset/rockchip,rk3588-cru.h>

    soc {
      #address-cells = <2>;
      #size-cells = <2>;

      phy@feda0000 {
        compatible = "rockchip,rk3588-mipi-dcphy";
        reg = <0x0 0xfeda0000 0x0 0x10000>;
        clocks = <&cru PCLK_MIPI_DCPHY0>,
                 <&cru CLK_USBDPPHY_MIPIDCPPHY_REF>;
        clock-names = "pclk", "ref";
        resets = <&cru SRST_M_MIPI_DCPHY0>,
                 <&cru SRST_P_MIPI_DCPHY0>,
                 <&cru SRST_P_MIPI_DCPHY0_GRF>,
                 <&cru SRST_S_MIPI_DCPHY0>;
        reset-names = "m_phy", "apb", "grf", "s_phy";
        rockchip,grf = <&mipidcphy0_grf>;
        #phy-cells = <1>;
      };
    };
```

## Documentation/devicetree/bindings/phy/rockchip-dp-phy.txt
```
Rockchip specific extensions to the Analogix Display Port PHY
------------------------------------

Required properties:
- compatible : should be one of the following supported values:
	 - "rockchip.rk3288-dp-phy"
- clocks: from common clock binding: handle to dp clock.
	of memory mapped region.
- clock-names: from common clock binding:
	Required elements: "24m"
- #phy-cells : from the generic PHY bindings, must be 0;

Example:

grf: syscon@ff770000 {
	compatible = "rockchip,rk3288-grf", "syscon", "simple-mfd";

...

	edp_phy: edp-phy {
		compatible = "rockchip,rk3288-dp-phy";
		clocks = <&cru SCLK_EDP_24M>;
		clock-names = "24m";
		#phy-cells = <0>;
	};
};
```

## Documentation/devicetree/bindings/phy/rockchip-emmc-phy.txt
```
Rockchip EMMC PHY
-----------------------

Required properties:
 - compatible: rockchip,rk3399-emmc-phy
 - #phy-cells: must be 0
 - reg: PHY register address offset and length in "general
   register files"

Optional properties:
 - clock-names: Should contain "emmcclk".  Although this is listed as optional
		(because most boards can get basic functionality without having
		access to it), it is strongly suggested.
		See ../clock/clock-bindings.txt for details.
 - clocks: Should have a phandle to the card clock exported by the SDHCI driver.
 - drive-impedance-ohm: Specifies the drive impedance in Ohm.
                        Possible values are 33, 40, 50, 66 and 100.
                        If not set, the default value of 50 will be applied.
 - enable-strobe-pulldown: Enable internal pull-down for the strobe line.
                           If not set, pull-down is not used.
 - output-tapdelay-select: Specifies the phyctrl_otapdlysec register.
                           If not set, the register defaults to 0x4.
                           Maximum value 0xf.

Example:


grf: syscon@ff770000 {
	compatible = "rockchip,rk3399-grf", "syscon", "simple-mfd";
	#address-cells = <1>;
	#size-cells = <1>;

...

	emmcphy: phy@f780 {
		compatible = "rockchip,rk3399-emmc-phy";
		reg = <0xf780 0x20>;
		clocks = <&sdhci>;
		clock-names = "emmcclk";
		drive-impedance-ohm = <50>;
		#phy-cells = <0>;
	};
};
```

## Documentation/devicetree/bindings/phy/rockchip-inno-csi-dphy.yaml
```yaml
# SPDX-License-Identifier: (GPL-2.0-only OR BSD-2-Clause)
%YAML 1.2
---
$id: http://devicetree.org/schemas/phy/rockchip-inno-csi-dphy.yaml#
$schema: http://devicetree.org/meta-schemas/core.yaml#

title: Rockchip SoC MIPI RX0 D-PHY

maintainers:
  - Heiko Stuebner <heiko@sntech.de>

description: |
  The Rockchip SoC has a MIPI CSI D-PHY based on an Innosilicon IP wich
  connects to the ISP1 (Image Signal Processing unit v1.0) for CSI cameras.

properties:
  compatible:
    enum:
      - rockchip,px30-csi-dphy
      - rockchip,rk1808-csi-dphy
      - rockchip,rk3326-csi-dphy
      - rockchip,rk3368-csi-dphy

  reg:
    maxItems: 1

  clocks:
    maxItems: 1

  clock-names:
    const: pclk

  '#phy-cells':
    const: 0

  power-domains:
    description: Video in/out power domain.
    maxItems: 1

  resets:
    items:
      - description: exclusive PHY reset line

  reset-names:
    items:
      - const: apb

  rockchip,grf:
    $ref: /schemas/types.yaml#/definitions/phandle
    description:
      Some additional phy settings are access through GRF regs.

required:
  - compatible
  - reg
  - clocks
  - clock-names
  - '#phy-cells'
  - power-domains
  - resets
  - reset-names
  - rockchip,grf

additionalProperties: false

examples:
  - |

    csi_dphy: phy@ff2f0000 {
        compatible = "rockchip,px30-csi-dphy";
        reg = <0xff2f0000 0x4000>;
        clocks = <&cru 1>;
        clock-names = "pclk";
        #phy-cells = <0>;
        power-domains = <&power 1>;
        resets = <&cru 1>;
        reset-names = "apb";
        rockchip,grf = <&grf>;
    };
```
