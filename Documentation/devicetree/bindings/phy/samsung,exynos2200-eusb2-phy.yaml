## Documentation/devicetree/bindings/phy/socionext,uniphier-usb3ss-phy.yaml
```yaml
# SPDX-License-Identifier: (GPL-2.0-only OR BSD-2-Clause)
%YAML 1.2
---
$id: http://devicetree.org/schemas/phy/socionext,uniphier-usb3ss-phy.yaml#
$schema: http://devicetree.org/meta-schemas/core.yaml#

title: Socionext UniPhier USB3 Super-Speed (SS) PHY

description: |
  This describes the devicetree bindings for PHY interfaces built into
  USB3 controller implemented on Socionext UniPhier SoCs.
  Although the controller includes High-Speed PHY and Super-Speed PHY,
  this describes about Super-Speed PHY.

maintainers:
  - Kunihiko Hayashi <hayashi.kunihiko@socionext.com>

properties:
  compatible:
    enum:
      - socionext,uniphier-pro4-usb3-ssphy
      - socionext,uniphier-pro5-usb3-ssphy
      - socionext,uniphier-pxs2-usb3-ssphy
      - socionext,uniphier-ld20-usb3-ssphy
      - socionext,uniphier-pxs3-usb3-ssphy
      - socionext,uniphier-nx1-usb3-ssphy

  reg:
    maxItems: 1

  "#phy-cells":
    const: 0

  clocks:
    minItems: 2
    maxItems: 3

  clock-names:
    minItems: 2
    maxItems: 3

  resets:
    maxItems: 2

  reset-names:
    maxItems: 2

  vbus-supply:
    description: A phandle to the regulator for USB VBUS, only for USB host

allOf:
  - if:
      properties:
        compatible:
          contains:
            enum:
              - socionext,uniphier-pro4-usb3-ssphy
              - socionext,uniphier-pro5-usb3-ssphy
    then:
      properties:
        clocks:
          minItems: 2
          maxItems: 2
        clock-names:
          items:
            - const: gio
            - const: link
        resets:
          minItems: 2
          maxItems: 2
        reset-names:
          items:
            - const: gio
            - const: link
  - if:
      properties:
        compatible:
          contains:
            enum:
              - socionext,uniphier-pxs2-usb3-ssphy
              - socionext,uniphier-ld20-usb3-ssphy
    then:
      properties:
        clocks:
          minItems: 2
          maxItems: 2
        clock-names:
          items:
            - const: link
            - const: phy
        resets:
          minItems: 2
          maxItems: 2
        reset-names:
          items:
            - const: link
            - const: phy
  - if:
      properties:
        compatible:
          contains:
            enum:
              - socionext,uniphier-pxs3-usb3-ssphy
              - socionext,uniphier-nx1-usb3-ssphy
    then:
      properties:
        clocks:
          minItems: 2
          maxItems: 3
        clock-names:
          minItems: 2
          items:
            - const: link
            - const: phy
            - const: phy-ext
        resets:
          minItems: 2
          maxItems: 2
        reset-names:
          items:
            - const: link
            - const: phy

required:
  - compatible
  - reg
  - "#phy-cells"
  - clocks
  - clock-names
  - resets
  - reset-names

additionalProperties: false

examples:
  - |
    usb_ssphy0: phy@300 {
        compatible = "socionext,uniphier-ld20-usb3-ssphy";
        reg = <0x300 0x10>;
        #phy-cells = <0>;
        clock-names = "link", "phy";
        clocks = <&sys_clk 14>, <&sys_clk 16>;
        reset-names = "link", "phy";
        resets = <&sys_rst 14>, <&sys_rst 16>;
        vbus-supply = <&usb_vbus0>;
    };
```

## Documentation/devicetree/bindings/phy/sophgo,cv1800b-usb2-phy.yaml
```yaml
# SPDX-License-Identifier: (GPL-2.0-only OR BSD-2-Clause)
%YAML 1.2
---
$id: http://devicetree.org/schemas/phy/sophgo,cv1800b-usb2-phy.yaml#
$schema: http://devicetree.org/meta-schemas/core.yaml#

title: Sophgo CV18XX/SG200X USB 2.0 PHY

maintainers:
  - Inochi Amaoto <inochiama@gmail.com>

properties:
  compatible:
    const: sophgo,cv1800b-usb2-phy

  reg:
    maxItems: 1

  "#phy-cells":
    const: 0

  clocks:
    items:
      - description: PHY app clock
      - description: PHY stb clock
      - description: PHY lpm clock

  clock-names:
    items:
      - const: app
      - const: stb
      - const: lpm

  resets:
    maxItems: 1

required:
  - compatible
  - "#phy-cells"
  - clocks
  - clock-names

additionalProperties: false

examples:
  - |
    phy@48 {
      compatible = "sophgo,cv1800b-usb2-phy";
      reg = <0x48 0x4>;
      #phy-cells = <0>;
      clocks = <&clk 93>, <&clk 94>, <&clk 95>;
      clock-names = "app", "stb", "lpm";
      resets = <&rst 58>;
    };
```

## Documentation/devicetree/bindings/phy/spacemit,k1-combo-phy.yaml
```yaml
# SPDX-License-Identifier: (GPL-2.0-only OR BSD-2-Clause)
%YAML 1.2
---
$id: http://devicetree.org/schemas/phy/spacemit,k1-combo-phy.yaml#
$schema: http://devicetree.org/meta-schemas/core.yaml#

title: SpacemiT K1 PCIe/USB3 Combo PHY

maintainers:
  - Alex Elder <elder@riscstar.com>

description: >
  Of the three PHYs on the SpacemiT K1 SoC capable of being used for
  PCIe, one is a combo PHY that can also be configured for use by a
  USB 3 controller.  Using PCIe or USB 3 is a board design decision.

  The combo PHY is also the only PCIe PHY that is able to determine
  PCIe calibration values to use, and this must be determined before
  the other two PCIe PHYs can be used.  This calibration must be
  performed with the combo PHY in PCIe mode, and is this is done
  when the combo PHY is probed.

  The combo PHY uses an external oscillator as a reference clock.
  During normal operation, the PCIe or USB port driver is responsible
  for ensuring all other clocks needed by a PHY are enabled, and all
  resets affecting the PHY are deasserted.  However, for the combo
  PHY to perform calibration independent of whether it's later used
  for PCIe or USB, all PCIe mode clocks and resets must be defined.

properties:
  compatible:
    const: spacemit,k1-combo-phy

  reg:
    items:
      - description: PHY control registers

  clocks:
    items:
      - description: External oscillator used by the PHY PLL
      - description: DWC PCIe Data Bus Interface (DBI) clock
      - description: DWC PCIe application AXI-bus Master interface clock
      - description: DWC PCIe application AXI-bus slave interface clock

  clock-names:
    items:
      - const: refclk
      - const: dbi
      - const: mstr
      - const: slv

  resets:
    items:
      - description: PHY reset; remains deasserted after initialization
      - description: DWC PCIe Data Bus Interface (DBI) reset
      - description: DWC PCIe application AXI-bus Master interface reset
      - description: DWC PCIe application AXI-bus slave interface reset

  reset-names:
    items:
      - const: phy
      - const: dbi
      - const: mstr
      - const: slv

  spacemit,apmu:
    description:
      A phandle that refers to the APMU system controller, whose
      regmap is used in setting the mode
    $ref: /schemas/types.yaml#/definitions/phandle

  "#phy-cells":
    const: 1
    description:
      The argument value (PHY_TYPE_PCIE or PHY_TYPE_USB3) determines
      whether the PHY operates in PCIe or USB3 mode.

required:
  - compatible
  - reg
  - clocks
  - clock-names
  - resets
  - reset-names
  - spacemit,apmu
  - "#phy-cells"

additionalProperties: false

examples:
  - |
    #include <dt-bindings/clock/spacemit,k1-syscon.h>
    phy@c0b10000 {
        compatible = "spacemit,k1-combo-phy";
        reg = <0xc0b10000 0x1000>;
        clocks = <&vctcxo_24m>,
                 <&syscon_apmu CLK_PCIE0_DBI>,
                 <&syscon_apmu CLK_PCIE0_MASTER>,
                 <&syscon_apmu CLK_PCIE0_SLAVE>;
        clock-names = "refclk",
                      "dbi",
                      "mstr",
                      "slv";
        resets = <&syscon_apmu RESET_PCIE0_GLOBAL>,
                 <&syscon_apmu RESET_PCIE0_DBI>,
                 <&syscon_apmu RESET_PCIE0_MASTER>,
                 <&syscon_apmu RESET_PCIE0_SLAVE>;
        reset-names = "phy",
                      "dbi",
                      "mstr",
                      "slv";
        spacemit,apmu = <&syscon_apmu>;
        #phy-cells = <1>;
    };
```

## Documentation/devicetree/bindings/phy/spacemit,k1-pcie-phy.yaml
```yaml
# SPDX-License-Identifier: (GPL-2.0-only OR BSD-2-Clause)
%YAML 1.2
---
$id: http://devicetree.org/schemas/phy/spacemit,k1-pcie-phy.yaml#
$schema: http://devicetree.org/meta-schemas/core.yaml#

title: SpacemiT K1 PCIe PHY

maintainers:
  - Alex Elder <elder@riscstar.com>

description: >
  Two PHYs on the SpacemiT K1 SoC used for only for PCIe.  These
  PHYs must be configured using calibration values that are
  determined by a third "combo PHY".  The combo PHY determines
  these calibration values during probe so they can be used for
  the two PCIe-only PHYs.

  The PHY uses an external oscillator as a reference clock.  During
  normal operation, the PCIe host driver is responsible for ensuring
  all other clocks needed by a PHY are enabled, and all resets
  affecting the PHY are deasserted.

properties:
  compatible:
    const: spacemit,k1-pcie-phy

  reg:
    items:
      - description: PHY control registers

  clocks:
    items:
      - description: External oscillator used by the PHY PLL

  clock-names:
    const: refclk

  resets:
    items:
      - description: PHY reset; remains deasserted after initialization

  reset-names:
    const: phy

  "#phy-cells":
    const: 0

required:
  - compatible
  - reg
  - clocks
  - clock-names
  - resets
  - reset-names
  - "#phy-cells"

additionalProperties: false

examples:
  - |
    #include <dt-bindings/clock/spacemit,k1-syscon.h>
    phy@c0c10000 {
        compatible = "spacemit,k1-pcie-phy";
        reg = <0xc0c10000 0x1000>;
        clocks = <&vctcxo_24m>;
        clock-names = "refclk";
        resets = <&syscon_apmu RESET_PCIE1_GLOBAL>;
        reset-names = "phy";
        #phy-cells = <0>;
    };
```

## Documentation/devicetree/bindings/phy/spacemit,k3-combo-phy.yaml
```yaml
# SPDX-License-Identifier: (GPL-2.0-only OR BSD-2-Clause)
%YAML 1.2
---
$id: http://devicetree.org/schemas/phy/spacemit,k3-combo-phy.yaml#
$schema: http://devicetree.org/meta-schemas/core.yaml#

title: Spacemit K3 PCIE/USB3 Comb PHY

maintainers:
  - Inochi Amaoto <inochiama@gmail.com>

properties:
  compatible:
    const: spacemit,k3-combo-phy

  reg:
    maxItems: 1

  "#phy-cells":
    const: 2
    description:
      The first one is phy id, the second one is phy type. This
      only supports types are PCIe and USB .

  spacemit,apb-spare:
    $ref: /schemas/types.yaml#/definitions/phandle
    description:
      Phandle to APB SPARE system controller interface, used for
      PHY calibration.

  spacemit,apmu:
    $ref: /schemas/types.yaml#/definitions/phandle-array
    items:
      - items:
          - description: phandle of APMU syscon
          - description: configuration of the PHY lanes
    description: |
      Phandle to control PHY mux configuration. The configuration
      is described as follows:
      bit 4: 0 - PCIe A x8 mode, 1 - PCIe lane share mode
      bit 3: 0 - PCIe A x4 mode, 1 - PCIe A x2 and PCIe B x2 mode
      bit 2: 0 - PCIe C lane 0 is PCIe mode , 1 - USB mode
      bit 1: 0 - PCIe C lane 1 is PCIe mode , 1 - USB mode
      bit 0: 0 - PCIe D lane is PCIe mode , 1 - USB mode

      The bit[3:0] is only valid when bit 4 is 1.

      This mux control does not affect the PHY for PCIe E, it is always
      in PCIe mode.

required:
  - compatible
  - reg
  - "#phy-cells"
  - spacemit,apb-spare
  - spacemit,apmu

additionalProperties: false

examples:
  - |
    phy@81d00000 {
      compatible = "spacemit,k3-combo-phy";
      reg = <0x81d00000 0x600000>;
      #phy-cells = <2>;
      spacemit,apb-spare = <&apb_spare>;
      spacemit,apmu = <&apmu 0x00>;
    };
```

## Documentation/devicetree/bindings/phy/spacemit,usb2-phy.yaml
```yaml
# SPDX-License-Identifier: (GPL-2.0-only OR BSD-2-Clause)
%YAML 1.2
---
$id: http://devicetree.org/schemas/phy/spacemit,usb2-phy.yaml#
$schema: http://devicetree.org/meta-schemas/core.yaml#

title: SpacemiT K1 SoC USB 2.0 PHY

maintainers:
  - Ze Huang <huang.ze@linux.dev>

properties:
  compatible:
    const: spacemit,k1-usb2-phy

  reg:
    maxItems: 1

  clocks:
    maxItems: 1

  "#phy-cells":
    const: 0

required:
  - compatible
  - reg
  - clocks
  - "#phy-cells"

additionalProperties: false

examples:
  - |
    usb-phy@c09c0000 {
        compatible = "spacemit,k1-usb2-phy";
        reg = <0xc09c0000 0x200>;
        clocks = <&syscon_apmu 15>;
        #phy-cells = <0>;
    };
```

## Documentation/devicetree/bindings/phy/st,spear1310-miphy.yaml
```yaml
# SPDX-License-Identifier: (GPL-2.0-only OR BSD-2-Clause)
%YAML 1.2
---
$id: http://devicetree.org/schemas/phy/st,spear1310-miphy.yaml#
$schema: http://devicetree.org/meta-schemas/core.yaml#

title: ST SPEAr miphy

maintainers:
  - Pratyush Anand <pratyush.anand@gmail.com>

description:
  ST Microelectronics SPEAr miphy is a phy controller supporting PCIe and SATA.

properties:
  compatible:
    enum:
      - st,spear1310-miphy
      - st,spear1340-miphy

  reg:
    maxItems: 1

  misc:
    description: Phandle for the syscon node to access misc registers.
    $ref: /schemas/types.yaml#/definitions/phandle

  '#phy-cells':
    description: >
      Cell[0] indicates interface type: 0 = SATA, 1 = PCIe.
    const: 1

  phy-id:
    description: Instance id of the phy. Required when multiple PHYs are present.
    $ref: /schemas/types.yaml#/definitions/uint32

required:
  - compatible
  - reg
  - misc
  - '#phy-cells'

additionalProperties: false

examples:
  - |
    miphy@1000 {
        compatible = "st,spear1310-miphy";
        reg = <0x1000 0x100>;
        misc = <&syscon>;
        #phy-cells = <1>;
        phy-id = <0>;
    };
```

## Documentation/devicetree/bindings/phy/st,stih407-usb2-phy.yaml
```yaml
# SPDX-License-Identifier: (GPL-2.0-only OR BSD-2-Clause)
%YAML 1.2
---
$id: http://devicetree.org/schemas/phy/st,stih407-usb2-phy.yaml#
$schema: http://devicetree.org/meta-schemas/core.yaml#

title: STMicroelectronics STiH407 USB PHY controller

maintainers:
  - Patrice Chotard <patrice.chotard@foss.st.com>

description:
  The USB picoPHY device is the PHY for both USB2 and USB3 host controllers
  (when controlling usb2/1.1 devices) available on STiH407 SoC family from
  STMicroelectronics.

properties:
  compatible:
    const: st,stih407-usb2-phy

  st,syscfg:
    description: Phandle to the syscfg bank
    $ref: /schemas/types.yaml#/definitions/phandle-array
    items:
      - items:
          - description: phandle to syscfg
          - description: phyparam register offset
          - description: phyctrl register offset

  resets:
    items:
      - description: Phandle and reset specifier pair for the whole phy.
      - description: Phandle and reset specifier pair for the port.

  reset-names:
    items:
      - const: global
      - const: port

  "#phy-cells":
    const: 0

required:
  - compatible
  - st,syscfg
  - resets
  - reset-names
  - "#phy-cells"

additionalProperties: false

examples:
  - |
    #include <dt-bindings/reset/stih407-resets.h>
    usb-phy {
        compatible = "st,stih407-usb2-phy";
        #phy-cells = <0>;
        st,syscfg = <&syscfg_core 0x100 0xf4>;
        resets = <&softreset STIH407_PICOPHY_SOFTRESET>,
                 <&picophyreset STIH407_PICOPHY0_RESET>;
        reset-names = "global", "port";
    };
...
```
