## Documentation/devicetree/bindings/phy/st,stm32mp25-combophy.yaml
```yaml
# SPDX-License-Identifier: (GPL-2.0 OR BSD-2-Clause)
%YAML 1.2
---
$id: http://devicetree.org/schemas/phy/st,stm32mp25-combophy.yaml#
$schema: http://devicetree.org/meta-schemas/core.yaml#

title: STMicroelectronics STM32MP25 USB3/PCIe COMBOPHY

maintainers:
  - Christian Bruel <christian.bruel@foss.st.com>

description:
  Single lane PHY shared (exclusive) between the USB3 and PCIe controllers.
  Supports 5Gbit/s for USB3 and PCIe gen2 or 2.5Gbit/s for PCIe gen1.

properties:
  compatible:
    const: st,stm32mp25-combophy

  reg:
    maxItems: 1

  "#phy-cells":
    const: 1

  clocks:
    minItems: 2
    items:
      - description: apb Bus clock mandatory to access registers.
      - description: ker Internal RCC reference clock for USB3 or PCIe
      - description: pad Optional on board clock input for PCIe only. Typically an
                     external 100Mhz oscillator wired on dedicated CLKIN pad. Used as reference
                     clock input instead of the ker

  clock-names:
    minItems: 2
    items:
      - const: apb
      - const: ker
      - const: pad

  resets:
    maxItems: 1

  reset-names:
    const: phy

  power-domains:
    maxItems: 1

  wakeup-source: true

  interrupts:
    maxItems: 1
    description: interrupt used for wakeup

  access-controllers:
    maxItems: 1
    description: Phandle to the rifsc device to check access right.

  st,ssc-on:
    $ref: /schemas/types.yaml#/definitions/flag
    description:
      A property whose presence indicates that the Spread Spectrum Clocking is active.

  st,rx-equalizer:
    $ref: /schemas/types.yaml#/definitions/uint32
    minimum: 0
    maximum: 7
    default: 2
    description:
      A 3 bit value to tune the RX fixed equalizer setting for optimal eye compliance

  st,output-micro-ohms:
    minimum: 3999000
    maximum: 6090000
    default: 4968000
    description:
      A value property to tune the Single Ended Output Impedance, simulations results
      at 25C for a VDDP=0.8V. The hardware accepts discrete values in this range.

  st,output-vswing-microvolt:
    minimum: 442000
    maximum: 803000
    default: 803000
    description:
      A value property in microvolt to tune the Single Ended Output Voltage Swing to change the
      Vlo, Vhi for a VDDP = 0.8V. The hardware accepts discrete values in this range.

required:
  - compatible
  - reg
  - "#phy-cells"
  - clocks
  - clock-names
  - resets
  - reset-names

additionalProperties: false

examples:
  - |
    #include <dt-bindings/clock/st,stm32mp25-rcc.h>
    #include <dt-bindings/interrupt-controller/arm-gic.h>
    #include <dt-bindings/reset/st,stm32mp25-rcc.h>

    phy@480c0000 {
        compatible = "st,stm32mp25-combophy";
        reg = <0x480c0000 0x1000>;
        #phy-cells = <1>;
        clocks = <&rcc CK_BUS_USB3PCIEPHY>, <&rcc CK_KER_USB3PCIEPHY>;
        clock-names = "apb", "ker";
        resets = <&rcc USB3PCIEPHY_R>;
        reset-names = "phy";
        access-controllers = <&rifsc 67>;
        power-domains = <&CLUSTER_PD>;
        wakeup-source;
        interrupts-extended = <&exti1 45 IRQ_TYPE_EDGE_FALLING>;
    };
```

## Documentation/devicetree/bindings/phy/st-spear-miphy.txt
```
ST SPEAr miphy DT details
=========================

ST Microelectronics SPEAr miphy is a phy controller supporting PCIe and SATA.

Required properties:
- compatible : should be "st,spear1310-miphy" or "st,spear1340-miphy"
- reg : offset and length of the PHY register set.
- misc: phandle for the syscon node to access misc registers
- #phy-cells : from the generic PHY bindings, must be 1.
	- cell[1]: 0 if phy used for SATA, 1 for PCIe.

Optional properties:
- phy-id: Instance id of the phy. Only required when there are multiple phys
  present on a implementation.
```

## Documentation/devicetree/bindings/phy/starfive,jh7110-dphy-rx.yaml
```yaml
# SPDX-License-Identifier: (GPL-2.0 OR BSD-2-Clause)
%YAML 1.2
---
$id: http://devicetree.org/schemas/phy/starfive,jh7110-dphy-rx.yaml#
$schema: http://devicetree.org/meta-schemas/core.yaml#

title: StarFive SoC JH7110 MIPI D-PHY Rx Controller

maintainers:
  - Jack Zhu <jack.zhu@starfivetech.com>
  - Changhuang Liang <changhuang.liang@starfivetech.com>

description:
  StarFive SoCs contain a MIPI CSI D-PHY based on M31 IP, used to
  transfer CSI camera data.

properties:
  compatible:
    const: starfive,jh7110-dphy-rx

  reg:
    maxItems: 1

  clocks:
    items:
      - description: config clock
      - description: reference clock
      - description: escape mode transmit clock

  clock-names:
    items:
      - const: cfg
      - const: ref
      - const: tx

  resets:
    items:
      - description: DPHY_HW reset
      - description: DPHY_B09_ALWAYS_ON reset

  power-domains:
    maxItems: 1

  "#phy-cells":
    const: 0

required:
  - compatible
  - reg
  - clocks
  - clock-names
  - resets
  - power-domains
  - "#phy-cells"

additionalProperties: false

examples:
  - |
    phy@19820000 {
      compatible = "starfive,jh7110-dphy-rx";
      reg = <0x19820000 0x10000>;
      clocks = <&ispcrg 3>,
               <&ispcrg 4>,
               <&ispcrg 5>;
      clock-names = "cfg", "ref", "tx";
      resets = <&ispcrg 2>,
               <&ispcrg 3>;
      power-domains = <&aon_syscon 1>;
      #phy-cells = <0>;
    };
```

## Documentation/devicetree/bindings/phy/starfive,jh7110-dphy-tx.yaml
```yaml
# SPDX-License-Identifier: (GPL-2.0 OR BSD-2-Clause)
%YAML 1.2
---
$id: http://devicetree.org/schemas/phy/starfive,jh7110-dphy-tx.yaml#
$schema: http://devicetree.org/meta-schemas/core.yaml#

title: Starfive SoC MIPI D-PHY Tx Controller

maintainers:
  - Keith Zhao <keith.zhao@starfivetech.com>
  - Shengyang Chen <shengyang.chen@starfivetech.com>

description:
  The Starfive SoC uses the MIPI DSI D-PHY based on M31 IP to transfer
  DSI data.

properties:
  compatible:
    const: starfive,jh7110-dphy-tx

  reg:
    maxItems: 1

  clocks:
    maxItems: 1

  clock-names:
    items:
      - const: txesc

  resets:
    items:
      - description: MIPITX_DPHY_SYS reset

  reset-names:
    items:
      - const: sys

  power-domains:
    maxItems: 1

  "#phy-cells":
    const: 0

required:
  - compatible
  - reg
  - clocks
  - clock-names
  - resets
  - reset-names
  - power-domains
  - "#phy-cells"

additionalProperties: false

examples:
  - |
    phy@295e0000 {
      compatible = "starfive,jh7110-dphy-tx";
      reg = <0x295e0000 0x10000>;
      clocks = <&voutcrg 14>;
      clock-names = "txesc";
      resets = <&syscrg 10>;
      reset-names = "sys";
      power-domains = <&aon_syscon 0>;
      #phy-cells = <0>;
    };
```

## Documentation/devicetree/bindings/phy/starfive,jh7110-pcie-phy.yaml
```yaml
# SPDX-License-Identifier: (GPL-2.0-only OR BSD-2-Clause)
%YAML 1.2
---
$id: http://devicetree.org/schemas/phy/starfive,jh7110-pcie-phy.yaml#
$schema: http://devicetree.org/meta-schemas/core.yaml#

title: StarFive JH7110 PCIe 2.0 PHY

maintainers:
  - Minda Chen <minda.chen@starfivetech.com>

properties:
  compatible:
    const: starfive,jh7110-pcie-phy

  reg:
    maxItems: 1

  "#phy-cells":
    const: 0

  starfive,sys-syscon:
    $ref: /schemas/types.yaml#/definitions/phandle-array
    items:
      - items:
          - description: phandle to System Register Controller sys_syscon node.
          - description: PHY connect offset of SYS_SYSCONSAIF__SYSCFG register for USB PHY.
    description:
      The phandle to System Register Controller syscon node and the PHY connect offset
      of SYS_SYSCONSAIF__SYSCFG register. Connect PHY to USB3 controller.

  starfive,stg-syscon:
    $ref: /schemas/types.yaml#/definitions/phandle-array
    items:
      - items:
          - description: phandle to System Register Controller stg_syscon node.
          - description: PHY mode offset of STG_SYSCONSAIF__SYSCFG register.
          - description: PHY enable for USB offset of STG_SYSCONSAIF__SYSCFG register.
    description:
      The phandle to System Register Controller syscon node and the offset
      of STG_SYSCONSAIF__SYSCFG register for PCIe PHY. Total 2 regsisters offset.

required:
  - compatible
  - reg
  - "#phy-cells"

additionalProperties: false

examples:
  - |
    phy@10210000 {
        compatible = "starfive,jh7110-pcie-phy";
        reg = <0x10210000 0x10000>;
        #phy-cells = <0>;
        starfive,sys-syscon = <&sys_syscon 0x18>;
        starfive,stg-syscon = <&stg_syscon 0x148 0x1f4>;
    };
```

## Documentation/devicetree/bindings/phy/starfive,jh7110-usb-phy.yaml
```yaml
# SPDX-License-Identifier: (GPL-2.0-only OR BSD-2-Clause)
%YAML 1.2
---
$id: http://devicetree.org/schemas/phy/starfive,jh7110-usb-phy.yaml#
$schema: http://devicetree.org/meta-schemas/core.yaml#

title: StarFive JH7110 USB 2.0 PHY

maintainers:
  - Minda Chen <minda.chen@starfivetech.com>

properties:
  compatible:
    const: starfive,jh7110-usb-phy

  reg:
    maxItems: 1

  "#phy-cells":
    const: 0

  clocks:
    items:
      - description: PHY 125m
      - description: app 125m

  clock-names:
    items:
      - const: 125m
      - const: app_125m

required:
  - compatible
  - reg
  - clocks
  - clock-names
  - "#phy-cells"

additionalProperties: false

examples:
  - |
    phy@10200000 {
        compatible = "starfive,jh7110-usb-phy";
        reg = <0x10200000 0x10000>;
        clocks = <&syscrg 95>,
                 <&stgcrg 6>;
        clock-names = "125m", "app_125m";
        #phy-cells = <0>;
    };
```
