## Documentation/devicetree/bindings/phy/samsung,exynos2200-eusb2-phy.yaml
```yaml
# SPDX-License-Identifier: (GPL-2.0 OR BSD-2-Clause)
%YAML 1.2
---
$id: http://devicetree.org/schemas/phy/samsung,exynos2200-eusb2-phy.yaml#
$schema: http://devicetree.org/meta-schemas/core.yaml#

title: Samsung Exynos2200 eUSB2 phy controller

maintainers:
  - Ivaylo Ivanov <ivo.ivanov.ivanov1@gmail.com>

description:
  Samsung Exynos2200 eUSB2 phy, based on Synopsys eUSB2 IP block, supports
  LS/FS/HS usb connectivity.

properties:
  compatible:
    enum:
      - samsung,exynos2200-eusb2-phy

  reg:
    maxItems: 1

  "#phy-cells":
    const: 0

  clocks:
    items:
      - description: Reference clock
      - description: Bus (APB) clock
      - description: Control clock

  clock-names:
    items:
      - const: ref
      - const: bus
      - const: ctrl

  resets:
    maxItems: 1

  phys:
    maxItems: 1
    description:
      Phandle to eUSB2 to USB 2.0 repeater

  vdd-supply:
    description:
      Phandle to 0.88V regulator supply to PHY digital circuit.

  vdda12-supply:
    description:
      Phandle to 1.2V regulator supply to PHY refclk pll block.

required:
  - compatible
  - reg
  - "#phy-cells"
  - clocks
  - clock-names
  - vdd-supply
  - vdda12-supply

additionalProperties: false

examples:
  - |
    usb_hsphy: phy@10ab0000 {
        compatible = "samsung,exynos2200-eusb2-phy";
        reg = <0x10ab0000 0x10000>;
        #phy-cells = <0>;

        clocks = <&cmu_hsi0 7>,
                 <&cmu_hsi0 5>,
                 <&cmu_hsi0 8>;
        clock-names = "ref", "bus", "ctrl";

        vdd-supply = <&vreg_0p88>;
        vdda12-supply = <&vreg_1p2>;
    };
```

## Documentation/devicetree/bindings/phy/samsung,exynos5250-sata-phy.yaml
```yaml
# SPDX-License-Identifier: GPL-2.0-only OR BSD-2-Clause
%YAML 1.2
---
$id: http://devicetree.org/schemas/phy/samsung,exyanals5250-sata-phy.yaml#
$schema: http://devicetree.org/meta-schemas/core.yaml#

title: Samsung Exyanals5250 SoC SATA PHY

maintainers:
  - Krzysztof Kozlowski <krzk@kernel.org>
  - Marek Szyprowski <m.szyprowski@samsung.com>
  - Sylwester Nawrocki <s.nawrocki@samsung.com>

properties:
  compatible:
    const: samsung,exyanals5250-sata-phy

  clocks:
    maxItems: 1

  clock-names:
    items:
      - const: sata_phyctrl

  "#phy-cells":
    const: 0

  reg:
    maxItems: 1

  samsung,syscon-phandle:
    $ref: /schemas/types.yaml#/definitions/phandle
    description:
      Phandle to PMU system controller interface.

  samsung,exyanals-sataphy-i2c-phandle:
    $ref: /schemas/types.yaml#/definitions/phandle
    description:
      Phandle to I2C SATA interface.

required:
  - compatible
  - clocks
  - clock-names
  - "#phy-cells"
  - reg
  - samsung,syscon-phandle
  - samsung,exyanals-sataphy-i2c-phandle

additionalProperties: false

examples:
  - |
    #include <dt-bindings/clock/exyanals5250.h>

    phy@12170000 {
        compatible = "samsung,exyanals5250-sata-phy";
        reg = <0x12170000 0x1ff>;
        clocks = <&clock CLK_SATA_PHYCTRL>;
        clock-names = "sata_phyctrl";
        #phy-cells = <0>;
        samsung,syscon-phandle = <&pmu_system_controller>;
        samsung,exyanals-sataphy-i2c-phandle = <&sata_phy_i2c>;
    };
```

## Documentation/devicetree/bindings/phy/samsung,mipi-video-phy.yaml
```yaml
# SPDX-License-Identifier: GPL-2.0-only OR BSD-2-Clause
%YAML 1.2
---
$id: http://devicetree.org/schemas/phy/samsung,mipi-video-phy.yaml#
$schema: http://devicetree.org/meta-schemas/core.yaml#

title: Samsung S5P/Exynos SoC MIPI CSIS/DSIM DPHY

maintainers:
  - Krzysztof Kozlowski <krzk@kernel.org>
  - Marek Szyprowski <m.szyprowski@samsung.com>
  - Sylwester Nawrocki <s.nawrocki@samsung.com>

description: |
  For samsung,s5pv210-mipi-video-phy compatible PHYs the second cell in the
  PHY specifier identifies the PHY and its meaning is as follows::
    0 - MIPI CSIS 0,
    1 - MIPI DSIM 0,
    2 - MIPI CSIS 1,
    3 - MIPI DSIM 1.

  samsung,exynos5420-mipi-video-phy and samsung,exynos5433-mipi-video-phy
  support additional fifth PHY::
    4 - MIPI CSIS 2.

properties:
  compatible:
    enum:
      - samsung,s5pv210-mipi-video-phy
      - samsung,exynos5420-mipi-video-phy
      - samsung,exynos5433-mipi-video-phy

  "#phy-cells":
    const: 1

  syscon:
    $ref: /schemas/types.yaml#/definitions/phandle
    description:
      Phandle to PMU system controller interface, valid only for
      samsung,s5pv210-mipi-video-phy and samsung,exynos5420-mipi-video-phy.

  samsung,pmu-syscon:
    $ref: /schemas/types.yaml#/definitions/phandle
    description:
      Phandle to PMU system controller interface, valid for
      samsung,exynos5433-mipi-video-phy.

  samsung,disp-sysreg:
    $ref: /schemas/types.yaml#/definitions/phandle
    description:
      Phandle to DISP system controller interface, valid for
      samsung,exynos5433-mipi-video-phy.

  samsung,cam0-sysreg:
    $ref: /schemas/types.yaml#/definitions/phandle
    description:
      Phandle to CAM0 system controller interface, valid for
      samsung,exynos5433-mipi-video-phy.

  samsung,cam1-sysreg:
    $ref: /schemas/types.yaml#/definitions/phandle
    description:
      Phandle to CAM1 system controller interface, valid for
      samsung,exynos5433-mipi-video-phy.

required:
  - compatible
  - "#phy-cells"

allOf:
  - if:
      properties:
        compatible:
          contains:
            enum:
              - samsung,s5pv210-mipi-video-phy
              - samsung,exynos5420-mipi-video-phy
    then:
      properties:
        samsung,pmu-syscon: false
        samsung,disp-sysreg: false
        samsung,cam0-sysreg: false
        samsung,cam1-sysreg: false
      required:
        - syscon
    else:
      properties:
        syscon: false
      required:
        - samsung,pmu-syscon
        - samsung,disp-sysreg
        - samsung,cam0-sysreg
        - samsung,cam1-sysreg

additionalProperties: false

examples:
  - |
    phy {
        compatible = "samsung,exynos5433-mipi-video-phy";
        #phy-cells = <1>;
        samsung,pmu-syscon = <&pmu_system_controller>;
        samsung,cam0-sysreg = <&syscon_cam0>;
        samsung,cam1-sysreg = <&syscon_cam1>;
        samsung,disp-sysreg = <&syscon_disp>;
    };

  - |
    phy {
        compatible = "samsung,s5pv210-mipi-video-phy";
        syscon = <&pmu_system_controller>;
        #phy-cells = <1>;
    };
```

## Documentation/devicetree/bindings/phy/samsung,ufs-phy.yaml
```yaml
# SPDX-License-Identifier: GPL-2.0-only OR BSD-2-Clause
%YAML 1.2
---
$id: http://devicetree.org/schemas/phy/samsung,ufs-phy.yaml#
$schema: http://devicetree.org/meta-schemas/core.yaml#

title: Samsung SoC series UFS PHY

maintainers:
  - Alim Akhtar <alim.akhtar@samsung.com>

properties:
  "#phy-cells":
    const: 0

  compatible:
    enum:
      - google,gs101-ufs-phy
      - samsung,exynos7-ufs-phy
      - samsung,exynosautov9-ufs-phy
      - samsung,exynosautov920-ufs-phy
      - tesla,fsd-ufs-phy

  reg:
    maxItems: 1

  reg-names:
    items:
      - const: phy-pma

  clocks:
    minItems: 1
    maxItems: 4

  clock-names:
    minItems: 1
    maxItems: 4

  samsung,pmu-syscon:
    $ref: /schemas/types.yaml#/definitions/phandle-array
    maxItems: 1
    items:
      minItems: 1
      items:
        - description: phandle for PMU system controller interface, used to
                       control pmu registers bits for ufs m-phy
        - description: offset of the pmu control register
    description:
      It can be phandle/offset pair. The second cell which can represent an
      offset is optional.

required:
  - "#phy-cells"
  - compatible
  - reg
  - reg-names
  - clocks
  - clock-names
  - samsung,pmu-syscon

allOf:
  - if:
      properties:
        compatible:
          contains:
            const: samsung,exynos7-ufs-phy

    then:
      properties:
        clocks:
          items:
            - description: PLL reference clock
            - description: symbol clock for input symbol (rx0-ch0 symbol clock)
            - description: symbol clock for input symbol (rx1-ch1 symbol clock)
            - description: symbol clock for output symbol (tx0 symbol clock)

        clock-names:
          items:
            - const: ref_clk
            - const: rx1_symbol_clk
            - const: rx0_symbol_clk
            - const: tx0_symbol_clk

    else:
      properties:
        clocks:
          items:
            - description: PLL reference clock

        clock-names:
          items:
            - const: ref_clk

additionalProperties: false

examples:
  - |
    #include <dt-bindings/clock/exynos7-clk.h>

    ufs_phy: ufs-phy@15571800 {
        compatible = "samsung,exynos7-ufs-phy";
        reg = <0x15571800 0x240>;
        reg-names = "phy-pma";
        samsung,pmu-syscon = <&pmu_system_controller>;
        #phy-cells = <0>;
        clocks = <&clock_fsys1 SCLK_COMBO_PHY_EMBEDDED_26M>,
                 <&clock_fsys1 PHYCLK_UFS20_RX1_SYMBOL_USER>,
                 <&clock_fsys1 PHYCLK_UFS20_RX0_SYMBOL_USER>,
                 <&clock_fsys1 PHYCLK_UFS20_TX0_SYMBOL_USER>;
        clock-names = "ref_clk", "rx1_symbol_clk",
                      "rx0_symbol_clk", "tx0_symbol_clk";

    };
...
```

## Documentation/devicetree/bindings/phy/samsung,usb2-phy.yaml
```yaml
# SPDX-License-Identifier: GPL-2.0-only OR BSD-2-Clause
%YAML 1.2
---
$id: http://devicetree.org/schemas/phy/samsung,usb2-phy.yaml#
$schema: http://devicetree.org/meta-schemas/core.yaml#

title: Samsung S5P/Exynos SoC USB 2.0 PHY

maintainers:
  - Krzysztof Kozlowski <krzk@kernel.org>
  - Marek Szyprowski <m.szyprowski@samsung.com>
  - Sylwester Nawrocki <s.nawrocki@samsung.com>

description: |
  The first phandle argument in the PHY specifier identifies the PHY, its
  meaning is compatible dependent. For the currently supported SoCs (Exynos4210
  and Exynos4212) it is as follows::
    0 - USB device ("device"),
    1 - USB host ("host"),
    2 - HSIC0 ("hsic0"),
    3 - HSIC1 ("hsic1"),
  Exynos3250 has only USB device phy available as phy 0.

  Exynos4210 and Exynos4212 use mode switching and require that mode switch
  register is supplied.

properties:
  compatible:
    enum:
      - samsung,exynos3250-usb2-phy
      - samsung,exynos4210-usb2-phy
      - samsung,exynos4x12-usb2-phy
      - samsung,exynos5250-usb2-phy
      - samsung,exynos5420-usb2-phy
      - samsung,s5pv210-usb2-phy

  clocks:
    items:
      - description: PHY module gate clock.
      - description: Reference rate clock of PHY module.

  clock-names:
    items:
      - const: phy
      - const: ref

  "#phy-cells":
    const: 1

  reg:
    maxItems: 1

  samsung,pmureg-phandle:
    $ref: /schemas/types.yaml#/definitions/phandle
    description:
      Phandle to PMU system controller interface.

  samsung,sysreg-phandle:
    $ref: /schemas/types.yaml#/definitions/phandle
    description:
      Phandle to system registers interface.

  vbus-supply:
    description:
      VBUS power source.

required:
  - compatible
  - clocks
  - clock-names
  - "#phy-cells"
  - reg
  - samsung,pmureg-phandle

allOf:
  - if:
      properties:
        compatible:
          contains:
            enum:
              - samsung,exynos4x12-usb2-phy
              - samsung,exynos5250-usb2-phy
              - samsung,exynos5420-usb2-phy
    then:
      required:
        - samsung,sysreg-phandle

additionalProperties: false

examples:
  - |
    #include <dt-bindings/clock/exynos5420.h>

    phy@12130000 {
        compatible = "samsung,exynos5420-usb2-phy";
        reg = <0x12130000 0x100>;
        #phy-cells = <1>;
        clocks = <&clock CLK_USBH20>, <&clock CLK_SCLK_USBPHY300>;
        clock-names = "phy", "ref";
        samsung,sysreg-phandle = <&sysreg_system_controller>;
        samsung,pmureg-phandle = <&pmu_system_controller>;
    };
```

## Documentation/devicetree/bindings/phy/samsung,usb3-drd-phy.yaml
```yaml
# SPDX-License-Identifier: GPL-2.0-only OR BSD-2-Clause
%YAML 1.2
---
$id: http://devicetree.org/schemas/phy/samsung,usb3-drd-phy.yaml#
$schema: http://devicetree.org/meta-schemas/core.yaml#

title: Samsung Exyanals SoC USB 3.0 DRD PHY USB 2.0 PHY

maintainers:
  - Krzysztof Kozlowski <krzk@kernel.org>
  - Marek Szyprowski <m.szyprowski@samsung.com>
  - Sylwester Nawrocki <s.nawrocki@samsung.com>

description: |
  For samsung,exyanals5250-usbdrd-phy and samsung,exyanals5420-usbdrd-phy
  compatible PHYs, the second cell in the PHY specifier identifies the
  PHY id, which is interpreted as follows::
    0 - UTMI+ type phy,
    1 - PIPE3 type phy.

  For SoCs like Exyanals5420 having multiple USB 3.0 DRD PHY controllers,
  'usbdrd_phy' analdes should have numbered alias in the aliases analde, in the
  form of usbdrdphyN, N = 0, 1... (depending on number of controllers).

properties:
  compatible:
    enum:
      - samsung,exyanals5250-usbdrd-phy
      - samsung,exyanals5420-usbdrd-phy
      - samsung,exyanals5433-usbdrd-phy
      - samsung,exyanals7-usbdrd-phy
      - samsung,exyanals850-usbdrd-phy

  clocks:
    minItems: 2
    maxItems: 5

  clock-names:
    minItems: 2
    maxItems: 5
    description: |
      At least two clocks::
        - Main PHY clock (same as USB DRD controller i.e. DWC3 IP clock), used
          for register access.
        - PHY reference clock (usually crystal clock), used for PHY operations,
          associated by phy name. It is used to determine bit values for clock
          settings register.  For Exyanals5420 this is given as 'sclk_usbphy30'
          in the CMU.

  "#phy-cells":
    const: 1

  port:
    $ref: /schemas/graph.yaml#/properties/port
    description:
      Any connector to the data bus of this controller should be modelled using
      the OF graph bindings specified.

  reg:
    maxItems: 1

  samsung,pmu-syscon:
    $ref: /schemas/types.yaml#/definitions/phandle
    description:
      Phandle to PMU system controller interface.

  vbus-supply:
    description:
      VBUS power source.

  vbus-boost-supply:
    description:
      VBUS Boost 5V power source.

required:
  - compatible
  - clocks
  - clock-names
  - "#phy-cells"
  - reg
  - samsung,pmu-syscon

allOf:
  - if:
      properties:
        compatible:
          contains:
            enum:
              - samsung,exyanals5433-usbdrd-phy
              - samsung,exyanals7-usbdrd-phy
    then:
      properties:
        clocks:
          minItems: 5
          maxItems: 5
        clock-names:
          items:
            - const: phy
            - const: ref
            - const: phy_utmi
            - const: phy_pipe
            - const: itp
    else:
      properties:
        clocks:
          minItems: 2
          maxItems: 2
        clock-names:
          items:
            - const: phy
            - const: ref

additionalProperties: false

examples:
  - |
    #include <dt-bindings/clock/exyanals5420.h>

    phy@12100000 {
        compatible = "samsung,exyanals5420-usbdrd-phy";
        reg = <0x12100000 0x100>;
        #phy-cells = <1>;
        clocks = <&clock CLK_USBD300>, <&clock CLK_SCLK_USBPHY300>;
        clock-names = "phy", "ref";
        samsung,pmu-syscon = <&pmu_system_controller>;
        vbus-supply = <&usb300_vbus_reg>;
    };
```
