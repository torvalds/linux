## Documentation/devicetree/bindings/phy/uniphier-pcie-phy.txt
```
Socionext UniPhier PCIe PHY bindings

This describes the devicetree bindings for PHY interface built into
PCIe controller implemented on Socionext UniPhier SoCs.

Required properties:
- compatible: Should contain one of the following:
    "socionext,uniphier-pro5-pcie-phy" - for Pro5 PHY
    "socionext,uniphier-ld20-pcie-phy" - for LD20 PHY
    "socionext,uniphier-pxs3-pcie-phy" - for PXs3 PHY
- reg: Specifies offset and length of the register set for the device.
- #phy-cells: Must be zero.
- clocks: A list of phandles to the clock gate for PCIe glue layer
	including this phy.
- clock-names: For Pro5 only, should contain the following:
    "gio", "link" - for Pro5 SoC
- resets: A list of phandles to the reset line for PCIe glue layer
	including this phy.
- reset-names: For Pro5 only, should contain the following:
    "gio", "link" - for Pro5 SoC

Optional properties:
- socionext,syscon: A phandle to system control to set configurations
	for phy.

Refer to phy/phy-bindings.txt for the generic PHY binding properties.

Example:
	pcie_phy: phy@66038000 {
		compatible = "socionext,uniphier-ld20-pcie-phy";
		reg = <0x66038000 0x4000>;
		#phy-cells = <0>;
		clocks = <&sys_clk 24>;
		resets = <&sys_rst 24>;
		socionext,syscon = <&soc_glue>;
	};
```

## Documentation/devicetree/bindings/phy/uniphier-usb2-phy.txt
```
Socionext UniPhier USB2 PHY

This describes the devicetree bindings for PHY interface built into
USB2 controller implemented on Socionext UniPhier SoCs.

Pro4 SoC has both USB2 and USB3 host controllers, however, this USB3
controller doesn't include its own High-Speed PHY. This needs to specify
USB2 PHY instead of USB3 HS-PHY.

Required properties:
- compatible: Should contain one of the following:
    "socionext,uniphier-pro4-usb2-phy" - for Pro4 SoC
    "socionext,uniphier-ld11-usb2-phy" - for LD11 SoC

Sub-nodes:
Each PHY should be represented as a sub-node.

Sub-nodes required properties:
- #phy-cells: Should be 0.
- reg: The number of the PHY.

Sub-nodes optional properties:
- vbus-supply: A phandle to the regulator for USB VBUS.

Refer to phy/phy-bindings.txt for the generic PHY binding properties.

Example:
	soc-glue@5f800000 {
		...
		usb-phy {
			compatible = "socionext,uniphier-ld11-usb2-phy";
			usb_phy0: phy@0 {
				reg = <0>;
				#phy-cells = <0>;
			};
			...
		};
	};

	usb@5a800100 {
		compatible = "socionext,uniphier-ehci", "generic-ehci";
		...
		phy-names = "usb";
		phys = <&usb_phy0>;
	};
```

## Documentation/devicetree/bindings/phy/uniphier-usb3-hsphy.txt
```
Socionext UniPhier USB3 High-Speed (HS) PHY

This describes the devicetree bindings for PHY interfaces built into
USB3 controller implemented on Socionext UniPhier SoCs.
Although the controller includes High-Speed PHY and Super-Speed PHY,
this describes about High-Speed PHY.

Required properties:
- compatible: Should contain one of the following:
    "socionext,uniphier-pro5-usb3-hsphy" - for Pro5 SoC
    "socionext,uniphier-pxs2-usb3-hsphy" - for PXs2 SoC
    "socionext,uniphier-ld20-usb3-hsphy" - for LD20 SoC
    "socionext,uniphier-pxs3-usb3-hsphy" - for PXs3 SoC
- reg: Specifies offset and length of the register set for the device.
- #phy-cells: Should be 0.
- clocks: A list of phandles to the clock gate for USB3 glue layer.
	According to the clock-names, appropriate clocks are required.
- clock-names: Should contain the following:
    "gio", "link" - for Pro5 SoC
    "phy", "phy-ext", "link" - for PXs3 SoC, "phy-ext" is optional.
    "phy", "link" - for others
- resets: A list of phandles to the reset control for USB3 glue layer.
	According to the reset-names, appropriate resets are required.
- reset-names: Should contain the following:
    "gio", "link" - for Pro5 SoC
    "phy", "link" - for others

Optional properties:
- vbus-supply: A phandle to the regulator for USB VBUS.
- nvmem-cells: Phandles to nvmem cell that contains the trimming data.
	Available only for HS-PHY implemented on LD20 and PXs3, and
	if unspecified, default value is used.
- nvmem-cell-names: Should be the following names, which correspond to
	each nvmem-cells.
	All of the 3 parameters associated with the following names are
	required for each port, if any one is omitted, the trimming data
	of the port will not be set at all.
    "rterm", "sel_t", "hs_i" - Each cell name for phy parameters

Refer to phy/phy-bindings.txt for the generic PHY binding properties.

Example:

	usb-glue@65b00000 {
		compatible = "socionext,uniphier-ld20-dwc3-glue",
			     "simple-mfd";
		#address-cells = <1>;
		#size-cells = <1>;
		ranges = <0 0x65b00000 0x400>;

		usb_vbus0: regulator {
			...
		};

		usb_hsphy0: hs-phy@200 {
			compatible = "socionext,uniphier-ld20-usb3-hsphy";
			reg = <0x200 0x10>;
			#phy-cells = <0>;
			clock-names = "link", "phy";
			clocks = <&sys_clk 14>, <&sys_clk 16>;
			reset-names = "link", "phy";
			resets = <&sys_rst 14>, <&sys_rst 16>;
			vbus-supply = <&usb_vbus0>;
			nvmem-cell-names = "rterm", "sel_t", "hs_i";
			nvmem-cells = <&usb_rterm0>, <&usb_sel_t0>,
				      <&usb_hs_i0>;
		};
		...
	};
```

## Documentation/devicetree/bindings/phy/uniphier-usb3-ssphy.txt
```
Socionext UniPhier USB3 Super-Speed (SS) PHY

This describes the devicetree bindings for PHY interfaces built into
USB3 controller implemented on Socionext UniPhier SoCs.
Although the controller includes High-Speed PHY and Super-Speed PHY,
this describes about Super-Speed PHY.

Required properties:
- compatible: Should contain one of the following:
    "socionext,uniphier-pro4-usb3-ssphy" - for Pro4 SoC
    "socionext,uniphier-pro5-usb3-ssphy" - for Pro5 SoC
    "socionext,uniphier-pxs2-usb3-ssphy" - for PXs2 SoC
    "socionext,uniphier-ld20-usb3-ssphy" - for LD20 SoC
    "socionext,uniphier-pxs3-usb3-ssphy" - for PXs3 SoC
- reg: Specifies offset and length of the register set for the device.
- #phy-cells: Should be 0.
- clocks: A list of phandles to the clock gate for USB3 glue layer.
	According to the clock-names, appropriate clocks are required.
- clock-names:
    "gio", "link" - for Pro4 and Pro5 SoC
    "phy", "phy-ext", "link" - for PXs3 SoC, "phy-ext" is optional.
    "phy", "link" - for others
- resets: A list of phandles to the reset control for USB3 glue layer.
	According to the reset-names, appropriate resets are required.
- reset-names:
    "gio", "link" - for Pro4 and Pro5 SoC
    "phy", "link" - for others

Optional properties:
- vbus-supply: A phandle to the regulator for USB VBUS.

Refer to phy/phy-bindings.txt for the generic PHY binding properties.

Example:

	usb-glue@65b00000 {
		compatible = "socionext,uniphier-ld20-dwc3-glue",
			     "simple-mfd";
		#address-cells = <1>;
		#size-cells = <1>;
		ranges = <0 0x65b00000 0x400>;

		usb_vbus0: regulator {
			...
		};

		usb_ssphy0: ss-phy@300 {
			compatible = "socionext,uniphier-ld20-usb3-ssphy";
			reg = <0x300 0x10>;
			#phy-cells = <0>;
			clock-names = "link", "phy";
			clocks = <&sys_clk 14>, <&sys_clk 16>;
			reset-names = "link", "phy";
			resets = <&sys_rst 14>, <&sys_rst 16>;
			vbus-supply = <&usb_vbus0>;
		};
		...
	};
```

## Documentation/devicetree/bindings/phy/xlnx,zynqmp-psgtr.yaml
```yaml
# SPDX-License-Identifier: (GPL-2.0-only OR BSD-2-Clause)
%YAML 1.2
---
$id: http://devicetree.org/schemas/phy/xlnx,zynqmp-psgtr.yaml#
$schema: http://devicetree.org/meta-schemas/core.yaml#

title: Xilinx ZynqMP Gigabit Transceiver PHY

maintainers:
  - Laurent Pinchart <laurent.pinchart@ideasonboard.com>

description: |
  This binding describes the Xilinx ZynqMP Gigabit Transceiver (GTR) PHY. The
  GTR provides four lanes and is used by USB, SATA, PCIE, Display port and
  Ethernet SGMII controllers.

properties:
  "#phy-cells":
    const: 4
    description: |
      The cells contain the following arguments.

      - description: The GTR lane
        minimum: 0
        maximum: 3
      - description: The PHY type
        enum:
          - PHY_TYPE_DP
          - PHY_TYPE_PCIE
          - PHY_TYPE_SATA
          - PHY_TYPE_SGMII
          - PHY_TYPE_USB3
      - description: The PHY instance
        minimum: 0
        maximum: 1 # for DP, SATA or USB
        maximum: 3 # for PCIE or SGMII
      - description: The reference clock number
        minimum: 0
        maximum: 3

  compatible:
    enum:
      - xlnx,zynqmp-psgtr-v1.1
      - xlnx,zynqmp-psgtr

  clocks:
    minItems: 1
    maxItems: 4
    description: |
      Clock for each PS_MGTREFCLK[0-3] reference clock input. Unconnected
      inputs shall not have an entry.

  clock-names:
    minItems: 1
    maxItems: 4
    items:
      pattern: "^ref[0-3]$"

  reg:
    items:
      - description: SERDES registers block
      - description: SIOU registers block

  reg-names:
    items:
      - const: serdes
      - const: siou

  xlnx,tx-termination-fix:
    description: |
      Include this for fixing functional issue with the TX termination
      resistance in GT, which can be out of spec for the XCZU9EG silicon
      version.
    type: boolean

required:
  - "#phy-cells"
  - compatible
  - reg
  - reg-names

if:
  properties:
    compatible:
      const: xlnx,zynqmp-psgtr-v1.1

then:
  properties:
    xlnx,tx-termination-fix: false

additionalProperties: false

examples:
  - |
    phy: phy@fd400000 {
        compatible = "xlnx,zynqmp-psgtr-v1.1";
        reg = <0xfd400000 0x40000>,
              <0xfd3d0000 0x1000>;
        reg-names = "serdes", "siou";
        clocks = <&refclks 3>, <&refclks 2>, <&refclks 0>;
        clock-names = "ref1", "ref2", "ref3";
        #phy-cells = <4>;
    };

...
```

## Documentation/devicetree/bindings/pinctrl/abilis,tb10x-iomux.txt
```
Abilis Systems TB10x pin controller
===================================

Required properties
-------------------

- compatible: should be "abilis,tb10x-iomux";
- reg: should contain the physical address and size of the pin controller's
  register range.


Function definitions
--------------------

Functions are defined (and referenced) by sub-nodes of the pin controller.
Every sub-node defines exactly one function (implying a set of pins).
Every function is associated to one named pin group inside the pin controller
driver and these names are used to associate pin group predefinitions to pin
controller sub-nodes.

Required function definition subnode properties:
  - abilis,function: should be set to the name of the function's pin group.

The following pin groups are available:
  - GPIO ports: gpioa, gpiob, gpioc, gpiod, gpioe, gpiof, gpiog,
                gpioh, gpioi, gpioj, gpiok, gpiol, gpiom, gpion
  - Serial TS input ports: mis0, mis1, mis2, mis3, mis4, mis5, mis6, mis7
  - Parallel TS input ports: mip1, mip3, mip5, mip7
  - Serial TS output ports: mos0, mos1, mos2, mos3
  - Parallel TS output port: mop
  - CI+ port: ciplus
  - CableCard (Mcard) port: mcard
  - Smart card ports: stc0, stc1
  - UART ports: uart0, uart1
  - SPI ports: spi1, spi3
  - JTAG: jtag

All other ports of the chip are not multiplexed and thus not managed by this
driver.


GPIO ranges definition
----------------------

The named pin groups of GPIO ports can be used to define GPIO ranges as
explained in Documentation/devicetree/bindings/gpio/gpio.txt.


Example
-------

iomux: iomux@ff10601c {
	compatible = "abilis,tb10x-iomux";
	reg = <0xFF10601c 0x4>;
	pctl_gpio_a: pctl-gpio-a {
		abilis,function = "gpioa";
	};
	pctl_uart0: pctl-uart0 {
		abilis,function = "uart0";
	};
};
uart@ff100000 {
	compatible = "snps,dw-apb-uart";
	reg = <0xFF100000 0x100>;
	clock-frequency = <166666666>;
	interrupts = <25 1>;
	reg-shift = <2>;
	reg-io-width = <4>;
	pinctrl-names = "default";
	pinctrl-0 = <&pctl_uart0>;
};
gpioa: gpio@ff140000 {
	compatible = "abilis,tb10x-gpio";
	reg = <0xFF140000 0x1000>;
	gpio-controller;
	#gpio-cells = <2>;
	ngpio = <3>;
	gpio-ranges = <&iomux 0 0>;
	gpio-ranges-group-names = "gpioa";
};
```
