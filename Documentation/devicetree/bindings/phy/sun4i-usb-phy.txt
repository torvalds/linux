## Documentation/devicetree/bindings/phy/sun4i-usb-phy.txt
```
Allwinner sun4i USB PHY
-----------------------

Required properties:
- compatible : should be one of
  * allwinner,sun4i-a10-usb-phy
  * allwinner,sun5i-a13-usb-phy
  * allwinner,sun6i-a31-usb-phy
  * allwinner,sun7i-a20-usb-phy
  * allwinner,sun8i-a23-usb-phy
  * allwinner,sun8i-a33-usb-phy
  * allwinner,sun8i-a83t-usb-phy
  * allwinner,sun8i-h3-usb-phy
  * allwinner,sun8i-v3s-usb-phy
  * allwinner,sun50i-a64-usb-phy
- reg : a list of offset + length pairs
- reg-names :
  * "phy_ctrl"
  * "pmu0" for H3, V3s and A64
  * "pmu1"
  * "pmu2" for sun4i, sun6i, sun7i, sun8i-a83t or sun8i-h3
  * "pmu3" for sun8i-h3
- #phy-cells : from the generic phy bindings, must be 1
- clocks : phandle + clock specifier for the phy clocks
- clock-names :
  * "usb_phy" for sun4i, sun5i or sun7i
  * "usb0_phy", "usb1_phy" and "usb2_phy" for sun6i
  * "usb0_phy", "usb1_phy" for sun8i
  * "usb0_phy", "usb1_phy", "usb2_phy" and "usb2_hsic_12M" for sun8i-a83t
  * "usb0_phy", "usb1_phy", "usb2_phy" and "usb3_phy" for sun8i-h3
- resets : a list of phandle + reset specifier pairs
- reset-names :
  * "usb0_reset"
  * "usb1_reset"
  * "usb2_reset" for sun4i, sun6i, sun7i, sun8i-a83t or sun8i-h3
  * "usb3_reset" for sun8i-h3

Optional properties:
- usb0_id_det-gpios : gpio phandle for reading the otg id pin value
- usb0_vbus_det-gpios : gpio phandle for detecting the presence of usb0 vbus
- usb0_vbus_power-supply: power-supply phandle for usb0 vbus presence detect
- usb0_vbus-supply : regulator phandle for controller usb0 vbus
- usb1_vbus-supply : regulator phandle for controller usb1 vbus
- usb2_vbus-supply : regulator phandle for controller usb2 vbus
- usb3_vbus-supply : regulator phandle for controller usb3 vbus

Example:
	usbphy: phy@01c13400 {
		#phy-cells = <1>;
		compatible = "allwinner,sun4i-a10-usb-phy";
		/* phy base regs, phy1 pmu reg, phy2 pmu reg */
		reg = <0x01c13400 0x10 0x01c14800 0x4 0x01c1c800 0x4>;
		reg-names = "phy_ctrl", "pmu1", "pmu2";
		clocks = <&usb_clk 8>;
		clock-names = "usb_phy";
		resets = <&usb_clk 0>, <&usb_clk 1>, <&usb_clk 2>;
		reset-names = "usb0_reset", "usb1_reset", "usb2_reset";
		pinctrl-names = "default";
		pinctrl-0 = <&usb0_id_detect_pin>, <&usb0_vbus_detect_pin>;
		usb0_id_det-gpios = <&pio 7 19 GPIO_ACTIVE_HIGH>; /* PH19 */
		usb0_vbus_det-gpios = <&pio 7 22 GPIO_ACTIVE_HIGH>; /* PH22 */
		usb0_vbus-supply = <&reg_usb0_vbus>;
		usb1_vbus-supply = <&reg_usb1_vbus>;
		usb2_vbus-supply = <&reg_usb2_vbus>;
	};
```

## Documentation/devicetree/bindings/phy/sun9i-usb-phy.txt
```
Allwinner sun9i USB PHY
-----------------------

Required properties:
- compatible : should be one of
  * allwinner,sun9i-a80-usb-phy
- reg : a list of offset + length pairs
- #phy-cells : from the generic phy bindings, must be 0
- phy_type : "hsic" for HSIC usage;
	     other values or absence of this property indicates normal USB
- clocks : phandle + clock specifier for the phy clocks
- clock-names : depending on the "phy_type" property,
  * "phy" for normal USB
  * "hsic_480M", "hsic_12M" for HSIC
- resets : a list of phandle + reset specifier pairs
- reset-names : depending on the "phy_type" property,
  * "phy" for normal USB
  * "hsic" for HSIC

Optional Properties:
- phy-supply : from the generic phy bindings, a phandle to a regulator that
	       provides power to VBUS.

It is recommended to list all clocks and resets available.
The driver will only use those matching the phy_type.

Example:
	usbphy1: phy@00a01800 {
		compatible = "allwinner,sun9i-a80-usb-phy";
		reg = <0x00a01800 0x4>;
		clocks = <&usb_phy_clk 2>, <&usb_phy_clk 10>,
		       <&usb_phy_clk 3>;
		clock-names = "hsic_480M", "hsic_12M", "phy";
		resets = <&usb_phy_clk 18>, <&usb_phy_clk 19>;
		reset-names = "hsic", "phy";
		status = "disabled";
		#phy-cells = <0>;
	};
```

## Documentation/devicetree/bindings/phy/sunplus,sp7021-usb2-phy.yaml
```yaml
# SPDX-License-Identifier: (GPL-2.0-only OR BSD-2-Clause)
# Copyright (C) Sunplus Co., Ltd. 2021
%YAML 1.2
---
$id: "http://devicetree.org/schemas/phy/sunplus,sp7021-usb2-phy.yaml#"
$schema: "http://devicetree.org/meta-schemas/core.yaml#"

title: Sunplus SP7021 USB 2.0 PHY Controller

maintainers:
  - Vincent Shih <vincent.sunplus@gmail.com>

properties:
  compatible:
    const: sunplus,sp7021-usb2-phy

  reg:
    items:
      - description: UPHY register region
      - description: MOON4 register region

  reg-names:
    items:
      - const: phy
      - const: moon4

  clocks:
    maxItems: 1

  resets:
    maxItems: 1

  "#phy-cells":
    const: 0

  nvmem-cell-names:
    description: names corresponding to the nvmem cells of disconnect voltage
    const: disc_vol

  nvmem-cells:
    description: nvmem cell address of disconnect voltage
    maxItems: 1

  sunplus,disc-vol-addr-off:
    $ref: /schemas/types.yaml#/definitions/uint32
    description: the otp address offset of disconnect voltage

required:
  - compatible
  - reg
  - reg-names
  - clocks
  - resets
  - "#phy-cells"
  - nvmem-cell-names
  - nvmem-cells
  - sunplus,disc-vol-addr-off

additionalProperties: false

examples:
  - |
    sp_uphy0: usb-phy@9c004a80 {
      compatible = "sunplus,sp7021-usb2-phy";
      reg = <0x9c004a80 0x80>, <0x9c000248 0x10>;
      reg-names = "phy", "moon4";
      clocks = <&clkc 0x3d>;
      resets = <&rstc 0x2d>;
      #phy-cells = <0>;
      nvmem-cell-names = "disc_vol";
      nvmem-cells = <&disc_vol>;
      sunplus,disc-vol-addr-off = <0>;
    };
```

## Documentation/devicetree/bindings/phy/ti,control-phy-otghs.yaml
```yaml
# SPDX-License-Identifier: (GPL-2.0-only OR BSD-2-Clause)
%YAML 1.2
---
$id: http://devicetree.org/schemas/phy/ti,control-phy-otghs.yaml#
$schema: http://devicetree.org/meta-schemas/core.yaml#

title: TI OMAP Control PHY Module

maintainers:
  - Roger Quadros <rogerq@ti.com>

description:
  The TI OMAP Control PHY module is a hardware block within the system
  control module (SCM) of Texas Instruments OMAP SoCs. It provides
  centralized control over power, configuration, and auxiliary features
  for multiple on-chip PHYs. This module is essential for proper PHY
  operation in power-constrained embedded systems.

properties:
  $nodename:
    pattern: "^phy@[0-9a-f]+$"

  compatible:
    enum:
      - ti,control-phy-otghs
      - ti,control-phy-pcie
      - ti,control-phy-pipe3
      - ti,control-phy-usb2
      - ti,control-phy-usb2-am437
      - ti,control-phy-usb2-dra7

  reg:
    minItems: 1
    maxItems: 3

  reg-names:
    minItems: 1
    maxItems: 3
    items:
      enum: [otghs_control, power, pcie_pcs, control_sma]

allOf:
  - if:
      properties:
        compatible:
          contains:
            enum:
              - ti,control-phy-otghs
    then:
      properties:
        reg-names:
          const: otghs_control

  - if:
      properties:
        compatible:
          contains:
            enum:
              - ti,control-phy-pcie
    then:
      properties:
        reg:
          minItems: 3

        reg-names:
          items:
            - const: power
            - const: pcie_pcs
            - const: control_sma

  - if:
      properties:
        compatible:
          contains:
            enum:
              - ti,control-phy-usb2
              - ti,control-phy-usb2-dra7
              - ti,control-phy-usb2-am437
              - ti,control-phy-pipe3
    then:
      properties:
        reg-names:
          const: power

required:
  - reg
  - compatible
  - reg-names

unevaluatedProperties: false

examples:
  - |
    phy@4a00233c {
        compatible = "ti,control-phy-otghs";
        reg = <0x4a00233c 0x4>;
        reg-names = "otghs_control";
    };
...
```

## Documentation/devicetree/bindings/phy/ti,da830-usb-phy.yaml
```yaml
# SPDX-License-Identifier: (GPL-2.0-only OR BSD-2-Clause)
%YAML 1.2
---
$id: http://devicetree.org/schemas/phy/ti,da830-usb-phy.yaml#
$schema: http://devicetree.org/meta-schemas/core.yaml#

title: TI DA8xx/OMAP-L1xx/AM18xx USB PHY

maintainers:
  - David Lechner <david@lechnology.com>

description: >
  This device controls the PHY for both the USB 1.1 OHCI and USB 2.0 OTG
  controllers on DA8xx SoCs.

  It also requires a "syscon" node with compatible = "ti,da830-cfgchip", "syscon"
  to access the CFGCHIP2 register.

properties:
  compatible:
    items:
      - const: ti,da830-usb-phy

  '#phy-cells':
    const: 1
    description:
      Consumers of this device should use index 0 for the USB 2.0 phy device and
      index 1 for the USB 1.1 phy device.

  clocks:
    maxItems: 2

  clock-names:
    items:
      - const: usb0_clk48
      - const: usb1_clk48

required:
  - compatible
  - '#phy-cells'
  - clocks
  - clock-names

additionalProperties: false

examples:
  - |
    usb-phy {
        compatible = "ti,da830-usb-phy";
        #phy-cells = <1>;
        clocks = <&usb_phy_clk 0>, <&usb_phy_clk 1>;
        clock-names = "usb0_clk48", "usb1_clk48";
    };
```

## Documentation/devicetree/bindings/phy/ti,dm8168-usb-phy.yaml
```yaml
# SPDX-License-Identifier: (GPL-2.0-only OR BSD-2-Clause)
%YAML 1.2
---
$id: http://devicetree.org/schemas/phy/ti,dm8168-usb-phy.yaml#
$schema: http://devicetree.org/meta-schemas/core.yaml#

title: TI DM8168 USB PHY

maintainers:
  - Tony Lindgren <tony@atomide.com>

properties:
  compatible:
    const: ti,dm8168-usb-phy

  reg:
    maxItems: 1

  reg-names:
    items:
      - const: phy

  clocks:
    maxItems: 1

  clock-names:
    items:
      - const: refclk

  '#phy-cells':
    const: 0

  syscon:
    $ref: /schemas/types.yaml#/definitions/phandle
    description: Phandle for the syscon node to access misc registers.

required:
  - compatible
  - reg
  - reg-names
  - clocks
  - clock-names
  - '#phy-cells'
  - syscon

additionalProperties: false

examples:
  - |
    usb-phy@20 {
        compatible = "ti,dm8168-usb-phy";
        reg = <0x20 0x8>;
        reg-names = "phy";
        clocks = <&main_fapll 6>;
        clock-names = "refclk";
        #phy-cells = <0>;
        syscon = <&scm_conf>;
    };
```

## Documentation/devicetree/bindings/phy/ti,ds125df111.yaml
```yaml
# SPDX-License-Identifier: (GPL-2.0-only OR BSD-2-Clause)
%YAML 1.2
---
$id: http://devicetree.org/schemas/phy/ti,ds125df111.yaml#
$schema: http://devicetree.org/meta-schemas/core.yaml#

title: TI DS125DF111 Retimer PHY

description:
  This binding describes the TI DS125DF111 multi-protocol Retimer PHY.

maintainers:
  - Ioana Ciornei <ioana.ciornei@nxp.com>

properties:
  compatible:
    const: ti,ds125df111

  reg:
    maxItems: 1

  "#phy-cells":
    const: 1
    description: |
      The phandle's argument in the PHY specifier selects one of the two
      channels of the retimer

required:
  - compatible
  - reg
  - "#phy-cells"

additionalProperties: false

examples:
  - |
    i2c {
      #address-cells = <1>;
      #size-cells = <0>;

      phy@18 {
        compatible = "ti,ds125df111";
        reg = <0x18>;
        #phy-cells = <1>;
      };
    };
```

## Documentation/devicetree/bindings/phy/ti,keystone-usbphy.yaml
```yaml
# SPDX-License-Identifier: (GPL-2.0-only OR BSD-2-Clause)
%YAML 1.2
---
$id: http://devicetree.org/schemas/phy/ti,keystone-usbphy.yaml#
$schema: http://devicetree.org/meta-schemas/core.yaml#

title: TI Keystone USB PHY

maintainers:
  - Nishanth Menon <nm@ti.com>
  - Santosh Shilimkar <ssantosh@kernel.org>

description:
  The main purpose of this PHY driver is to enable the USB PHY reference clock
  gate on the Keystone SOC for both the USB2 and USB3 PHY. Otherwise it is just
  an NOP PHY driver. Hence this node is referenced as both the usb2 and usb3
  phy node in the USB Glue layer driver node.

properties:
  compatible:
    const: ti,keystone-usbphy

  reg:
    maxItems: 1

required:
  - compatible
  - reg

additionalProperties: false

examples:
  - |
    usb-phy@2620738 {
        compatible = "ti,keystone-usbphy";
        reg = <0x2620738 32>;
    };
```

## Documentation/devicetree/bindings/phy/ti,omap-usb2.yaml
```yaml
# SPDX-License-Identifier: (GPL-2.0-only OR BSD-2-Clause)
%YAML 1.2
---
$id: http://devicetree.org/schemas/phy/ti,omap-usb2.yaml#
$schema: http://devicetree.org/meta-schemas/core.yaml#

title: OMAP USB2 PHY

maintainers:
  - Kishon Vijay Abraham I <kishon@ti.com>
  - Roger Quadros <rogerq@ti.com>

properties:
  compatible:
    oneOf:
      - items:
          - enum:
              - ti,dra7x-usb2
              - ti,dra7x-usb2-phy2
              - ti,am654-usb2
          - enum:
              - ti,omap-usb2
      - items:
          - const: ti,am437x-usb2
      - items:
          - const: ti,omap-usb2

  reg:
    maxItems: 1

  "#phy-cells":
    const: 0

  clocks:
    minItems: 1
    items:
      - description: wakeup clock
      - description: reference clock

  clock-names:
    minItems: 1
    items:
      - const: wkupclk
      - const: refclk

  syscon-phy-power:
    $ref: /schemas/types.yaml#definitions/phandle-array
    description:
      phandle/offset pair. Phandle to the system control module and
      register offset to power on/off the PHY.

  ctrl-module:
    $ref: /schemas/types.yaml#definitions/phandle
    description:
      (deprecated) phandle of the control module used by PHY driver
      to power on the PHY. Use syscon-phy-power instead.

required:
  - compatible
  - reg
  - "#phy-cells"
  - clocks
  - clock-names

additionalProperties: false

examples:
  - |
    usb0_phy: phy@4100000 {
      compatible = "ti,am654-usb2", "ti,omap-usb2";
      reg = <0x4100000 0x54>;
      syscon-phy-power = <&scm_conf 0x4000>;
      clocks = <&k3_clks 151 0>, <&k3_clks 151 1>;
      clock-names = "wkupclk", "refclk";
      #phy-cells = <0>;
    };
```
