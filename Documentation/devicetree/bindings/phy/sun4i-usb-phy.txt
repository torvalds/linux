## Documentation/devicetree/bindings/phy/ti,phy-usb3.yaml
```yaml
# SPDX-License-Identifier: (GPL-2.0-only OR BSD-2-Clause)
%YAML 1.2
---
$id: http://devicetree.org/schemas/phy/ti,phy-usb3.yaml#
$schema: http://devicetree.org/meta-schemas/core.yaml#

title: TI PIPE3 PHY Module

maintainers:
  - Roger Quadros <rogerq@ti.com>

description:
  The TI PIPE3 PHY is a high-speed SerDes (Serializer/Deserializer)
  transceiver integrated in OMAP5, DRA7xx/AM57xx, and similar SoCs.
  It supports multiple protocols (USB3, SATA, PCIe) using the PIPE3
  interface standard, which defines a common physical layer for
  high-speed serial interfaces.

properties:
  $nodename:
    pattern: "^(pcie-phy|usb3-phy|phy)@[0-9a-f]+$"

  compatible:
    enum:
      - ti,omap-usb3
      - ti,phy-pipe3-pcie
      - ti,phy-pipe3-sata
      - ti,phy-usb3

  reg:
    minItems: 2
    maxItems: 3

  reg-names:
    minItems: 2
    items:
      - const: phy_rx
      - const: phy_tx
      - const: pll_ctrl

  "#phy-cells":
    const: 0

  clocks:
    minItems: 2
    maxItems: 7

  clock-names:
    minItems: 2
    maxItems: 7
    items:
      enum: [wkupclk, sysclk, refclk, dpll_ref,
             dpll_ref_m2, phy-div, div-clk]

  syscon-phy-power:
    $ref: /schemas/types.yaml#/definitions/phandle-array
    maxItems: 1
    items:
      items:
        - description: Phandle to the system control module
        - description: Register offset controlling PHY power

  syscon-pllreset:
    $ref: /schemas/types.yaml#/definitions/phandle-array
    maxItems: 1
    items:
      items:
        - description: Phandle to the system control module
        - description: Register offset of CTRL_CORE_SMA_SW_0

  syscon-pcs:
    $ref: /schemas/types.yaml#/definitions/phandle-array
    maxItems: 1
    items:
      items:
        - description: Phandle to the system control module
        - description: Register offset for PCS delay programming

  ctrl-module:
    $ref: /schemas/types.yaml#/definitions/phandle
    description:
      Phandle of control module for PHY power on.
    deprecated: true

allOf:
  - if:
      properties:
        compatible:
          contains:
            const: ti,phy-pipe3-sata
    then:
      properties:
        syscon-pllreset: true
    else:
      properties:
        syscon-pllreset: false

required:
  - reg
  - compatible
  - reg-names
  - "#phy-cells"
  - clocks
  - clock-names

unevaluatedProperties: false

examples:
  - |
    /* TI PIPE3 USB3 PHY */
    usb3-phy@4a084400 {
        compatible = "ti,phy-usb3";
        reg = <0x4a084400 0x80>,
              <0x4a084800 0x64>,
              <0x4a084c00 0x40>;
        reg-names = "phy_rx", "phy_tx", "pll_ctrl";
        #phy-cells = <0>;
        clocks = <&usb_phy_cm_clk32k>,
                 <&sys_clkin>,
                 <&usb_otg_ss_refclk960m>;
        clock-names = "wkupclk", "sysclk", "refclk";
        ctrl-module = <&omap_control_usb>;
    };

  - |
    /* TI PIPE3 SATA PHY */
    phy@4a096000 {
        compatible = "ti,phy-pipe3-sata";
        reg = <0x4a096000 0x80>,  /* phy_rx */
              <0x4a096400 0x64>,  /* phy_tx */
              <0x4a096800 0x40>;  /* pll_ctrl */
        reg-names = "phy_rx", "phy_tx", "pll_ctrl";
        clocks = <&sys_clkin1>, <&sata_ref_clk>;
        clock-names = "sysclk", "refclk";
        syscon-pllreset = <&scm_conf 0x3fc>;
        #phy-cells = <0>;
    };
...
```

## Documentation/devicetree/bindings/phy/ti,tcan104x-can.yaml
```yaml
# SPDX-License-Identifier: (GPL-2.0-only OR BSD-2-Clause)
%YAML 1.2
---
$id: http://devicetree.org/schemas/phy/ti,tcan104x-can.yaml#
$schema: http://devicetree.org/meta-schemas/core.yaml#

title: TCAN104x CAN TRANSCEIVER PHY

maintainers:
  - Aswath Govindraju <a-govindraju@ti.com>

properties:
  $nodename:
    pattern: "^can-phy"

  compatible:
    oneOf:
      - items:
          - enum:
              - microchip,ata6561
              - ti,tcan1051
          - const: ti,tcan1042
      - enum:
          - ti,tcan1042
          - ti,tcan1043
          - nxp,tja1048
          - nxp,tja1051
          - nxp,tja1057
          - nxp,tjr1443

  '#phy-cells':
    enum: [0, 1]

  silent-gpios:
    description:
      gpio node to toggle silent signal on transceiver
    maxItems: 1

  standby-gpios:
    description:
      gpio node to toggle standby signal on transceiver. For two Items, item 1
      is for stbn1, item 2 is for stbn2.
    minItems: 1
    maxItems: 2

  enable-gpios:
    description:
      gpio node to toggle enable signal on transceiver
    maxItems: 1

  max-bitrate:
    $ref: /schemas/types.yaml#/definitions/uint32
    description:
      max bit rate supported in bps
    minimum: 1

  mux-states:
    description:
      mux controller node to route the signals from controller to
      transceiver.
    maxItems: 1

required:
  - compatible
  - '#phy-cells'

allOf:
  - if:
      properties:
        compatible:
          enum:
            - nxp,tjr1443
            - ti,tcan1042
            - ti,tcan1043
    then:
      properties:
        '#phy-cells':
          const: 0
        silent-gpios: false
        standby-gpios:
          maxItems: 1

  - if:
      properties:
        compatible:
          contains:
            const: nxp,tja1048
    then:
      properties:
        '#phy-cells':
          const: 1
        enable-gpios: false
        silent-gpios: false
        standby-gpios:
          minItems: 2

  - if:
      properties:
        compatible:
          contains:
            const: nxp,tja1051
    then:
      properties:
        '#phy-cells':
          const: 0
        standby-gpios: false

  - if:
      properties:
        compatible:
          contains:
            const: nxp,tja1057
    then:
      properties:
        '#phy-cells':
          const: 0
        enable-gpios: false
        standby-gpios: false

additionalProperties: false

examples:
  - |
    #include <dt-bindings/gpio/gpio.h>

    transceiver1: can-phy {
      compatible = "ti,tcan1043";
      #phy-cells = <0>;
      max-bitrate = <5000000>;
      standby-gpios = <&wakeup_gpio1 16 GPIO_ACTIVE_LOW>;
      enable-gpios = <&main_gpio1 67 GPIO_ACTIVE_HIGH>;
      mux-states = <&mux0 1>;
    };
```

## Documentation/devicetree/bindings/phy/ti-phy-gmii-sel.txt
```
CPSW Port's Interface Mode Selection PHY Tree Bindings
-----------------------------------------------

TI am335x/am437x/dra7(am5)/dm814x CPSW3G Ethernet Subsystem supports
two 10/100/1000 Ethernet ports with selectable G/MII, RMII, and RGMII interfaces.
The interface mode is selected by configuring the MII mode selection register(s)
(GMII_SEL) in the System Control Module chapter (SCM). GMII_SEL register(s) and
bit fields placement in SCM are different between SoCs while fields meaning
is the same.
                                               +--------------+
        +-------------------------------+      |SCM           |
        |                     CPSW      |      |  +---------+ |
        |        +--------------------------------+gmii_sel | |
        |        |                      |      |  +---------+ |
        |   +----v---+     +--------+   |      +--------------+
        |   |Port 1..<--+-->GMII/MII<------->
        |   |        |  |  |        |   |
        |   +--------+  |  +--------+   |
        |               |               |
        |               |  +--------+   |
        |               |  | RMII   <------->
        |               +-->        |   |
        |               |  +--------+   |
        |               |               |
        |               |  +--------+   |
        |               |  | RGMII  <------->
        |               +-->        |   |
        |                  +--------+   |
        +-------------------------------+

CPSW Port's Interface Mode Selection PHY describes MII interface mode between
CPSW Port and Ethernet PHY which depends on Eth PHY and board configuration.

CPSW Port's Interface Mode Selection PHY device should defined as child device
of SCM node (scm_conf) and can be attached to each CPSW port node using standard
PHY bindings (See phy/phy-bindings.txt).

Required properties:
- compatible		: Should be "ti,am3352-phy-gmii-sel" for am335x platform
			  "ti,dra7xx-phy-gmii-sel" for dra7xx/am57xx platform
			  "ti,am43xx-phy-gmii-sel" for am43xx platform
			  "ti,dm814-phy-gmii-sel" for dm814x platform
- reg			: Address and length of the register set for the device
- #phy-cells		: must be 2.
			  cell 1 - CPSW port number (starting from 1)
			  cell 2 - RMII refclk mode

Examples:
	phy_gmii_sel: phy-gmii-sel {
		compatible = "ti,am3352-phy-gmii-sel";
		reg = <0x650 0x4>;
		#phy-cells = <2>;
	};

	mac: ethernet@4a100000 {
		compatible = "ti,am335x-cpsw","ti,cpsw";
		...

		cpsw_emac0: slave@4a100200 {
			...
			phys = <&phy_gmii_sel 1 1>;
		};

		cpsw_emac1: slave@4a100300 {
			...
			phys = <&phy_gmii_sel 2 1>;
		};
	};
```

## Documentation/devicetree/bindings/phy/ti-phy.txt
```
TI PHY: DT DOCUMENTATION FOR PHYs in TI PLATFORMs

OMAP CONTROL PHY

Required properties:
 - compatible: Should be one of
 "ti,control-phy-otghs" - if it has otghs_control mailbox register as on OMAP4.
 "ti,control-phy-usb2" - if it has Power down bit in control_dev_conf register
                        e.g. USB2_PHY on OMAP5.
 "ti,control-phy-pipe3" - if it has DPLL and individual Rx & Tx power control
                        e.g. USB3 PHY and SATA PHY on OMAP5.
 "ti,control-phy-pcie" - for pcie to support external clock for pcie and to
			set PCS delay value.
			e.g. PCIE PHY in DRA7x
 "ti,control-phy-usb2-dra7" - if it has power down register like USB2 PHY on
                        DRA7 platform.
 "ti,control-phy-usb2-am437" - if it has power down register like USB2 PHY on
                        AM437 platform.
 - reg : register ranges as listed in the reg-names property
 - reg-names: "otghs_control" for control-phy-otghs
	      "power", "pcie_pcs" and "control_sma" for control-phy-pcie
	      "power" for all other types

omap_control_usb: omap-control-usb@4a002300 {
        compatible = "ti,control-phy-otghs";
        reg = <0x4a00233c 0x4>;
        reg-names = "otghs_control";
};

OMAP USB2 PHY

Required properties:
 - compatible: Should be "ti,omap-usb2"
 - reg : Address and length of the register set for the device.
 - #phy-cells: determine the number of cells that should be given in the
   phandle while referencing this phy.
 - clocks: a list of phandles and clock-specifier pairs, one for each entry in
   clock-names.
 - clock-names: should include:
   * "wkupclk" - wakeup clock.
   * "refclk" - reference clock (optional).

Optional properties:
 - ctrl-module : phandle of the control module used by PHY driver to power on
   the PHY.

This is usually a subnode of ocp2scp to which it is connected.

usb2phy@4a0ad080 {
	compatible = "ti,omap-usb2";
	reg = <0x4a0ad080 0x58>;
	ctrl-module = <&omap_control_usb>;
	#phy-cells = <0>;
	clocks = <&usb_phy_cm_clk32k>, <&usb_otg_ss_refclk960m>;
	clock-names = "wkupclk", "refclk";
};

TI PIPE3 PHY

Required properties:
 - compatible: Should be "ti,phy-usb3", "ti,phy-pipe3-sata" or
   "ti,phy-pipe3-pcie. "ti,omap-usb3" is deprecated.
 - reg : Address and length of the register set for the device.
 - reg-names: The names of the register addresses corresponding to the registers
   filled in "reg".
 - #phy-cells: determine the number of cells that should be given in the
   phandle while referencing this phy.
 - clocks: a list of phandles and clock-specifier pairs, one for each entry in
   clock-names.
 - clock-names: should include:
   * "wkupclk" - wakeup clock.
   * "sysclk" - system clock.
   * "refclk" - reference clock.
   * "dpll_ref" - external dpll ref clk
   * "dpll_ref_m2" - external dpll ref clk
   * "phy-div" - divider for apll
   * "div-clk" - apll clock

Optional properties:
 - ctrl-module : phandle of the control module used by PHY driver to power on
   the PHY.
 - id: If there are multiple instance of the same type, in order to
   differentiate between each instance "id" can be used (e.g., multi-lane PCIe
   PHY). If "id" is not provided, it is set to default value of '1'.
 - syscon-pllreset: Handle to system control region that contains the
   CTRL_CORE_SMA_SW_0 register and register offset to the CTRL_CORE_SMA_SW_0
   register that contains the SATA_PLL_SOFT_RESET bit. Only valid for sata_phy.

This is usually a subnode of ocp2scp to which it is connected.

usb3phy@4a084400 {
	compatible = "ti,phy-usb3";
	reg = <0x4a084400 0x80>,
	      <0x4a084800 0x64>,
	      <0x4a084c00 0x40>;
	reg-names = "phy_rx", "phy_tx", "pll_ctrl";
	ctrl-module = <&omap_control_usb>;
	#phy-cells = <0>;
	clocks = <&usb_phy_cm_clk32k>,
		 <&sys_clkin>,
		 <&usb_otg_ss_refclk960m>;
	clock-names =	"wkupclk",
			"sysclk",
			"refclk";
};

sata_phy: phy@4A096000 {
	compatible = "ti,phy-pipe3-sata";
	reg = <0x4A096000 0x80>, /* phy_rx */
	      <0x4A096400 0x64>, /* phy_tx */
	      <0x4A096800 0x40>; /* pll_ctrl */
	reg-names = "phy_rx", "phy_tx", "pll_ctrl";
	ctrl-module = <&omap_control_sata>;
	clocks = <&sys_clkin1>, <&sata_ref_clk>;
	clock-names = "sysclk", "refclk";
	syscon-pllreset = <&scm_conf 0x3fc>;
	#phy-cells = <0>;
};
```

## Documentation/devicetree/bindings/phy/transmit-amplitude.yaml
```yaml
# SPDX-License-Identifier: (GPL-2.0 OR BSD-2-Clause)
%YAML 1.2
---
$id: http://devicetree.org/schemas/phy/transmit-amplitude.yaml#
$schema: http://devicetree.org/meta-schemas/core.yaml#

title: Common PHY and network PCS transmit amplitude property

description:
  Binding describing the peak-to-peak transmit amplitude for common PHYs
  and network PCSes.

maintainers:
  - Marek Behún <kabel@kernel.org>

properties:
  tx-p2p-microvolt:
    description:
      Transmit amplitude voltages in microvolts, peak-to-peak. If this property
      contains multiple values for various PHY modes, the
      'tx-p2p-microvolt-names' property must be provided and contain
      corresponding mode names.

  tx-p2p-microvolt-names:
    description: |
      Names of the modes corresponding to voltages in the 'tx-p2p-microvolt'
      property. Required only if multiple voltages are provided.

      If a value of 'default' is provided, the system should use it for any PHY
      mode that is otherwise not defined here. If 'default' is not provided, the
      system should use manufacturer default value.
    minItems: 1
    maxItems: 16
    items:
      enum:
        - default

        # ethernet modes
        - sgmii
        - qsgmii
        - xgmii
        - 1000base-x
        - 2500base-x
        - 5gbase-r
        - rxaui
        - xaui
        - 10gbase-kr
        - usxgmii
        - 10gbase-r
        - 25gbase-r

        # PCIe modes
        - pcie
        - pcie1
        - pcie2
        - pcie3
        - pcie4
        - pcie5
        - pcie6

        # USB modes
        - usb
        - usb-ls
        - usb-fs
        - usb-hs
        - usb-ss
        - usb-ss+
        - usb-4

        # storage modes
        - sata
        - ufs-hs
        - ufs-hs-a
        - ufs-hs-b

        # display modes
        - lvds
        - dp
        - dp-rbr
        - dp-hbr
        - dp-hbr2
        - dp-hbr3
        - dp-uhbr-10
        - dp-uhbr-13.5
        - dp-uhbr-20

        # camera modes
        - mipi-dphy
        - mipi-dphy-univ
        - mipi-dphy-v2.5-univ

dependencies:
  tx-p2p-microvolt-names: [ tx-p2p-microvolt ]

additionalProperties: true

examples:
  - |
    phy: phy {
      #phy-cells = <1>;
      tx-p2p-microvolt = <915000>, <1100000>, <1200000>;
      tx-p2p-microvolt-names = "2500base-x", "usb-hs", "usb-ss";
    };
```
