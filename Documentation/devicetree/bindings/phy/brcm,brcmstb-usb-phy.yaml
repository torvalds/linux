## Documentation/devicetree/bindings/phy/brcm,sr-pcie-phy.txt
```
Broadcom Stingray PCIe PHY

Required properties:
- compatible: must be "brcm,sr-pcie-phy"
- reg: base address and length of the PCIe SS register space
- brcm,sr-cdru: phandle to the CDRU syscon node
- brcm,sr-mhb: phandle to the MHB syscon node
- #phy-cells: Must be 1, denotes the PHY index

For PAXB based root complex, one can have a configuration of up to 8 PHYs
PHY index goes from 0 to 7

For the internal PAXC based root complex, PHY index is always 8

Example:
	mhb: syscon@60401000 {
		compatible = "brcm,sr-mhb", "syscon";
		reg = <0 0x60401000 0 0x38c>;
	};

	cdru: syscon@6641d000 {
		compatible = "brcm,sr-cdru", "syscon";
		reg = <0 0x6641d000 0 0x400>;
	};

	pcie_phy: phy@40000000 {
		compatible = "brcm,sr-pcie-phy";
		reg = <0 0x40000000 0 0x800>;
		brcm,sr-cdru = <&cdru>;
		brcm,sr-mhb = <&mhb>;
		#phy-cells = <1>;
	};

	/* users of the PCIe PHY */

	pcie0: pcie@48000000 {
		...
		...
		phys = <&pcie_phy 0>;
		phy-names = "pcie-phy";
	};
```

## Documentation/devicetree/bindings/phy/brcm,sr-pcie-phy.yaml
```yaml
# SPDX-License-Identifier: (GPL-2.0-only OR BSD-2-Clause)
%YAML 1.2
---
$id: http://devicetree.org/schemas/phy/brcm,sr-pcie-phy.yaml#
$schema: http://devicetree.org/meta-schemas/core.yaml#

title: Broadcom Stingray PCIe PHY

maintainers:
  - Ray Jui <ray.jui@broadcom.com>

description: >
  For PAXB based root complex, one can have a configuration of up to 8 PHYs.
  PHY index goes from 0 to 7.

  For the internal PAXC based root complex, PHY index is always 8.

properties:
  compatible:
    const: brcm,sr-pcie-phy

  reg:
    maxItems: 1

  '#phy-cells':
    const: 1

  brcm,sr-cdru:
    description: phandle to the CDRU syscon node
    $ref: /schemas/types.yaml#/definitions/phandle

  brcm,sr-mhb:
    description: phandle to the MHB syscon node
    $ref: /schemas/types.yaml#/definitions/phandle

additionalProperties: false

examples:
  - |
    phy@40000000 {
        compatible = "brcm,sr-pcie-phy";
        reg = <0x40000000 0x800>;
        brcm,sr-cdru = <&cdru>;
        brcm,sr-mhb = <&mhb>;
        #phy-cells = <1>;
    };
```

## Documentation/devicetree/bindings/phy/brcm,sr-usb-combo-phy.yaml
```yaml
# SPDX-License-Identifier: (GPL-2.0-only OR BSD-2-Clause)
%YAML 1.2
---
$id: http://devicetree.org/schemas/phy/brcm,sr-usb-combo-phy.yaml#
$schema: http://devicetree.org/meta-schemas/core.yaml#

title: Broadcom Stingray USB PHY

maintainers:
  - Ray Jui <rjui@broadcom.com>
  - Scott Branden <sbranden@broadcom.com>

properties:
  compatible:
    enum:
      - brcm,sr-usb-combo-phy
      - brcm,sr-usb-hs-phy

  reg:
    maxItems: 1

  '#phy-cells':
    description: PHY cell count indicating PHY type
    enum: [ 0, 1 ]

required:
  - compatible
  - reg
  - '#phy-cells'

allOf:
  - if:
      properties:
        compatible:
          contains:
            const: brcm,sr-usb-combo-phy
    then:
      properties:
        '#phy-cells':
          const: 1
  - if:
      properties:
        compatible:
          contains:
            const: brcm,sr-usb-hs-phy
    then:
      properties:
        '#phy-cells':
          const: 0

additionalProperties: false

examples:
  - |
    usb-phy@0 {
        compatible = "brcm,sr-usb-combo-phy";
        reg = <0x00000000 0x100>;
        #phy-cells = <1>;
    };
  - |
    usb-phy@20000 {
        compatible = "brcm,sr-usb-hs-phy";
        reg = <0x00020000 0x100>;
        #phy-cells = <0>;
    };
```

## Documentation/devicetree/bindings/phy/brcm,stingray-usb-phy.txt
```
Broadcom Stingray USB PHY

Required properties:
 - compatible : should be one of the listed compatibles
	- "brcm,sr-usb-combo-phy" is combo PHY has two PHYs, one SS and one HS.
	- "brcm,sr-usb-hs-phy" is a single HS PHY.
 - reg: offset and length of the PHY blocks registers
 - #phy-cells:
   - Must be 1 for brcm,sr-usb-combo-phy as it expects one argument to indicate
     the PHY number of two PHYs. 0 for HS PHY and 1 for SS PHY.
   - Must be 0 for brcm,sr-usb-hs-phy.

Refer to phy/phy-bindings.txt for the generic PHY binding properties

Example:
	usbphy0: usb-phy@0 {
		compatible = "brcm,sr-usb-combo-phy";
		reg = <0x00000000 0x100>;
		#phy-cells = <1>;
	};

	usbphy1: usb-phy@10000 {
		compatible = "brcm,sr-usb-combo-phy";
		reg = <0x00010000 0x100>,
		#phy-cells = <1>;
	};

	usbphy2: usb-phy@20000 {
		compatible = "brcm,sr-usb-hs-phy";
		reg = <0x00020000 0x100>,
		#phy-cells = <0>;
	};
```

## Documentation/devicetree/bindings/phy/brcm-sata-phy.txt
```
* Broadcom SATA3 PHY

Required properties:
- compatible: should be one or more of
     "brcm,bcm7425-sata-phy"
     "brcm,bcm7445-sata-phy"
     "brcm,iproc-ns2-sata-phy"
     "brcm,iproc-nsp-sata-phy"
     "brcm,phy-sata3"
     "brcm,iproc-sr-sata-phy"
- address-cells: should be 1
- size-cells: should be 0
- reg: register ranges for the PHY PCB interface
- reg-names: should be "phy" and "phy-ctrl"
     The "phy-ctrl" registers are only required for
     "brcm,iproc-ns2-sata-phy" and "brcm,iproc-sr-sata-phy".

Sub-nodes:
  Each port's PHY should be represented as a sub-node.

Sub-nodes required properties:
- reg: the PHY number
- phy-cells: generic PHY binding; must be 0

Sub-nodes optional properties:
- brcm,enable-ssc: use spread spectrum clocking (SSC) on this port
     This property is not applicable for "brcm,iproc-ns2-sata-phy",
     "brcm,iproc-nsp-sata-phy" and "brcm,iproc-sr-sata-phy".

- brcm,rxaeq-mode: string that indicates the desired RX equalizer
  mode, possible values are:
	"off" (equivalent to not specifying the property)
	"auto"
	"manual" (brcm,rxaeq-value is used in that case)

- brcm,rxaeq-value: when 'rxaeq-mode' is set to "manual", provides the RX
  equalizer value that should be used. Allowed range is 0..63.

Example
	sata-phy@f0458100 {
		compatible = "brcm,bcm7445-sata-phy", "brcm,phy-sata3";
		reg = <0xf0458100 0x1e00>, <0xf045804c 0x10>;
		reg-names = "phy";
		#address-cells = <1>;
		#size-cells = <0>;

		sata-phy@0 {
			reg = <0>;
			#phy-cells = <0>;
		};

		sata-phy@1 {
			reg = <1>;
			#phy-cells = <0>;
		};
	};
```

## Documentation/devicetree/bindings/phy/calxeda-combophy.txt
```
Calxeda Highbank Combination Phys for SATA

Properties:
- compatible : Should be "calxeda,hb-combophy"
- #phy-cells: Should be 1.
- reg : Address and size for Combination Phy registers.
- phydev: device ID for programming the combophy.

Example:

	combophy5: combo-phy@fff5d000 {
		compatible = "calxeda,hb-combophy";
		#phy-cells = <1>;
		reg = <0xfff5d000 0x1000>;
		phydev = <31>;
	};
```

## Documentation/devicetree/bindings/phy/calxeda-combophy.yaml
```yaml
# SPDX-License-Identifier: (GPL-2.0-only OR BSD-2-Clause)
%YAML 1.2
---
$id: http://devicetree.org/schemas/phy/calxeda-combophy.yaml#
$schema: http://devicetree.org/meta-schemas/core.yaml#

title: Calxeda Highbank Combination PHYs for SATA

description: |
  The Calxeda Combination PHYs connect the SoC to the internal fabric
  and to SATA connectors. The PHYs support multiple protocols (SATA,
  SGMII, PCIe) and can be assigned to different devices (SATA or XGMAC
  controller).
  Programming the PHYs is typically handled by those device drivers,
  not by a dedicated PHY driver.

maintainers:
  - Andre Przywara <andre.przywara@arm.com>

properties:
  compatible:
    const: calxeda,hb-combophy

  '#phy-cells':
    const: 1

  reg:
    maxItems: 1

  phydev:
    description: device ID for programming the ComboPHY.
    $ref: /schemas/types.yaml#/definitions/uint32
    maximum: 31

required:
  - compatible
  - reg
  - phydev
  - '#phy-cells'

additionalProperties: false

examples:
  - |
    combophy5: combo-phy@fff5d000 {
                   compatible = "calxeda,hb-combophy";
                   #phy-cells = <1>;
                   reg = <0xfff5d000 0x1000>;
                   phydev = <31>;
               };
```

## Documentation/devicetree/bindings/phy/canaan,k230-usb-phy.yaml
```yaml
# SPDX-License-Identifier: (GPL-2.0-only OR BSD-2-Clause)
%YAML 1.2
---
$id: http://devicetree.org/schemas/phy/canaan,k230-usb-phy.yaml#
$schema: http://devicetree.org/meta-schemas/core.yaml#

title: Canaan K230 USB2.0 PHY

maintainers:
  - Jiayu Du <jiayu.riscv@isrc.iscas.ac.cn>

properties:
  compatible:
    const: canaan,k230-usb-phy

  reg:
    maxItems: 1

  "#phy-cells":
    const: 1

required:
  - compatible
  - reg
  - "#phy-cells"

additionalProperties: false

examples:
  - |
    usbphy: usb-phy@91585000 {
        compatible = "canaan,k230-usb-phy";
        reg = <0x91585000 0x400>;
        #phy-cells = <1>;
    };
```

## Documentation/devicetree/bindings/phy/cdns,dphy-rx.yaml
```yaml
# SPDX-License-Identifier: (GPL-2.0-only OR BSD-2-Clause)
%YAML 1.2
---
$id: http://devicetree.org/schemas/phy/cdns,dphy-rx.yaml#
$schema: http://devicetree.org/meta-schemas/core.yaml#

title: Cadence DPHY Rx Device Tree Bindings

maintainers:
  - Pratyush Yadav <p.yadav@ti.com>

properties:
  compatible:
    items:
      - const: cdns,dphy-rx

  reg:
    maxItems: 1

  "#phy-cells":
    const: 0

  power-domains:
    maxItems: 1

required:
  - compatible
  - reg
  - "#phy-cells"

additionalProperties: false

examples:
  - |
    #include <dt-bindings/soc/ti,sci_pm_domain.h>

    dphy0: phy@4580000 {
        compatible = "cdns,dphy-rx";
        reg = <0x4580000 0x1100>;
        #phy-cells = <0>;
        power-domains = <&k3_pds 147 TI_SCI_PD_EXCLUSIVE>;
    };
```

## Documentation/devicetree/bindings/phy/cdns,dphy.txt
```
Cadence DPHY
============

Cadence DPHY block.

Required properties:
- compatible: should be set to "cdns,dphy".
- reg: physical base address and length of the DPHY registers.
- clocks: DPHY reference clocks.
- clock-names: must contain "psm" and "pll_ref".
- #phy-cells: must be set to 0.

Example:
	dphy0: dphy@fd0e0000{
		compatible = "cdns,dphy";
		reg = <0x0 0xfd0e0000 0x0 0x1000>;
		clocks = <&psm_clk>, <&pll_ref_clk>;
		clock-names = "psm", "pll_ref";
		#phy-cells = <0>;
	};
```

## Documentation/devicetree/bindings/phy/cdns,dphy.yaml
```yaml
# SPDX-License-Identifier: (GPL-2.0-only OR BSD-2-Clause)
%YAML 1.2
---
$id: http://devicetree.org/schemas/phy/cdns,dphy.yaml#
$schema: http://devicetree.org/meta-schemas/core.yaml#

title: Cadence DPHY

maintainers:
  - Pratyush Yadav <pratyush@kernel.org>

properties:
  compatible:
    enum:
      - cdns,dphy
      - ti,j721e-dphy

  reg:
    maxItems: 1

  clocks:
    items:
      - description: PMA state machine clock
      - description: PLL reference clock

  clock-names:
    items:
      - const: psm
      - const: pll_ref

  "#phy-cells":
    const: 0

  power-domains:
    maxItems: 1

required:
  - compatible
  - reg
  - clocks
  - clock-names
  - "#phy-cells"

additionalProperties: false

examples:
  - |
    #include <dt-bindings/soc/ti,sci_pm_domain.h>

    dphy0: phy@fd0e0000{
        compatible = "cdns,dphy";
        reg = <0xfd0e0000 0x1000>;
        clocks = <&psm_clk>, <&pll_ref_clk>;
        clock-names = "psm", "pll_ref";
        power-domains = <&k3_pds 147 TI_SCI_PD_EXCLUSIVE>;
        #phy-cells = <0>;
    };
```

## Documentation/devicetree/bindings/phy/cdns,salvo-phy.yaml
```yaml
# SPDX-License-Identifier: (GPL-2.0 OR BSD-2-Clause)
# Copyright (c) 2020 NXP
%YAML 1.2
---
$id: http://devicetree.org/schemas/phy/cdns,salvo-phy.yaml#
$schema: http://devicetree.org/meta-schemas/core.yaml#

title: Cadence SALVO PHY

maintainers:
  - Peter Chen <peter.chen@nxp.com>

properties:
  compatible:
    enum:
      - nxp,salvo-phy

  reg:
    maxItems: 1

  clocks:
    maxItems: 1

  clock-names:
    items:
      - const: salvo_phy_clk

  power-domains:
    maxItems: 1

  "#phy-cells":
    const: 0

required:
  - compatible
  - reg
  - "#phy-cells"

additionalProperties: false

examples:
  - |
    #include <dt-bindings/firmware/imx/rsrc.h>

    usb3phy: usb3-phy@5b160000 {
        compatible = "nxp,salvo-phy";
        reg = <0x5b160000 0x40000>;
        clocks = <&usb3_lpcg 4>;
        clock-names = "salvo_phy_clk";
        power-domains = <&pd IMX_SC_R_USB_2_PHY>;
        #phy-cells = <0>;
    };
```

## Documentation/devicetree/bindings/phy/dm816x-phy.txt
```
Device tree binding documentation for am816x USB PHY
=========================

Required properties:
- compatible : should be "ti,dm816x-usb-phy"
- reg : offset and length of the PHY register set.
- reg-names : name for the phy registers
- clocks : phandle to the clock
- clock-names : name of the clock
- syscon: phandle for the syscon node to access misc registers
- #phy-cells : from the generic PHY bindings, must be 1
- syscon: phandle for the syscon node to access misc registers

Example:

usb_phy0: usb-phy@20 {
	compatible = "ti,dm8168-usb-phy";
	reg = <0x20 0x8>;
	reg-names = "phy";
	clocks = <&main_fapll 6>;
	clock-names = "refclk";
	#phy-cells = <0>;
	syscon = <&scm_conf>;
};
```

## Documentation/devicetree/bindings/phy/econet,en751221-pcie-phy.yaml
```yaml
# SPDX-License-Identifier: (GPL-2.0 OR BSD-2-Clause)
%YAML 1.2
---
$id: http://devicetree.org/schemas/phy/econet,en751221-pcie-phy.yaml#
$schema: http://devicetree.org/meta-schemas/core.yaml#

title: EcoNet PCI-Express PHY for EcoNet EN751221 and EN7528

maintainers:
  - Caleb James DeLisle <cjd@cjdns.fr>

description:
  The PCIe PHY supports physical layer functionality for PCIe Gen1 and
  Gen1/Gen2 ports. On these SoCs, port 0 is a Gen1-only port while
  port 1 is Gen1/Gen2 capable.

properties:
  compatible:
    enum:
      - econet,en751221-pcie-gen1
      - econet,en751221-pcie-gen2
      - econet,en7528-pcie-gen1
      - econet,en7528-pcie-gen2

  reg:
    maxItems: 1

  "#phy-cells":
    const: 0

required:
  - compatible
  - reg
  - "#phy-cells"

additionalProperties: false

examples:
  - |
    soc {
      #address-cells = <1>;
      #size-cells = <1>;

      pcie-phy@1faf2000 {
        compatible = "econet,en7528-pcie-gen1";
        reg = <0x1faf2000 0x1000>;
        #phy-cells = <0>;
      };
    };
...
```
