## Documentation/devicetree/bindings/phy/brcm,brcmstb-usb-phy.yaml
```yaml
# SPDX-License-Identifier: GPL-2.0-only OR BSD-2-Clause
%YAML 1.2
---
$id: http://devicetree.org/schemas/phy/brcm,brcmstb-usb-phy.yaml#
$schema: http://devicetree.org/meta-schemas/core.yaml#

title: Broadcom STB USB PHY

description: Broadcom's PHY that handles EHCI/OHCI and/or XHCI

maintainers:
  - Al Cooper <alcooperx@gmail.com>
  - Rafał Miłecki <rafal@milecki.pl>

properties:
  compatible:
    enum:
      - brcm,bcm4908-usb-phy
      - brcm,bcm7211-usb-phy
      - brcm,bcm7216-usb-phy
      - brcm,brcmstb-usb-phy

  reg:
    minItems: 1
    maxItems: 6
    items:
      - description: the base CTRL register
      - description: XHCI EC register
      - description: XHCI GBL register
      - description: USB PHY register
      - description: USB MDIO register
      - description: BDC register

  reg-names:
    minItems: 1
    maxItems: 6
    items:
      - const: ctrl
      - const: xhci_ec
      - const: xhci_gbl
      - const: usb_phy
      - const: usb_mdio
      - const: bdc_ec

  clocks:
    minItems: 1
    maxItems: 2

  clock-names:
    minItems: 1
    maxItems: 2
    items:
      - const: sw_usb
      - const: sw_usb3

  interrupts:
    description: wakeup interrupt

  interrupt-names:
    const: wake

  brcm,ipp:
    $ref: /schemas/types.yaml#/definitions/uint32
    description: Invert Port Power
    minimum: 0
    maximum: 1

  brcm,ioc:
    $ref: /schemas/types.yaml#/definitions/uint32
    description: Invert Over Current detection
    minimum: 0
    maximum: 1

  dr_mode:
    description: PHY Device mode. If this property is not defined, the PHY will
      default to "host" mode.
    enum:
      - host
      - peripheral
      - drd
      - typec-pd

  brcm,syscon-piarbctl:
    description: phandle to syscon for handling config registers
    $ref: /schemas/types.yaml#/definitions/phandle

  brcm,has-xhci:
    description: Indicates the PHY has an XHCI PHY.
    type: boolean

  brcm,has-eohci:
    description: Indicates the PHY has an EHCI/OHCI PHY.
    type: boolean

  "#phy-cells":
    description: |
      Cell allows setting the type of the PHY. Possible values are:
      - PHY_TYPE_USB2 for USB1.1/2.0 PHY
      - PHY_TYPE_USB3 for USB3.x PHY
    const: 1

required:
  - reg
  - "#phy-cells"

anyOf:
  - required:
      - brcm,has-xhci
  - required:
      - brcm,has-eohci

allOf:
  - if:
      properties:
        compatible:
          contains:
            enum:
              - const: brcm,bcm4908-usb-phy
              - const: brcm,brcmstb-usb-phy
    then:
      properties:
        reg:
          minItems: 1
          maxItems: 2
  - if:
      properties:
        compatible:
          contains:
            const: brcm,bcm7211-usb-phy
    then:
      properties:
        reg:
          minItems: 5
          maxItems: 6
        reg-names:
          minItems: 5
          maxItems: 6
  - if:
      properties:
        compatible:
          contains:
            const: brcm,bcm7216-usb-phy
    then:
      properties:
        reg:
          minItems: 3
          maxItems: 3
        reg-names:
          minItems: 3
          maxItems: 3

additionalProperties: false

examples:
  - |
    #include <dt-bindings/phy/phy.h>

    usb-phy@f0470200 {
        compatible = "brcm,brcmstb-usb-phy";
        reg = <0xf0470200 0xb8>,
              <0xf0471940 0x6c0>;
        #phy-cells = <1>;
        dr_mode = "host";
        brcm,ioc = <1>;
        brcm,ipp = <1>;
        brcm,has-xhci;
        brcm,has-eohci;
        clocks = <&usb20>, <&usb30>;
        clock-names = "sw_usb", "sw_usb3";
    };
  - |
    #include <dt-bindings/phy/phy.h>

    usb-phy@29f0200 {
        compatible = "brcm,bcm7211-usb-phy";
        reg = <0x29f0200 0x200>,
              <0x29c0880 0x30>,
              <0x29cc100 0x534>,
              <0x2808000 0x24>,
              <0x2980080 0x8>;
        reg-names = "ctrl",
            "xhci_ec",
            "xhci_gbl",
            "usb_phy",
            "usb_mdio";
        brcm,ioc = <0x0>;
        brcm,ipp = <0x0>;
        interrupts = <0x30>;
        interrupt-parent = <&vpu_intr1_nosec_intc>;
        interrupt-names = "wake";
        #phy-cells = <0x1>;
        brcm,has-xhci;
        brcm,syscon-piarbctl = <&syscon_piarbctl>;
        clocks = <&scmi_clk 256>;
        clock-names = "sw_usb";
    };
```

## Documentation/devicetree/bindings/phy/brcm,cygnus-pcie-phy.txt
```
Broadcom Cygnus PCIe PHY

Required properties:
- compatible: must be "brcm,cygnus-pcie-phy"
- reg: base address and length of the PCIe PHY block
- #address-cells: must be 1
- #size-cells: must be 0

Each PCIe PHY should be represented by a child node

Required properties For the child node:
- reg: the PHY ID
0 - PCIe RC 0
1 - PCIe RC 1
- #phy-cells: must be 0

Example:
	pcie_phy: phy@0301d0a0 {
		compatible = "brcm,cygnus-pcie-phy";
		reg = <0x0301d0a0 0x14>;

		pcie0_phy: phy@0 {
			reg = <0>;
			#phy-cells = <0>;
		};

		pcie1_phy: phy@1 {
			reg = <1>;
			#phy-cells = <0>;
		};
	};

	/* users of the PCIe phy */

	pcie0: pcie@18012000 {
		...
		...
		phys = <&pcie0_phy>;
		phy-names = "pcie-phy";
	};

	pcie1: pcie@18013000 {
		...
		...
		phys = <pcie1_phy>;
		phy-names = "pcie-phy";
	};
```

## Documentation/devicetree/bindings/phy/brcm,cygnus-pcie-phy.yaml
```yaml
# SPDX-License-Identifier: GPL-2.0-only OR BSD-2-Clause
%YAML 1.2
---
$id: http://devicetree.org/schemas/phy/brcm,cygnus-pcie-phy.yaml#
$schema: http://devicetree.org/meta-schemas/core.yaml#

title: Broadcom Cygnus PCIe PHY

maintainers:
  - Ray Jui <ray.jui@broadcom.com>
  - Scott Branden <scott.branden@broadcom.com>

properties:
  $nodename:
    pattern: "^pcie[-|_]phy(@.*)?$"

  compatible:
    items:
      - const: brcm,cygnus-pcie-phy

  reg:
    maxItems: 1
    description: >
      Base address and length of the PCIe PHY block

  "#address-cells":
    const: 1

  "#size-cells":
    const: 0

patternProperties:
  "^pcie-phy@[0-9]+$":
    type: object
    description: >
      PCIe PHY child nodes

    properties:
      reg:
        maxItems: 1
        description: >
          The PCIe PHY port number

      "#phy-cells":
        const: 0

    required:
      - reg
      - "#phy-cells"

required:
  - compatible
  - reg
  - "#address-cells"
  - "#size-cells"

additionalProperties: false

examples:
  - |
    pcie_phy: pcie_phy@301d0a0 {
      compatible = "brcm,cygnus-pcie-phy";
      reg = <0x0301d0a0 0x14>;
      #address-cells = <1>;
      #size-cells = <0>;

      pcie0_phy: pcie-phy@0 {
          reg = <0>;
          #phy-cells = <0>;
      };

      pcie1_phy: pcie-phy@1 {
          reg = <1>;
          #phy-cells = <0>;
      };
    };
```

## Documentation/devicetree/bindings/phy/brcm,kona-usb2-phy.yaml
```yaml
# SPDX-License-Identifier: GPL-2.0-only OR BSD-2-Clause
%YAML 1.2
---
$id: http://devicetree.org/schemas/phy/brcm,kona-usb2-phy.yaml#
$schema: http://devicetree.org/meta-schemas/core.yaml#

title: Broadcom Kona family USB 2.0 PHY

maintainers:
  - Florian Fainelli <f.fainelli@gmail.com>

properties:
  compatible:
    const: brcm,kona-usb2-phy

  reg:
    maxItems: 1

  '#phy-cells':
    const: 0

required:
  - compatible
  - reg
  - '#phy-cells'

additionalProperties: false

examples:
  - |
    usb-phy@3f130000 {
        compatible = "brcm,kona-usb2-phy";
        reg = <0x3f130000 0x28>;
        #phy-cells = <0>;
    };
...
```

## Documentation/devicetree/bindings/phy/brcm,mdio-mux-bus-pci.txt
```
* Broadcom NS2 PCIe PHY binding document

Required bus properties:
- reg: MDIO Bus number for the MDIO interface
- #address-cells: must be 1
- #size-cells: must be 0

Required PHY properties:
- compatible: should be "brcm,ns2-pcie-phy"
- reg: MDIO Phy ID for the MDIO interface
- #phy-cells: must be 0

This is a child bus node of "brcm,mdio-mux-iproc" node.

Example:

mdio@0 {
	reg = <0x0>;
	#address-cells = <1>;
	#size-cells = <0>;

	pci_phy0: pci-phy@0 {
		compatible = "brcm,ns2-pcie-phy";
		reg = <0x0>;
		#phy-cells = <0>;
	};
};
```

## Documentation/devicetree/bindings/phy/brcm,ns2-drd-phy.txt
```
BROADCOM NORTHSTAR2 USB2 (DUAL ROLE DEVICE) PHY

Required properties:
 - compatible: brcm,ns2-drd-phy
 - reg: offset and length of the NS2 PHY related registers.
 - reg-names
   The below registers must be provided.
   icfg - for DRD ICFG configurations
   rst-ctrl - for DRD IDM reset
   crmu-ctrl - for CRMU core vdd, PHY and PHY PLL reset
   usb2-strap - for port over current polarity reversal
 - #phy-cells: Must be 0. No args required.
 - vbus-gpios: vbus gpio binding
 - id-gpios: id gpio binding

Refer to phy/phy-bindings.txt for the generic PHY binding properties

Example:
	usbdrd_phy: phy@66000960 {
			#phy-cells = <0>;
			compatible = "brcm,ns2-drd-phy";
			reg = <0x66000960 0x24>,
			      <0x67012800 0x4>,
			      <0x6501d148 0x4>,
			      <0x664d0700 0x4>;
			reg-names = "icfg", "rst-ctrl",
				    "crmu-ctrl", "usb2-strap";
			id-gpios = <&gpio_g 30 0>;
			vbus-gpios = <&gpio_g 31 0>;
	};
```

## Documentation/devicetree/bindings/phy/brcm,ns2-drd-phy.yaml
```yaml
# SPDX-License-Identifier: (GPL-2.0-only OR BSD-2-Clause)
%YAML 1.2
---
$id: http://devicetree.org/schemas/phy/brcm,ns2-drd-phy.yaml#
$schema: http://devicetree.org/meta-schemas/core.yaml#

title: Broadcom Northstar2 USB2 Dual Role Device PHY

maintainers:
  - Florian Fainelli <florian.fainelli@broadcom.com>
  - Hauke Mehrtens <hauke@hauke-m.de>
  - Rafał Miłecki <zajec5@gmail.com>

properties:
  compatible:
    const: brcm,ns2-drd-phy

  reg:
    items:
      - description: DRD ICFG configurations
      - description: DRD IDM reset
      - description: CRMU core vdd, PHY and PHY PLL reset
      - description: Port over current polarity reversal

  reg-names:
    items:
      - const: icfg
      - const: rst-ctrl
      - const: crmu-ctrl
      - const: usb2-strap

  '#phy-cells':
    const: 0

  id-gpios:
    maxItems: 1
    description: ID GPIO line

  vbus-gpios:
    maxItems: 1
    description: VBUS GPIO line

required:
  - '#phy-cells'
  - compatible
  - reg
  - reg-names
  - id-gpios
  - vbus-gpios

additionalProperties: false

examples:
  - |
    phy@66000960 {
        #phy-cells = <0>;
        compatible = "brcm,ns2-drd-phy";
        reg = <0x66000960 0x24>, <0x67012800 0x4>, <0x6501d148 0x4>, <0x664d0700 0x4>;
        reg-names = "icfg", "rst-ctrl", "crmu-ctrl", "usb2-strap";
        id-gpios = <&gpio_g 30 0>;
        vbus-gpios = <&gpio_g 31 0>;
    };
```

## Documentation/devicetree/bindings/phy/brcm,ns2-pcie-phy.yaml
```yaml
# SPDX-License-Identifier: GPL-2.0-only OR BSD-2-Clause
%YAML 1.2
---
$id: http://devicetree.org/schemas/phy/brcm,ns2-pcie-phy.yaml#
$schema: http://devicetree.org/meta-schemas/core.yaml#

title: Broadcom NS2 PCIe PHY

maintainers:
  - Ray Jui <ray.jui@broadcom.com>
  - Scott Branden <scott.branden@broadcom.com>

properties:
  compatible:
    const: brcm,ns2-pcie-phy

  reg:
    maxItems: 1

  "#phy-cells":
    const: 0

required:
  - compatible
  - reg
  - "#phy-cells"

additionalProperties: false

examples:
  - |
    mdio {
       #address-cells = <1>;
       #size-cells = <0>;

       pci-phy@0 {
          compatible = "brcm,ns2-pcie-phy";
          reg = <0x0>;
          #phy-cells = <0>;
       };
    };
```

## Documentation/devicetree/bindings/phy/brcm,nsp-usb3-phy.txt
```
Broadcom USB3 phy binding for northstar plus SoC
The USB3 phy is internal to the SoC and is accessed using mdio interface.

Required mdio bus properties:
- reg: Should be 0x0 for SoC internal USB3 phy
- #address-cells: must be 1
- #size-cells: must be 0

Required USB3 PHY properties:
- compatible: should be "brcm,nsp-usb3-phy"
- reg: USB3 Phy address on SoC internal MDIO bus and it should be 0x10.
- usb3-ctrl-syscon: handler of syscon node defining physical address
  of usb3 control register.
- #phy-cells: must be 0

Required usb3 control properties:
- compatible: should be "brcm,nsp-usb3-ctrl"
- reg: offset and length of the control registers

Example:

	mdio@0 {
		reg = <0x0>;
		#address-cells = <1>;
		#size-cells = <0>;

		usb3_phy: usb-phy@10 {
			compatible = "brcm,nsp-usb3-phy";
			reg = <0x10>;
			usb3-ctrl-syscon = <&usb3_ctrl>;
			#phy-cells = <0>;
			status = "disabled";
		};
	};

	usb3_ctrl: syscon@104408 {
		compatible = "brcm,nsp-usb3-ctrl", "syscon";
		reg = <0x104408 0x3fc>;
	};
```

## Documentation/devicetree/bindings/phy/brcm,sata-phy.yaml
```yaml
# SPDX-License-Identifier: (GPL-2.0 OR BSD-2-Clause)
%YAML 1.2
---
$id: http://devicetree.org/schemas/phy/brcm,sata-phy.yaml#
$schema: http://devicetree.org/meta-schemas/core.yaml#

title: Broadcom SATA3 PHY

maintainers:
  - Florian Fainelli <f.fainelli@gmail.com>

properties:
  $nodename:
    pattern: "^sata[-|_]phy(@.*)?$"

  compatible:
    oneOf:
      - items:
          - enum:
              - brcm,bcm7216-sata-phy
              - brcm,bcm7425-sata-phy
              - brcm,bcm7445-sata-phy
              - brcm,bcm63138-sata-phy
          - const: brcm,phy-sata3
      - items:
          - const: brcm,iproc-nsp-sata-phy
      - items:
          - const: brcm,iproc-ns2-sata-phy
      - items:
          - const: brcm,iproc-sr-sata-phy

  reg:
    minItems: 1
    maxItems: 2

  reg-names:
    minItems: 1
    items:
      - const: phy
      - const: phy-ctrl

  "#address-cells":
    const: 1

  "#size-cells":
    const: 0

patternProperties:
  "^sata-phy@[0-9]+$":
    type: object
    description: |
      Each port's PHY should be represented as a sub-node.

    properties:
      reg:
        description: The SATA PHY port number
        maxItems: 1

      "#phy-cells":
        const: 0

      "brcm,enable-ssc":
        $ref: /schemas/types.yaml#/definitions/flag
        description: |
          Use spread spectrum clocking (SSC) on this port
          This property is not applicable for "brcm,iproc-ns2-sata-phy",
          "brcm,iproc-nsp-sata-phy" and "brcm,iproc-sr-sata-phy".

      "brcm,rxaeq-mode":
        $ref: /schemas/types.yaml#/definitions/string
        description:
          String that indicates the desired RX equalizer mode.
        enum:
          - off
          - auto
          - manual

      "brcm,rxaeq-value":
        $ref: /schemas/types.yaml#/definitions/uint32
        description: |
            When 'brcm,rxaeq-mode' is set to "manual", provides the RX
            equalizer value that should be used.
        minimum: 0
        maximum: 63

      "brcm,tx-amplitude-millivolt":
        description: |
            Transmit amplitude voltage in millivolt.
        $ref: /schemas/types.yaml#/definitions/uint32
        enum: [400, 500, 600, 800]

    required:
      - reg
      - "#phy-cells"

    additionalProperties: false

if:
  properties:
    compatible:
      const: brcm,iproc-ns2-sata-phy
then:
  properties:
    reg:
      minItems: 2

    reg-names:
      minItems: 2
else:
  properties:
    reg:
      maxItems: 1

    reg-names:
      maxItems: 1

required:
  - compatible
  - "#address-cells"
  - "#size-cells"
  - reg
  - reg-names

additionalProperties: false

examples:
  - |
    sata_phy@f0458100 {
        compatible = "brcm,bcm7445-sata-phy", "brcm,phy-sata3";
        reg = <0xf0458100 0x1e00>;
        reg-names = "phy";
        #address-cells = <1>;
        #size-cells = <0>;

        sata-phy@0 {
                reg = <0>;
                #phy-cells = <0>;
        };

        sata-phy@1 {
                reg = <1>;
                #phy-cells = <0>;
        };
    };
```
