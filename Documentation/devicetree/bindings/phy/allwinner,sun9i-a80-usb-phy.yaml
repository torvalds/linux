## Documentation/devicetree/bindings/phy/apm,xgene-phy.yaml
```yaml
# SPDX-License-Identifier: (GPL-2.0-only OR BSD-2-Clause)
%YAML 1.2
---
$id: http://devicetree.org/schemas/phy/apm,xgene-phy.yaml#
$schema: http://devicetree.org/meta-schemas/core.yaml#

title: APM X-Gene 15Gbps Multi-purpose PHY

maintainers:
  - Khuong Dinh <khuong@os.amperecomputing.com>

description:
  PHY nodes are defined to describe on-chip 15Gbps Multi-purpose PHY. Each
  PHY (pair of lanes) has its own node.

properties:
  compatible:
    items:
      - const: apm,xgene-phy

  reg:
    maxItems: 1

  '#phy-cells':
    description:
      Possible values are 0 (SATA), 1 (SGMII), 2 (PCIe), 3 (USB), and 4 (XFI).
    const: 1

  clocks:
    maxItems: 1

  apm,tx-eye-tuning:
    description:
      Manual control to fine tune the capture of the serial bit lines from the
      automatic calibrated position. Two set of 3-tuple setting for each
      supported link speed on the host. Range from 0 to 127 in unit of one bit
      period.
    $ref: /schemas/types.yaml#/definitions/uint32-matrix
    minItems: 2
    maxItems: 2
    items:
      minItems: 3
      maxItems: 3
      items:
        minimum: 0
        maximum: 127
        default: 10

  apm,tx-eye-direction:
    description:
      Eye tuning manual control direction. 0 means sample data earlier than the
      nominal sampling point. 1 means sample data later than the nominal
      sampling point. Two set of 3-tuple setting for each supported link speed
      on the host.
    $ref: /schemas/types.yaml#/definitions/uint32-matrix
    minItems: 2
    maxItems: 2
    items:
      minItems: 3
      maxItems: 3
      items:
        enum: [0, 1]
        default: 0

  apm,tx-boost-gain:
    description:
      Frequency boost AC (LSB 3-bit) and DC (2-bit) gain control. Two set of
      3-tuple setting for each supported link speed on the host. Range is
      between 0 to 31 in unit of dB. Default is 3.
    $ref: /schemas/types.yaml#/definitions/uint32-matrix
    minItems: 2
    maxItems: 2
    items:
      minItems: 3
      maxItems: 3
      items:
        minimum: 0
        maximum: 31

  apm,tx-amplitude:
    description:
      Amplitude control. Two set of 3-tuple setting for each supported link
      speed on the host. Range is between 0 to 199500 in unit of uV.
    $ref: /schemas/types.yaml#/definitions/uint32-matrix
    minItems: 2
    maxItems: 2
    items:
      minItems: 3
      maxItems: 3
      items:
        minimum: 0
        maximum: 199500
        default: 199500

  apm,tx-pre-cursor1:
    description:
      1st pre-cursor emphasis taps control. Two set of 3-tuple setting for
      each supported link speed on the host. Range is 0 to 273000 in unit of
      uV.
    $ref: /schemas/types.yaml#/definitions/uint32-matrix
    minItems: 2
    maxItems: 2
    items:
      minItems: 3
      maxItems: 3
      items:
        minimum: 0
        maximum: 273000
        default: 0

  apm,tx-pre-cursor2:
    description:
      2nd pre-cursor emphasis taps control. Two set of 3-tuple setting for
      each supported link speed on the host. Range is 0 to 127400 in unit uV.
    $ref: /schemas/types.yaml#/definitions/uint32-matrix
    minItems: 2
    maxItems: 2
    items:
      minItems: 3
      maxItems: 3
      items:
        minimum: 0
        maximum: 127400
        default: 0

  apm,tx-post-cursor:
    description: |
      Post-cursor emphasis taps control. Two set of 3-tuple setting for Gen1,
      Gen2, and Gen3 link speeds. Range is between 0 to 31 in unit of 18.2mV.
    $ref: /schemas/types.yaml#/definitions/uint32-matrix
    minItems: 2
    maxItems: 2
    items:
      minItems: 3
      maxItems: 3
      items:
        minimum: 0
        maximum: 31
        default: 0xf

  apm,tx-speed:
    description: >
      Tx operating speed. One set of 3-tuple for each supported link speed on
      the host:

        0 = 1-2Gbps
        1 = 2-4Gbps (1st tuple default)
        2 = 4-8Gbps
        3 = 8-15Gbps (2nd tuple default)
        4 = 2.5-4Gbps
        5 = 4-5Gbps
        6 = 5-6Gbps
        7 = 6-16Gbps (3rd tuple default).

    $ref: /schemas/types.yaml#/definitions/uint32-array
    minItems: 3
    maxItems: 3
    items:
      maximum: 7

additionalProperties: false

examples:
  - |
    phy@1f21a000 {
        compatible = "apm,xgene-phy";
        reg = <0x1f21a000 0x100>;
        #phy-cells = <1>;
    };
```

## Documentation/devicetree/bindings/phy/apm-xgene-phy.txt
```
* APM X-Gene 15Gbps Multi-purpose PHY nodes

PHY nodes are defined to describe on-chip 15Gbps Multi-purpose PHY. Each
PHY (pair of lanes) has its own node.

Required properties:
- compatible		: Shall be "apm,xgene-phy".
- reg			: PHY memory resource is the SDS PHY access resource.
- #phy-cells		: Shall be 1 as it expects one argument for setting
			  the mode of the PHY. Possible values are 0 (SATA),
			  1 (SGMII), 2 (PCIe), 3 (USB), and 4 (XFI).

Optional properties:
- status		: Shall be "ok" if enabled or "disabled" if disabled.
			  Default is "ok".
- clocks		: Reference to the clock entry.
- apm,tx-eye-tuning	: Manual control to fine tune the capture of the serial
			  bit lines from the automatic calibrated position.
			  Two set of 3-tuple setting for each (up to 3)
			  supported link speed on the host. Range from 0 to
			  127 in unit of one bit period. Default is 10.
- apm,tx-eye-direction	: Eye tuning manual control direction. 0 means sample
			  data earlier than the nominal sampling point. 1 means
			  sample data later than the nominal sampling point.
			  Two set of 3-tuple setting for each (up to 3)
			  supported link speed on the host. Default is 0.
- apm,tx-boost-gain	: Frequency boost AC (LSB 3-bit) and DC (2-bit)
			  gain control. Two set of 3-tuple setting for each
			  (up to 3) supported link speed on the host. Range is
			  between 0 to 31 in unit of dB. Default is 3.
- apm,tx-amplitude	: Amplitude control. Two set of 3-tuple setting for
			  each (up to 3) supported link speed on the host.
			  Range is between 0 to 199500 in unit of uV.
			  Default is 199500 uV.
- apm,tx-pre-cursor1	: 1st pre-cursor emphasis taps control. Two set of
			  3-tuple setting for each (up to 3) supported link
			  speed on the host. Range is 0 to 273000 in unit of
			  uV. Default is 0.
- apm,tx-pre-cursor2	: 2nd pre-cursor emphasis taps control. Two set of
			  3-tuple setting for each (up to 3) supported link
			  speed on the host. Range is 0 to 127400 in unit uV.
			  Default is 0x0.
- apm,tx-post-cursor	: Post-cursor emphasis taps control. Two set of
			  3-tuple setting for Gen1, Gen2, and Gen3. Range is
			  between 0 to 0x1f in unit of 18.2mV. Default is 0xf.
- apm,tx-speed		: Tx operating speed. One set of 3-tuple for each
			  supported link speed on the host.
			   0 = 1-2Gbps
			   1 = 2-4Gbps (1st tuple default)
			   2 = 4-8Gbps
			   3 = 8-15Gbps (2nd tuple default)
			   4 = 2.5-4Gbps
			   5 = 4-5Gbps
			   6 = 5-6Gbps
			   7 = 6-16Gbps (3rd tuple default)

NOTE: PHY override parameters are board specific setting.

Example:
		phy1: phy@1f21a000 {
			compatible = "apm,xgene-phy";
			reg = <0x0 0x1f21a000 0x0 0x100>;
			#phy-cells = <1>;
		};

		phy2: phy@1f22a000 {
			compatible = "apm,xgene-phy";
			reg = <0x0 0x1f22a000 0x0 0x100>;
			#phy-cells = <1>;
		};

		phy3: phy@1f23a000 {
			compatible = "apm,xgene-phy";
			reg = <0x0 0x1f23a000 0x0 0x100>;
			#phy-cells = <1>;
		};
```

## Documentation/devicetree/bindings/phy/apple,atcphy.yaml
```yaml
# SPDX-License-Identifier: (GPL-2.0-only OR BSD-2-Clause)
%YAML 1.2
---
$id: http://devicetree.org/schemas/phy/apple,atcphy.yaml#
$schema: http://devicetree.org/meta-schemas/core.yaml#

title: Apple Type-C PHY (ATCPHY)

maintainers:
  - Sven Peter <sven@kernel.org>

description: >
  The Apple Type-C PHY (ATCPHY) is a combined PHY for USB 2.0, USB 3.x,
  USB4/Thunderbolt, and DisplayPort connectivity via Type-C ports found in
  Apple Silicon SoCs.

  The PHY handles muxing between these different protocols and also provides the
  reset controller for the attached DWC3 USB controller.

  It is designed for USB4 operation and does not handle individual differential
  pairs as distinct DisplayPort lanes. Any reference to lane in this binding
  hence refers to two differential pairs (RX and TX) as used in USB terminology.

  In order to correctly setup these lanes for the various modes calibration
  values copied from Apple's firmware and converted to the format described
  below by our bootloader m1n1 are required. Without these only USB2 operation
  is possible.

allOf:
  - $ref: /schemas/usb/usb-switch.yaml#

$defs:
  apple,tunable:
    $ref: /schemas/types.yaml#/definitions/uint32-matrix
    items:
      items:
        - description: Register offset
        - description: Mask to be applied to the register value
        - description: Bits to be set after applying the mask
    description: >
      List of (register offset, mask, value) tuples copied from Apple's Device
      Tree by our bootloader m1n1 and used to configure the PHY. These values
      even vary for a single product/device and likely contain calibration
      values determined by Apple at manufacturing time.
      Unless otherwise noted these tunables are always applied to the core
      register region.

properties:
  compatible:
    oneOf:
      - items:
          - enum:
              - apple,t6000-atcphy
              - apple,t6020-atcphy
              - apple,t8112-atcphy
          - const: apple,t8103-atcphy
      - const: apple,t8103-atcphy

  reg:
    items:
      - description: Common controls for all PHYs (USB2/3/4, DisplayPort, TBT)
      - description: DisplayPort Alternate Mode PHY specific controls
      - description: Type-C PHY AXI to Apple Fabric interconnect controls
      - description: USB2 PHY specific controls
      - description: USB3 PIPE interface controls

  reg-names:
    items:
      - const: core
      - const: lpdptx
      - const: axi2af
      - const: usb2phy
      - const: pipehandler

  "#phy-cells":
    const: 1

  "#reset-cells":
    const: 0

  mode-switch: true
  orientation-switch: true

  power-domains:
    maxItems: 1

  ports:
    $ref: /schemas/graph.yaml#/properties/ports
    properties:
      port@0:
        $ref: /schemas/graph.yaml#/properties/port
        description: Outgoing connection to the SS port of the Type-C connector.

      port@1:
        $ref: /schemas/graph.yaml#/properties/port
        description: Incoming endpoint from the USB3 controller.

      port@2:
        $ref: /schemas/graph.yaml#/properties/port
        description: Incoming endpoint from the DisplayPort controller.

      port@3:
        $ref: /schemas/graph.yaml#/properties/port
        description: Incoming endpoint from the USB4/Thunderbolt controller.

  apple,tunable-common-a:
    $ref: "#/$defs/apple,tunable"
    description: >
      Common tunables required for all modes, applied before tunable-axi2af.

  apple,tunable-axi2af:
    $ref: "#/$defs/apple,tunable"
    description: >
      AXI to Apple Fabric tunables, required for all modes. Unlike all other
      tunables these are applied to the axi2af region.

  apple,tunable-common-b:
    $ref: "#/$defs/apple,tunable"
    description: >
      Common tunables required for all modes, applied after tunable-axi2af.

  apple,tunable-lane0-usb:
    $ref: "#/$defs/apple,tunable"
    description: USB3 tunables for lane 0.

  apple,tunable-lane1-usb:
    $ref: "#/$defs/apple,tunable"
    description: USB3 tunables for lane 1.

  apple,tunable-lane0-cio:
    $ref: "#/$defs/apple,tunable"
    description: USB4/Thunderbolt ("Converged IO") tunables for lane 0.

  apple,tunable-lane1-cio:
    $ref: "#/$defs/apple,tunable"
    description: USB4/Thunderbolt ("Converged IO") tunables for lane 1.

  apple,tunable-lane0-dp:
    $ref: "#/$defs/apple,tunable"
    description: >
      DisplayPort tunables for lane 0.

      Note that lane here refers to a USB RX and TX pair re-used for DisplayPort
      and not to an individual DisplayPort differential lane.

  apple,tunable-lane1-dp:
    $ref: "#/$defs/apple,tunable"
    description: >
      DisplayPort tunables for lane 1.

      Note that lane here refers to a USB RX and TX pair re-used for DisplayPort
      and not to an individual DisplayPort differential lane.

required:
  - compatible
  - reg
  - reg-names
  - "#phy-cells"
  - "#reset-cells"
  - orientation-switch
  - mode-switch
  - power-domains
  - ports

additionalProperties: false

examples:
  - |
    phy@83000000 {
      compatible = "apple,t8103-atcphy";
      reg = <0x83000000 0x4c000>,
            <0x83050000 0x8000>,
            <0x80000000 0x4000>,
            <0x82a90000 0x4000>,
            <0x82a84000 0x4000>;
      reg-names = "core", "lpdptx", "axi2af", "usb2phy",
                  "pipehandler";

      #phy-cells = <1>;
      #reset-cells = <0>;

      orientation-switch;
      mode-switch;
      power-domains = <&ps_atc0_usb>;

      ports {
        #address-cells = <1>;
        #size-cells = <0>;

        port@0 {
          reg = <0>;

          endpoint {
            remote-endpoint = <&typec_connector_ss>;
          };
        };

        port@1 {
          reg = <1>;

          endpoint {
            remote-endpoint = <&dwc3_ss_out>;
          };
        };

        port@2 {
          reg = <2>;

          endpoint {
            remote-endpoint = <&dcp_dp_out>;
          };
        };

        port@3 {
          reg = <3>;

          endpoint {
            remote-endpoint = <&acio_tbt_out>;
          };
        };
      };
    };
```

## Documentation/devicetree/bindings/phy/axiado,ax3000-emmc-phy.yaml
```yaml
# SPDX-License-Identifier: GPL-2.0-only OR BSD-2-Clause
%YAML 1.2
---
$id: http://devicetree.org/schemas/phy/axiado,ax3000-emmc-phy.yaml#
$schema: http://devicetree.org/meta-schemas/core.yaml#

title: Axiado AX3000 Arasan eMMC PHY

maintainers:
  - SriNavmani A <srinavmani@axiado.com>
  - Tzu-Hao Wei <twei@axiado.com>
  - Prasad Bolisetty <pbolisetty@axiado.com>

properties:
  compatible:
    const: axiado,ax3000-emmc-phy

  reg:
    maxItems: 1

  "#phy-cells":
    const: 0

required:
  - compatible
  - reg
  - "#phy-cells"

additionalProperties: false

examples:
  - |
    phy@80801c00 {
        compatible = "axiado,ax3000-emmc-phy";
        reg = <0x80801c00 0x1000>;
        #phy-cells = <0>;
    };
```

## Documentation/devicetree/bindings/phy/bcm-ns-usb2-phy.txt
```
Driver for Broadcom Northstar USB 2.0 PHY

Required properties:
- compatible: brcm,ns-usb2-phy
- reg: iomem address range of DMU (Device Management Unit)
- reg-names: "dmu", the only needed & supported reg right now
- clocks: USB PHY reference clock
- clock-names: "phy-ref-clk", the only needed & supported clock right now

To initialize USB 2.0 PHY driver needs to setup PLL correctly. To do this it
requires passing phandle to the USB PHY reference clock.

Example:
	usb2-phy {
		compatible = "brcm,ns-usb2-phy";
		reg = <0x1800c000 0x1000>;
		reg-names = "dmu";
		#phy-cells = <0>;
		clocks = <&genpll BCM_NSP_GENPLL_USB_PHY_REF_CLK>;
		clock-names = "phy-ref-clk";
	};
```
