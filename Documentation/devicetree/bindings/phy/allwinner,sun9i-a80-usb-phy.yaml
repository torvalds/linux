## Documentation/devicetree/bindings/phy/bcm-ns-usb2-phy.yaml
```yaml
# SPDX-License-Identifier: GPL-2.0-only OR BSD-2-Clause
%YAML 1.2
---
$id: http://devicetree.org/schemas/phy/bcm-ns-usb2-phy.yaml#
$schema: http://devicetree.org/meta-schemas/core.yaml#

title: Broadcom Northstar USB 2.0 PHY

description: >
  To initialize USB 2.0 PHY driver needs to setup PLL correctly.
  To do this it requires passing phandle to the USB PHY reference clock.

maintainers:
  - Rafał Miłecki <rafal@milecki.pl>

properties:
  compatible:
    const: brcm,ns-usb2-phy

  reg:
    maxItems: 1
    description: PHY control register

  brcm,syscon-clkset:
    description: phandle to syscon for clkset register
    $ref: /schemas/types.yaml#/definitions/phandle

  clocks:
    items:
      - description: USB PHY reference clock

  clock-names:
    items:
      - const: phy-ref-clk

  "#phy-cells":
    const: 0

required:
  - compatible
  - reg
  - clocks
  - clock-names
  - "#phy-cells"
  - brcm,syscon-clkset

additionalProperties: false

examples:
  - |
    #include <dt-bindings/clock/bcm-nsp.h>
    phy@1800c164 {
        compatible = "brcm,ns-usb2-phy";
        reg = <0x1800c164 0x4>;
        brcm,syscon-clkset = <&clkset>;
        clocks = <&genpll BCM_NSP_GENPLL_USB_PHY_REF_CLK>;
        clock-names = "phy-ref-clk";
        #phy-cells = <0>;
    };
```

## Documentation/devicetree/bindings/phy/bcm-ns-usb3-phy.txt
```
Driver for Broadcom Northstar USB 3.0 PHY

Required properties:

- compatible: one of: "brcm,ns-ax-usb3-phy", "brcm,ns-bx-usb3-phy".
- reg: address of MDIO bus device
- usb3-dmp-syscon: phandle to syscon with DMP (Device Management Plugin)
		   registers
- #phy-cells: must be 0

Initialization of USB 3.0 PHY depends on Northstar version. There are currently
three known series: Ax, Bx and Cx.
Known A0: BCM4707 rev 0
Known B0: BCM4707 rev 4, BCM53573 rev 2
Known B1: BCM4707 rev 6
Known C0: BCM47094 rev 0

Example:
	mdio: mdio@0 {
		reg = <0x0>;
		#size-cells = <1>;
		#address-cells = <0>;

		usb3-phy@10 {
			compatible = "brcm,ns-ax-usb3-phy";
			reg = <0x10>;
			usb3-dmp-syscon = <&usb3_dmp>;
			#phy-cells = <0>;
		};
	};

	usb3_dmp: syscon@18105000 {
		reg = <0x18105000 0x1000>;
	};
```

## Documentation/devicetree/bindings/phy/bcm-ns-usb3-phy.yaml
```yaml
# SPDX-License-Identifier: GPL-2.0-only OR BSD-2-Clause
%YAML 1.2
---
$id: http://devicetree.org/schemas/phy/bcm-ns-usb3-phy.yaml#
$schema: http://devicetree.org/meta-schemas/core.yaml#

title: Broadcom Analrthstar USB 3.0 PHY

description: |
  Initialization of USB 3.0 PHY depends on Analrthstar version. There are currently
  three kanalwn series: Ax, Bx and Cx.
  Kanalwn A0: BCM4707 rev 0
  Kanalwn B0: BCM4707 rev 4, BCM53573 rev 2
  Kanalwn B1: BCM4707 rev 6
  Kanalwn C0: BCM47094 rev 0

maintainers:
  - Rafał Miłecki <rafal@milecki.pl>

properties:
  compatible:
    enum:
      - brcm,ns-ax-usb3-phy
      - brcm,ns-bx-usb3-phy

  reg:
    description: address of MDIO bus device
    maxItems: 1

  usb3-dmp-syscon:
    $ref: /schemas/types.yaml#/definitions/phandle
    description:
      Phandle to the DMP (Device Management Plugin) syscon

  "#phy-cells":
    const: 0

required:
  - compatible
  - reg
  - usb3-dmp-syscon
  - "#phy-cells"

additionalProperties: false

examples:
  - |
    mdio {
        #address-cells = <1>;
        #size-cells = <0>;

        usb3-phy@10 {
            compatible = "brcm,ns-ax-usb3-phy";
            reg = <0x10>;
            usb3-dmp-syscon = <&usb3_dmp>;
            #phy-cells = <0>;
        };
    };

    usb3_dmp: syscon@18105000 {
        reg = <0x18105000 0x1000>;
    };
```

## Documentation/devicetree/bindings/phy/bcm-phy.txt
```
BROADCOM KONA USB2 PHY

Required properties:
 - compatible: brcm,kona-usb2-phy
 - reg: offset and length of the PHY registers
 - #phy-cells: must be 0
Refer to phy/phy-bindings.txt for the generic PHY binding properties

Example:

	usbphy: usb-phy@3f130000 {
		compatible = "brcm,kona-usb2-phy";
		reg = <0x3f130000 0x28>;
		#phy-cells = <0>;
	};
```

## Documentation/devicetree/bindings/phy/berlin-sata-phy.txt
```
Berlin SATA PHY
---------------

Required properties:
- compatible: should be one of
    "marvell,berlin2-sata-phy"
    "marvell,berlin2q-sata-phy"
- address-cells: should be 1
- size-cells: should be 0
- phy-cells: from the generic PHY bindings, must be 1
- reg: address and length of the register
- clocks: reference to the clock entry

Sub-nodes:
Each PHY should be represented as a sub-node.

Sub-nodes required properties:
- reg: the PHY number

Example:
	sata_phy: phy@f7e900a0 {
		compatible = "marvell,berlin2q-sata-phy";
		reg = <0xf7e900a0 0x200>;
		clocks = <&chip CLKID_SATA>;
		#address-cells = <1>;
		#size-cells = <0>;
		#phy-cells = <1>;

		sata-phy@0 {
			reg = <0>;
		};

		sata-phy@1 {
			reg = <1>;
		};
	};
```

## Documentation/devicetree/bindings/phy/berlin-usb-phy.txt
```
* Marvell Berlin USB PHY

Required properties:
- compatible: "marvell,berlin2-usb-phy" or "marvell,berlin2cd-usb-phy"
- reg: base address and length of the registers
- #phys-cells: should be 0
- resets: reference to the reset controller

Example:

	usb-phy@f774000 {
		compatible = "marvell,berlin2-usb-phy";
		reg = <0xf774000 0x128>;
		#phy-cells = <0>;
		resets = <&chip 0x104 14>;
	};
```

## Documentation/devicetree/bindings/phy/brcm,bcm63xx-usbh-phy.yaml
```yaml
# SPDX-License-Identifier: (GPL-2.0 OR BSD-2-Clause)
%YAML 1.2
---
$id: "http://devicetree.org/schemas/phy/brcm,bcm63xx-usbh-phy.yaml#"
$schema: "http://devicetree.org/meta-schemas/core.yaml#"

title: BCM63xx USBH PHY

maintainers:
  - Álvaro Fernández Rojas <noltari@gmail.com>

properties:
  compatible:
    enum:
      - brcm,bcm6318-usbh-phy
      - brcm,bcm6328-usbh-phy
      - brcm,bcm6358-usbh-phy
      - brcm,bcm6362-usbh-phy
      - brcm,bcm6368-usbh-phy
      - brcm,bcm63268-usbh-phy

  reg:
    maxItems: 1

  clocks:
    minItems: 1
    maxItems: 2

  clock-names:
    minItems: 1
    items:
      - const: usbh
      - const: usb_ref

  resets:
    maxItems: 1

  "#phy-cells":
    const: 1

additionalProperties: false

required:
  - compatible
  - reg
  - clocks
  - clock-names
  - resets
  - "#phy-cells"

if:
  properties:
    compatible:
      enum:
        - brcm,bcm6318-usbh-phy
        - brcm,bcm6328-usbh-phy
        - brcm,bcm6362-usbh-phy
        - brcm,bcm63268-usbh-phy
then:
  properties:
    power-domains:
      maxItems: 1
  required:
    - power-domains
else:
  properties:
    power-domains: false

examples:
  - |
    usbh: usb-phy@10001700 {
      compatible = "brcm,bcm6368-usbh-phy";
      reg = <0x10001700 0x38>;
      clocks = <&periph_clk 15>;
      clock-names = "usbh";
      resets = <&periph_rst 12>;
      #phy-cells = <1>;
    };
```

## Documentation/devicetree/bindings/phy/brcm,brcmstb-sata-phy.txt
```
* Broadcom SATA3 PHY for STB

Required properties:
- compatible: should be one or more of
     "brcm,bcm7425-sata-phy"
     "brcm,bcm7445-sata-phy"
     "brcm,phy-sata3"
- address-cells: should be 1
- size-cells: should be 0
- reg: register range for the PHY PCB interface
- reg-names: should be "phy"

Sub-nodes:
  Each port's PHY should be represented as a sub-node.

Sub-nodes required properties:
- reg: the PHY number
- phy-cells: generic PHY binding; must be 0
Optional:
- brcm,enable-ssc: use spread spectrum clocking (SSC) on this port


Example:

	sata-phy@f0458100 {
		compatible = "brcm,bcm7445-sata-phy", "brcm,phy-sata3";
		reg = <0xf0458100 0x1e00>, <0xf045804c 0x10>;
		reg-names = "phy";
		#address-cells = <1>;
		#size-cells = <0>;

		sata-phy@0 {
			reg = <0>;
			#phy-cells = <0>;
		};

		sata-phy@1 {
			reg = <1>;
			#phy-cells = <0>;
		};
	};
```

## Documentation/devicetree/bindings/phy/brcm,brcmstb-usb-phy.txt
```
Broadcom STB USB PHY

Required properties:
- compatible: should be one of
	"brcm,brcmstb-usb-phy"
	"brcm,bcm7216-usb-phy"
	"brcm,bcm7211-usb-phy"

- reg and reg-names properties requirements are specific to the
  compatible string.
  "brcm,brcmstb-usb-phy":
    - reg: 1 or 2 offset and length pairs. One for the base CTRL registers
           and an optional pair for systems with USB 3.x support
    - reg-names: not specified
  "brcm,bcm7216-usb-phy":
    - reg: 3 offset and length pairs for CTRL, XHCI_EC and XHCI_GBL
           registers
    - reg-names: "ctrl", "xhci_ec", "xhci_gbl"
  "brcm,bcm7211-usb-phy":
    - reg: 5 offset and length pairs for CTRL, XHCI_EC, XHCI_GBL,
           USB_PHY and USB_MDIO registers and an optional pair
	   for the BDC registers
    - reg-names: "ctrl", "xhci_ec", "xhci_gbl", "usb_phy", "usb_mdio", "bdc_ec"

- #phy-cells: Shall be 1 as it expects one argument for setting
	      the type of the PHY. Possible values are:
	      - PHY_TYPE_USB2 for USB1.1/2.0 PHY
	      - PHY_TYPE_USB3 for USB3.x PHY

Optional Properties:
- clocks : clock phandles.
- clock-names: String, clock name.
- interrupts: wakeup interrupt
- interrupt-names: "wakeup"
- brcm,ipp: Boolean, Invert Port Power.
  Possible values are: 0 (Don't invert), 1 (Invert)
- brcm,ioc: Boolean, Invert Over Current detection.
  Possible values are: 0 (Don't invert), 1 (Invert)
- dr_mode: String, PHY Device mode.
  Possible values are: "host", "peripheral ", "drd" or "typec-pd"
  If this property is not defined, the phy will default to "host" mode.
- brcm,syscon-piarbctl: phandle to syscon for handling config registers
NOTE: one or both of the following two properties must be set
- brcm,has-xhci: Boolean indicating the phy has an XHCI phy.
- brcm,has-eohci: Boolean indicating the phy has an EHCI/OHCI phy.


Example:

usbphy_0: usb-phy@f0470200 {
	reg = <0xf0470200 0xb8>,
		<0xf0471940 0x6c0>;
	compatible = "brcm,brcmstb-usb-phy";
	#phy-cells = <1>;
	dr_mode = "host"
	brcm,ioc = <1>;
	brcm,ipp = <1>;
	brcm,has-xhci;
	brcm,has-eohci;
	clocks = <&usb20>, <&usb30>;
	clock-names = "sw_usb", "sw_usb3";
};

usb-phy@29f0200 {
	reg = <0x29f0200 0x200>,
		<0x29c0880 0x30>,
		<0x29cc100 0x534>,
		<0x2808000 0x24>,
		<0x2980080 0x8>;
	reg-names = "ctrl",
		"xhci_ec",
		"xhci_gbl",
		"usb_phy",
		"usb_mdio";
	brcm,ioc = <0x0>;
	brcm,ipp = <0x0>;
	compatible = "brcm,bcm7211-usb-phy";
	interrupts = <0x30>;
	interrupt-parent = <&vpu_intr1_nosec_intc>;
	interrupt-names = "wake";
	#phy-cells = <0x1>;
	brcm,has-xhci;
	syscon-piarbctl = <&syscon_piarbctl>;
	clocks = <&scmi_clk 256>;
	clock-names = "sw_usb";
};
```
