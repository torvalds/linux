## Documentation/devicetree/bindings/phy/allwinner,sun9i-a80-usb-phy.yaml
```yaml
# SPDX-License-Identifier: GPL-2.0
%YAML 1.2
---
$id: http://devicetree.org/schemas/phy/allwinner,sun9i-a80-usb-phy.yaml#
$schema: http://devicetree.org/meta-schemas/core.yaml#

title: Allwinner A80 USB PHY Device Tree Bindings

maintainers:
  - Chen-Yu Tsai <wens@csie.org>
  - Maxime Ripard <mripard@kernel.org>

properties:
  "#phy-cells":
    const: 0

  compatible:
    const: allwinner,sun9i-a80-usb-phy

  reg:
    maxItems: 1

  clocks:
    anyOf:
      - description: Main PHY Clock

      - items:
          - description: Main PHY clock
          - description: HSIC 12MHz clock
          - description: HSIC 480MHz clock

  clock-names:
    oneOf:
      - const: phy

      - items:
          - const: phy
          - const: hsic_12M
          - const: hsic_480M

  resets:
    anyOf:
      - description: Normal USB PHY reset

      - items:
          - description: Normal USB PHY reset
          - description: HSIC Reset

  reset-names:
    oneOf:
      - const: phy

      - items:
          - const: phy
          - const: hsic

  phy_type:
    const: hsic
    description:
      When absent, the PHY type will be assumed to be normal USB.

  phy-supply:
    description:
      Regulator that powers VBUS

required:
  - "#phy-cells"
  - compatible
  - reg
  - clocks
  - clock-names
  - resets
  - reset-names

additionalProperties: false

if:
  properties:
    phy_type:
      const: hsic

  required:
    - phy_type

then:
  properties:
    clocks:
      maxItems: 3

    clock-names:
      maxItems: 3

    resets:
      maxItems: 2

    reset-names:
      maxItems: 2

examples:
  - |
    #include <dt-bindings/clock/sun9i-a80-usb.h>
    #include <dt-bindings/reset/sun9i-a80-usb.h>

    usbphy1: phy@a00800 {
        compatible = "allwinner,sun9i-a80-usb-phy";
        reg = <0x00a00800 0x4>;
        clocks = <&usb_clocks CLK_USB0_PHY>;
        clock-names = "phy";
        resets = <&usb_clocks RST_USB0_PHY>;
        reset-names = "phy";
        phy-supply = <&reg_usb1_vbus>;
        #phy-cells = <0>;
    };

  - |
    #include <dt-bindings/clock/sun9i-a80-usb.h>
    #include <dt-bindings/reset/sun9i-a80-usb.h>

    usbphy3: phy@a02800 {
        compatible = "allwinner,sun9i-a80-usb-phy";
        reg = <0x00a02800 0x4>;
        clocks = <&usb_clocks CLK_USB2_PHY>,
                 <&usb_clocks CLK_USB_HSIC>,
                 <&usb_clocks CLK_USB2_HSIC>;
        clock-names = "phy",
                      "hsic_12M",
                      "hsic_480M";
        resets = <&usb_clocks RST_USB2_PHY>,
                 <&usb_clocks RST_USB2_HSIC>;
        reset-names = "phy",
                      "hsic";
        phy_type = "hsic";
        phy-supply = <&reg_usb3_vbus>;
        #phy-cells = <0>;
    };
```

## Documentation/devicetree/bindings/phy/allwinner,suniv-f1c100s-usb-phy.yaml
```yaml
# SPDX-License-Identifier: (GPL-2.0-only OR BSD-2-Clause)
%YAML 1.2
---
$id: http://devicetree.org/schemas/phy/allwinner,suniv-f1c100s-usb-phy.yaml#
$schema: http://devicetree.org/meta-schemas/core.yaml#

title: Allwinner F1C100s USB PHY

maintainers:
  - Chen-Yu Tsai <wens@csie.org>
  - Maxime Ripard <mripard@kernel.org>

properties:
  "#phy-cells":
    const: 1

  compatible:
    const: allwinner,suniv-f1c100s-usb-phy

  reg:
    maxItems: 1
    description: PHY Control registers

  reg-names:
    const: phy_ctrl

  clocks:
    maxItems: 1
    description: USB OTG PHY bus clock

  clock-names:
    const: usb0_phy

  resets:
    maxItems: 1
    description: USB OTG reset

  reset-names:
    const: usb0_reset

  usb0_id_det-gpios:
    maxItems: 1
    description: GPIO to the USB OTG ID pin

  usb0_vbus_det-gpios:
    maxItems: 1
    description: GPIO to the USB OTG VBUS detect pin

  usb0_vbus_power-supply:
    description: Power supply to detect the USB OTG VBUS

  usb0_vbus-supply:
    description: Regulator controlling USB OTG VBUS

required:
  - "#phy-cells"
  - compatible
  - clocks
  - clock-names
  - reg
  - reg-names
  - resets
  - reset-names

additionalProperties: false

examples:
  - |
    #include <dt-bindings/gpio/gpio.h>
    #include <dt-bindings/clock/suniv-ccu-f1c100s.h>
    #include <dt-bindings/reset/suniv-ccu-f1c100s.h>

    phy@1c13400 {
        compatible = "allwinner,suniv-f1c100s-usb-phy";
        reg = <0x01c13400 0x10>;
        reg-names = "phy_ctrl";
        clocks = <&ccu CLK_USB_PHY0>;
        clock-names = "usb0_phy";
        resets = <&ccu RST_USB_PHY0>;
        reset-names = "usb0_reset";
        #phy-cells = <1>;
        usb0_id_det-gpios = <&pio 4 2 GPIO_ACTIVE_HIGH>;
    };
```

## Documentation/devicetree/bindings/phy/amlogic,axg-mipi-dphy.yaml
```yaml
# SPDX-License-Identifier: (GPL-2.0 OR BSD-2-Clause)
# Copyright 2020 BayLibre, SAS
%YAML 1.2
---
$id: "http://devicetree.org/schemas/phy/amlogic,axg-mipi-dphy.yaml#"
$schema: "http://devicetree.org/meta-schemas/core.yaml#"

title: Amlogic AXG MIPI D-PHY

maintainers:
  - Neil Armstrong <neil.armstrong@linaro.org>

properties:
  compatible:
    enum:
      - amlogic,axg-mipi-dphy

  reg:
    maxItems: 1

  clocks:
    maxItems: 1

  clock-names:
    items:
      - const: pclk

  resets:
    maxItems: 1

  reset-names:
    items:
      - const: phy

  "#phy-cells":
    const: 0

  phys:
    maxItems: 1

  phy-names:
    items:
      - const: analog

required:
  - compatible
  - reg
  - clocks
  - clock-names
  - resets
  - reset-names
  - phys
  - phy-names
  - "#phy-cells"

additionalProperties: false

examples:
  - |
    phy@ff640000 {
            compatible = "amlogic,axg-mipi-dphy";
            reg = <0xff640000 0x100>;
            clocks = <&clk_mipi_dsi_phy>;
            clock-names = "pclk";
            resets = <&reset_phy>;
            reset-names = "phy";
            phys = <&mipi_pcie_analog_dphy>;
            phy-names = "analog";
            #phy-cells = <0>;
    };
```

## Documentation/devicetree/bindings/phy/amlogic,g12a-mipi-dphy-analog.yaml
```yaml
# SPDX-License-Identifier: (GPL-2.0 OR BSD-2-Clause)
%YAML 1.2
---
$id: "http://devicetree.org/schemas/phy/amlogic,g12a-mipi-dphy-analog.yaml#"
$schema: "http://devicetree.org/meta-schemas/core.yaml#"

title: Amlogic G12A MIPI analog PHY

maintainers:
  - Neil Armstrong <narmstrong@baylibre.com>

properties:
  compatible:
    const: amlogic,g12a-mipi-dphy-analog

  "#phy-cells":
    const: 0

  reg:
    maxItems: 1

required:
  - compatible
  - reg
  - "#phy-cells"

additionalProperties: false

examples:
  - |
    phy@0 {
          compatible = "amlogic,g12a-mipi-dphy-analog";
          reg = <0x0 0xc>;
          #phy-cells = <0>;
    };
```

## Documentation/devicetree/bindings/phy/amlogic,meson-axg-mipi-pcie-analog.yaml
```yaml
# SPDX-License-Identifier: (GPL-2.0 OR BSD-2-Clause)
%YAML 1.2
---
$id: "http://devicetree.org/schemas/phy/amlogic,meson-axg-mipi-pcie-analog.yaml#"
$schema: "http://devicetree.org/meta-schemas/core.yaml#"

title: Amlogic AXG shared MIPI/PCIE analog PHY

maintainers:
  - Remi Pommarel <repk@triplefau.lt>

description: |+
  The Everything-Else Power Domains node should be the child of a syscon
  node with the required property:

  - compatible: Should be the following:
                "amlogic,meson-gx-hhi-sysctrl", "simple-mfd", "syscon"

  Refer to the bindings described in
  Documentation/devicetree/bindings/mfd/syscon.yaml

properties:
  compatible:
    const: amlogic,axg-mipi-pcie-analog-phy

  "#phy-cells":
    const: 0

required:
  - compatible
  - "#phy-cells"

additionalProperties: false

examples:
  - |
    mpphy: phy {
          compatible = "amlogic,axg-mipi-pcie-analog-phy";
          #phy-cells = <0>;
    };
```

## Documentation/devicetree/bindings/phy/amlogic,meson-axg-pcie.yaml
```yaml
# SPDX-License-Identifier: (GPL-2.0 OR BSD-2-Clause)
%YAML 1.2
---
$id: "http://devicetree.org/schemas/phy/amlogic,meson-axg-pcie.yaml#"
$schema: "http://devicetree.org/meta-schemas/core.yaml#"

title: Amlogic AXG PCIE PHY

maintainers:
  - Remi Pommarel <repk@triplefau.lt>

properties:
  compatible:
    const: amlogic,axg-pcie-phy

  reg:
    maxItems: 1

  resets:
    maxItems: 1

  phys:
    maxItems: 1

  phy-names:
    const: analog

  "#phy-cells":
    const: 0

required:
  - compatible
  - reg
  - phys
  - phy-names
  - resets
  - "#phy-cells"

additionalProperties: false

examples:
  - |
    #include <dt-bindings/reset/amlogic,meson-axg-reset.h>
    #include <dt-bindings/phy/phy.h>
    pcie_phy: pcie-phy@ff644000 {
          compatible = "amlogic,axg-pcie-phy";
          reg = <0xff644000 0x1c>;
          resets = <&reset RESET_PCIE_PHY>;
          phys = <&mipi_analog_phy PHY_TYPE_PCIE>;
          phy-names = "analog";
          #phy-cells = <0>;
    };
```

## Documentation/devicetree/bindings/phy/amlogic,meson-g12a-usb2-phy.yaml
```yaml
# SPDX-License-Identifier: (GPL-2.0 OR BSD-2-Clause)
# Copyright 2019 BayLibre, SAS
%YAML 1.2
---
$id: "http://devicetree.org/schemas/phy/amlogic,meson-g12a-usb2-phy.yaml#"
$schema: "http://devicetree.org/meta-schemas/core.yaml#"

title: Amlogic G12A USB2 PHY

maintainers:
  - Neil Armstrong <narmstrong@baylibre.com>

properties:
  compatible:
    enum:
      - amlogic,meson-g12a-usb2-phy

  reg:
    maxItems: 1

  clocks:
    maxItems: 1

  clock-names:
    items:
      - const: xtal

  resets:
    maxItems: 1

  reset-names:
    items:
      - const: phy

  "#phy-cells":
    const: 0

  phy-supply:
     description:
       Phandle to a regulator that provides power to the PHY. This
       regulator will be managed during the PHY power on/off sequence.

required:
  - compatible
  - reg
  - clocks
  - clock-names
  - resets
  - reset-names
  - "#phy-cells"

examples:
  - |
    phy@36000 {
          compatible = "amlogic,meson-g12a-usb2-phy";
          reg = <0x36000 0x2000>;
          clocks = <&xtal>;
          clock-names = "xtal";
          resets = <&phy_reset>;
          reset-names = "phy";
          #phy-cells = <0>;
    };
```

## Documentation/devicetree/bindings/phy/amlogic,meson-g12a-usb3-pcie-phy.yaml
```yaml
# SPDX-License-Identifier: (GPL-2.0 OR BSD-2-Clause)
# Copyright 2019 BayLibre, SAS
%YAML 1.2
---
$id: "http://devicetree.org/schemas/phy/amlogic,meson-g12a-usb3-pcie-phy.yaml#"
$schema: "http://devicetree.org/meta-schemas/core.yaml#"

title: Amlogic G12A USB3 + PCIE Combo PHY

maintainers:
  - Neil Armstrong <narmstrong@baylibre.com>

properties:
  compatible:
    enum:
      - amlogic,meson-g12a-usb3-pcie-phy

  reg:
    maxItems: 1

  clocks:
    maxItems: 1

  clock-names:
    items:
      - const: ref_clk

  resets:
    maxItems: 1

  reset-names:
    items:
      - const: phy

  "#phy-cells":
    const: 1

required:
  - compatible
  - reg
  - clocks
  - clock-names
  - resets
  - reset-names
  - "#phy-cells"

additionalProperties: false

examples:
  - |
    phy@46000 {
          compatible = "amlogic,meson-g12a-usb3-pcie-phy";
          reg = <0x46000 0x2000>;
          clocks = <&ref_clk>;
          clock-names = "ref_clk";
          resets = <&phy_reset>;
          reset-names = "phy";
          #phy-cells = <1>;
    };
```

## Documentation/devicetree/bindings/phy/amlogic,meson-gxl-usb2-phy.yaml
```yaml
# SPDX-License-Identifier: (GPL-2.0-only OR BSD-2-Clause)
%YAML 1.2
---
$id: http://devicetree.org/schemas/phy/amlogic,meson-gxl-usb2-phy.yaml#
$schema: http://devicetree.org/meta-schemas/core.yaml#

title: Amlogic Meson GXL USB2 PHY

maintainers:
  - Neil Armstrong <neil.armstrong@linaro.org>

properties:
  compatible:
    const: amlogic,meson-gxl-usb2-phy

  reg:
    maxItems: 1

  clocks:
    maxItems: 1

  clock-names:
    items:
      - const: phy

  resets:
    maxItems: 1

  reset-names:
    items:
      - const: phy

  "#phy-cells":
    const: 0

  phy-supply: true

required:
  - compatible
  - reg
  - "#phy-cells"

additionalProperties: false

examples:
  - |
    phy@78000 {
        compatible = "amlogic,meson-gxl-usb2-phy";
        reg = <0x78000 0x20>;
        clocks = <&xtal>;
        clock-names = "phy";
        resets = <&phy_reset>;
        reset-names = "phy";
        #phy-cells = <0>;
        phy-supply = <&usb2_supply>;
    };
```

## Documentation/devicetree/bindings/phy/amlogic,meson8-hdmi-tx-phy.yaml
```yaml
# SPDX-License-Identifier: (GPL-2.0 OR BSD-2-Clause)
%YAML 1.2
---
$id: http://devicetree.org/schemas/phy/amlogic,meson8-hdmi-tx-phy.yaml#
$schema: http://devicetree.org/meta-schemas/core.yaml#

title: Amlogic Meson8, Meson8b and Meson8m2 HDMI TX PHY

maintainers:
  - Martin Blumenstingl <martin.blumenstingl@googlemail.com>

description: |+
  The HDMI TX PHY node should be the child of a syscon node with the
  required property:

  compatible = "amlogic,meson-hhi-sysctrl", "simple-mfd", "syscon"

  Refer to the bindings described in
  Documentation/devicetree/bindings/mfd/syscon.yaml

properties:
  $nodename:
    pattern: "^hdmi-phy@[0-9a-f]+$"

  compatible:
    oneOf:
      - items:
          - enum:
              - amlogic,meson8b-hdmi-tx-phy
              - amlogic,meson8m2-hdmi-tx-phy
          - const: amlogic,meson8-hdmi-tx-phy
      - const: amlogic,meson8-hdmi-tx-phy

  reg:
    maxItems: 1

  clocks:
    minItems: 1
    description:
      HDMI TMDS clock

  "#phy-cells":
    const: 0

required:
  - compatible
  - "#phy-cells"

additionalProperties: false

examples:
  - |
    hdmi-phy@3a0 {
      compatible = "amlogic,meson8-hdmi-tx-phy";
      reg = <0x3a0 0xc>;
      clocks = <&tmds_clock>;
      #phy-cells = <0>;
    };
  - |
    hdmi-phy@3a0 {
      compatible = "amlogic,meson8b-hdmi-tx-phy", "amlogic,meson8-hdmi-tx-phy";
      reg = <0x3a0 0xc>;
      clocks = <&tmds_clock>;
      #phy-cells = <0>;
    };
```

## Documentation/devicetree/bindings/phy/amlogic,meson8b-usb2-phy.yaml
```yaml
# SPDX-License-Identifier: (GPL-2.0-only OR BSD-2-Clause)
%YAML 1.2
---
$id: "http://devicetree.org/schemas/phy/amlogic,meson8b-usb2-phy.yaml#"
$schema: "http://devicetree.org/meta-schemas/core.yaml#"

title: Amlogic Meson8, Meson8b, Meson8m2 and GXBB USB2 PHY

maintainers:
  - Martin Blumenstingl <martin.blumenstingl@googlemail.com>

properties:
  compatible:
    oneOf:
      - items:
          - enum:
              - amlogic,meson8-usb2-phy
              - amlogic,meson8b-usb2-phy
          - const: amlogic,meson-mx-usb2-phy
      - const: amlogic,meson-gxbb-usb2-phy

  reg:
    maxItems: 1

  clocks:
    minItems: 2

  clock-names:
    items:
      - const: usb_general
      - const: usb

  resets:
    minItems: 1

  "#phy-cells":
    const: 0

  phy-supply:
    description:
      Phandle to a regulator that provides power to the PHY. This
      regulator will be managed during the PHY power on/off sequence.

required:
  - compatible
  - reg
  - clocks
  - clock-names
  - "#phy-cells"

additionalProperties: false

examples:
  - |
    usb-phy@c0000000 {
      compatible = "amlogic,meson-gxbb-usb2-phy";
      reg = <0xc0000000 0x20>;
      resets = <&reset_usb_phy>;
      clocks = <&clk_usb_general>, <&reset_usb>;
      clock-names = "usb_general", "usb";
      phy-supply = <&usb_vbus>;
      #phy-cells = <0>;
    };
```
