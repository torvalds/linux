## Documentation/devicetree/bindings/phy/intel,lgm-usb-phy.yaml
```yaml
# SPDX-License-Identifier: (GPL-2.0 OR BSD-2-Clause)
%YAML 1.2
---
$id: http://devicetree.org/schemas/phy/intel,lgm-usb-phy.yaml#
$schema: http://devicetree.org/meta-schemas/core.yaml#

title: Intel LGM USB PHY Device Tree Bindings

maintainers:
  - Vadivel Murugan Ramuthevar <vadivel.muruganx.ramuthevar@linux.intel.com>

properties:
  compatible:
    const: intel,lgm-usb-phy

  reg:
    maxItems: 1

  clocks:
    maxItems: 1

  resets:
    items:
      - description: USB PHY and Host controller reset
      - description: APB BUS reset
      - description: General Hardware reset

  reset-names:
    items:
      - const: phy
      - const: apb
      - const: phy31

  "#phy-cells":
    const: 0

required:
  - compatible
  - clocks
  - reg
  - resets
  - reset-names
  - "#phy-cells"

additionalProperties: false

examples:
  - |
    usb-phy@e7e00000 {
        compatible = "intel,lgm-usb-phy";
        reg = <0xe7e00000 0x10000>;
        clocks = <&cgu0 153>;
        resets = <&rcu 0x70 0x24>,
                 <&rcu 0x70 0x26>,
                 <&rcu 0x70 0x28>;
        reset-names = "phy", "apb", "phy31";
        #phy-cells = <0>;
    };
```

## Documentation/devicetree/bindings/phy/intel,phy-keembay-usb.yaml
```yaml
# SPDX-License-Identifier: (GPL-2.0-only OR BSD-2-Clause)
%YAML 1.2
---
$id: http://devicetree.org/schemas/phy/intel,phy-keembay-usb.yaml#
$schema: http://devicetree.org/meta-schemas/core.yaml#

title: Intel Keem Bay USB PHY bindings

maintainers:
  - Wan Ahmad Zainie <wan.ahmad.zainie.wan.mohamad@intel.com>

properties:
  compatible:
    const: intel,keembay-usb-phy

  reg:
    items:
      - description: USB APB CPR (clock, power, reset) register
      - description: USB APB slave register

  reg-names:
    items:
      - const: cpr-apb-base
      - const: slv-apb-base

  '#phy-cells':
    const: 0

required:
  - compatible
  - reg
  - '#phy-cells'

additionalProperties: false

examples:
  - |
    usb-phy@20400000 {
          compatible = "intel,keembay-usb-phy";
          reg = <0x20400000 0x1c>,
                <0x20480000 0xd0>;
          reg-names = "cpr-apb-base", "slv-apb-base";
          #phy-cells = <0>;
    };
```

## Documentation/devicetree/bindings/phy/intel,phy-thunderbay-emmc.yaml
```yaml
# SPDX-License-Identifier: (GPL-2.0-only OR BSD-2-Clause)
%YAML 1.2
---
$id: http://devicetree.org/schemas/phy/intel,phy-thunderbay-emmc.yaml#
$schema: http://devicetree.org/meta-schemas/core.yaml#

title: Intel Thunder Bay eMMC PHY

maintainers:
  - Srikandan Nandhini <nandhini.srikandan@intel.com>

properties:
  compatible:
    const: intel,thunderbay-emmc-phy

  "#phy-cells":
    const: 0

  reg:
    maxItems: 1

  clocks:
    maxItems: 1

  clock-names:
    items:
      - const: emmcclk

required:
  - "#phy-cells"
  - compatible
  - reg
  - clocks

additionalProperties: false

examples:
  - |
    mmc_phy@80440800 {
        #phy-cells = <0x0>;
        compatible = "intel,thunderbay-emmc-phy";
        reg = <0x80440800 0x100>;
        clocks = <&emmc>;
        clock-names = "emmcclk";
    };
```

## Documentation/devicetree/bindings/phy/keystone-usb-phy.txt
```
TI Keystone USB PHY

Required properties:
 - compatible: should be "ti,keystone-usbphy".
 - #address-cells, #size-cells : should be '1' if the device has sub-nodes
   with 'reg' property.
 - reg : Address and length of the usb phy control register set.

The main purpose of this PHY driver is to enable the USB PHY reference clock
gate on the Keystone SOC for both the USB2 and USB3 PHY. Otherwise it is just
an NOP PHY driver.  Hence this node is referenced as both the usb2 and usb3
phy node in the USB Glue layer driver node.

usb_phy: usb_phy@2620738 {
	compatible = "ti,keystone-usbphy";
	#address-cells = <1>;
	#size-cells = <1>;
	reg = <0x2620738 32>;
};
```
