## Documentation/devicetree/bindings/phy/fsl,imx8-pcie-phy.yaml
```yaml
# SPDX-License-Identifier: (GPL-2.0-only OR BSD-2-Clause)
%YAML 1.2
---
$id: http://devicetree.org/schemas/phy/fsl,imx8-pcie-phy.yaml#
$schema: http://devicetree.org/meta-schemas/core.yaml#

title: Freescale i.MX8 SoC series PCIe PHY Device Tree Bindings

maintainers:
  - Richard Zhu <hongxing.zhu@nxp.com>

properties:
  "#phy-cells":
    const: 0

  compatible:
    enum:
      - fsl,imx8mm-pcie-phy

  reg:
    maxItems: 1

  clocks:
    maxItems: 1

  clock-names:
    items:
      - const: ref

  resets:
    maxItems: 1

  reset-names:
    items:
      - const: pciephy

  fsl,refclk-pad-mode:
    description: |
      Specifies the mode of the refclk pad used. It can be UNUSED(PHY
      refclock is derived from SoC internal source), INPUT(PHY refclock
      is provided externally via the refclk pad) or OUTPUT(PHY refclock
      is derived from SoC internal source and provided on the refclk pad).
      Refer include/dt-bindings/phy/phy-imx8-pcie.h for the constants
      to be used.
    $ref: /schemas/types.yaml#/definitions/uint32
    enum: [ 0, 1, 2 ]

  fsl,tx-deemph-gen1:
    description: Gen1 De-emphasis value (optional).
    $ref: /schemas/types.yaml#/definitions/uint32
    default: 0

  fsl,tx-deemph-gen2:
    description: Gen2 De-emphasis value (optional).
    $ref: /schemas/types.yaml#/definitions/uint32
    default: 0

  fsl,clkreq-unsupported:
    type: boolean
    description: A boolean property indicating the CLKREQ# signal is
      not supported in the board design (optional)

required:
  - "#phy-cells"
  - compatible
  - reg
  - clocks
  - clock-names
  - fsl,refclk-pad-mode

additionalProperties: false

examples:
  - |
    #include <dt-bindings/clock/imx8mm-clock.h>
    #include <dt-bindings/phy/phy-imx8-pcie.h>
    #include <dt-bindings/reset/imx8mq-reset.h>

    pcie_phy: pcie-phy@32f00000 {
            compatible = "fsl,imx8mm-pcie-phy";
            reg = <0x32f00000 0x10000>;
            clocks = <&clk IMX8MM_CLK_PCIE1_PHY>;
            clock-names = "ref";
            assigned-clocks = <&clk IMX8MM_CLK_PCIE1_PHY>;
            assigned-clock-rates = <100000000>;
            assigned-clock-parents = <&clk IMX8MM_SYS_PLL2_100M>;
            resets = <&src IMX8MQ_RESET_PCIEPHY>;
            reset-names = "pciephy";
            fsl,refclk-pad-mode = <IMX8_PCIE_REFCLK_PAD_INPUT>;
            #phy-cells = <0>;
    };
...
```

## Documentation/devicetree/bindings/phy/fsl,imx8mp-hdmi-phy.yaml
```yaml
# SPDX-License-Identifier: (GPL-2.0-only OR BSD-2-Clause)
%YAML 1.2
---
$id: http://devicetree.org/schemas/phy/fsl,imx8mp-hdmi-phy.yaml#
$schema: http://devicetree.org/meta-schemas/core.yaml#

title: Freescale i.MX8MP HDMI PHY

maintainers:
  - Lucas Stach <l.stach@pengutronix.de>

properties:
  compatible:
    enum:
      - fsl,imx8mp-hdmi-phy

  reg:
    maxItems: 1

  "#clock-cells":
    const: 0

  clocks:
    maxItems: 2

  clock-names:
    items:
      - const: apb
      - const: ref

  "#phy-cells":
    const: 0

  power-domains:
    maxItems: 1

required:
  - compatible
  - reg
  - "#clock-cells"
  - clocks
  - clock-names
  - "#phy-cells"
  - power-domains

additionalProperties: false

examples:
  - |
    #include <dt-bindings/clock/imx8mp-clock.h>
    #include <dt-bindings/power/imx8mp-power.h>

    phy@32fdff00 {
        compatible = "fsl,imx8mp-hdmi-phy";
        reg = <0x32fdff00 0x100>;
        clocks = <&clk IMX8MP_CLK_HDMI_APB>,
                 <&clk IMX8MP_CLK_HDMI_24M>;
        clock-names = "apb", "ref";
        power-domains = <&hdmi_blk_ctrl IMX8MP_HDMIBLK_PD_HDMI_TX_PHY>;
        #clock-cells = <0>;
        #phy-cells = <0>;
    };
```

## Documentation/devicetree/bindings/phy/fsl,imx8mq-usb-phy.txt
```
* Freescale i.MX8MQ USB3 PHY binding

Required properties:
- compatible:	Should be "fsl,imx8mq-usb-phy"
- #phys-cells:	must be 0 (see phy-bindings.txt in this directory)
- reg:		The base address and length of the registers
- clocks:	phandles to the clocks for each clock listed in clock-names
- clock-names:	must contain "phy"

Example:
	usb3_phy0: phy@381f0040 {
		compatible = "fsl,imx8mq-usb-phy";
		reg = <0x381f0040 0x40>;
		clocks = <&clk IMX8MQ_CLK_USB1_PHY_ROOT>;
		clock-names = "phy";
		#phy-cells = <0>;
	};
```

## Documentation/devicetree/bindings/phy/fsl,imx8mq-usb-phy.yaml
```yaml
# SPDX-License-Identifier: (GPL-2.0-only OR BSD-2-Clause)
%YAML 1.2
---
$id: http://devicetree.org/schemas/phy/fsl,imx8mq-usb-phy.yaml#
$schema: http://devicetree.org/meta-schemas/core.yaml#

title: Freescale i.MX8MQ USB3 PHY

maintainers:
  - Li Jun <jun.li@nxp.com>

properties:
  compatible:
    enum:
      - fsl,imx8mq-usb-phy
      - fsl,imx8mp-usb-phy

  reg:
    maxItems: 1

  "#phy-cells":
    const: 0

  clocks:
    maxItems: 1

  clock-names:
    items:
      - const: phy

  power-domains:
    maxItems: 1

  vbus-supply:
    description:
      A phandle to the regulator for USB VBUS.

  fsl,phy-tx-vref-tune-percent:
    description:
      Tunes the HS DC level relative to the nominal level
    minimum: 94
    maximum: 124

  fsl,phy-tx-rise-tune-percent:
    description:
      Adjusts the rise/fall time duration of the HS waveform relative to
      its nominal value
    minimum: 97
    maximum: 103

  fsl,phy-tx-preemp-amp-tune-microamp:
    description:
      Adjust amount of current sourced to DPn and DMn after a J-to-K
      or K-to-J transition. Default is 0 (disabled).
    minimum: 0
    maximum: 1800

  fsl,phy-tx-vboost-level-microvolt:
    description:
      Adjust the boosted transmit launch pk-pk differential amplitude
    minimum: 880
    maximum: 1120

  fsl,phy-comp-dis-tune-percent:
    description:
      Adjust the voltage level used to detect a disconnect event at the host
      relative to the nominal value
    minimum: 91
    maximum: 115

  fsl,phy-pcs-tx-deemph-3p5db-attenuation-db:
    description:
      Adjust TX de-emphasis attenuation in dB at nominal
      3.5dB point as per USB specification
    $ref: /schemas/types.yaml#/definitions/uint32
    minimum: 0
    maximum: 36

  fsl,phy-pcs-tx-swing-full-percent:
    description:
      Scaling of the voltage defined by fsl,phy-tx-vboost-level-microvolt
    minimum: 0
    maximum: 100

required:
  - compatible
  - reg
  - "#phy-cells"
  - clocks
  - clock-names

additionalProperties: false

examples:
  - |
    #include <dt-bindings/clock/imx8mq-clock.h>
    usb3_phy0: phy@381f0040 {
        compatible = "fsl,imx8mq-usb-phy";
        reg = <0x381f0040 0x40>;
        clocks = <&clk IMX8MQ_CLK_USB1_PHY_ROOT>;
        clock-names = "phy";
        #phy-cells = <0>;
    };
```

## Documentation/devicetree/bindings/phy/fsl,imx8qm-hsio.yaml
```yaml
# SPDX-License-Identifier: (GPL-2.0-only OR BSD-2-Clause)
%YAML 1.2
---
$id: http://devicetree.org/schemas/phy/fsl,imx8qm-hsio.yaml#
$schema: http://devicetree.org/meta-schemas/core.yaml#

title: Freescale i.MX8QM SoC series High Speed IO(HSIO) SERDES PHY

maintainers:
  - Richard Zhu <hongxing.zhu@nxp.com>

properties:
  compatible:
    enum:
      - fsl,imx8qm-hsio
      - fsl,imx8qxp-hsio
  reg:
    items:
      - description: Base address and length of the PHY block
      - description: HSIO control and status registers(CSR) of the PHY
      - description: HSIO CSR of the controller bound to the PHY
      - description: HSIO CSR for MISC

  reg-names:
    items:
      - const: reg
      - const: phy
      - const: ctrl
      - const: misc

  "#phy-cells":
    const: 3
    description:
      The first defines lane index.
      The second defines the type of the PHY refer to the include phy.h.
      The third defines the controller index, indicated which controller
      is bound to the lane.

  clocks:
    minItems: 5
    maxItems: 14

  clock-names:
    minItems: 5
    maxItems: 14

  fsl,hsio-cfg:
    description: |
      Specifies the use case of the HSIO module in the hardware design.
      Regarding the design of i.MX8QM HSIO subsystem, HSIO module can be
      confiured as following three use cases.
      +---------------------------------------+
      |                  | i.MX8QM            |
      |------------------|--------------------|
      |                  | Lane0| Lane1| Lane2|
      |------------------|------|------|------|
      | pciea-x2-sata    | PCIEA| PCIEA| SATA |
      |------------------|------|------|------|
      | pciea-x2-pcieb   | PCIEA| PCIEA| PCIEB|
      |------------------|------|------|------|
      | pciea-pcieb-sata | PCIEA| PCIEB| SATA |
      +---------------------------------------+
    $ref: /schemas/types.yaml#/definitions/string
    enum: [ pciea-x2-sata, pciea-x2-pcieb, pciea-pcieb-sata]
    default: pciea-pcieb-sata

  fsl,refclk-pad-mode:
    description:
      Specifies the mode of the refclk pad used. INPUT(PHY refclock is
      provided externally via the refclk pad) or OUTPUT(PHY refclock is
      derived from SoC internal source and provided on the refclk pad).
      This property not exists means unused(PHY refclock is derived from
      SoC internal source).
    $ref: /schemas/types.yaml#/definitions/string
    enum: [ input, output, unused ]
    default: unused

  power-domains:
    minItems: 1
    maxItems: 2

required:
  - compatible
  - reg
  - reg-names
  - "#phy-cells"
  - clocks
  - clock-names
  - fsl,hsio-cfg

allOf:
  - if:
      properties:
        compatible:
          contains:
            enum:
              - fsl,imx8qxp-hsio
    then:
      properties:
        clock-names:
          items:
            - const: pclk0
            - const: apb_pclk0
            - const: phy0_crr
            - const: ctl0_crr
            - const: misc_crr
        power-domains:
          maxItems: 1

  - if:
      properties:
        compatible:
          contains:
            enum:
              - fsl,imx8qm-hsio
    then:
      properties:
        clock-names:
          items:
            - const: pclk0
            - const: pclk1
            - const: apb_pclk0
            - const: apb_pclk1
            - const: pclk2
            - const: epcs_tx
            - const: epcs_rx
            - const: apb_pclk2
            - const: phy0_crr
            - const: phy1_crr
            - const: ctl0_crr
            - const: ctl1_crr
            - const: ctl2_crr
            - const: misc_crr
        power-domains:
          minItems: 2

additionalProperties: false

examples:
  - |
    #include <dt-bindings/clock/imx8-clock.h>
    #include <dt-bindings/clock/imx8-lpcg.h>
    #include <dt-bindings/firmware/imx/rsrc.h>
    #include <dt-bindings/phy/phy-imx8-pcie.h>

    phy@5f1a0000 {
        compatible = "fsl,imx8qxp-hsio";
        reg = <0x5f1a0000 0x10000>,
              <0x5f120000 0x10000>,
              <0x5f140000 0x10000>,
              <0x5f160000 0x10000>;
        reg-names = "reg", "phy", "ctrl", "misc";
        clocks = <&phyx1_lpcg IMX_LPCG_CLK_0>,
                 <&phyx1_lpcg IMX_LPCG_CLK_4>,
                 <&phyx1_crr1_lpcg IMX_LPCG_CLK_4>,
                 <&pcieb_crr3_lpcg IMX_LPCG_CLK_4>,
                 <&misc_crr5_lpcg IMX_LPCG_CLK_4>;
        clock-names = "pclk0", "apb_pclk0", "phy0_crr", "ctl0_crr", "misc_crr";
        power-domains = <&pd IMX_SC_R_SERDES_1>;
        #phy-cells = <3>;
        fsl,hsio-cfg = "pciea-pcieb-sata";
        fsl,refclk-pad-mode = "input";
    };
...
```

## Documentation/devicetree/bindings/phy/fsl,imx8qm-lvds-phy.yaml
```yaml
# SPDX-License-Identifier: (GPL-2.0-only OR BSD-2-Clause)
%YAML 1.2
---
$id: http://devicetree.org/schemas/phy/fsl,imx8qm-lvds-phy.yaml#
$schema: http://devicetree.org/meta-schemas/core.yaml#

title: Mixel LVDS PHY for Freescale i.MX8qm SoC

maintainers:
  - Liu Ying <victor.liu@nxp.com>

description: |
  The Mixel LVDS PHY IP block is found on Freescale i.MX8qm SoC.
  It converts two groups of four 7/10 bits of CMOS data into two
  groups of four data lanes of LVDS data streams. A phase-locked
  transmit clock is transmitted in parallel with each group of
  data streams over a fifth LVDS link. Every cycle of the transmit
  clock, 56/80 bits of input data are sampled and transmitted
  through the two groups of LVDS data streams. Together with the
  transmit clocks, the two groups of LVDS data streams form two
  LVDS channels.

  The Mixel LVDS PHY found on Freescale i.MX8qm SoC is controlled
  by Control and Status Registers(CSR) module in the SoC. The CSR
  module, as a system controller, contains the PHY's registers.

properties:
  compatible:
    enum:
      - fsl,imx8qm-lvds-phy
      - mixel,28fdsoi-lvds-1250-8ch-tx-pll

  "#phy-cells":
    const: 1
    description: |
      Cell allows setting the LVDS channel index of the PHY.
      Index 0 is for LVDS channel0 and index 1 is for LVDS channel1.

  clocks:
    maxItems: 1

  power-domains:
    maxItems: 1

required:
  - compatible
  - "#phy-cells"
  - clocks
  - power-domains

additionalProperties: false

examples:
  - |
    #include <dt-bindings/firmware/imx/rsrc.h>
    phy {
        compatible = "fsl,imx8qm-lvds-phy";
        #phy-cells = <1>;
        clocks = <&clk IMX_SC_R_LVDS_0 IMX_SC_PM_CLK_PHY>;
        power-domains = <&pd IMX_SC_R_LVDS_0>;
    };
```
