## Documentation/devicetree/bindings/phy/fsl,lynx-10g.yaml
```yaml
# SPDX-License-Identifier: (GPL-2.0-only OR BSD-2-Clause)
%YAML 1.2
---
$id: http://devicetree.org/schemas/phy/fsl,lynx-10g.yaml#
$schema: http://devicetree.org/meta-schemas/core.yaml#

title: Freescale Lynx 10G SerDes PHY

maintainers:
  - Vladimir Oltean <vladimir.oltean@nxp.com>

description:
  The 10G Lynx is a multi-protocol SerDes block which handles networking, PCIe,
  SATA and other high-speed interfaces. It is present on most QorIQ and
  Layerscape SoCs. The register map is common, but the integration is
  SoC-specific, with the differences consisting in register endianness, the
  number of lanes, protocol converters available per lane and their location in
  the PCCR registers. Some SoCs have multiple SerDes blocks and those differ in
  their protocol capabilities per lane.

properties:
  compatible:
    enum:
      - fsl,ls1028a-serdes
      - fsl,ls1046a-serdes1
      - fsl,ls1046a-serdes2
      - fsl,ls1088a-serdes1
      - fsl,ls1088a-serdes2
      - fsl,ls2088a-serdes1
      - fsl,ls2088a-serdes2

  reg:
    maxItems: 1

  big-endian: true

  "#phy-cells":
    const: 1

  "#address-cells":
    const: 1

  "#size-cells":
    const: 0

patternProperties:
  "^phy@[0-7]$":
    type: object
    description: SerDes lane (single RX/TX differential pair)

    properties:
      reg:
        minimum: 0
        maximum: 7
        description: Lane index as seen in register map

      "#phy-cells":
        const: 0

    required:
      - reg
      - "#phy-cells"

    additionalProperties: false

required:
  - compatible
  - reg
  - "#phy-cells"
  - "#address-cells"
  - "#size-cells"

allOf:
  - if:
      properties:
        compatible:
          contains:
            enum:
              - fsl,ls1028a-serdes
              - fsl,ls1046a-serdes1
              - fsl,ls1046a-serdes2
              - fsl,ls1088a-serdes1
              - fsl,ls1088a-serdes2
    then:
      patternProperties:
        "^phy@[0-7]$":
          properties:
            reg:
              minimum: 0
              maximum: 3
  - if:
      properties:
        compatible:
          enum:
            - fsl,ls1046a-serdes1
            - fsl,ls1046a-serdes2
    then:
      required:
        - big-endian
    else:
      properties:
        big-endian: false

additionalProperties: false

examples:
  - |
    soc {
      #address-cells = <2>;
      #size-cells = <2>;

      serdes@1ea0000 {
        compatible = "fsl,ls1028a-serdes";
        reg = <0x0 0x1ea0000 0x0 0xffff>;
        #address-cells = <1>;
        #size-cells = <0>;
        #phy-cells = <1>;

        phy@0 {
          reg = <0>;
          #phy-cells = <0>;
        };

        phy@1 {
          reg = <1>;
          #phy-cells = <0>;
        };

        phy@2 {
          reg = <2>;
          #phy-cells = <0>;
        };

        phy@3 {
          reg = <3>;
          #phy-cells = <0>;
        };
      };
    };
```

## Documentation/devicetree/bindings/phy/fsl,lynx-28g.yaml
```yaml
# SPDX-License-Identifier: (GPL-2.0-only OR BSD-2-Clause)
%YAML 1.2
---
$id: http://devicetree.org/schemas/phy/fsl,lynx-28g.yaml#
$schema: http://devicetree.org/meta-schemas/core.yaml#

title: Freescale Lynx 28G SerDes PHY

maintainers:
  - Ioana Ciornei <ioana.ciornei@nxp.com>

description:
  The Lynx 28G is a multi-lane, multi-protocol SerDes (PCIe, SATA, Ethernet)
  present in multiple instances on NXP LX2160A and LX2162A SoCs. All instances
  share a common register map and programming model, however they differ in
  supported protocols per lane in a way that is not detectable by said
  programming model without prior knowledge. The distinction is made through
  the compatible string.

properties:
  compatible:
    oneOf:
      - const: fsl,lynx-28g
        deprecated: true
        description:
          Legacy compatibility string for Lynx 28G SerDes. Any assumption
          regarding whether a certain lane supports a certain protocol may
          be incorrect. Deprecated except when used as a fallback. Use
          device-specific strings instead.
      - items:
          - const: fsl,lx2160a-serdes1
          - const: fsl,lynx-28g
      - items:
          - const: fsl,lx2160a-serdes2
          - const: fsl,lynx-28g
      - items:
          - const: fsl,lx2162a-serdes1
          - const: fsl,lynx-28g
      - items:
          - const: fsl,lx2162a-serdes2
          - const: fsl,lynx-28g
      - const: fsl,lx2160a-serdes3

  reg:
    maxItems: 1

  "#phy-cells":
    const: 1

  "#address-cells":
    const: 1

  "#size-cells":
    const: 0

patternProperties:
  "^phy@[0-7]$":
    type: object
    description: SerDes lane (single RX/TX differential pair)

    properties:
      reg:
        minimum: 0
        maximum: 7
        description: Lane index as seen in register map

      "#phy-cells":
        const: 0

    required:
      - reg
      - "#phy-cells"

    additionalProperties: false

required:
  - compatible
  - reg
  - "#phy-cells"

allOf:
  # LX2162A SerDes 1 has fewer lanes than the others
  - if:
      properties:
        compatible:
          contains:
            const: fsl,lx2162a-serdes1
    then:
      patternProperties:
        "^phy@[0-7]$":
          properties:
            reg:
              minimum: 4
              maximum: 7

additionalProperties: false

examples:
  - |
    soc {
      #address-cells = <2>;
      #size-cells = <2>;

      serdes@1ea0000 {
        compatible = "fsl,lx2160a-serdes1", "fsl,lynx-28g";
        reg = <0x0 0x1ea0000 0x0 0x1e30>;
        #address-cells = <1>;
        #size-cells = <0>;
        #phy-cells = <1>;

        phy@0 {
          reg = <0>;
          #phy-cells = <0>;
        };

        phy@1 {
          reg = <1>;
          #phy-cells = <0>;
        };

        phy@2 {
          reg = <2>;
          #phy-cells = <0>;
        };

        phy@3 {
          reg = <3>;
          #phy-cells = <0>;
        };

        phy@4 {
          reg = <4>;
          #phy-cells = <0>;
        };

        phy@5 {
          reg = <5>;
          #phy-cells = <0>;
        };

        phy@6 {
          reg = <6>;
          #phy-cells = <0>;
        };

        phy@7 {
          reg = <7>;
          #phy-cells = <0>;
        };
      };
    };
```

## Documentation/devicetree/bindings/phy/fsl,mxs-usbphy.yaml
```yaml
# SPDX-License-Identifier: (GPL-2.0-only OR BSD-2-Clause)
%YAML 1.2
---
$id: http://devicetree.org/schemas/phy/fsl,mxs-usbphy.yaml#
$schema: http://devicetree.org/meta-schemas/core.yaml#

title: Freescale MXS USB Phy Device

maintainers:
  - Xu Yang <xu.yang_2@nxp.com>

properties:
  compatible:
    oneOf:
      - enum:
          - fsl,imx23-usbphy
          - fsl,imx7ulp-usbphy
          - fsl,vf610-usbphy
      - items:
          - enum:
              - fsl,imx28-usbphy
              - fsl,imx6ul-usbphy
              - fsl,imx6sl-usbphy
              - fsl,imx6sx-usbphy
              - fsl,imx6q-usbphy
          - const: fsl,imx23-usbphy
      - items:
          - const: fsl,imx6sll-usbphy
          - const: fsl,imx6ul-usbphy
          - const: fsl,imx23-usbphy
      - items:
          - enum:
              - fsl,imx8dxl-usbphy
              - fsl,imx8qm-usbphy
              - fsl,imx8ulp-usbphy
          - const: fsl,imx7ulp-usbphy

  reg:
    maxItems: 1

  interrupts:
    maxItems: 1

  clocks:
    maxItems: 1

  '#phy-cells':
    const: 0

  power-domains:
    maxItems: 1

  fsl,anatop:
    description:
      phandle for anatop register, it is only for imx6 SoC series.
    $ref: /schemas/types.yaml#/definitions/phandle

  phy-3p0-supply:
    description:
      One of USB PHY's power supply. Can be used to keep a good signal
      quality.

  fsl,tx-cal-45-dn-ohms:
    description:
      Resistance (in ohms) of switchable high-speed trimming resistor
      connected in parallel with the 45 ohm resistor that terminates
      the DN output signal.
    minimum: 35
    maximum: 54
    default: 45

  fsl,tx-cal-45-dp-ohms:
    description:
      Resistance (in ohms) of switchable high-speed trimming resistor
      connected in parallel with the 45 ohm resistor that terminates
      the DP output signal.
    minimum: 35
    maximum: 54
    default: 45

  fsl,tx-d-cal:
    description:
      Current trimming value (as a percentage) of the 17.78 mA TX
      reference current.
    $ref: /schemas/types.yaml#/definitions/uint32
    minimum: 79
    maximum: 119
    default: 100

  nxp,sim:
    description:
      The system integration module (SIM) provides system control and chip
      configuration registers.
    $ref: /schemas/types.yaml#/definitions/phandle

required:
  - compatible
  - reg
  - clocks

allOf:
  - if:
      properties:
        compatible:
          oneOf:
            - enum:
                - fsl,imx6q-usbphy
                - fsl,imx6sl-usbphy
                - fsl,imx6sx-usbphy
                - fsl,imx6sll-usbphy
                - fsl,vf610-usbphy
            - items:
                - const: fsl,imx6ul-usbphy
                - const: fsl,imx23-usbphy
    then:
      required:
        - fsl,anatop

  - if:
      properties:
        compatible:
          const: fsl,imx7ulp-usbphy
    then:
      required:
        - nxp,sim
    else:
      properties:
        nxp,sim: false

additionalProperties: false

examples:
  - |
    #include <dt-bindings/interrupt-controller/arm-gic.h>
    #include <dt-bindings/clock/imx6qdl-clock.h>

    usbphy1: usb-phy@20c9000 {
        compatible = "fsl,imx6q-usbphy", "fsl,imx23-usbphy";
        reg = <0x020c9000 0x1000>;
        clocks = <&clks IMX6QDL_CLK_USBPHY1>;
        interrupts = <GIC_SPI 44 IRQ_TYPE_LEVEL_HIGH>;
        fsl,anatop = <&anatop>;
    };

...
```

## Documentation/devicetree/bindings/phy/google,lga-usb-phy.yaml
```yaml
# SPDX-License-Identifier: (GPL-2.0-only OR BSD-2-Clause)
# Copyright (C) 2025, Google LLC
%YAML 1.2
---
$id: http://devicetree.org/schemas/phy/google,lga-usb-phy.yaml#
$schema: http://devicetree.org/meta-schemas/core.yaml#

title: Google Tensor Series G5 (Laguna) USB PHY

maintainers:
  - Roy Luo <royluo@google.com>

description:
  Describes the USB PHY interfaces integrated with the DWC3 USB controller on
  Google Tensor SoCs, starting with the G5 generation (laguna).
  Two specific PHY IPs from Synopsys are integrated, including eUSB 2.0 PHY IP
  and USB3.2/DisplayPort combo PHY IP.

properties:
  compatible:
    const: google,lga-usb-phy

  reg:
    items:
      - description: USB3.2/DisplayPort combo PHY core registers.
      - description: USB3.2/DisplayPort combo PHY Type-C Assist registers.
      - description: eUSB 2.0 PHY core registers.
      - description: Top-level wrapper registers for the integrated PHYs.

  reg-names:
    items:
      - const: usb3_core
      - const: usb3_tca
      - const: usb2_core
      - const: usbdp_top

  "#phy-cells":
    description: |
      The phandle's argument in the PHY specifier selects one of the three
      following PHY interfaces.
      - 0 for USB high-speed.
      - 1 for USB super-speed.
      - 2 for DisplayPort.
    const: 1

  clocks:
    items:
      - description: USB2 PHY clock.
      - description: USB2 PHY APB clock.
      - description: USB3.2/DisplayPort combo PHY clock.
      - description: USB3.2/DisplayPort combo PHY firmware clock.

  clock-names:
    items:
      - const: usb2
      - const: usb2_apb
      - const: usb3
      - const: usb3_fw

  resets:
    items:
      - description: USB2 PHY reset.
      - description: USB2 PHY APB reset.
      - description: USB3.2/DisplayPort combo PHY reset.

  reset-names:
    items:
      - const: usb2
      - const: usb2_apb
      - const: usb3

  power-domains:
    maxItems: 1

  orientation-switch:
    type: boolean
    description:
      Indicates the PHY as a handler of USB Type-C orientation changes

  google,usb-cfg-csr:
    description:
      A phandle to a syscon node used to access the USB configuration
      registers. These registers are the top-level wrapper of the USB
      subsystem and provide control and status for the integrated USB
      controller and USB PHY.
    $ref: /schemas/types.yaml#/definitions/phandle-array
    items:
      - items:
          - description: phandle to the syscon node.
          - description: USB2 PHY configuration register offset.

required:
  - compatible
  - reg
  - reg-names
  - "#phy-cells"
  - clocks
  - clock-names
  - resets
  - reset-names
  - power-domains
  - orientation-switch
  - google,usb-cfg-csr

additionalProperties: false

examples:
  - |
    soc {
        #address-cells = <2>;
        #size-cells = <2>;

        usb-phy@c410000 {
            compatible = "google,lga-usb-phy";
            reg = <0 0x0c410000 0 0x20000>,
                  <0 0x0c430000 0 0x1000>,
                  <0 0x0c440000 0 0x10000>,
                  <0 0x0c637000 0 0xa0>;
            reg-names = "usb3_core", "usb3_tca", "usb2_core", "usbdp_top";
            #phy-cells = <1>;
            clocks = <&hsion_usb2_phy_clk>, <&hsion_u2phy_apb_clk>,
                     <&hsion_usb3_phy_clk>, <&hsion_usb3_phy_fw_clk>;
            clock-names = "usb2", "usb2_apb", "usb3", "usb3_fw";
            resets = <&hsion_resets_usb2_phy>,
                     <&hsion_resets_u2phy_apb>,
                     <&hsion_resets_usb3_phy>;
            reset-names = "usb2", "usb2_apb", "usb3";
            power-domains = <&hsio_n_usb_pd>;
            orientation-switch;
            google,usb-cfg-csr = <&usb_cfg_csr 0x14>;
        };
    };
...
```

## Documentation/devicetree/bindings/phy/hisilicon,hi3660-usb3.yaml
```yaml
# SPDX-License-Identifier: GPL-2.0
%YAML 1.2
---
$id: http://devicetree.org/schemas/phy/hisilicon,hi3660-usb3.yaml#
$schema: http://devicetree.org/meta-schemas/core.yaml#

title: Hisilicon Kirin 960 USB PHY

maintainers:
  - Mauro Carvalho Chehab <mchehab+huawei@kernel.org>
description: |+
  Bindings for USB3 PHY on HiSilicon Kirin 960.

properties:
  compatible:
    const: hisilicon,hi3660-usb-phy

  "#phy-cells":
    const: 0

  hisilicon,pericrg-syscon:
    $ref: /schemas/types.yaml#/definitions/phandle
    description: phandle of syscon used to control iso refclk.

  hisilicon,pctrl-syscon:
    $ref: /schemas/types.yaml#/definitions/phandle
    description: phandle of syscon used to control usb tcxo.

  hisilicon,eye-diagram-param:
    $ref: /schemas/types.yaml#/definitions/uint32-array
    maxItems: 1
    description: Eye diagram for phy.

required:
  - compatible
  - hisilicon,pericrg-syscon
  - hisilicon,pctrl-syscon
  - hisilicon,eye-diagram-param
  - "#phy-cells"

additionalProperties: false

examples:
  - |
    usb-phy {
        compatible = "hisilicon,hi3660-usb-phy";
        #phy-cells = <0>;
        hisilicon,pericrg-syscon = <&crg_ctrl>;
        hisilicon,pctrl-syscon = <&pctrl>;
        hisilicon,eye-diagram-param = <0x22466e4>;
    };
```
