## Documentation/devicetree/bindings/phy/hisilicon,hi3798cv200-combphy.yaml
```yaml
# SPDX-License-Identifier: GPL-2.0
%YAML 1.2
---
$id: http://devicetree.org/schemas/phy/hisilicon,hi3798cv200-combphy.yaml#
$schema: http://devicetree.org/meta-schemas/core.yaml#

title: HiSilicon STB PCIE/SATA/USB3 PHY

maintainers:
  - Shawn Guo <shawn.guo@linaro.org>

properties:
  compatible:
    const: hisilicon,hi3798cv200-combphy

  reg:
    maxItems: 1

  '#phy-cells':
    description: The cell contains the PHY mode
    const: 1

  clocks:
    maxItems: 1

  resets:
    maxItems: 1

  hisilicon,fixed-mode:
    description: If the phy device doesn't support mode select but a fixed mode
      setting, the property should be present to specify the particular mode.
    $ref: /schemas/types.yaml#/definitions/uint32
    enum: [ 1, 2, 4]  # SATA, PCIE, USB3

  hisilicon,mode-select-bits:
    description: If the phy device support mode select, this property should be
      present to specify the register bits in peripheral controller.
    items:
      - description: register_offset
      - description: bit shift
      - description: bit mask

required:
  - compatible
  - reg
  - '#phy-cells'
  - clocks
  - resets

oneOf:
  - required: ['hisilicon,fixed-mode']
  - required: ['hisilicon,mode-select-bits']

additionalProperties: false

...
```

## Documentation/devicetree/bindings/phy/hisilicon,hi6220-usb-phy.yaml
```yaml
# SPDX-License-Identifier: (GPL-2.0-only OR BSD-2-Clause)
%YAML 1.2
---
$id: http://devicetree.org/schemas/phy/hisilicon,hi6220-usb-phy.yaml#
$schema: http://devicetree.org/meta-schemas/core.yaml#

title: Hisilicon hi6220 USB PHY

maintainers:
  - Zhangfei Gao <zhangfei.gao@linaro.org>

properties:
  compatible:
    const: hisilicon,hi6220-usb-phy

  '#phy-cells':
    const: 0

  phy-supply:
    description: PHY power supply.

  hisilicon,peripheral-syscon:
    description: Phandle to the system controller for PHY control.
    $ref: /schemas/types.yaml#/definitions/phandle

additionalProperties: false

examples:
  - |
    usbphy {
        compatible = "hisilicon,hi6220-usb-phy";
        #phy-cells = <0>;
        phy-supply = <&fixed_5v_hub>;
        hisilicon,peripheral-syscon = <&sys_ctrl>;
    };
```

## Documentation/devicetree/bindings/phy/hisilicon,hix5hd2-sata-phy.yaml
```yaml
# SPDX-License-Identifier: (GPL-2.0-only OR BSD-2-Clause)
%YAML 1.2
---
$id: http://devicetree.org/schemas/phy/hisilicon,hix5hd2-sata-phy.yaml#
$schema: http://devicetree.org/meta-schemas/core.yaml#

title: HiSilicon hix5hd2 SATA PHY

maintainers:
  - Jiancheng Xue <xuejiancheng@huawei.com>

properties:
  compatible:
    const: hisilicon,hix5hd2-sata-phy

  reg:
    maxItems: 1

  '#phy-cells':
    const: 0

  hisilicon,peripheral-syscon:
    description: Phandle of syscon used to control peripheral
    $ref: /schemas/types.yaml#/definitions/phandle

  hisilicon,power-reg:
    description: Offset and bit number within peripheral-syscon register controlling SATA power supply
    $ref: /schemas/types.yaml#/definitions/uint32-array
    items:
      - description: Offset within peripheral-syscon register
      - description: Bit number controlling SATA power supply

required:
  - compatible
  - reg
  - '#phy-cells'

additionalProperties: false

examples:
  - |
    phy@f9900000 {
        compatible = "hisilicon,hix5hd2-sata-phy";
        reg = <0xf9900000 0x10000>;
        #phy-cells = <0>;
        hisilicon,peripheral-syscon = <&peripheral_ctrl>;
        hisilicon,power-reg = <0x8 10>;
    };
```

## Documentation/devicetree/bindings/phy/hisilicon,inno-usb2-phy.yaml
```yaml
# SPDX-License-Identifier: (GPL-2.0-only OR BSD-2-Clause)
%YAML 1.2
---
$id: http://devicetree.org/schemas/phy/hisilicon,inno-usb2-phy.yaml#
$schema: http://devicetree.org/meta-schemas/core.yaml#

title: HiSilicon INNO USB2 PHY

maintainers:
  - Pengcheng Li <lpc.li@hisilicon.com>

description:
  The INNO USB2 PHY device should be a child node of peripheral controller that
  contains the PHY configuration register, and each device supports up to 2 PHY
  ports which are represented as child nodes of INNO USB2 PHY device.

properties:
  compatible:
    enum:
      - hisilicon,hi3798cv200-usb2-phy
      - hisilicon,hi3798mv100-usb2-phy
      - hisilicon,inno-usb2-phy

  reg:
    maxItems: 1

  clocks:
    maxItems: 1

  resets:
    maxItems: 1

  "#address-cells":
    const: 1

  "#size-cells":
    const: 0

patternProperties:
  "^phy@[0-1]$":
    description: PHY port subnode
    type: object
    additionalProperties: false

    properties:
      reg:
        maximum: 1

      "#phy-cells":
        const: 0

      resets:
        maxItems: 1

    required:
      - reg
      - "#phy-cells"
      - resets

required:
  - compatible
  - reg
  - clocks
  - resets
  - "#address-cells"
  - "#size-cells"

additionalProperties: false

examples:
  - |
    #include <dt-bindings/clock/histb-clock.h>

    usb2-phy@120 {
        compatible = "hisilicon,hi3798cv200-usb2-phy";
        reg = <0x120 0x4>;
        clocks = <&crg HISTB_USB2_PHY1_REF_CLK>;
        resets = <&crg 0xbc 4>;
        #address-cells = <1>;
        #size-cells = <0>;

        phy@0 {
            reg = <0>;
            #phy-cells = <0>;
            resets = <&crg 0xbc 8>;
        };

        phy@1 {
            reg = <1>;
            #phy-cells = <0>;
            resets = <&crg 0xbc 9>;
        };
    };
```

## Documentation/devicetree/bindings/phy/hisilicon,phy-hi3670-pcie.yaml
```yaml
# SPDX-License-Identifier: GPL-2.0-only OR BSD-2-Clause
%YAML 1.2
---
$id: http://devicetree.org/schemas/phy/hisilicon,phy-hi3670-pcie.yaml#
$schema: http://devicetree.org/meta-schemas/core.yaml#

title: HiSilicon Kirin970 PCIe PHY

maintainers:
  - Mauro Carvalho Chehab <mchehab+huawei@kernel.org>

description: |+
  Bindings for PCIe PHY on HiSilicon Kirin 970.

properties:
  compatible:
    const: hisilicon,hi970-pcie-phy

  "#phy-cells":
    const: 0

  reg:
    maxItems: 1
    description: PHY Control registers

  phy-supply:
    description: The PCIe PHY power supply

  clocks:
    items:
      - description: PCIe PHY clock
      - description: PCIe AUX clock
      - description: PCIe APB PHY clock
      - description: PCIe APB SYS clock
      - description: PCIe ACLK clock

  clock-names:
    items:
      - const: phy_ref
      - const: aux
      - const: apb_phy
      - const: apb_sys
      - const: aclk

  hisilicon,eye-diagram-param:
    $ref: /schemas/types.yaml#/definitions/uint32-array
    description: Eye diagram for phy.

required:
  - "#phy-cells"
  - compatible
  - reg
  - clocks
  - clock-names
  - hisilicon,eye-diagram-param
  - phy-supply

additionalProperties: false

examples:
  - |
    #include <dt-bindings/clock/hi3670-clock.h>

    soc {
      #address-cells = <2>;
      #size-cells = <2>;
      pcie_phy: pcie-phy@fc000000 {
        compatible = "hisilicon,hi970-pcie-phy";
        reg = <0x0 0xfc000000 0x0 0x80000>;
        #phy-cells = <0>;
        phy-supply = <&ldo33>;
        clocks = <&crg_ctrl HI3670_CLK_GATE_PCIEPHY_REF>,
                 <&crg_ctrl HI3670_CLK_GATE_PCIEAUX>,
                 <&crg_ctrl HI3670_PCLK_GATE_PCIE_PHY>,
                 <&crg_ctrl HI3670_PCLK_GATE_PCIE_SYS>,
                 <&crg_ctrl HI3670_ACLK_GATE_PCIE>;
        clock-names = "phy_ref", "aux",
                      "apb_phy", "apb_sys", "aclk";
        hisilicon,eye-diagram-param = <0xffffffff 0xffffffff
                                       0xffffffff 0xffffffff 0xffffffff>;
      };
    };
```

## Documentation/devicetree/bindings/phy/hix5hd2-phy.txt
```
Hisilicon hix5hd2 SATA PHY
-----------------------

Required properties:
- compatible: should be "hisilicon,hix5hd2-sata-phy"
- reg: offset and length of the PHY registers
- #phy-cells: must be 0
Refer to phy/phy-bindings.txt for the generic PHY binding properties

Optional Properties:
- hisilicon,peripheral-syscon: phandle of syscon used to control peripheral.
- hisilicon,power-reg: offset and bit number within peripheral-syscon,
	register of controlling sata power supply.

Example:
	sata_phy: phy@f9900000 {
		compatible = "hisilicon,hix5hd2-sata-phy";
		reg = <0xf9900000 0x10000>;
		#phy-cells = <0>;
		hisilicon,peripheral-syscon = <&peripheral_ctrl>;
		hisilicon,power-reg = <0x8 10>;
	};
```

## Documentation/devicetree/bindings/phy/img,pistachio-usb-phy.yaml
```yaml
# SPDX-License-Identifier: (GPL-2.0-only OR BSD-2-Clause)
%YAML 1.2
---
$id: http://devicetree.org/schemas/phy/img,pistachio-usb-phy.yaml#
$schema: http://devicetree.org/meta-schemas/core.yaml#

title: Imagination Pistachio USB PHY

maintainers:
  - Andrew Bresticker <abrestic@chromium.org>

properties:
  compatible:
    const: img,pistachio-usb-phy

  clocks:
    maxItems: 1

  clock-names:
    items:
      - const: usb_phy

  '#phy-cells':
    const: 0

  phy-supply:
    description: USB VBUS supply. Must supply 5.0V.

  img,refclk:
    description:
      Reference clock source for the USB PHY. See
      <dt-bindings/phy/phy-pistachio-usb.h> for valid values.
    $ref: /schemas/types.yaml#/definitions/uint32

  img,cr-top:
    description: CR_TOP syscon phandle.
    $ref: /schemas/types.yaml#/definitions/phandle

required:
  - compatible
  - clocks
  - clock-names
  - '#phy-cells'
  - img,refclk
  - img,cr-top

additionalProperties: false

examples:
  - |
    #include <dt-bindings/phy/phy-pistachio-usb.h>
    #include <dt-bindings/clock/pistachio-clk.h>

    usb-phy {
        compatible = "img,pistachio-usb-phy";
        clocks = <&clk_core CLK_USB_PHY>;
        clock-names = "usb_phy";
        #phy-cells = <0>;
        phy-supply = <&usb_vbus>;
        img,refclk = <REFCLK_CLK_CORE>;
        img,cr-top = <&cr_top>;
    };
```

## Documentation/devicetree/bindings/phy/ingenic,phy-usb.yaml
```yaml
# SPDX-License-Identifier: (GPL-2.0-only OR BSD-2-Clause)
%YAML 1.2
---
$id: http://devicetree.org/schemas/phy/ingenic,phy-usb.yaml#
$schema: http://devicetree.org/meta-schemas/core.yaml#

title: Ingenic SoCs USB PHY devicetree bindings

maintainers:
  - Paul Cercueil <paul@crapouillou.net>
  - 周琰杰 (Zhou Yanjie) <zhouyanjie@wanyeetech.com>

properties:
  $nodename:
    pattern: '^usb-phy@.*'

  compatible:
    enum:
      - ingenic,jz4770-phy
      - ingenic,jz4775-phy
      - ingenic,jz4780-phy
      - ingenic,x1000-phy
      - ingenic,x1830-phy
      - ingenic,x2000-phy

  reg:
    maxItems: 1

  clocks:
    maxItems: 1

  vcc-supply:
    description: VCC power supply

  '#phy-cells':
    const: 0

required:
  - compatible
  - reg
  - clocks
  - vcc-supply
  - '#phy-cells'

additionalProperties: false

examples:
  - |
    #include <dt-bindings/clock/ingenic,jz4770-cgu.h>
    otg_phy: usb-phy@3c {
      compatible = "ingenic,jz4770-phy";
      reg = <0x3c 0x10>;

      vcc-supply = <&vcc>;
      clocks = <&cgu JZ4770_CLK_OTG_PHY>;

      #phy-cells = <0>;
    };
```

## Documentation/devicetree/bindings/phy/intel,combo-phy.yaml
```yaml
# SPDX-License-Identifier: (GPL-2.0 OR BSD-2-Clause)
%YAML 1.2
---
$id: http://devicetree.org/schemas/phy/intel,combo-phy.yaml#
$schema: http://devicetree.org/meta-schemas/core.yaml#

title: Intel ComboPhy Subsystem

maintainers:
  - Dilip Kota <eswara.kota@linux.intel.com>

description: |
  Intel Combophy subsystem supports PHYs for PCIe, EMAC and SATA
  controllers. A single Combophy provides two PHY instances.

properties:
  $nodename:
    pattern: "combophy(@.*|-[0-9a-f])*$"

  compatible:
    items:
      - const: intel,combophy-lgm
      - const: intel,combo-phy

  clocks:
    maxItems: 1

  reg:
    items:
      - description: ComboPhy core registers
      - description: PCIe app core control registers

  reg-names:
    items:
      - const: core
      - const: app

  resets:
    maxItems: 4

  reset-names:
    items:
      - const: phy
      - const: core
      - const: iphy0
      - const: iphy1

  intel,syscfg:
    $ref: /schemas/types.yaml#/definitions/phandle-array
    items:
      - items:
          - description: phandle to Chip configuration registers
          - description: ComboPhy instance id
    description: Chip configuration registers handle and ComboPhy instance id

  intel,hsio:
    $ref: /schemas/types.yaml#/definitions/phandle-array
    items:
      - items:
          - description: phandle to HSIO registers
          - description: ComboPhy instance id
    description: HSIO registers handle and ComboPhy instance id on NOC

  intel,aggregation:
    type: boolean
    description: |
      Specify the flag to configure ComboPHY in dual lane mode.

  intel,phy-mode:
    $ref: /schemas/types.yaml#/definitions/uint32
    description: |
      Mode of the two phys in ComboPhy.
      See dt-bindings/phy/phy.h for values.

  "#phy-cells":
    const: 1

required:
  - compatible
  - clocks
  - reg
  - reg-names
  - intel,syscfg
  - intel,hsio
  - intel,phy-mode
  - "#phy-cells"

additionalProperties: false

examples:
  - |
    #include <dt-bindings/phy/phy.h>
    combophy@d0a00000 {
        compatible = "intel,combophy-lgm", "intel,combo-phy";
        clocks = <&cgu0 1>;
        #phy-cells = <1>;
        reg = <0xd0a00000 0x40000>,
              <0xd0a40000 0x1000>;
        reg-names = "core", "app";
        resets = <&rcu0 0x50 6>,
                 <&rcu0 0x50 17>,
                 <&rcu0 0x50 23>,
                 <&rcu0 0x50 24>;
        reset-names = "phy", "core", "iphy0", "iphy1";
        intel,syscfg = <&sysconf 0>;
        intel,hsio = <&hsiol 0>;
        intel,phy-mode = <PHY_TYPE_PCIE>;
        intel,aggregation;
    };
```

## Documentation/devicetree/bindings/phy/intel,lgm-emmc-phy.yaml
```yaml
# SPDX-License-Identifier: (GPL-2.0-only OR BSD-2-Clause)
%YAML 1.2
---
$id: http://devicetree.org/schemas/phy/intel,lgm-emmc-phy.yaml#
$schema: http://devicetree.org/meta-schemas/core.yaml#

title: Intel Lightning Mountain(LGM) eMMC PHY

maintainers:
  - Ramuthevar Vadivel Murugan <vadivel.muruganx.ramuthevar@linux.intel.com>

description: |+
  Bindings for eMMC PHY on Intel's Lightning Mountain SoC, syscon
  node is used to reference the base address of eMMC phy registers.

  The eMMC PHY node should be the child of a syscon node with the
  required property:

  - compatible:         Should be one of the following:
                        "intel,lgm-syscon", "syscon"
  - reg:
      maxItems: 1

properties:
  compatible:
    enum:
      - intel,lgm-emmc-phy
      - intel,keembay-emmc-phy

  "#phy-cells":
    const: 0

  reg:
    maxItems: 1

  clocks:
    maxItems: 1

  clock-names:
    items:
      - const: emmcclk

required:
  - "#phy-cells"
  - compatible
  - reg
  - clocks

additionalProperties: false

examples:
  - |
    sysconf: chiptop@e0200000 {
      compatible = "intel,lgm-syscon", "syscon";
      reg = <0xe0200000 0x100>;
      #address-cells = <1>;
      #size-cells = <1>;

      emmc_phy: emmc-phy@a8 {
        compatible = "intel,lgm-emmc-phy";
        reg = <0x00a8 0x10>;
        clocks = <&emmc>;
        #phy-cells = <0>;
      };
    };

  - |
    phy@20290000 {
          compatible = "intel,keembay-emmc-phy";
          reg = <0x20290000 0x54>;
          clocks = <&emmc>;
          clock-names = "emmcclk";
          #phy-cells = <0>;
    };
...
```
