## Documentation/devicetree/bindings/phy/motorola,mapphone-mdm6600.yaml
```yaml
# SPDX-License-Identifier: (GPL-2.0-only OR BSD-2-Clause)
%YAML 1.2
---
$id: http://devicetree.org/schemas/phy/motorola,mapphone-mdm6600.yaml#
$schema: http://devicetree.org/meta-schemas/core.yaml#

title: Motorola Mapphone MDM6600 USB PHY

maintainers:
  - Tony Lindgren <tony@atomide.com>

properties:
  compatible:
    items:
      - const: motorola,mapphone-mdm6600

  enable-gpios:
    description: GPIO to enable the USB PHY
    maxItems: 1

  power-gpios:
    description: GPIO to power on the device
    maxItems: 1

  reset-gpios:
    description: GPIO to reset the device
    maxItems: 1

  motorola,mode-gpios:
    description: Two GPIOs to configure MDM6600 USB start-up mode for normal mode versus USB flashing mode
    items:
      - description: normal mode select GPIO
      - description: USB flashing mode select GPIO

  motorola,cmd-gpios:
    description: Three GPIOs to control the power state of the MDM6600
    items:
      - description: power state control GPIO 0
      - description: power state control GPIO 1
      - description: power state control GPIO 2

  motorola,status-gpios:
    description: Three GPIOs to read the power state of the MDM6600
    items:
      - description: power state read GPIO 0
      - description: power state read GPIO 1
      - description: power state read GPIO 2

  '#phy-cells':
    const: 0

required:
  - compatible
  - enable-gpios
  - power-gpios
  - reset-gpios
  - motorola,mode-gpios
  - motorola,cmd-gpios
  - motorola,status-gpios

additionalProperties: false

examples:
  - |
    #include <dt-bindings/gpio/gpio.h>

    usb-phy {
        compatible = "motorola,mapphone-mdm6600";
        enable-gpios = <&gpio3 31 GPIO_ACTIVE_LOW>;
        power-gpios = <&gpio2 22 GPIO_ACTIVE_HIGH>;
        reset-gpios = <&gpio2 17 GPIO_ACTIVE_HIGH>;
        motorola,mode-gpios = <&gpio5 20 GPIO_ACTIVE_HIGH>,
                              <&gpio5 21 GPIO_ACTIVE_HIGH>;
        motorola,cmd-gpios = <&gpio4 7 GPIO_ACTIVE_HIGH>,
                              <&gpio4 8 GPIO_ACTIVE_HIGH>,
                              <&gpio5 14 GPIO_ACTIVE_HIGH>;
        motorola,status-gpios = <&gpio2 20 GPIO_ACTIVE_HIGH>,
                                <&gpio2 21 GPIO_ACTIVE_HIGH>,
                                <&gpio2 23 GPIO_ACTIVE_HIGH>;
        #phy-cells = <0>;
    };
```

## Documentation/devicetree/bindings/phy/mscc,vsc7514-serdes.yaml
```yaml
# SPDX-License-Identifier: (GPL-2.0-only OR BSD-2-Clause)
%YAML 1.2
---
$id: http://devicetree.org/schemas/phy/mscc,vsc7514-serdes.yaml#
$schema: http://devicetree.org/meta-schemas/core.yaml#

title: Microsemi Ocelot SerDes muxing

maintainers:
  - Alexandre Belloni <alexandre.belloni@bootlin.com>
  - UNGLinuxDriver@microchip.com

description: |
  On Microsemi Ocelot, there is a handful of registers in HSIO address
  space for setting up the SerDes to switch port muxing.

  A SerDes X can be "muxed" to work with switch port Y or Z for example.
  One specific SerDes can also be used as a PCIe interface.

  Hence, a SerDes represents an interface, be it an Ethernet or a PCIe one.

  There are two kinds of SerDes: SERDES1G supports 10/100Mbps in
  half/full-duplex and 1000Mbps in full-duplex mode while SERDES6G supports
  10/100Mbps in half/full-duplex and 1000/2500Mbps in full-duplex mode.

  Also, SERDES6G number (aka "macro") 0 is the only interface supporting
  QSGMII.

  This is a child of the HSIO syscon ("mscc,ocelot-hsio", see
  Documentation/devicetree/bindings/mips/mscc.txt) on the Microsemi Ocelot.

properties:
  compatible:
    enum:
      - mscc,vsc7514-serdes

  "#phy-cells":
    const: 2
    description: |
      The first number defines the input port to use for a given SerDes macro.
      The second defines the macro to use. They are defined in
      dt-bindings/phy/phy-ocelot-serdes.h

required:
  - compatible
  - "#phy-cells"

additionalProperties:
  false

examples:
  - |
    serdes: serdes {
      compatible = "mscc,vsc7514-serdes";
      #phy-cells = <2>;
    };
```

## Documentation/devicetree/bindings/phy/mxs-usb-phy.txt
```
* Freescale MXS USB Phy Device

Required properties:
- compatible: should contain:
	* "fsl,imx23-usbphy" for imx23 and imx28
	* "fsl,imx6q-usbphy" for imx6dq and imx6dl
	* "fsl,imx6sl-usbphy" for imx6sl
	* "fsl,vf610-usbphy" for Vybrid vf610
	* "fsl,imx6sx-usbphy" for imx6sx
	* "fsl,imx7ulp-usbphy" for imx7ulp
	* "fsl,imx8dxl-usbphy" for imx8dxl
  "fsl,imx23-usbphy" is still a fallback for other strings
- reg: Should contain registers location and length
- interrupts: Should contain phy interrupt
- fsl,anatop: phandle for anatop register, it is only for imx6 SoC series

Optional properties:
- fsl,tx-cal-45-dn-ohms: Integer [35-54]. Resistance (in ohms) of switchable
  high-speed trimming resistor connected in parallel with the 45 ohm resistor
  that terminates the DN output signal. Default: 45
- fsl,tx-cal-45-dp-ohms: Integer [35-54]. Resistance (in ohms) of switchable
  high-speed trimming resistor connected in parallel with the 45 ohm resistor
  that terminates the DP output signal. Default: 45
- fsl,tx-d-cal: Integer [79-119]. Current trimming value (as a percentage) of
  the 17.78mA TX reference current. Default: 100

Example:
usbphy1: usb-phy@20c9000 {
	compatible = "fsl,imx6q-usbphy", "fsl,imx23-usbphy";
	reg = <0x020c9000 0x1000>;
	interrupts = <0 44 0x04>;
	fsl,anatop = <&anatop>;
};
```

## Documentation/devicetree/bindings/phy/nuvoton,ma35d1-usb2-phy.yaml
```yaml
# SPDX-License-Identifier: (GPL-2.0-only OR BSD-2-Clause)
%YAML 1.2
---
$id: http://devicetree.org/schemas/phy/nuvoton,ma35d1-usb2-phy.yaml#
$schema: http://devicetree.org/meta-schemas/core.yaml#

title: Nuvoton MA35D1 USB2 phy

maintainers:
  - Hui-Ping Chen <hpchen0nvt@gmail.com>

properties:
  compatible:
    enum:
      - nuvoton,ma35d1-usb2-phy

  "#phy-cells":
    const: 0

  clocks:
    maxItems: 1

  nuvoton,sys:
    $ref: /schemas/types.yaml#/definitions/phandle
    description:
      phandle to syscon for checking the PHY clock status.

required:
  - compatible
  - "#phy-cells"
  - clocks
  - nuvoton,sys

additionalProperties: false

examples:
  - |
    #include <dt-bindings/clock/nuvoton,ma35d1-clk.h>

    usb_phy: usb-phy {
        compatible = "nuvoton,ma35d1-usb2-phy";
        clocks = <&clk USBD_GATE>;
        nuvoton,sys = <&sys>;
        #phy-cells = <0>;
    };
```
