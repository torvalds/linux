## Documentation/devicetree/bindings/phy/nxp,ptn3222.yaml
```yaml
# SPDX-License-Identifier: GPL-2.0-only OR BSD-2-Clause
%YAML 1.2
---
$id: http://devicetree.org/schemas/phy/nxp,ptn3222.yaml#
$schema: http://devicetree.org/meta-schemas/core.yaml#

title: NXP PTN3222 1-port eUSB2 to USB2 redriver

maintainers:
  - Dmitry Baryshkov <dmitry.baryshkov@linaro.org>

properties:
  compatible:
    enum:
      - nxp,ptn3222

  reg:
    maxItems: 1

  "#phy-cells":
    const: 0

  vdd1v8-supply:
    description: power supply (1.8V)

  vdd3v3-supply:
    description: power supply (3.3V)

  reset-gpios: true

required:
  - compatible
  - reg
  - '#phy-cells'

additionalProperties: false

examples:
  - |
    #include <dt-bindings/gpio/gpio.h>

    i2c {
        #address-cells = <1>;
        #size-cells = <0>;

        redriver@4f {
            compatible = "nxp,ptn3222";
            reg = <0x4f>;
            #phy-cells = <0>;
            vdd3v3-supply = <&vreg_3p3>;
            vdd1v8-supply = <&vreg_1p8>;
            reset-gpios = <&gpio_reset GPIO_ACTIVE_LOW>;
        };
    };
...
```

## Documentation/devicetree/bindings/phy/nxp,tja1145.yaml
```yaml
# SPDX-License-Identifier: GPL-2.0-only OR BSD-2-Clause
%YAML 1.2
---
$id: http://devicetree.org/schemas/phy/nxp,tja1145.yaml#
$schema: http://devicetree.org/meta-schemas/core.yaml#

title: TJA1145 CAN transceiver

maintainers:
  - Dimitri Fedrau <dimitri.fedrau@liebherr.com>

allOf:
  - $ref: /schemas/spi/spi-peripheral-props.yaml#

properties:
  compatible:
    const: nxp,tja1145

  interrupts:
    maxItems: 1

  reg:
    maxItems: 1

  "#phy-cells":
    const: 0

  spi-cpha: true

  spi-max-frequency:
    maximum: 4000000

  spi-cs-setup-delay-ns:
    minimum: 50
    default: 50

  spi-cs-hold-delay-ns:
    minimum: 50
    default: 50

  spi-cs-inactive-delay-ns:
    minimum: 250
    default: 250

  vcc-supply:
    description:
      CAN transceiver supply voltage

  vio-supply:
    description:
      Supply voltage for I/O level adaptor

  vbat-supply:
    description:
      Battery supply voltage

required:
  - compatible
  - reg
  - "#phy-cells"
  - spi-cpha

additionalProperties: false

examples:
  - |
    #include <dt-bindings/interrupt-controller/irq.h>
    spi {
        #address-cells = <1>;
        #size-cells = <0>;
        can-phy@0 {
            compatible = "nxp,tja1145";
            interrupt-parent = <&gpio0>;
            interrupts = <31 IRQ_TYPE_LEVEL_LOW>;
            reg = <0>;
            #phy-cells = <0>;
            spi-cpha;
            spi-max-frequency = <4000000>;
            spi-cs-setup-delay-ns = <50>;
            spi-cs-hold-delay-ns = <50>;
            spi-cs-inactive-delay-ns = <250>;
            vcc-supply = <&reg_5v0>;
            vio-supply = <&reg_3v3>;
            vbat-supply = <&reg_24v0>;
        };
    };
```

## Documentation/devicetree/bindings/phy/phy-armada38x-comphy.txt
```
mvebu armada 38x comphy driver
------------------------------

This comphy controller can be found on Marvell Armada 38x. It provides a
number of shared PHYs used by various interfaces (network, sata, usb,
PCIe...).

Required properties:

- compatible: should be "marvell,armada-380-comphy"
- reg: should contain the comphy register location and length.
- #address-cells: should be 1.
- #size-cells: should be 0.

Optional properties:

- reg-names: must be "comphy" as the first name, and "conf".
- reg: must contain the comphy register location and length as the first
    pair, followed by an optional configuration register address and
    length pair.

A sub-node is required for each comphy lane provided by the comphy.

Required properties (child nodes):

- reg: comphy lane number.
- #phy-cells : from the generic phy bindings, must be 1. Defines the
               input port to use for a given comphy lane.

Example:

	comphy: phy@18300 {
		compatible = "marvell,armada-380-comphy";
		reg-names = "comphy", "conf";
		reg = <0x18300 0x100>, <0x18460 4>;
		#address-cells = <1>;
		#size-cells = <0>;

		cpm_comphy0: phy@0 {
			reg = <0>;
			#phy-cells = <1>;
		};

		cpm_comphy1: phy@1 {
			reg = <1>;
			#phy-cells = <1>;
		};
	};
```

## Documentation/devicetree/bindings/phy/phy-ath79-usb.txt
```
* Atheros AR71XX/9XXX USB PHY

Required properties:
- compatible: "qca,ar7100-usb-phy"
- #phys-cells: should be 0
- reset-names: "phy"[, "suspend-override"]
- resets: references to the reset controllers

Example:

	usb-phy {
		compatible = "qca,ar7100-usb-phy";

		reset-names = "phy", "suspend-override";
		resets = <&rst 4>, <&rst 3>;

		#phy-cells = <0>;
	};
```

## Documentation/devicetree/bindings/phy/phy-bindings.txt
```
This document explains only the device tree data binding. For general
information about PHY subsystem refer to Documentation/phy.txt

PHY device node
===============

Required Properties:
#phy-cells:	Number of cells in a PHY specifier;  The meaning of all those
		cells is defined by the binding for the phy node. The PHY
		provider can use the values in cells to find the appropriate
		PHY.

For example:

phys: phy {
    compatible = "xxx";
    reg = <...>;
    .
    .
    #phy-cells = <1>;
    .
    .
};

That node describes an IP block (PHY provider) that implements 2 different PHYs.
In order to differentiate between these 2 PHYs, an additonal specifier should be
given while trying to get a reference to it.

PHY user node
=============

Required Properties:
phys : the phandle for the PHY device (used by the PHY subsystem)
phy-names : the names of the PHY corresponding to the PHYs present in the
	    *phys* phandle

Example 1:
usb1: usb_otg_ss@xxx {
    compatible = "xxx";
    reg = <xxx>;
    .
    .
    phys = <&usb2_phy>, <&usb3_phy>;
    phy-names = "usb2phy", "usb3phy";
    .
    .
};

This node represents a controller that uses two PHYs, one for usb2 and one for
usb3.

Example 2:
usb2: usb_otg_ss@xxx {
    compatible = "xxx";
    reg = <xxx>;
    .
    .
    phys = <&phys 1>;
    phy-names = "usbphy";
    .
    .
};

This node represents a controller that uses one of the PHYs of the PHY provider
device defined previously. Note that the phy handle has an additional specifier
"1" to differentiate between the two PHYs.
```

## Documentation/devicetree/bindings/phy/phy-cadence-dp.txt
```
Cadence MHDP DisplayPort SD0801 PHY binding
===========================================

This binding describes the Cadence SD0801 PHY hardware included with
the Cadence MHDP DisplayPort controller.

-------------------------------------------------------------------------------
Required properties (controller (parent) node):
- compatible	: Should be "cdns,dp-phy"
- reg		: Defines the following sets of registers in the parent
		  mhdp device:
			- Offset of the DPTX PHY configuration registers
			- Offset of the SD0801 PHY configuration registers
- #phy-cells	: from the generic PHY bindings, must be 0.

Optional properties:
- num_lanes	: Number of DisplayPort lanes to use (1, 2 or 4)
- max_bit_rate	: Maximum DisplayPort link bit rate to use, in Mbps (2160,
		  2430, 2700, 3240, 4320, 5400 or 8100)
-------------------------------------------------------------------------------

Example:
	dp_phy: phy@f0fb030a00 {
		compatible = "cdns,dp-phy";
		reg = <0xf0 0xfb030a00 0x0 0x00000040>,
		      <0xf0 0xfb500000 0x0 0x00100000>;
		num_lanes = <4>;
		max_bit_rate = <8100>;
		#phy-cells = <0>;
	};
```
