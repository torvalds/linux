## Documentation/devicetree/bindings/phy/meson-g12a-usb3-pcie-phy.txt
```
* Amlogic G12A USB3 + PCIE Combo PHY binding

Required properties:
- compatible:	Should be "amlogic,meson-g12a-usb3-pcie-phy"
- #phys-cells:	must be 1. The cell number is used to select the phy mode
  as defined in <dt-bindings/phy/phy.h> between PHY_TYPE_USB3 and PHY_TYPE_PCIE
- reg:		The base address and length of the registers
- clocks:	a phandle to the 100MHz reference clock of this PHY
- clock-names:	must be "ref_clk"
- resets:	phandle to the reset lines for the PHY control
- reset-names:	must be "phy"

Example:
	usb3_pcie_phy: phy@46000 {
		compatible = "amlogic,g12a-usb3-pcie-phy";
		reg = <0x0 0x46000 0x0 0x2000>;
		clocks = <&clkc CLKID_PCIE_PLL>;
		clock-names = "ref_clk";
		resets = <&reset RESET_PCIE_PHY>;
		reset-names = "phy";
		#phy-cells = <1>;
	};
```

## Documentation/devicetree/bindings/phy/meson-gxl-usb2-phy.txt
```
* Amlogic Meson GXL and GXM USB2 PHY binding

Required properties:
- compatible:	Should be "amlogic,meson-gxl-usb2-phy"
- reg:		The base address and length of the registers
- #phys-cells:	must be 0 (see phy-bindings.txt in this directory)

Optional properties:
- phy-supply:	see phy-bindings.txt in this directory


Example:
	usb2_phy0: phy@78000 {
		compatible = "amlogic,meson-gxl-usb2-phy";
		#phy-cells = <0>;
		reg = <0x0 0x78000 0x0 0x20>;
	};
```

## Documentation/devicetree/bindings/phy/meson-gxl-usb3-phy.txt
```
* Amlogic Meson GXL and GXM USB3 PHY and OTG detection binding

Required properties:
- compatible:	Should be "amlogic,meson-gxl-usb3-phy"
- #phys-cells:	must be 0 (see phy-bindings.txt in this directory)
- reg:		The base address and length of the registers
- interrupts:	the interrupt specifier for the OTG detection
- clocks:	phandles to the clocks for
		- the USB3 PHY
		- and peripheral mode/OTG detection
- clock-names:	must contain "phy" and "peripheral"
- resets:	phandle to the reset lines for:
		- the USB3 PHY and
		- peripheral mode/OTG detection
- reset-names:	must contain "phy" and "peripheral"

Optional properties:
- phy-supply:	see phy-bindings.txt in this directory


Example:
	usb3_phy0: phy@78080 {
		compatible = "amlogic,meson-gxl-usb3-phy";
		#phy-cells = <0>;
		reg = <0x0 0x78080 0x0 0x20>;
		interrupts = <GIC_SPI 16 IRQ_TYPE_LEVEL_HIGH>;
		clocks = <&clkc CLKID_USB_OTG>, <&clkc_AO CLKID_AO_CEC_32K>;
		clock-names = "phy", "peripheral";
		resets = <&reset RESET_USB_OTG>, <&reset RESET_USB_OTG>;
		reset-names = "phy", "peripheral";
	};
```

## Documentation/devicetree/bindings/phy/meson-usb2-phy.txt
```
* Amlogic USB2 PHY

Required properties:
- compatible:	Depending on the platform this should be one of:
	"amlogic,meson8b-usb2-phy"
	"amlogic,meson-gxbb-usb2-phy"
- reg:		The base address and length of the registers
- #phys-cells:	should be 0 (see phy-bindings.txt in this directory)
- clocks:	phandle and clock identifier for the phy clocks
- clock-names:	"usb_general" and "usb"

Optional properties:
- resets:	reference to the reset controller
- phy-supply:	see phy-bindings.txt in this directory


Example:

usb0_phy: usb_phy@0 {
	compatible = "amlogic,meson-gxbb-usb2-phy";
	#phy-cells = <0>;
	reg = <0x0 0x0 0x0 0x20>;
	resets = <&reset RESET_USB_OTG>;
	clocks = <&clkc CLKID_USB>, <&clkc CLKID_USB0>;
	clock-names = "usb_general", "usb";
	phy-supply = <&usb_vbus>;
};
```

## Documentation/devicetree/bindings/phy/microchip,lan966x-serdes.yaml
```yaml
# SPDX-License-Identifier: GPL-2.0-only OR BSD-2-Clause
%YAML 1.2
---
$id: http://devicetree.org/schemas/phy/microchip,lan966x-serdes.yaml#
$schema: http://devicetree.org/meta-schemas/core.yaml#

title: Microchip Lan966x Serdes controller

maintainers:
  - Horatiu Vultur <horatiu.vultur@microchip.com>

description: |
  Lan966x has 7 interfaces, consisting of 2 copper transceivers(CU),
  3 SERDES6G and 2 RGMII interfaces. Two of the SERDES6G support QSGMII.
  Also it has 8 logical Ethernet ports which can be connected to these
  interfaces. The Serdes controller will allow to configure these interfaces
  and allows to "mux" the interfaces to different ports.

  For simple selection of the interface that is used with a port, the
  following macros are defined CU(X), SERDES6G(X), RGMII(X). Where X is a
  number that represents the index of that interface type. For example
  CU(1) means use interface copper transceivers 1. SERDES6G(2) means use
  interface SerDes 2.

properties:
  $nodename:
    pattern: "^serdes@[0-9a-f]+$"

  compatible:
    const: microchip,lan966x-serdes

  reg:
    items:
      - description: HSIO registers
      - description: HW_STAT register

  '#phy-cells':
    const: 2
    description: |
      - Input port to use for a given macro.
      - The macro to be used. The macros are defined in
        dt-bindings/phy/phy-lan966x-serdes.

required:
  - compatible
  - reg
  - '#phy-cells'

additionalProperties: false

examples:
  - |
    serdes: serdes@e2004010 {
      compatible = "microchip,lan966x-serdes";
      reg = <0xe202c000 0x9c>, <0xe2004010 0x4>;
      #phy-cells = <2>;
    };

...
```

## Documentation/devicetree/bindings/phy/microchip,sparx5-serdes.yaml
```yaml
# SPDX-License-Identifier: GPL-2.0-only OR BSD-2-Clause
%YAML 1.2
---
$id: http://devicetree.org/schemas/phy/microchip,sparx5-serdes.yaml#
$schema: http://devicetree.org/meta-schemas/core.yaml#

title: Microchip Sparx5 Serdes controller

maintainers:
  - Steen Hegelund <steen.hegelund@microchip.com>
  - Daniel Machon <daniel.machon@microchip.com>

description: |
  The Sparx5 SERDES interfaces share the same basic functionality, but
  support different operating modes and line rates.

  The following list lists the SERDES features:

  * RX Adaptive Decision Feedback Equalizer (DFE)
  * Programmable continuous time linear equalizer (CTLE)
  * Rx variable gain control
  * Rx built-in fault detector (loss-of-lock/loss-of-signal)
  * Adjustable tx de-emphasis (FFE)
  * Tx output amplitude control
  * Supports rx eye monitor
  * Multiple loopback modes
  * Prbs generator and checker
  * Polarity inversion control

  SERDES6G:

  The SERDES6G is a high-speed SERDES interface, which can operate at
  the following data rates:

  * 100 Mbps (100BASE-FX)
  * 1.25 Gbps (SGMII/1000BASE-X/1000BASE-KX)
  * 3.125 Gbps (2.5GBASE-X/2.5GBASE-KX)
  * 5.15625 Gbps (5GBASE-KR/5G-USXGMII)

  SERDES10G

  The SERDES10G is a high-speed SERDES interface, which can operate at
  the following data rates:

  * 100 Mbps (100BASE-FX)
  * 1.25 Gbps (SGMII/1000BASE-X/1000BASE-KX)
  * 3.125 Gbps (2.5GBASE-X/2.5GBASE-KX)
  * 5 Gbps (QSGMII/USGMII)
  * 5.15625 Gbps (5GBASE-KR/5G-USXGMII)
  * 10 Gbps (10G-USGMII)
  * 10.3125 Gbps (10GBASE-R/10GBASE-KR/USXGMII)

  SERDES25G

  The SERDES25G is a high-speed SERDES interface, which can operate at
  the following data rates:

  * 1.25 Gbps (SGMII/1000BASE-X/1000BASE-KX)
  * 3.125 Gbps (2.5GBASE-X/2.5GBASE-KX)
  * 5 Gbps (QSGMII/USGMII)
  * 5.15625 Gbps (5GBASE-KR/5G-USXGMII)
  * 10 Gbps (10G-USGMII)
  * 10.3125 Gbps (10GBASE-R/10GBASE-KR/USXGMII)
  * 25.78125 Gbps (25GBASE-KR/25GBASE-CR/25GBASE-SR/25GBASE-LR/25GBASE-ER)

  lan969x has ten SERDES10G interfaces that share the same features, operating
  modes and data rates as the equivalent Sparx5 SERDES10G interfaces.

properties:
  $nodename:
    pattern: "^serdes@[0-9a-f]+$"

  compatible:
    oneOf:
      - enum:
          - microchip,sparx5-serdes
          - microchip,lan9691-serdes
      - items:
          - enum:
              - microchip,lan9698-serdes
              - microchip,lan9696-serdes
              - microchip,lan9694-serdes
              - microchip,lan9693-serdes
              - microchip,lan9692-serdes
          - const: microchip,lan9691-serdes

  reg:
    minItems: 1

  '#phy-cells':
    const: 1
    description: |
      - The main serdes input port

  clocks:
    maxItems: 1

required:
  - compatible
  - reg
  - '#phy-cells'
  - clocks

additionalProperties: false

examples:
  - |
    serdes: serdes@10808000 {
      compatible = "microchip,sparx5-serdes";
      #phy-cells = <1>;
      clocks = <&sys_clk>;
      reg = <0x10808000 0x5d0000>;
    };

...
```

## Documentation/devicetree/bindings/phy/mixel,mipi-dsi-phy.txt
```
Mixel DSI PHY for i.MX8

The Mixel MIPI-DSI PHY IP block is e.g. found on i.MX8 platforms (along the
MIPI-DSI IP from Northwest Logic). It represents the physical layer for the
electrical signals for DSI.

Required properties:
- compatible: Must be:
  - "fsl,imx8mq-mipi-dphy"
- clocks: Must contain an entry for each entry in clock-names.
- clock-names: Must contain the following entries:
  - "phy_ref": phandle and specifier referring to the DPHY ref clock
- reg: the register range of the PHY controller
- #phy-cells: number of cells in PHY, as defined in
  Documentation/devicetree/bindings/phy/phy-bindings.txt
  this must be <0>

Optional properties:
- power-domains: phandle to power domain

Example:
	dphy: dphy@30a0030 {
		compatible = "fsl,imx8mq-mipi-dphy";
		clocks = <&clk IMX8MQ_CLK_DSI_PHY_REF>;
		clock-names = "phy_ref";
		reg = <0x30a00300 0x100>;
		power-domains = <&pd_mipi0>;
		#phy-cells = <0>;
        };
```

## Documentation/devicetree/bindings/phy/mixel,mipi-dsi-phy.yaml
```yaml
# SPDX-License-Identifier: (GPL-2.0-only OR BSD-2-Clause)
%YAML 1.2
---
$id: http://devicetree.org/schemas/phy/mixel,mipi-dsi-phy.yaml#
$schema: http://devicetree.org/meta-schemas/core.yaml#

title: Mixel DSI PHY for i.MX8

maintainers:
  - Guido Günther <agx@sigxcpu.org>

description: |
  The Mixel MIPI-DSI PHY IP block is e.g. found on i.MX8 platforms (along the
  MIPI-DSI IP from Northwest Logic). It represents the physical layer for the
  electrical signals for DSI.

  The Mixel PHY IP block found on i.MX8qxp is a combo PHY that can work
  in either MIPI-DSI PHY mode or LVDS PHY mode.

properties:
  compatible:
    enum:
      - fsl,imx8mq-mipi-dphy
      - fsl,imx8qxp-mipi-dphy

  reg:
    maxItems: 1

  clocks:
    maxItems: 1

  clock-names:
    const: phy_ref

  "#phy-cells":
    const: 0

  fsl,syscon:
    $ref: /schemas/types.yaml#/definitions/phandle
    description: |
      A phandle which points to Control and Status Registers(CSR) module.

  power-domains:
    maxItems: 1

required:
  - compatible
  - reg
  - clocks
  - clock-names
  - "#phy-cells"
  - power-domains

allOf:
  - if:
      properties:
        compatible:
          contains:
            const: fsl,imx8mq-mipi-dphy
    then:
      properties:
        fsl,syscon: false

      required:
        - assigned-clocks
        - assigned-clock-parents
        - assigned-clock-rates

  - if:
      properties:
        compatible:
          contains:
            const: fsl,imx8qxp-mipi-dphy
    then:
      required:
        - fsl,syscon

additionalProperties: false

examples:
  - |
    #include <dt-bindings/clock/imx8mq-clock.h>
    dphy: dphy@30a0030 {
        compatible = "fsl,imx8mq-mipi-dphy";
        reg = <0x30a00300 0x100>;
        clocks = <&clk IMX8MQ_CLK_DSI_PHY_REF>;
        clock-names = "phy_ref";
        assigned-clocks = <&clk IMX8MQ_CLK_DSI_PHY_REF>;
        assigned-clock-parents = <&clk IMX8MQ_VIDEO_PLL1_OUT>;
        assigned-clock-rates = <24000000>;
        #phy-cells = <0>;
        power-domains = <&pgc_mipi>;
    };
```

## Documentation/devicetree/bindings/phy/motorola,cpcap-usb-phy.yaml
```yaml
# SPDX-License-Identifier: (GPL-2.0-only OR BSD-2-Clause)
%YAML 1.2
---
$id: http://devicetree.org/schemas/phy/motorola,cpcap-usb-phy.yaml#
$schema: http://devicetree.org/meta-schemas/core.yaml#

title: Motorola CPCAP PMIC USB PHY

maintainers:
  - Tony Lindgren <tony@atomide.com>

properties:
  compatible:
    enum:
      - motorola,cpcap-usb-phy
      - motorola,mapphone-cpcap-usb-phy

  '#phy-cells':
    const: 0

  interrupts:
    description: CPCAP PMIC interrupts used by the USB PHY
    items:
      - description: id_ground interrupt
      - description: id_float interrupt
      - description: se0conn interrupt
      - description: vbusvld interrupt
      - description: sessvld interrupt
      - description: sessend interrupt
      - description: se1 interrupt
      - description: dm interrupt
      - description: dp interrupt

  interrupt-names:
    description: Interrupt names
    items:
      - const: id_ground
      - const: id_float
      - const: se0conn
      - const: vbusvld
      - const: sessvld
      - const: sessend
      - const: se1
      - const: dm
      - const: dp

  io-channels:
    description: IIO ADC channels used by the USB PHY
    items:
      - description: vbus channel
      - description: id channel

  io-channel-names:
    items:
      - const: vbus
      - const: id

  vusb-supply: true

  pinctrl-names:
    items:
      - const: default
      - const: ulpi
      - const: utmi
      - const: uart

  mode-gpios:
    description: Optional GPIOs for configuring alternate modes
    items:
      - description: "mode selection GPIO #0"
      - description: "mode selection GPIO #1"

required:
  - compatible
  - '#phy-cells'
  - interrupts-extended
  - interrupt-names
  - io-channels
  - io-channel-names
  - vusb-supply

additionalProperties: false

examples:
  - |
    #include <dt-bindings/gpio/gpio.h>

    phy {
        compatible = "motorola,mapphone-cpcap-usb-phy";
        #phy-cells = <0>;
        interrupts-extended = <
            &cpcap 15 0 &cpcap 14 0 &cpcap 28 0 &cpcap 19 0
            &cpcap 18 0 &cpcap 17 0 &cpcap 16 0 &cpcap 49 0
            &cpcap 48 1
        >;
        interrupt-names = "id_ground", "id_float", "se0conn", "vbusvld",
                          "sessvld", "sessend", "se1", "dm", "dp";
        io-channels = <&cpcap_adc 2>, <&cpcap_adc 7>;
        io-channel-names = "vbus", "id";
        vusb-supply = <&vusb>;
        pinctrl-0 = <&usb_gpio_mux_sel1 &usb_gpio_mux_sel2>;
        pinctrl-1 = <&usb_ulpi_pins>;
        pinctrl-2 = <&usb_utmi_pins>;
        pinctrl-3 = <&uart3_pins>;
        pinctrl-names = "default", "ulpi", "utmi", "uart";
        mode-gpios = <&gpio2 28 GPIO_ACTIVE_HIGH>, <&gpio1 0 GPIO_ACTIVE_HIGH>;
    };
```
