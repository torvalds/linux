## Documentation/devicetree/bindings/phy/qcom,ipq8074-qmp-pcie-phy.yaml
```yaml
# SPDX-License-Identifier: (GPL-2.0 OR BSD-2-Clause)
%YAML 1.2
---
$id: http://devicetree.org/schemas/phy/qcom,ipq8074-qmp-pcie-phy.yaml#
$schema: http://devicetree.org/meta-schemas/core.yaml#

title: Qualcomm QMP PHY controller (PCIe, IPQ8074)

maintainers:
  - Vinod Koul <vkoul@kernel.org>

description:
  QMP PHY controller supports physical layer functionality for a number of
  controllers on Qualcomm chipsets, such as, PCIe, UFS, and USB.

properties:
  compatible:
    enum:
      - qcom,ipq6018-qmp-pcie-phy
      - qcom,ipq8074-qmp-gen3-pcie-phy
      - qcom,ipq8074-qmp-pcie-phy

  reg:
    items:
      - description: serdes

  clocks:
    maxItems: 3

  clock-names:
    items:
      - const: aux
      - const: cfg_ahb
      - const: pipe

  resets:
    maxItems: 2

  reset-names:
    items:
      - const: phy
      - const: common

  "#clock-cells":
    const: 0

  clock-output-names:
    maxItems: 1

  "#phy-cells":
    const: 0

required:
  - compatible
  - reg
  - clocks
  - clock-names
  - resets
  - reset-names
  - "#clock-cells"
  - clock-output-names
  - "#phy-cells"

additionalProperties: false

examples:
  - |
    #include <dt-bindings/clock/qcom,gcc-ipq6018.h>
    #include <dt-bindings/reset/qcom,gcc-ipq6018.h>

    phy@84000 {
        compatible = "qcom,ipq6018-qmp-pcie-phy";
        reg = <0x00084000 0x1000>;

        clocks = <&gcc GCC_PCIE0_AUX_CLK>,
                 <&gcc GCC_PCIE0_AHB_CLK>,
                 <&gcc GCC_PCIE0_PIPE_CLK>;
        clock-names = "aux",
                      "cfg_ahb",
                      "pipe";

        clock-output-names = "gcc_pcie0_pipe_clk_src";
        #clock-cells = <0>;

        #phy-cells = <0>;

        resets = <&gcc GCC_PCIE0_PHY_BCR>,
                 <&gcc GCC_PCIE0PHY_PHY_BCR>;
        reset-names = "phy",
                      "common";
    };
```

## Documentation/devicetree/bindings/phy/qcom,m31-eusb2-phy.yaml
```yaml
# SPDX-License-Identifier: (GPL-2.0 OR BSD-2-Clause)
%YAML 1.2
---
$id: http://devicetree.org/schemas/phy/qcom,m31-eusb2-phy.yaml#
$schema: http://devicetree.org/meta-schemas/core.yaml#

title: Qualcomm M31 eUSB2 phy

maintainers:
  - Wesley Cheng <quic_wcheng@quicinc.com>

description:
  M31 based eUSB2 controller, which supports LS/FS/HS usb connectivity
  on Qualcomm chipsets.  It is paired with a eUSB2 repeater.

properties:
  compatible:
    items:
      - enum:
          - qcom,sm8750-m31-eusb2-phy

  reg:
    maxItems: 1

  "#phy-cells":
    const: 0

  clocks:
    items:
      - description: reference clock

  clock-names:
    items:
      - const: ref

  resets:
    maxItems: 1

  phys:
    maxItems: 1
    description:
      Phandle to eUSB2 repeater

  vdd-supply:
    description:
      Phandle to 0.88V regulator supply to PHY digital circuit.

  vdda12-supply:
    description:
      Phandle to 1.2V regulator supply to PHY refclk pll block.

required:
  - compatible
  - reg
  - "#phy-cells"
  - clocks
  - clock-names
  - resets
  - vdd-supply
  - vdda12-supply

additionalProperties: false

examples:
  - |
    usb_1_hsphy: phy@88e3000 {
        compatible = "qcom,sm8750-m31-eusb2-phy";
        reg = <0x88e3000 0x29c>;

        clocks = <&tcsrcc_usb2_clkref_en>;
        clock-names = "ref";

        resets = <&gcc_qusb2phy_prim_bcr>;

        #phy-cells = <0>;

        vdd-supply = <&vreg_l2d_0p88>;
        vdda12-supply = <&vreg_l3g_1p2>;
    };
```

## Documentation/devicetree/bindings/phy/qcom,msm8996-qmp-pcie-phy.yaml
```yaml
# SPDX-License-Identifier: (GPL-2.0 OR BSD-2-Clause)
%YAML 1.2
---
$id: http://devicetree.org/schemas/phy/qcom,msm8996-qmp-pcie-phy.yaml#
$schema: http://devicetree.org/meta-schemas/core.yaml#

title: Qualcomm QMP PHY controller (MSM8996 PCIe)

maintainers:
  - Vinod Koul <vkoul@kernel.org>

description:
  QMP PHY controller supports physical layer functionality for a number of
  controllers on Qualcomm chipsets, such as, PCIe, UFS, and USB.

properties:
  compatible:
    const: qcom,msm8996-qmp-pcie-phy

  reg:
    items:
      - description: serdes

  "#address-cells":
    enum: [ 1, 2 ]

  "#size-cells":
    enum: [ 1, 2 ]

  ranges: true

  clocks:
    maxItems: 3

  clock-names:
    items:
      - const: aux
      - const: cfg_ahb
      - const: ref

  resets:
    maxItems: 3

  reset-names:
    items:
      - const: phy
      - const: common
      - const: cfg

  vdda-phy-supply: true

  vdda-pll-supply: true

  vddp-ref-clk-supply: true

patternProperties:
  "^phy@[0-9a-f]+$":
    type: object
    description: one child node per PHY provided by this block
    properties:
      reg:
        items:
          - description: TX
          - description: RX
          - description: PCS

      clocks:
        items:
          - description: PIPE clock

      clock-names:
        deprecated: true
        items:
          - enum:
              - pipe0
              - pipe1
              - pipe2

      resets:
        items:
          - description: PHY reset

      reset-names:
        deprecated: true
        items:
          - enum:
              - lane0
              - lane1
              - lane2

      "#clock-cells":
        const: 0

      clock-output-names:
        maxItems: 1

      "#phy-cells":
        const: 0

    required:
      - reg
      - clocks
      - resets
      - "#clock-cells"
      - clock-output-names
      - "#phy-cells"

    additionalProperties: false

required:
  - compatible
  - reg
  - "#address-cells"
  - "#size-cells"
  - ranges
  - clocks
  - clock-names
  - resets
  - reset-names
  - vdda-phy-supply
  - vdda-pll-supply

additionalProperties: false

examples:
  - |
    #include <dt-bindings/clock/qcom,gcc-msm8996.h>
    pcie_phy: phy-wrapper@34000 {
        compatible = "qcom,msm8996-qmp-pcie-phy";
        reg = <0x34000 0x488>;
        #address-cells = <1>;
        #size-cells = <1>;
        ranges = <0x0 0x34000 0x4000>;

        clocks = <&gcc GCC_PCIE_PHY_AUX_CLK>,
                 <&gcc GCC_PCIE_PHY_CFG_AHB_CLK>,
                 <&gcc GCC_PCIE_CLKREF_CLK>;
        clock-names = "aux", "cfg_ahb", "ref";

        resets = <&gcc GCC_PCIE_PHY_BCR>,
                 <&gcc GCC_PCIE_PHY_COM_BCR>,
                 <&gcc GCC_PCIE_PHY_COM_NOCSR_BCR>;
        reset-names = "phy", "common", "cfg";

        vdda-phy-supply = <&vreg_l28a_0p925>;
        vdda-pll-supply = <&vreg_l12a_1p8>;

        pciephy_0: phy@1000 {
            reg = <0x1000 0x130>,
                  <0x1200 0x200>,
                  <0x1400 0x1dc>;

            clocks = <&gcc GCC_PCIE_0_PIPE_CLK>;
            resets = <&gcc GCC_PCIE_0_PHY_BCR>;

            #clock-cells = <0>;
            clock-output-names = "pcie_0_pipe_clk_src";

            #phy-cells = <0>;
        };

        pciephy_1: phy@2000 {
            reg = <0x2000 0x130>,
                  <0x2200 0x200>,
                  <0x2400 0x1dc>;

            clocks = <&gcc GCC_PCIE_1_PIPE_CLK>;
            resets = <&gcc GCC_PCIE_1_PHY_BCR>;

            #clock-cells = <0>;
            clock-output-names = "pcie_1_pipe_clk_src";

            #phy-cells = <0>;
        };

        pciephy_2: phy@3000 {
            reg = <0x3000 0x130>,
                  <0x3200 0x200>,
                  <0x3400 0x1dc>;

            clocks = <&gcc GCC_PCIE_2_PIPE_CLK>;
            resets = <&gcc GCC_PCIE_2_PHY_BCR>;

            #clock-cells = <0>;
            clock-output-names = "pcie_2_pipe_clk_src";

            #phy-cells = <0>;
        };
    };
```

## Documentation/devicetree/bindings/phy/qcom,msm8996-qmp-ufs-phy.yaml
```yaml
# SPDX-License-Identifier: (GPL-2.0 OR BSD-2-Clause)
%YAML 1.2
---
$id: http://devicetree.org/schemas/phy/qcom,msm8996-qmp-ufs-phy.yaml#
$schema: http://devicetree.org/meta-schemas/core.yaml#

title: Qualcomm QMP PHY controller (UFS, MSM8996)

maintainers:
  - Vinod Koul <vkoul@kernel.org>

description:
  QMP PHY controller supports physical layer functionality for a number of
  controllers on Qualcomm chipsets, such as, PCIe, UFS, and USB.

  Note that these bindings are for SoCs up to SC8180X. For newer SoCs, see
  qcom,sc8280xp-qmp-ufs-phy.yaml.

properties:
  compatible:
    enum:
      - qcom,msm8996-qmp-ufs-phy
      - qcom,msm8998-qmp-ufs-phy
      - qcom,sc8180x-qmp-ufs-phy
      - qcom,sdm845-qmp-ufs-phy
      - qcom,sm6115-qmp-ufs-phy
      - qcom,sm6350-qmp-ufs-phy
      - qcom,sm8150-qmp-ufs-phy
      - qcom,sm8250-qmp-ufs-phy
      - qcom,sm8350-qmp-ufs-phy
      - qcom,sm8450-qmp-ufs-phy

  reg:
    items:
      - description: serdes

  "#address-cells":
    enum: [ 1, 2 ]

  "#size-cells":
    enum: [ 1, 2 ]

  ranges: true

  clocks:
    minItems: 1
    maxItems: 3

  clock-names:
    minItems: 1
    maxItems: 3

  power-domains:
    maxItems: 1

  resets:
    maxItems: 1

  reset-names:
    items:
      - const: ufsphy

  vdda-phy-supply: true

  vdda-pll-supply: true

  vddp-ref-clk-supply: true

patternProperties:
  "^phy@[0-9a-f]+$":
    type: object
    description: single PHY-provider child node
    properties:
      reg:
        minItems: 3
        maxItems: 6

      "#phy-cells":
        const: 0

    required:
      - reg
      - "#phy-cells"

    additionalProperties: false

required:
  - compatible
  - reg
  - "#address-cells"
  - "#size-cells"
  - ranges
  - clocks
  - clock-names
  - resets
  - reset-names
  - vdda-phy-supply
  - vdda-pll-supply

additionalProperties: false

allOf:
  - if:
      properties:
        compatible:
          contains:
            enum:
              - qcom,msm8996-qmp-ufs-phy
    then:
      properties:
        clocks:
          maxItems: 1
        clock-names:
          items:
            - const: ref

  - if:
      properties:
        compatible:
          contains:
            enum:
              - qcom,msm8998-qmp-ufs-phy
              - qcom,sc8180x-qmp-ufs-phy
              - qcom,sdm845-qmp-ufs-phy
              - qcom,sm6115-qmp-ufs-phy
              - qcom,sm6350-qmp-ufs-phy
              - qcom,sm8150-qmp-ufs-phy
              - qcom,sm8250-qmp-ufs-phy
    then:
      properties:
        clocks:
          maxItems: 2
        clock-names:
          items:
            - const: ref
            - const: ref_aux

  - if:
      properties:
        compatible:
          contains:
            enum:
              - qcom,sm8450-qmp-ufs-phy
    then:
      properties:
        clocks:
          maxItems: 3
        clock-names:
          items:
            - const: ref
            - const: ref_aux
            - const: qref

  - if:
      properties:
        compatible:
          contains:
            enum:
              - qcom,msm8998-qmp-ufs-phy
              - qcom,sdm845-qmp-ufs-phy
              - qcom,sm6350-qmp-ufs-phy
              - qcom,sm8150-qmp-ufs-phy
              - qcom,sm8250-qmp-ufs-phy
              - qcom,sm8350-qmp-ufs-phy
              - qcom,sm8450-qmp-ufs-phy
    then:
      patternProperties:
        "^phy@[0-9a-f]+$":
          properties:
            reg:
              items:
                - description: TX lane 1
                - description: RX lane 1
                - description: PCS
                - description: TX lane 2
                - description: RX lane 2

  - if:
      properties:
        compatible:
          contains:
            enum:
              - qcom,sc8180x-qmp-ufs-phy
    then:
      patternProperties:
        "^phy@[0-9a-f]+$":
          properties:
            reg:
              items:
                - description: TX
                - description: RX
                - description: PCS
                - description: PCS_MISC

  - if:
      properties:
        compatible:
          contains:
            enum:
              - qcom,msm8996-qmp-ufs-phy
              - qcom,sm6115-qmp-ufs-phy
    then:
      patternProperties:
        "^phy@[0-9a-f]+$":
          properties:
            reg:
              items:
                - description: TX
                - description: RX
                - description: PCS

examples:
  - |
    #include <dt-bindings/clock/qcom,gcc-sm8250.h>
    #include <dt-bindings/clock/qcom,rpmh.h>

    phy-wrapper@1d87000 {
        compatible = "qcom,sm8250-qmp-ufs-phy";
        reg = <0x01d87000 0x1c0>;
        #address-cells = <1>;
        #size-cells = <1>;
        ranges = <0x0 0x01d87000 0x1000>;

        clocks = <&rpmhcc RPMH_CXO_CLK>, <&gcc GCC_UFS_PHY_PHY_AUX_CLK>;
        clock-names = "ref", "ref_aux";

        resets = <&ufs_mem_hc 0>;
        reset-names = "ufsphy";

        vdda-phy-supply = <&vreg_l6b>;
        vdda-pll-supply = <&vreg_l3b>;

        phy@400 {
            reg = <0x400 0x108>,
                  <0x600 0x1e0>,
                  <0xc00 0x1dc>,
                  <0x800 0x108>,
                  <0xa00 0x1e0>;
            #phy-cells = <0>;
        };
    };
```

## Documentation/devicetree/bindings/phy/qcom,msm8998-qmp-pcie-phy.yaml
```yaml
# SPDX-License-Identifier: (GPL-2.0 OR BSD-2-Clause)
%YAML 1.2
---
$id: http://devicetree.org/schemas/phy/qcom,msm8998-qmp-pcie-phy.yaml#
$schema: http://devicetree.org/meta-schemas/core.yaml#

title: Qualcomm QMP PHY controller (PCIe, MSM8998)

maintainers:
  - Vinod Koul <vkoul@kernel.org>

description:
  The QMP PHY controller supports physical layer functionality for a number of
  controllers on Qualcomm chipsets, such as, PCIe, UFS, and USB.

properties:
  compatible:
    const: qcom,msm8998-qmp-pcie-phy

  reg:
    items:
      - description: serdes

  clocks:
    maxItems: 4

  clock-names:
    items:
      - const: aux
      - const: cfg_ahb
      - const: ref
      - const: pipe

  resets:
    maxItems: 2

  reset-names:
    items:
      - const: phy
      - const: common

  vdda-phy-supply: true

  vdda-pll-supply: true

  "#clock-cells":
    const: 0

  clock-output-names:
    maxItems: 1

  "#phy-cells":
    const: 0

required:
  - compatible
  - reg
  - clocks
  - clock-names
  - resets
  - reset-names
  - vdda-phy-supply
  - vdda-pll-supply
  - "#clock-cells"
  - clock-output-names
  - "#phy-cells"

additionalProperties: false

examples:
  - |
    #include <dt-bindings/clock/qcom,gcc-msm8998.h>

    phy@1c18000 {
        compatible = "qcom,msm8998-qmp-pcie-phy";
        reg = <0x01c06000 0x1000>;

        clocks = <&gcc GCC_PCIE_PHY_AUX_CLK>,
                 <&gcc GCC_PCIE_0_CFG_AHB_CLK>,
                 <&gcc GCC_PCIE_CLKREF_CLK>,
                 <&gcc GCC_PCIE_0_PIPE_CLK>;
        clock-names = "aux",
                      "cfg_ahb",
                      "ref",
                      "pipe";

        clock-output-names = "pcie_0_pipe_clk_src";
        #clock-cells = <0>;

        #phy-cells = <0>;

        resets = <&gcc GCC_PCIE_0_PHY_BCR>, <&gcc GCC_PCIE_PHY_BCR>;
        reset-names = "phy", "common";

        vdda-phy-supply = <&vreg_l1a_0p875>;
        vdda-pll-supply = <&vreg_l2a_1p2>;
    };
```
