## Documentation/devicetree/bindings/phy/qcom,glymur-qmp-gen5x8-pcie-phy.yaml
```yaml
# SPDX-License-Identifier: (GPL-2.0 OR BSD-2-Clause)
%YAML 1.2
---
$id: http://devicetree.org/schemas/phy/qcom,glymur-qmp-gen5x8-pcie-phy.yaml#
$schema: http://devicetree.org/meta-schemas/core.yaml#

title: Qualcomm QMP PCIe multiple link-mode PHY controller (PCIe, Glymur)

maintainers:
  - Qiang Yu <qiang.yu@oss.qualcomm.com>
  - Manivannan Sadhasivam <manivannan.sadhasivam@oss.qualcomm.com>

description: |
  The Glymur SoC uses a single PCIe Gen5 PHY hardware block for the
  PCIe3a/PCIe3b controllers. This block supports two link modes, selected
  at runtime via a TCSR syscon register:

  1. x8 - a single 8-lane PHY instance is exposed (PCIe3a only)
  2. x4+x4 - two independent 4-lane PHY instances are exposed (PCIe3a and
     PCIe3b)

  The node always describes both PHY instances ("port a" and "port b"),
  regardless of which link mode is active on the board.

properties:
  compatible:
    enum:
      - qcom,glymur-qmp-gen5x8-pcie-phy

  reg:
    maxItems: 2

  reg-names:
    items:
      - const: port_a
      - const: port_b

  clocks:
    maxItems: 10

  clock-names:
    items:
      - const: aux
      - const: cfg_ahb
      - const: ref
      - const: rchng
      - const: pipe
      - const: phy_b_aux
      - const: cfg_ahb_b
      - const: rchng_b
      - const: pipe_b
      - const: pipediv2_b

  power-domains:
    maxItems: 2

  power-domain-names:
    items:
      - const: port_a
      - const: port_b

  resets:
    maxItems: 4

  reset-names:
    items:
      - const: port_a
      - const: port_a_nocsr
      - const: port_b
      - const: port_b_nocsr

  vdda-phy-supply: true

  vdda-pll-supply: true

  vdda-refgen0p9-supply: true

  vdda-refgen1p2-supply: true

  qcom,link-mode:
    description:
      Reference to a register in the TCSR syscon that reports the link
      mode the PCIe PHY is currently configured for, either a single x8
      link or two independent x4 links. The link mode is programmed by
      firmware before Linux boots; this property is only used to read
      the active link mode, specified as a phandle to the syscon and
      the register offset.
    $ref: /schemas/types.yaml#/definitions/phandle-array
    items:
      - items:
          - description: phandle of TCSR syscon
          - description: offset of link mode register

  "#clock-cells":
    const: 1

  clock-output-names:
    items:
      - description: Name of the PHY A pipe clock output.
      - description: Name of the PHY B pipe clock output.

  "#phy-cells":
    const: 1
    description:
      The cell is the index of the sub-PHY within the active link
      mode, e.g. on Glymur, 0 for "port a" and 1 for "port b" in
      x4x4 mode, and only index 0 (the single wide PHY) is valid in
      x8 mode.

required:
  - compatible
  - reg
  - reg-names
  - clocks
  - clock-names
  - power-domains
  - power-domain-names
  - resets
  - reset-names
  - vdda-phy-supply
  - vdda-pll-supply
  - vdda-refgen0p9-supply
  - vdda-refgen1p2-supply
  - qcom,link-mode
  - "#clock-cells"
  - clock-output-names
  - "#phy-cells"

additionalProperties: false

examples:
  - |
    #include <dt-bindings/clock/qcom,glymur-gcc.h>
    #include <dt-bindings/clock/qcom,glymur-tcsr.h>

    phy@f00000 {
      compatible = "qcom,glymur-qmp-gen5x8-pcie-phy";
      reg = <0x00f00000 0x10000>, <0x00f10000 0x10000>;
      reg-names = "port_a", "port_b";

      clocks = <&gcc GCC_PCIE_PHY_3A_AUX_CLK>,
               <&gcc GCC_PCIE_3A_CFG_AHB_CLK>,
               <&tcsr TCSR_PCIE_3_CLKREF_EN>,
               <&gcc GCC_PCIE_3A_PHY_RCHNG_CLK>,
               <&gcc GCC_PCIE_3A_PIPE_CLK>,
               <&gcc GCC_PCIE_PHY_3B_AUX_CLK>,
               <&gcc GCC_PCIE_3B_CFG_AHB_CLK>,
               <&gcc GCC_PCIE_3B_PHY_RCHNG_CLK>,
               <&gcc GCC_PCIE_3B_PIPE_CLK>,
               <&gcc GCC_PCIE_3B_PIPE_DIV2_CLK>;
      clock-names = "aux", "cfg_ahb", "ref", "rchng", "pipe",
                    "phy_b_aux", "cfg_ahb_b", "rchng_b", "pipe_b",
                    "pipediv2_b";

      resets = <&gcc GCC_PCIE_3A_PHY_BCR>,
               <&gcc GCC_PCIE_3A_NOCSR_COM_PHY_BCR>,
               <&gcc GCC_PCIE_3B_PHY_BCR>,
               <&gcc GCC_PCIE_3B_NOCSR_COM_PHY_BCR>;
      reset-names = "port_a", "port_a_nocsr", "port_b", "port_b_nocsr";

      power-domains = <&gcc GCC_PCIE_3A_PHY_GDSC>,
                      <&gcc GCC_PCIE_3B_PHY_GDSC>;
      power-domain-names = "port_a", "port_b";

      vdda-phy-supply = <&vreg_l3c>;
      vdda-pll-supply = <&vreg_l2c>;

      vdda-refgen0p9-supply = <&vreg_l3c>;
      vdda-refgen1p2-supply = <&vreg_l2c>;

      qcom,link-mode = <&tcsr 0x5000>;

      #clock-cells = <1>;
      clock-output-names = "pcie3a_pipe_clk", "pcie3b_pipe_clk";

      #phy-cells = <1>;
    };
```

## Documentation/devicetree/bindings/phy/qcom,hdmi-phy-other.yaml
```yaml
# SPDX-License-Identifier: (GPL-2.0-only OR BSD-2-Clause)
%YAML 1.2
---

$id: http://devicetree.org/schemas/phy/qcom,hdmi-phy-other.yaml#
$schema: http://devicetree.org/meta-schemas/core.yaml#

title: Qualcomm Adreno/Snapdragon HDMI phy

maintainers:
  - Rob Clark <robdclark@gmail.com>

properties:
  compatible:
    enum:
      - qcom,hdmi-phy-8660
      - qcom,hdmi-phy-8960
      - qcom,hdmi-phy-8974
      - qcom,hdmi-phy-8084

  reg:
    maxItems: 2

  reg-names:
    items:
      - const: hdmi_phy
      - const: hdmi_pll

  clocks:
    minItems: 1
    maxItems: 2

  clock-names:
    minItems: 1
    maxItems: 2

  power-domains:
    maxItems: 1

  core-vdda-supply:
    description: phandle to VDDA supply regulator

  vddio-supply:
    description: phandle to VDD I/O supply regulator

  '#clock-cells':
    const: 0

  '#phy-cells':
    const: 0

allOf:
  - if:
      properties:
        compatible:
          contains:
            enum:
              - qcom,hdmi-phy-8660
    then:
      properties:
        clocks:
          maxItems: 1
        clock-names:
          items:
            - const: slave_iface
        vddio-supply: false

  - if:
      properties:
        compatible:
          contains:
            enum:
              - qcom,hdmi-phy-8960
    then:
      properties:
        clocks:
          minItems: 1
          maxItems: 2
        clock-names:
          minItems: 1
          items:
            - const: slave_iface
            - const: pxo
        vddio-supply: false

  - if:
      properties:
        compatible:
          contains:
            enum:
              - qcom,hdmi-phy-8084
              - qcom,hdmi-phy-8974
    then:
      properties:
        clocks:
          maxItems: 2
        clock-names:
          items:
            - const: iface
            - const: alt_iface

required:
  - compatible
  - clocks
  - reg
  - reg-names
  - '#phy-cells'

additionalProperties: false

examples:
  - |
    hdmi_phy: phy@4a00400 {
      compatible = "qcom,hdmi-phy-8960";
      reg-names = "hdmi_phy",
                  "hdmi_pll";
      reg = <0x4a00400 0x60>,
            <0x4a00500 0x100>;
      #clock-cells = <0>;
      #phy-cells = <0>;
      power-domains = <&mmcc 1>;
      clock-names = "slave_iface", "pxo";
      clocks = <&clk 21>, <&pxo_board>;
      core-vdda-supply = <&pm8921_hdmi_mvs>;
    };
```

## Documentation/devicetree/bindings/phy/qcom,hdmi-phy-qmp.yaml
```yaml
# SPDX-License-Identifier: (GPL-2.0-only OR BSD-2-Clause)
%YAML 1.2
---

$id: http://devicetree.org/schemas/phy/qcom,hdmi-phy-qmp.yaml#
$schema: http://devicetree.org/meta-schemas/core.yaml#

title: Qualcomm Adreno/Snapdragon QMP HDMI phy

maintainers:
  - Rob Clark <robdclark@gmail.com>

properties:
  compatible:
    enum:
      - qcom,hdmi-phy-8996

  reg:
    maxItems: 6

  reg-names:
    items:
      - const: hdmi_pll
      - const: hdmi_tx_l0
      - const: hdmi_tx_l1
      - const: hdmi_tx_l2
      - const: hdmi_tx_l3
      - const: hdmi_phy

  clocks:
    minItems: 2
    maxItems: 3

  clock-names:
    minItems: 2
    items:
      - const: iface
      - const: ref
      - const: xo

  power-domains:
    maxItems: 1

  vcca-supply:
    description: phandle to VCCA supply regulator

  vddio-supply:
    description: phandle to VDD I/O supply regulator

  '#clock-cells':
    const: 0

  '#phy-cells':
    const: 0

required:
  - compatible
  - clocks
  - clock-names
  - reg
  - reg-names
  - '#phy-cells'

additionalProperties: false

examples:
  - |
    hdmi-phy@9a0600 {
      compatible = "qcom,hdmi-phy-8996";
      reg = <0x009a0600 0x1c4>,
            <0x009a0a00 0x124>,
            <0x009a0c00 0x124>,
            <0x009a0e00 0x124>,
            <0x009a1000 0x124>,
            <0x009a1200 0x0c8>;
      reg-names = "hdmi_pll",
                  "hdmi_tx_l0",
                  "hdmi_tx_l1",
                  "hdmi_tx_l2",
                  "hdmi_tx_l3",
                  "hdmi_phy";

      clocks = <&mmcc 116>,
               <&gcc 214>,
               <&xo_board>;
      clock-names = "iface",
                    "ref",
                    "xo";
      #clock-cells = <0>;
      #phy-cells = <0>;

      vddio-supply = <&vreg_l12a_1p8>;
      vcca-supply = <&vreg_l28a_0p925>;
    };
```

## Documentation/devicetree/bindings/phy/qcom,ipq5332-uniphy-pcie-phy.yaml
```yaml
# SPDX-License-Identifier: (GPL-2.0 OR BSD-2-Clause)
%YAML 1.2
---
$id: http://devicetree.org/schemas/phy/qcom,ipq5332-uniphy-pcie-phy.yaml#
$schema: http://devicetree.org/meta-schemas/core.yaml#

title: Qualcomm UNIPHY PCIe 28LP PHY

maintainers:
  - Nitheesh Sekar <quic_nsekar@quicinc.com>
  - Varadarajan Narayanan <quic_varada@quicinc.com>

description:
  PCIe and USB combo PHY found in Qualcomm IPQ5018 & IPQ5332 SoCs

properties:
  compatible:
    enum:
      - qcom,ipq5018-uniphy-pcie-phy
      - qcom,ipq5332-uniphy-pcie-phy

  reg:
    maxItems: 1

  clocks:
    minItems: 1
    maxItems: 2

  resets:
    minItems: 2
    maxItems: 3

  "#phy-cells":
    const: 0

  "#clock-cells":
    const: 0

  num-lanes:
    $ref: /schemas/types.yaml#/definitions/uint32
    enum: [1, 2]

required:
  - compatible
  - reg
  - clocks
  - resets
  - "#phy-cells"
  - "#clock-cells"
  - num-lanes

additionalProperties: false

allOf:
  - if:
      properties:
        compatible:
          contains:
            enum:
              - qcom,ipq5018-uniphy-pcie-phy
    then:
      properties:
        clocks:
          items:
            - description: pcie pipe clock
        resets:
          items:
            - description: phy reset
            - description: cfg reset

  - if:
      properties:
        compatible:
          contains:
            enum:
              - qcom,ipq5332-uniphy-pcie-phy
    then:
      properties:
        clocks:
          items:
            - description: pcie pipe clock
            - description: pcie ahb clock
        resets:
          items:
            - description: phy reset
            - description: ahb reset
            - description: cfg reset

examples:
  - |
    #include <dt-bindings/clock/qcom,ipq5332-gcc.h>

    pcie0_phy: phy@4b0000 {
        compatible = "qcom,ipq5332-uniphy-pcie-phy";
        reg = <0x004b0000 0x800>;

        clocks = <&gcc GCC_PCIE3X1_0_PIPE_CLK>,
                 <&gcc GCC_PCIE3X1_PHY_AHB_CLK>;

        resets = <&gcc GCC_PCIE3X1_0_PHY_BCR>,
                 <&gcc GCC_PCIE3X1_PHY_AHB_CLK_ARES>,
                 <&gcc GCC_PCIE3X1_0_PHY_PHY_BCR>;

        #clock-cells = <0>;

        #phy-cells = <0>;

        num-lanes = <1>;
    };
```

## Documentation/devicetree/bindings/phy/qcom,ipq5332-usb-hsphy.yaml
```yaml
# SPDX-License-Identifier: (GPL-2.0 OR BSD-2-Clause)
%YAML 1.2
---
$id: http://devicetree.org/schemas/phy/qcom,ipq5332-usb-hsphy.yaml#
$schema: http://devicetree.org/meta-schemas/core.yaml#

title: M31 USB PHY

maintainers:
  - Sricharan Ramabadhran <quic_srichara@quicinc.com>
  - Varadarajan Narayanan <quic_varada@quicinc.com>

description:
  USB M31 PHY (https://www.m31tech.com) found in Qualcomm
  IPQ5018, IPQ5332 SoCs.

properties:
  compatible:
    items:
      - enum:
          - qcom,ipq5018-usb-hsphy
          - qcom,ipq5332-usb-hsphy

  "#phy-cells":
    const: 0

  reg:
    maxItems: 1

  clocks:
    maxItems: 1

  clock-names:
    items:
      - const: cfg_ahb

  resets:
    maxItems: 1

  vdd-supply:
    description:
      Phandle to 5V regulator supply to PHY digital circuit.

additionalProperties: false

examples:
  - |
    #include <dt-bindings/clock/qcom,ipq5332-gcc.h>
    usb-phy@7b000 {
        compatible = "qcom,ipq5332-usb-hsphy";
        reg = <0x0007b000 0x12c>;

        clocks = <&gcc GCC_USB0_PHY_CFG_AHB_CLK>;
        clock-names = "cfg_ahb";

        #phy-cells = <0>;

        resets = <&gcc GCC_QUSB2_0_PHY_BCR>;

        vdd-supply = <&regulator_fixed_5p0>;
    };
```

## Documentation/devicetree/bindings/phy/qcom,ipq806x-usb-phy-hs.yaml
```yaml
# SPDX-License-Identifier: GPL-2.0-only OR BSD-2-Clause
%YAML 1.2
---
$id: http://devicetree.org/schemas/phy/qcom,ipq806x-usb-phy-hs.yaml#
$schema: http://devicetree.org/meta-schemas/core.yaml#

title: Qualcomm ipq806x usb DWC3 HS PHY CONTROLLER

maintainers:
  - Ansuel Smith <ansuelsmth@gmail.com>

description:
  DWC3 PHY nodes are defined to describe on-chip Synopsis Physical layer
  controllers used in ipq806x. Each DWC3 PHY controller should have its
  own node.

properties:
  compatible:
    const: qcom,ipq806x-usb-phy-hs

  "#phy-cells":
    const: 0

  reg:
    maxItems: 1

  clocks:
    minItems: 1
    maxItems: 2

  clock-names:
    minItems: 1
    maxItems: 2
    items:
      - const: ref
      - const: xo

required:
  - compatible
  - "#phy-cells"
  - reg
  - clocks
  - clock-names

additionalProperties: false

examples:
  - |
    #include <dt-bindings/clock/qcom,gcc-ipq806x.h>

    hs_phy_0: phy@110f8800 {
      compatible = "qcom,ipq806x-usb-phy-hs";
      reg = <0x110f8800 0x30>;
      clocks = <&gcc USB30_0_UTMI_CLK>;
      clock-names = "ref";
      #phy-cells = <0>;
    };
```

## Documentation/devicetree/bindings/phy/qcom,ipq806x-usb-phy-ss.yaml
```yaml
# SPDX-License-Identifier: GPL-2.0-only OR BSD-2-Clause
%YAML 1.2
---
$id: http://devicetree.org/schemas/phy/qcom,ipq806x-usb-phy-ss.yaml#
$schema: http://devicetree.org/meta-schemas/core.yaml#

title: Qualcomm ipq806x usb DWC3 SS PHY CONTROLLER

maintainers:
  - Ansuel Smith <ansuelsmth@gmail.com>

description:
  DWC3 PHY nodes are defined to describe on-chip Synopsis Physical layer
  controllers used in ipq806x. Each DWC3 PHY controller should have its
  own node.

properties:
  compatible:
    const: qcom,ipq806x-usb-phy-ss

  "#phy-cells":
    const: 0

  reg:
    maxItems: 1

  clocks:
    minItems: 1
    maxItems: 2

  clock-names:
    minItems: 1
    maxItems: 2
    items:
      - const: ref
      - const: xo

  qcom,rx-eq:
    $ref: /schemas/types.yaml#/definitions/uint32
    description: Override value for rx_eq.
    default: 4
    maximum: 7

  qcom,tx-deamp-3_5db:
    $ref: /schemas/types.yaml#/definitions/uint32
    description: Override value for transmit preemphasis.
    default: 23
    maximum: 63

  qcom,mpll:
    $ref: /schemas/types.yaml#/definitions/uint32
    description: Override value for mpll.
    default: 0
    maximum: 7

required:
  - compatible
  - "#phy-cells"
  - reg
  - clocks
  - clock-names

examples:
  - |
    #include <dt-bindings/clock/qcom,gcc-ipq806x.h>

    ss_phy_0: phy@110f8830 {
      compatible = "qcom,ipq806x-usb-phy-ss";
      reg = <0x110f8830 0x30>;
      clocks = <&gcc USB30_0_MASTER_CLK>;
      clock-names = "ref";
      #phy-cells = <0>;
    };
```
