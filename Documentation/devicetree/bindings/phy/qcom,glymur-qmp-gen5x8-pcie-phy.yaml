## Documentation/devicetree/bindings/phy/qcom,msm8998-qmp-usb3-phy.yaml
```yaml
# SPDX-License-Identifier: (GPL-2.0 OR BSD-2-Clause)
%YAML 1.2
---
$id: http://devicetree.org/schemas/phy/qcom,msm8998-qmp-usb3-phy.yaml#
$schema: http://devicetree.org/meta-schemas/core.yaml#

title: Qualcomm QMP PHY controller (USB, MSM8998)

maintainers:
  - Vinod Koul <vkoul@kernel.org>

description:
  The QMP PHY controller supports physical layer functionality for USB-C on
  several Qualcomm chipsets.

properties:
  compatible:
    enum:
      - qcom,msm8998-qmp-usb3-phy
      - qcom,qcm2290-qmp-usb3-phy
      - qcom,qcs615-qmp-usb3-phy
      - qcom,sdm660-qmp-usb3-phy
      - qcom,sm6115-qmp-usb3-phy

  reg:
    maxItems: 1

  clocks:
    maxItems: 4

  clock-names:
    maxItems: 4

  resets:
    maxItems: 2

  reset-names:
    items:
      - const: phy
      - const: phy_phy

  vdda-phy-supply: true

  vdda-pll-supply: true

  "#clock-cells":
    const: 0

  clock-output-names:
    maxItems: 1

  "#phy-cells":
    const: 0

  orientation-switch:
    description:
      Flag the PHY as possible handler of USB Type-C orientation switching
    type: boolean

  qcom,tcsr-reg:
    $ref: /schemas/types.yaml#/definitions/phandle-array
    items:
      - items:
          - description: phandle to TCSR hardware block
          - description: offset of the VLS CLAMP register
    description: Clamp register present in the TCSR

  ports:
    $ref: /schemas/graph.yaml#/properties/ports
    properties:
      port@0:
        $ref: /schemas/graph.yaml#/properties/port
        description: Output endpoint of the PHY

      port@1:
        $ref: /schemas/graph.yaml#/properties/port
        description: Incoming endpoint from the USB controller

required:
  - compatible
  - reg
  - clocks
  - clock-names
  - resets
  - reset-names
  - vdda-phy-supply
  - vdda-pll-supply
  - "#clock-cells"
  - clock-output-names
  - "#phy-cells"
  - qcom,tcsr-reg

allOf:
  - if:
      properties:
        compatible:
          contains:
            enum:
              - qcom,msm8998-qmp-usb3-phy
              - qcom,qcs615-qmp-usb3-phy
              - qcom,sdm660-qmp-usb3-phy
    then:
      properties:
        clocks:
          maxItems: 4
        clock-names:
          items:
            - const: aux
            - const: ref
            - const: cfg_ahb
            - const: pipe

  - if:
      properties:
        compatible:
          contains:
            enum:
              - qcom,qcm2290-qmp-usb3-phy
              - qcom,sm6115-qmp-usb3-phy
    then:
      properties:
        clocks:
          maxItems: 4
        clock-names:
          items:
            - const: cfg_ahb
            - const: ref
            - const: com_aux
            - const: pipe

additionalProperties: false

examples:
  - |
    #include <dt-bindings/clock/qcom,gcc-msm8998.h>
    #include <dt-bindings/clock/qcom,rpmh.h>

    phy@c010000 {
      compatible = "qcom,msm8998-qmp-usb3-phy";
      reg = <0x0c010000 0x1000>;

      clocks = <&gcc GCC_USB3_PHY_AUX_CLK>,
               <&gcc GCC_USB3_CLKREF_CLK>,
               <&gcc GCC_USB_PHY_CFG_AHB2PHY_CLK>,
               <&gcc GCC_USB3_PHY_PIPE_CLK>;
      clock-names = "aux",
                    "ref",
                    "cfg_ahb",
                    "pipe";
      clock-output-names = "usb3_phy_pipe_clk_src";
      #clock-cells = <0>;
      #phy-cells = <0>;

      resets = <&gcc GCC_USB3_PHY_BCR>,
               <&gcc GCC_USB3PHY_PHY_BCR>;
      reset-names = "phy",
                    "phy_phy";

      vdda-phy-supply = <&vreg_l1a_0p875>;
      vdda-pll-supply = <&vreg_l2a_1p2>;

      orientation-switch;

      qcom,tcsr-reg = <&tcsr_regs_1 0x6b244>;

      ports {
        #address-cells = <1>;
        #size-cells = <0>;

        port@0 {
          reg = <0>;

          endpoint {
            remote-endpoint = <&pmic_typec_mux_in>;
          };
        };

        port@1 {
          reg = <1>;

          endpoint {
            remote-endpoint = <&usb_dwc3_ss>;
          };
        };
      };
    };
```

## Documentation/devicetree/bindings/phy/qcom,pcie2-phy.yaml
```yaml
# SPDX-License-Identifier: (GPL-2.0 OR BSD-2-Clause)
%YAML 1.2
---
$id: http://devicetree.org/schemas/phy/qcom,pcie2-phy.yaml#
$schema: http://devicetree.org/meta-schemas/core.yaml#

title: Qualcomm PCIe2 PHY controller

maintainers:
  - Vinod Koul <vkoul@kernel.org>

description:
  The Qualcomm PCIe2 PHY is a Synopsys based phy found in a number of Qualcomm
  platforms.

properties:
  compatible:
    items:
      - const: qcom,qcs404-pcie2-phy
      - const: qcom,pcie2-phy

  reg:
    items:
      - description: PHY register set

  clocks:
    items:
      - description: a clock-specifier pair for the "pipe" clock

  clock-output-names:
    maxItems: 1

  "#clock-cells":
    const: 0

  "#phy-cells":
    const: 0

  vdda-vp-supply:
    description: low voltage regulator

  vdda-vph-supply:
    description: high voltage regulator

  resets:
    maxItems: 2

  reset-names:
    items:
      - const: phy
      - const: pipe

required:
  - compatible
  - reg
  - clocks
  - clock-output-names
  - "#clock-cells"
  - "#phy-cells"
  - vdda-vp-supply
  - vdda-vph-supply
  - resets
  - reset-names

additionalProperties: false

examples:
  - |
    #include <dt-bindings/clock/qcom,gcc-qcs404.h>
    phy@7786000 {
      compatible = "qcom,qcs404-pcie2-phy", "qcom,pcie2-phy";
      reg = <0x07786000 0xb8>;

      clocks = <&gcc GCC_PCIE_0_PIPE_CLK>;
      resets = <&gcc GCC_PCIEPHY_0_PHY_BCR>,
               <&gcc GCC_PCIE_0_PIPE_ARES>;
      reset-names = "phy", "pipe";

      vdda-vp-supply = <&vreg_l3_1p05>;
      vdda-vph-supply = <&vreg_l5_1p8>;

      clock-output-names = "pcie_0_pipe_clk";
      #clock-cells = <0>;
      #phy-cells = <0>;
    };
...
```

## Documentation/devicetree/bindings/phy/qcom,qcs615-qmp-usb3dp-phy.yaml
```yaml
# SPDX-License-Identifier: (GPL-2.0 OR BSD-2-Clause)
%YAML 1.2
---
$id: http://devicetree.org/schemas/phy/qcom,qcs615-qmp-usb3dp-phy.yaml#
$schema: http://devicetree.org/meta-schemas/core.yaml#

title: Qualcomm QMP USB3-DP PHY controller (DP, QCS615)

maintainers:
  - Xiangxu Yin <xiangxu.yin@oss.qualcomm.com>

description:
  The QMP PHY controller supports physical layer functionality for both USB3
  and DisplayPort over USB-C. While it enables mode switching between USB3 and
  DisplayPort, but does not support combo mode.

properties:
  compatible:
    enum:
      - qcom,qcs615-qmp-usb3-dp-phy

  reg:
    maxItems: 1

  clocks:
    maxItems: 4

  clock-names:
    items:
      - const: aux
      - const: ref
      - const: cfg_ahb
      - const: pipe

  resets:
    maxItems: 2

  reset-names:
    items:
      - const: phy_phy
      - const: dp_phy

  vdda-phy-supply: true

  vdda-pll-supply: true

  "#clock-cells":
    const: 1
    description:
      See include/dt-bindings/phy/phy-qcom-qmp.h

  "#phy-cells":
    const: 1
    description:
      See include/dt-bindings/phy/phy-qcom-qmp.h

  qcom,tcsr-reg:
    $ref: /schemas/types.yaml#/definitions/phandle-array
    items:
      - items:
          - description: phandle to TCSR hardware block
          - description: offset of the VLS CLAMP register
          - description: offset of the PHY mode register
    description: Clamp and PHY mode register present in the TCSR

required:
  - compatible
  - reg
  - clocks
  - clock-names
  - resets
  - reset-names
  - vdda-phy-supply
  - vdda-pll-supply
  - "#clock-cells"
  - "#phy-cells"
  - qcom,tcsr-reg

additionalProperties: false

examples:
  - |
    #include <dt-bindings/clock/qcom,qcs615-gcc.h>
    #include <dt-bindings/clock/qcom,rpmh.h>

    phy@88e8000 {
      compatible = "qcom,qcs615-qmp-usb3-dp-phy";
      reg = <0x88e8000 0x2000>;

      clocks = <&gcc GCC_USB2_SEC_PHY_AUX_CLK>,
               <&gcc GCC_USB3_SEC_CLKREF_CLK>,
               <&gcc GCC_AHB2PHY_WEST_CLK>,
               <&gcc GCC_USB2_SEC_PHY_PIPE_CLK>;
      clock-names = "aux",
                    "ref",
                    "cfg_ahb",
                    "pipe";

      resets = <&gcc GCC_USB3PHY_PHY_SEC_BCR>,
               <&gcc GCC_USB3_DP_PHY_SEC_BCR>;
      reset-names = "phy_phy",
                    "dp_phy";

      vdda-phy-supply = <&vreg_l5a>;
      vdda-pll-supply = <&vreg_l12a>;

      #clock-cells = <1>;
      #phy-cells = <1>;

      qcom,tcsr-reg = <&tcsr 0xbff0 0xb24c>;
    };
```

## Documentation/devicetree/bindings/phy/qcom,qmp-pcie-phy.yaml
```yaml
# SPDX-License-Identifier: (GPL-2.0 OR BSD-2-Clause)
%YAML 1.2
---
$id: http://devicetree.org/schemas/phy/qcom,qmp-pcie-phy.yaml#
$schema: http://devicetree.org/meta-schemas/core.yaml#

title: Qualcomm QMP PHY controller (PCIe)

maintainers:
  - Vinod Koul <vkoul@kernel.org>

description:
  QMP PHY controller supports physical layer functionality for a number of
  controllers on Qualcomm chipsets, such as, PCIe, UFS, and USB.

properties:
  compatible:
    enum:
      - qcom,ipq6018-qmp-pcie-phy
      - qcom,ipq8074-qmp-gen3-pcie-phy
      - qcom,ipq8074-qmp-pcie-phy
      - qcom,msm8998-qmp-pcie-phy
      - qcom,sc8180x-qmp-pcie-phy
      - qcom,sdm845-qhp-pcie-phy
      - qcom,sdm845-qmp-pcie-phy
      - qcom,sdx55-qmp-pcie-phy
      - qcom,sm8250-qmp-gen3x1-pcie-phy
      - qcom,sm8250-qmp-gen3x2-pcie-phy
      - qcom,sm8250-qmp-modem-pcie-phy
      - qcom,sm8450-qmp-gen3x1-pcie-phy
      - qcom,sm8450-qmp-gen4x2-pcie-phy

  reg:
    items:
      - description: serdes

  "#address-cells":
    enum: [ 1, 2 ]

  "#size-cells":
    enum: [ 1, 2 ]

  ranges: true

  clocks:
    minItems: 2
    maxItems: 4

  clock-names:
    minItems: 2
    maxItems: 4

  resets:
    minItems: 1
    maxItems: 2

  reset-names:
    minItems: 1
    maxItems: 2

  vdda-phy-supply: true

  vdda-pll-supply: true

  vddp-ref-clk-supply: true

patternProperties:
  "^phy@[0-9a-f]+$":
    type: object
    description: single PHY-provider child node

required:
  - compatible
  - reg
  - "#address-cells"
  - "#size-cells"
  - ranges
  - clocks
  - clock-names
  - resets
  - reset-names

additionalProperties: false

allOf:
  - if:
      properties:
        compatible:
          contains:
            enum:
              - qcom,msm8998-qmp-pcie-phy
    then:
      properties:
        clocks:
          maxItems: 3
        clock-names:
          items:
            - const: aux
            - const: cfg_ahb
            - const: ref
        resets:
          maxItems: 2
        reset-names:
          items:
            - const: phy
            - const: common
      required:
        - vdda-phy-supply
        - vdda-pll-supply

  - if:
      properties:
        compatible:
          contains:
            enum:
              - qcom,ipq6018-qmp-pcie-phy
              - qcom,ipq8074-qmp-gen3-pcie-phy
              - qcom,ipq8074-qmp-pcie-phy
    then:
      properties:
        clocks:
          maxItems: 2
        clock-names:
          items:
            - const: aux
            - const: cfg_ahb
        resets:
          maxItems: 2
        reset-names:
          items:
            - const: phy
            - const: common

  - if:
      properties:
        compatible:
          contains:
            enum:
              - qcom,sc8180x-qmp-pcie-phy
              - qcom,sdm845-qhp-pcie-phy
              - qcom,sdm845-qmp-pcie-phy
              - qcom,sdx55-qmp-pcie-phy
              - qcom,sm8250-qmp-gen3x1-pcie-phy
              - qcom,sm8250-qmp-gen3x2-pcie-phy
              - qcom,sm8250-qmp-modem-pcie-phy
              - qcom,sm8450-qmp-gen3x1-pcie-phy
              - qcom,sm8450-qmp-gen4x2-pcie-phy
    then:
      properties:
        clocks:
          maxItems: 4
        clock-names:
          items:
            - const: aux
            - const: cfg_ahb
            - const: ref
            - const: refgen
        resets:
          maxItems: 1
        reset-names:
          items:
            - const: phy
      required:
        - vdda-phy-supply
        - vdda-pll-supply

examples:
  - |
    #include <dt-bindings/clock/qcom,gcc-sm8250.h>
    phy-wrapper@1c0e000 {
        compatible = "qcom,sm8250-qmp-gen3x2-pcie-phy";
        reg = <0x01c0e000 0x1c0>;
        #address-cells = <1>;
        #size-cells = <1>;
        ranges = <0x0 0x01c0e000 0x1000>;

        clocks = <&gcc GCC_PCIE_PHY_AUX_CLK>,
                 <&gcc GCC_PCIE_1_CFG_AHB_CLK>,
                 <&gcc GCC_PCIE_WIGIG_CLKREF_EN>,
                 <&gcc GCC_PCIE1_PHY_REFGEN_CLK>;
        clock-names = "aux", "cfg_ahb", "ref", "refgen";

        resets = <&gcc GCC_PCIE_1_PHY_BCR>;
        reset-names = "phy";

        vdda-phy-supply = <&vreg_l10c_0p88>;
        vdda-pll-supply = <&vreg_l6b_1p2>;

        phy@200 {
            reg = <0x200 0x170>,
                  <0x400 0x200>,
                  <0xa00 0x1f0>,
                  <0x600 0x170>,
                  <0x800 0x200>,
                  <0xe00 0xf4>;

            clocks = <&gcc GCC_PCIE_1_PIPE_CLK>;
            clock-names = "pipe0";

            #clock-cells = <0>;
            clock-output-names = "pcie_1_pipe_clk";

            #phy-cells = <0>;
        };
    };
```
