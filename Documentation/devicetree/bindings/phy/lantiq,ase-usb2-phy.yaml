## Documentation/devicetree/bindings/phy/marvell,comphy-cp110.yaml
```yaml
# SPDX-License-Identifier: (GPL-2.0-only OR BSD-2-Clause)
%YAML 1.2
---
$id: http://devicetree.org/schemas/phy/marvell,comphy-cp110.yaml#
$schema: http://devicetree.org/meta-schemas/core.yaml#

title: Marvell MVEBU COMPHY Controller

maintainers:
  - Miquel Raynal <miquel.raynal@bootlin.com>

description: >
  COMPHY controllers can be found on the following Marvell MVEBU SoCs:

    * Armada 7k/8k (on the CP110)
    * Armada 3700

  It provides a number of shared PHYs used by various interfaces (network, SATA,
  USB, PCIe...).

properties:
  compatible:
    enum:
      - marvell,comphy-cp110
      - marvell,comphy-a3700

  reg:
    minItems: 1
    items:
      - description: Generic COMPHY registers
      - description: Lane 1 (PCIe/GbE) registers (Armada 3700)
      - description: Lane 0 (USB3/GbE) registers (Armada 3700)
      - description: Lane 2 (SATA/USB3) registers (Armada 3700)

  reg-names:
    minItems: 1
    items:
      - const: comphy
      - const: lane1_pcie_gbe
      - const: lane0_usb3_gbe
      - const: lane2_sata_usb3

  '#address-cells':
    const: 1

  '#size-cells':
    const: 0

  clocks:
    minItems: 1
    maxItems: 3

  clock-names:
    minItems: 1
    maxItems: 3

  marvell,system-controller:
    description: Phandle to the Marvell system controller (CP110 only)
    $ref: /schemas/types.yaml#/definitions/phandle

patternProperties:
  '^phy@[0-5]$':
    description: A COMPHY lane child node
    type: object
    additionalProperties: false

    properties:
      reg:
        description: COMPHY lane number
        maximum: 5

      '#phy-cells':
        const: 1

      connector:
        type: object

    required:
      - reg
      - '#phy-cells'

required:
  - compatible
  - reg

additionalProperties: false

allOf:
  - if:
      properties:
        compatible:
          const: marvell,comphy-a3700

    then:
      properties:
        clocks:
          maxItems: 1
        clock-names:
          const: xtal

      required:
        - reg-names

    else:
      properties:
        clocks:
          minItems: 3
        clock-names:
          items:
            - const: mg_clk
            - const: mg_core_clk
            - const: axi_clk

      required:
        - marvell,system-controller

examples:
  - |
    phy@120000 {
        compatible = "marvell,comphy-cp110";
        reg = <0x120000 0x6000>;
        clocks = <&clk 1 5>, <&clk 1 6>, <&clk 1 18>;
        clock-names = "mg_clk", "mg_core_clk", "axi_clk";
        #address-cells = <1>;
        #size-cells = <0>;
        marvell,system-controller = <&syscon0>;

        phy@0 {
            reg = <0>;
            #phy-cells = <1>;
        };

        phy@1 {
            reg = <1>;
            #phy-cells = <1>;
        };
    };

  - |
    phy@18300 {
        compatible = "marvell,comphy-a3700";
        reg = <0x18300 0x300>,
              <0x1F000 0x400>,
              <0x5C000 0x400>,
              <0xe0178 0x8>;
        reg-names = "comphy",
                    "lane1_pcie_gbe",
                    "lane0_usb3_gbe",
                    "lane2_sata_usb3";
        #address-cells = <1>;
        #size-cells = <0>;

        comphy0: phy@0 {
            reg = <0>;
            #phy-cells = <1>;
        };

        comphy1: phy@1 {
            reg = <1>;
            #phy-cells = <1>;
        };

        comphy2: phy@2 {
            reg = <2>;
            #phy-cells = <1>;
        };
    };
```

## Documentation/devicetree/bindings/phy/marvell,mmp2-usb-phy.yaml
```yaml
# SPDX-License-Identifier: (GPL-2.0-only OR BSD-2-Clause)
%YAML 1.2
---
$id: http://devicetree.org/schemas/phy/marvell,mmp2-usb-phy.yaml#
$schema: http://devicetree.org/meta-schemas/core.yaml#

title: Marvell MMP2/PXA USB PHY

maintainers:
  - Lubomir Rintel <lkundrak@v3.sk>

properties:
  compatible:
    enum:
      - marvell,mmp2-usb-phy
      - marvell,pxa910-usb-phy
      - marvell,pxa168-usb-phy

  reg:
    maxItems: 1

  "#phy-cells":
    const: 0

required:
  - compatible
  - "#phy-cells"

additionalProperties: false

examples:
  - |
    usbphy@d4207000 {
        compatible = "marvell,mmp2-usb-phy";
        reg = <0xd4207000 0x40>;
        #phy-cells = <0>;
    };
```

## Documentation/devicetree/bindings/phy/marvell,mmp3-hsic-phy.yaml
```yaml
# SPDX-License-Identifier: (GPL-2.0-or-later OR BSD-2-Clause)
# Copyright 2019 Lubomir Rintel <lkundrak@v3.sk>
%YAML 1.2
---
$id: "http://devicetree.org/schemas/phy/marvell,mmp3-hsic-phy.yaml#"
$schema: "http://devicetree.org/meta-schemas/core.yaml#"

title: Marvell MMP3 HSIC PHY

maintainers:
  - Lubomir Rintel <lkundrak@v3.sk>

properties:
  compatible:
    const: marvell,mmp3-hsic-phy

  reg:
    maxItems: 1
    description: base address of the device

  "#phy-cells":
    const: 0

required:
  - compatible
  - reg
  - "#phy-cells"

additionalProperties: false

examples:
  - |
    hsic-phy@f0001800 {
            compatible = "marvell,mmp3-hsic-phy";
            reg = <0xf0001800 0x40>;
            #phy-cells = <0>;
    };
```

## Documentation/devicetree/bindings/phy/marvell,mmp3-usb-phy.yaml
```yaml
# SPDX-License-Identifier: (GPL-2.0-or-later OR BSD-2-Clause)
# Copyright 2019,2020 Lubomir Rintel <lkundrak@v3.sk>
%YAML 1.2
---
$id: http://devicetree.org/schemas/phy/marvell,mmp3-usb-phy.yaml#
$schema: http://devicetree.org/meta-schemas/core.yaml#

title: Marvell MMP3 USB PHY

maintainers:
  - Lubomir Rintel <lkundrak@v3.sk>

properties:
  $nodename:
    pattern: '^usb-phy@[a-f0-9]+$'

  compatible:
    const: marvell,mmp3-usb-phy

  reg:
    maxItems: 1
    description: base address of the device

  '#phy-cells':
    const: 0

required:
  - compatible
  - reg
  - '#phy-cells'

additionalProperties: false

examples:
  - |
    usb-phy@d4207000 {
      compatible = "marvell,mmp3-usb-phy";
      reg = <0xd4207000 0x40>;
      #phy-cells = <0>;
    };

...
```

## Documentation/devicetree/bindings/phy/marvell,mvebu-sata-phy.yaml
```yaml
# SPDX-License-Identifier: (GPL-2.0-only OR BSD-2-Clause)
%YAML 1.2
---
$id: http://devicetree.org/schemas/phy/marvell,mvebu-sata-phy.yaml#
$schema: http://devicetree.org/meta-schemas/core.yaml#

title: Marvell MVEBU SATA PHY

maintainers:
  - Andrew Lunn <andrew@lunn.ch>
  - Gregory Clement <gregory.clement@bootlin.com>

properties:
  compatible:
    const: marvell,mvebu-sata-phy

  reg:
    maxItems: 1

  clocks:
    maxItems: 1

  clock-names:
    items:
      - const: sata

  '#phy-cells':
    const: 0

required:
  - compatible
  - reg
  - clocks
  - clock-names
  - '#phy-cells'

additionalProperties: false

examples:
  - |
    sata-phy@84000 {
        compatible = "marvell,mvebu-sata-phy";
        reg = <0x84000 0x0334>;
        clocks = <&gate_clk 15>;
        clock-names = "sata";
        #phy-cells = <0>;
    };
```

## Documentation/devicetree/bindings/phy/marvell,pxa1928-usb-phy.yaml
```yaml
# SPDX-License-Identifier: (GPL-2.0-only OR BSD-2-Clause)
%YAML 1.2
---
$id: http://devicetree.org/schemas/phy/marvell,pxa1928-usb-phy.yaml#
$schema: http://devicetree.org/meta-schemas/core.yaml#

title: Marvell PXA1928 USB/HSIC PHY

maintainers:
  - Duje Mihanović <duje.mihanovic@skole.hr>

properties:
  compatible:
    enum:
      - marvell,pxa1928-usb-phy
      - marvell,pxa1928-hsic-phy

  reg:
    maxItems: 1

  clocks:
    maxItems: 1

  '#phy-cells':
    const: 0

  resets:
    maxItems: 1

required:
  - compatible
  - reg
  - clocks
  - '#phy-cells'

additionalProperties: false

examples:
  - |
    #include <dt-bindings/clock/marvell,pxa1928.h>

    usbphy: phy@7000 {
        compatible = "marvell,pxa1928-usb-phy";
        reg = <0x7000 0xe0>;
        clocks = <&apmu PXA1928_CLK_USB>;
        #phy-cells = <0>;
    };
```

## Documentation/devicetree/bindings/phy/mediatek,dsi-phy.yaml
```yaml
# SPDX-License-Identifier: (GPL-2.0-only OR BSD-2-Clause)
# Copyright (c) 2020 MediaTek
%YAML 1.2
---
$id: http://devicetree.org/schemas/phy/mediatek,dsi-phy.yaml#
$schema: http://devicetree.org/meta-schemas/core.yaml#

title: MediaTek MIPI Display Serial Interface (DSI) PHY

maintainers:
  - Chun-Kuang Hu <chunkuang.hu@kernel.org>
  - Philipp Zabel <p.zabel@pengutronix.de>
  - Chunfeng Yun <chunfeng.yun@mediatek.com>

description: The MIPI DSI PHY supports up to 4-lane output.

properties:
  $nodename:
    pattern: "^dsi-phy@[0-9a-f]+$"

  compatible:
    oneOf:
      - items:
          - enum:
              - mediatek,mt7623-mipi-tx
          - const: mediatek,mt2701-mipi-tx
      - items:
          - enum:
              - mediatek,mt6795-mipi-tx
          - const: mediatek,mt8173-mipi-tx
      - items:
          - enum:
              - mediatek,mt8365-mipi-tx
          - const: mediatek,mt8183-mipi-tx
      - const: mediatek,mt2701-mipi-tx
      - const: mediatek,mt8173-mipi-tx
      - const: mediatek,mt8183-mipi-tx

  reg:
    maxItems: 1

  clocks:
    items:
      - description: PLL reference clock

  clock-output-names:
    maxItems: 1

  "#phy-cells":
    const: 0

  "#clock-cells":
    const: 0

  nvmem-cells:
    maxItems: 1
    description: A phandle to the calibration data provided by a nvmem device,
      if unspecified, default values shall be used.

  nvmem-cell-names:
    items:
      - const: calibration-data

  drive-strength-microamp:
    description: adjust driving current
    multipleOf: 200
    minimum: 2000
    maximum: 6000
    default: 4600

required:
  - compatible
  - reg
  - clocks
  - clock-output-names
  - "#phy-cells"
  - "#clock-cells"

additionalProperties: false

examples:
  - |
    #include <dt-bindings/clock/mt8173-clk.h>
    dsi-phy@10215000 {
        compatible = "mediatek,mt8173-mipi-tx";
        reg = <0x10215000 0x1000>;
        clocks = <&clk26m>;
        clock-output-names = "mipi_tx0_pll";
        drive-strength-microamp = <4000>;
        nvmem-cells= <&mipi_tx_calibration>;
        nvmem-cell-names = "calibration-data";
        #clock-cells = <0>;
        #phy-cells = <0>;
    };

...
```

## Documentation/devicetree/bindings/phy/mediatek,hdmi-phy.yaml
```yaml
# SPDX-License-Identifier: (GPL-2.0-only OR BSD-2-Clause)
# Copyright (c) 2020 MediaTek
%YAML 1.2
---
$id: http://devicetree.org/schemas/phy/mediatek,hdmi-phy.yaml#
$schema: http://devicetree.org/meta-schemas/core.yaml#

title: MediaTek High Definition Multimedia Interface (HDMI) PHY

maintainers:
  - Chun-Kuang Hu <chunkuang.hu@kernel.org>
  - Philipp Zabel <p.zabel@pengutronix.de>
  - Chunfeng Yun <chunfeng.yun@mediatek.com>

description: |
  The HDMI PHY serializes the HDMI encoder's three channel 10-bit parallel
  output and drives the HDMI pads.

properties:
  $nodename:
    pattern: "^hdmi-phy@[0-9a-f]+$"

  compatible:
    oneOf:
      - items:
          - enum:
              - mediatek,mt7623-hdmi-phy
          - const: mediatek,mt2701-hdmi-phy
      - items:
          - enum:
              - mediatek,mt8188-hdmi-phy
          - const: mediatek,mt8195-hdmi-phy
      - const: mediatek,mt2701-hdmi-phy
      - const: mediatek,mt8173-hdmi-phy
      - const: mediatek,mt8195-hdmi-phy

  reg:
    maxItems: 1

  clocks:
    minItems: 1
    items:
      - description: PLL reference clock
      - description: HDMI 26MHz clock
      - description: HDMI PLL1 clock
      - description: HDMI PLL2 clock

  clock-names:
    minItems: 1
    items:
      - const: pll_ref
      - const: 26m
      - const: pll1
      - const: pll2

  clock-output-names:
    maxItems: 1

  "#phy-cells":
    const: 0

  "#clock-cells":
    const: 0

  mediatek,ibias:
    description:
      TX DRV bias current for < 1.65Gbps
    $ref: /schemas/types.yaml#/definitions/uint32
    minimum: 0
    maximum: 63
    default: 0xa

  mediatek,ibias_up:
    description:
      TX DRV bias current for >= 1.65Gbps
    $ref: /schemas/types.yaml#/definitions/uint32
    minimum: 0
    maximum: 63
    default: 0x1c

required:
  - compatible
  - reg
  - clocks
  - clock-names
  - clock-output-names
  - "#phy-cells"
  - "#clock-cells"

allOf:
  - if:
      not:
        properties:
          compatible:
            contains:
              const: mediatek,mt8195-hdmi-phy
    then:
      properties:
        clocks:
          maxItems: 1
        clock-names:
          maxItems: 1

additionalProperties: false

examples:
  - |
    #include <dt-bindings/clock/mt8173-clk.h>
    hdmi_phy: hdmi-phy@10209100 {
        compatible = "mediatek,mt8173-hdmi-phy";
        reg = <0x10209100 0x24>;
        clocks = <&apmixedsys CLK_APMIXED_HDMI_REF>;
        clock-names = "pll_ref";
        clock-output-names = "hdmitx_dig_cts";
        mediatek,ibias = <0xa>;
        mediatek,ibias_up = <0x1c>;
        #clock-cells = <0>;
        #phy-cells = <0>;
    };

...
```

## Documentation/devicetree/bindings/phy/mediatek,mt7621-pci-phy.yaml
```yaml
# SPDX-License-Identifier: (GPL-2.0-only or BSD-2-Clause)
%YAML 1.2
---
$id: http://devicetree.org/schemas/phy/mediatek,mt7621-pci-phy.yaml#
$schema: http://devicetree.org/meta-schemas/core.yaml#

title: Mediatek Mt7621 PCIe PHY

maintainers:
  - Sergio Paracuellos <sergio.paracuellos@gmail.com>

properties:
  compatible:
    const: mediatek,mt7621-pci-phy

  reg:
    maxItems: 1

  clocks:
    maxItems: 1

  "#phy-cells":
    const: 1
    description: selects if the phy is dual-ported

required:
  - compatible
  - reg
  - clocks
  - "#phy-cells"

additionalProperties: false

examples:
  - |
    pcie0_phy: pcie-phy@1e149000 {
      compatible = "mediatek,mt7621-pci-phy";
      reg = <0x1e149000 0x0700>;
      clocks = <&sysc 0>;
      #phy-cells = <1>;
    };
```

## Documentation/devicetree/bindings/phy/mediatek,mt7628-usbphy.yaml
```yaml
# SPDX-License-Identifier: (GPL-2.0-only OR BSD-2-Clause)
%YAML 1.2
---
$id: http://devicetree.org/schemas/phy/mediatek,mt7628-usbphy.yaml#
$schema: http://devicetree.org/meta-schemas/core.yaml#

title: Mediatek/Ralink USB PHY

maintainers:
  - Sergio Paracuellos <sergio.paracuellos@gmail.com>

properties:
  compatible:
    enum:
      - mediatek,mt7620-usbphy
      - mediatek,mt7628-usbphy
      - ralink,rt3352-usbphy

  reg:
    maxItems: 1

  "#phy-cells":
    const: 0

  ralink,sysctl:
    description:
      phandle to a ralink syscon register region.
    $ref: /schemas/types.yaml#/definitions/phandle

  resets:
    items:
      - description: USB Host reset controller
      - description: USB Device reset controller

  reset-names:
    items:
      - const: host
      - const: device

required:
  - compatible
  - "#phy-cells"
  - ralink,sysctl
  - resets
  - reset-names

allOf:
  - if:
      properties:
        compatible:
          contains:
            const: mediatek,mt7628-usbphy
    then:
      required:
        - reg
    else:
      properties:
        reg: false

additionalProperties: false

examples:
  - |
    phy@10120000 {
      compatible = "mediatek,mt7628-usbphy";
      reg = <0x10120000 0x1000>;
      #phy-cells = <0>;
      ralink,sysctl = <&sysc>;
      resets = <&rstctrl 22>,
               <&rstctrl 25>;
      reset-names = "host", "device";
    };

...
```
