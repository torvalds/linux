## Documentation/devicetree/bindings/phy/mediatek,mt7988-xfi-tphy.yaml
```yaml
# SPDX-License-Identifier: (GPL-2.0-only OR BSD-2-Clause)
%YAML 1.2
---
$id: http://devicetree.org/schemas/phy/mediatek,mt7988-xfi-tphy.yaml#
$schema: http://devicetree.org/meta-schemas/core.yaml#

title: MediaTek MT7988 XFI T-PHY

maintainers:
  - Daniel Golle <daniel@makrotopia.org>

description:
  The MediaTek XFI SerDes T-PHY provides the physical SerDes lanes
  used by the (10G/5G) USXGMII PCS and (1G/2.5G) LynxI PCS found in
  MediaTek's 10G-capabale MT7988 SoC.
  In MediaTek's SDK sources, this unit is referred to as "pextp".

properties:
  compatible:
    const: mediatek,mt7988-xfi-tphy

  reg:
    maxItems: 1

  clocks:
    items:
      - description: XFI PHY clock
      - description: XFI register clock

  clock-names:
    items:
      - const: xfipll
      - const: topxtal

  resets:
    items:
      - description: Reset controller corresponding to the phy instance.

  mediatek,usxgmii-performance-errata:
    $ref: /schemas/types.yaml#/definitions/flag
    description:
      One instance of the T-PHY on MT7988 suffers from a performance
      problem in 10GBase-R mode which needs a work-around in the driver.
      This flag enables a work-around ajusting an analog phy setting and
      is required for XFI Port0 of the MT7988 SoC to be in compliance with
      the SFP specification.

  "#phy-cells":
    const: 0

required:
  - compatible
  - reg
  - clocks
  - clock-names
  - resets
  - "#phy-cells"

additionalProperties: false

examples:
  - |
    #include <dt-bindings/clock/mediatek,mt7988-clk.h>
    soc {
      #address-cells = <2>;
      #size-cells = <2>;

      phy@11f20000 {
        compatible = "mediatek,mt7988-xfi-tphy";
        reg = <0 0x11f20000 0 0x10000>;
        clocks = <&xfi_pll CLK_XFIPLL_PLL_EN>,
                 <&topckgen CLK_TOP_XFI_PHY_0_XTAL_SEL>;
        clock-names = "xfipll", "topxtal";
        resets = <&watchdog 14>;
        mediatek,usxgmii-performance-errata;
        #phy-cells = <0>;
      };
    };

...
```

## Documentation/devicetree/bindings/phy/mediatek,mt8365-csi-rx.yaml
```yaml
# SPDX-License-Identifier: (GPL-2.0-only OR BSD-2-Clause)
# Copyright (c) 2023 MediaTek, BayLibre
%YAML 1.2
---
$id: http://devicetree.org/schemas/phy/mediatek,mt8365-csi-rx.yaml#
$schema: http://devicetree.org/meta-schemas/core.yaml#

title: Mediatek Sensor Interface MIPI CSI CD-PHY

maintainers:
  - Julien Stephan <jstephan@baylibre.com>
  - Andy Hsieh <andy.hsieh@mediatek.com>

description:
  The SENINF CD-PHY is a set of CD-PHY connected to the SENINF CSI-2
  receivers. The number of PHYs depends on the SoC model.
  Depending on the SoC model, each PHYs can be either CD-PHY or D-PHY only
  capable.

properties:
  compatible:
    enum:
      - mediatek,mt8365-csi-rx

  reg:
    maxItems: 1

  num-lanes:
    enum: [2, 3, 4]

  '#phy-cells':
    enum: [0, 1]
    description: |
      If the PHY doesn't support mode selection then #phy-cells must be 0 and
      PHY mode is described using phy-type property.
      If the PHY supports mode selection, then #phy-cells must be 1 and mode
      is set in the PHY cells. Supported modes are:
        - PHY_TYPE_DPHY
        - PHY_TYPE_CPHY
      See include/dt-bindings/phy/phy.h for constants.

  phy-type:
    description:
      If the PHY doesn't support mode selection then this set the operating mode.
      See include/dt-bindings/phy/phy.h for constants.
    const: 10
    $ref: /schemas/types.yaml#/definitions/uint32

required:
  - compatible
  - reg
  - num-lanes
  - '#phy-cells'

additionalProperties: false

examples:
  - |
    #include <dt-bindings/phy/phy.h>
    soc {
      #address-cells = <2>;
      #size-cells = <2>;

      csi0_rx: phy@11c10000 {
        compatible = "mediatek,mt8365-csi-rx";
        reg = <0 0x11c10000 0 0x2000>;
        num-lanes = <2>;
        #phy-cells = <1>;
      };

      csi1_rx: phy@11c12000 {
        compatible = "mediatek,mt8365-csi-rx";
        reg = <0 0x11c12000 0 0x2000>;
        phy-type = <PHY_TYPE_DPHY>;
        num-lanes = <2>;
        #phy-cells = <0>;
      };
    };
...
```

## Documentation/devicetree/bindings/phy/mediatek,pcie-phy.yaml
```yaml
# SPDX-License-Identifier: (GPL-2.0 OR BSD-2-Clause)
%YAML 1.2
---
$id: http://devicetree.org/schemas/phy/mediatek,pcie-phy.yaml#
$schema: http://devicetree.org/meta-schemas/core.yaml#

title: MediaTek PCIe PHY

maintainers:
  - Jianjun Wang <jianjun.wang@mediatek.com>

description: |
  The PCIe PHY supports physical layer functionality for PCIe Gen3 port.

properties:
  compatible:
    const: mediatek,mt8195-pcie-phy

  reg:
    maxItems: 1

  reg-names:
    items:
      - const: sif

  "#phy-cells":
    const: 0

  nvmem-cells:
    maxItems: 7
    description:
      Phandles to nvmem cell that contains the efuse data, if unspecified,
      default value is used.

  nvmem-cell-names:
    items:
      - const: glb_intr
      - const: tx_ln0_pmos
      - const: tx_ln0_nmos
      - const: rx_ln0
      - const: tx_ln1_pmos
      - const: tx_ln1_nmos
      - const: rx_ln1

  power-domains:
    maxItems: 1

required:
  - compatible
  - reg
  - reg-names
  - "#phy-cells"

additionalProperties: false

examples:
  - |
    phy@11e80000 {
        compatible = "mediatek,mt8195-pcie-phy";
        #phy-cells = <0>;
        reg = <0x11e80000 0x10000>;
        reg-names = "sif";
        nvmem-cells = <&pciephy_glb_intr>,
                      <&pciephy_tx_ln0_pmos>,
                      <&pciephy_tx_ln0_nmos>,
                      <&pciephy_rx_ln0>,
                      <&pciephy_tx_ln1_pmos>,
                      <&pciephy_tx_ln1_nmos>,
                      <&pciephy_rx_ln1>;
        nvmem-cell-names = "glb_intr", "tx_ln0_pmos",
                           "tx_ln0_nmos", "rx_ln0",
                           "tx_ln1_pmos", "tx_ln1_nmos",
                           "rx_ln1";
        power-domains = <&spm 2>;
    };
```

## Documentation/devicetree/bindings/phy/mediatek,tphy.yaml
```yaml
# SPDX-License-Identifier: (GPL-2.0-only OR BSD-2-Clause)
# Copyright (c) 2020 MediaTek
%YAML 1.2
---
$id: http://devicetree.org/schemas/phy/mediatek,tphy.yaml#
$schema: http://devicetree.org/meta-schemas/core.yaml#

title: MediaTek T-PHY Controller Device Tree Bindings

maintainers:
  - Chunfeng Yun <chunfeng.yun@mediatek.com>

description: |
  The T-PHY controller supports physical layer functionality for a number of
  controllers on MediaTek SoCs, includes USB2.0, USB3.0, PCIe and SATA.

  Layout differences of banks between T-PHY V1 (mt8173/mt2701) and
  T-PHY V2 (mt2712) when works on USB mode:
  -----------------------------------
  Version 1:
  port        offset    bank
  shared      0x0000    SPLLC
              0x0100    FMREG
  u2 port0    0x0800    U2PHY_COM
  u3 port0    0x0900    U3PHYD
              0x0a00    U3PHYD_BANK2
              0x0b00    U3PHYA
              0x0c00    U3PHYA_DA
  u2 port1    0x1000    U2PHY_COM
  u3 port1    0x1100    U3PHYD
              0x1200    U3PHYD_BANK2
              0x1300    U3PHYA
              0x1400    U3PHYA_DA
  u2 port2    0x1800    U2PHY_COM
              ...

  Version 2:
  port        offset    bank
  u2 port0    0x0000    MISC
              0x0100    FMREG
              0x0300    U2PHY_COM
  u3 port0    0x0700    SPLLC
              0x0800    CHIP
              0x0900    U3PHYD
              0x0a00    U3PHYD_BANK2
              0x0b00    U3PHYA
              0x0c00    U3PHYA_DA
  u2 port1    0x1000    MISC
              0x1100    FMREG
              0x1300    U2PHY_COM
  u3 port1    0x1700    SPLLC
              0x1800    CHIP
              0x1900    U3PHYD
              0x1a00    U3PHYD_BANK2
              0x1b00    U3PHYA
              0x1c00    U3PHYA_DA
  u2 port2    0x2000    MISC
              ...

  SPLLC shared by u3 ports and FMREG shared by u2 ports on V1 are put back
  into each port; a new bank MISC for u2 ports and CHIP for u3 ports are
  added on V2.

properties:
  $nodename:
    pattern: "^t-phy@[0-9a-f]+$"

  compatible:
    oneOf:
      - items:
          - enum:
              - mediatek,mt2701-tphy
              - mediatek,mt7623-tphy
              - mediatek,mt7622-tphy
              - mediatek,mt8516-tphy
          - const: mediatek,generic-tphy-v1
      - items:
          - enum:
              - mediatek,mt2712-tphy
              - mediatek,mt7629-tphy
              - mediatek,mt8183-tphy
              - mediatek,mt8195-tphy
          - const: mediatek,generic-tphy-v2
      - const: mediatek,mt2701-u3phy
        deprecated: true
      - const: mediatek,mt2712-u3phy
        deprecated: true
      - const: mediatek,mt8173-u3phy

  reg:
    description:
      Register shared by multiple ports, exclude port's private register.
      It is needed for T-PHY V1, such as mt2701 and mt8173, but not for
      T-PHY V2, such as mt2712.
    maxItems: 1

  "#address-cells":
    enum: [1, 2]

  "#size-cells":
    enum: [1, 2]

  # Used with non-empty value if optional 'reg' is not provided.
  # The format of the value is an arbitrary number of triplets of
  # (child-bus-address, parent-bus-address, length).
  ranges: true

  mediatek,src-ref-clk-mhz:
    description:
      Frequency of reference clock for slew rate calibrate
    default: 26

  mediatek,src-coef:
    description:
      Coefficient for slew rate calibrate, depends on SoC process
    $ref: /schemas/types.yaml#/definitions/uint32
    default: 28

# Required child node:
patternProperties:
  "^(usb|pcie|sata)-phy@[0-9a-f]+$":
    type: object
    description:
      A sub-node is required for each port the controller provides.
      Address range information including the usual 'reg' property
      is used inside these nodes to describe the controller's topology.

    properties:
      reg:
        maxItems: 1

      clocks:
        minItems: 1
        items:
          - description: Reference clock, (HS is 48Mhz, SS/P is 24~27Mhz)
          - description: Reference clock of analog phy
        description:
          Uses both clocks if the clock of analog and digital phys are
          separated, otherwise uses "ref" clock only if needed.

      clock-names:
        minItems: 1
        items:
          - const: ref
          - const: da_ref

      "#phy-cells":
        const: 1
        description: |
          The cells contain the following arguments.

          - description: The PHY type
              enum:
                - PHY_TYPE_USB2
                - PHY_TYPE_USB3
                - PHY_TYPE_PCIE
                - PHY_TYPE_SATA

      # The following optional vendor properties are only for debug or HQA test
      mediatek,eye-src:
        description:
          The value of slew rate calibrate (U2 phy)
        $ref: /schemas/types.yaml#/definitions/uint32
        minimum: 1
        maximum: 7

      mediatek,eye-vrt:
        description:
          The selection of VRT reference voltage (U2 phy)
        $ref: /schemas/types.yaml#/definitions/uint32
        minimum: 1
        maximum: 7

      mediatek,eye-term:
        description:
          The selection of HS_TX TERM reference voltage (U2 phy)
        $ref: /schemas/types.yaml#/definitions/uint32
        minimum: 1
        maximum: 7

      mediatek,intr:
        description:
          The selection of internal resistor (U2 phy)
        $ref: /schemas/types.yaml#/definitions/uint32
        minimum: 1
        maximum: 31

      mediatek,discth:
        description:
          The selection of disconnect threshold (U2 phy)
        $ref: /schemas/types.yaml#/definitions/uint32
        minimum: 1
        maximum: 15

      mediatek,bc12:
        description:
          Specify the flag to enable BC1.2 if support it
        type: boolean

    required:
      - reg
      - "#phy-cells"

    additionalProperties: false

required:
  - compatible
  - "#address-cells"
  - "#size-cells"
  - ranges

additionalProperties: false

examples:
  - |
    #include <dt-bindings/clock/mt8173-clk.h>
    #include <dt-bindings/interrupt-controller/arm-gic.h>
    #include <dt-bindings/interrupt-controller/irq.h>
    #include <dt-bindings/phy/phy.h>
    usb@11271000 {
        compatible = "mediatek,mt8173-mtu3", "mediatek,mtu3";
        reg = <0x11271000 0x3000>, <0x11280700 0x0100>;
        reg-names = "mac", "ippc";
        phys = <&u2port0 PHY_TYPE_USB2>,
               <&u3port0 PHY_TYPE_USB3>,
               <&u2port1 PHY_TYPE_USB2>;
        interrupts = <GIC_SPI 115 IRQ_TYPE_LEVEL_LOW>;
        clocks = <&topckgen CLK_TOP_USB30_SEL>;
        clock-names = "sys_ck";
    };

    t-phy@11290000 {
        compatible = "mediatek,mt8173-u3phy";
        reg = <0x11290000 0x800>;
        #address-cells = <1>;
        #size-cells = <1>;
        ranges;

        u2port0: usb-phy@11290800 {
            reg = <0x11290800 0x100>;
            clocks = <&apmixedsys CLK_APMIXED_REF2USB_TX>, <&clk48m>;
            clock-names = "ref", "da_ref";
            #phy-cells = <1>;
        };

        u3port0: usb-phy@11290900 {
            reg = <0x11290900 0x700>;
            clocks = <&clk26m>;
            clock-names = "ref";
            #phy-cells = <1>;
        };

        u2port1: usb-phy@11291000 {
            reg = <0x11291000 0x100>;
            #phy-cells = <1>;
        };
    };

...
```

## Documentation/devicetree/bindings/phy/mediatek,ufs-phy.yaml
```yaml
# SPDX-License-Identifier: (GPL-2.0-only OR BSD-2-Clause)
# Copyright (c) 2020 MediaTek
%YAML 1.2
---
$id: http://devicetree.org/schemas/phy/mediatek,ufs-phy.yaml#
$schema: http://devicetree.org/meta-schemas/core.yaml#

title: MediaTek Universal Flash Storage (UFS) M-PHY binding

maintainers:
  - Stanley Chu <stanley.chu@mediatek.com>
  - Chunfeng Yun <chunfeng.yun@mediatek.com>

description: |
  UFS M-PHY nodes are defined to describe on-chip UFS M-PHY hardware macro.
  Each UFS M-PHY node should have its own node.
  To bind UFS M-PHY with UFS host controller, the controller node should
  contain a phandle reference to UFS M-PHY node.

properties:
  $nodename:
    pattern: "^ufs-phy@[0-9a-f]+$"

  compatible:
    const: mediatek,mt8183-ufsphy

  reg:
    maxItems: 1

  clocks:
    items:
      - description: Unipro core control clock.
      - description: M-PHY core control clock.

  clock-names:
    items:
      - const: unipro
      - const: mp

  "#phy-cells":
    const: 0

required:
  - compatible
  - reg
  - "#phy-cells"
  - clocks
  - clock-names

additionalProperties: false

examples:
  - |
    #include <dt-bindings/clock/mt8183-clk.h>
    ufsphy: ufs-phy@11fa0000 {
        compatible = "mediatek,mt8183-ufsphy";
        reg = <0x11fa0000 0xc000>;
        clocks = <&infracfg CLK_INFRA_UNIPRO_SCK>,
                 <&infracfg CLK_INFRA_UFS_MP_SAP_BCLK>;
        clock-names = "unipro", "mp";
        #phy-cells = <0>;
    };

...
```
