## Documentation/devicetree/bindings/phy/lantiq,ase-usb2-phy.yaml
```yaml
# SPDX-License-Identifier: (GPL-2.0-only OR BSD-2-Clause)
%YAML 1.2
---
$id: http://devicetree.org/schemas/phy/lantiq,ase-usb2-phy.yaml#
$schema: http://devicetree.org/meta-schemas/core.yaml#

title: Lantiq XWAY SoC RCU USB 1.1/2.0 PHY

maintainers:
  - Hauke Mehrtens <hauke@hauke-m.de>

description:
  This node has to be a sub node of the Lantiq RCU block.

properties:
  compatible:
    items:
      - enum:
          - lantiq,ase-usb2-phy
          - lantiq,danube-usb2-phy
          - lantiq,xrx100-usb2-phy
          - lantiq,xrx200-usb2-phy
          - lantiq,xrx300-usb2-phy

  reg:
    items:
      - description: Offset of the USB PHY configuration register
      - description: Offset of the USB Analog configuration register

  clocks:
    maxItems: 1

  clock-names:
    items:
      - const: phy

  resets:
    minItems: 1
    maxItems: 2

  reset-names:
    minItems: 1
    items:
      - enum: [ phy, ctrl ]
      - const: ctrl

  '#phy-cells':
    const: 0

required:
  - compatible
  - reg
  - clocks
  - clock-names
  - resets
  - reset-names
  - '#phy-cells'

additionalProperties: false

examples:
  - |
    usb2-phy@18 {
        compatible = "lantiq,xrx200-usb2-phy";
        reg = <0x18 4>, <0x38 4>;
        clocks = <&pmu 1>;
        clock-names = "phy";
        resets = <&reset1 4 4>, <&reset0 4 4>;
        reset-names = "phy", "ctrl";
        #phy-cells = <0>;
    };
```

## Documentation/devicetree/bindings/phy/lantiq,vrx200-pcie-phy.yaml
```yaml
# SPDX-License-Identifier: (GPL-2.0-only OR BSD-2-Clause)
%YAML 1.2
---
$id: http://devicetree.org/schemas/phy/lantiq,vrx200-pcie-phy.yaml#
$schema: http://devicetree.org/meta-schemas/core.yaml#

title: Lantiq VRX200 and ARX300 PCIe PHY

maintainers:
  - Martin Blumenstingl <martin.blumenstingl@googlemail.com>

properties:
  "#phy-cells":
    const: 1
    description: selects the PHY mode as defined in <dt-bindings/phy/phy-lantiq-vrx200-pcie.h>

  compatible:
    enum:
      - lantiq,vrx200-pcie-phy
      - lantiq,arx300-pcie-phy

  reg:
    maxItems: 1

  clocks:
    items:
      - description: PHY module clock
      - description: PDI register clock

  clock-names:
    items:
      - const: phy
      - const: pdi

  resets:
    items:
      - description: exclusive PHY reset line
      - description: shared reset line between the PCIe PHY and PCIe controller

  reset-names:
    items:
      - const: phy
      - const: pcie

  lantiq,rcu:
    $ref: /schemas/types.yaml#/definitions/phandle
    description: phandle to the RCU syscon

  lantiq,rcu-endian-offset:
    $ref: /schemas/types.yaml#/definitions/uint32
    description: the offset of the endian registers for this PHY instance in the RCU syscon

  lantiq,rcu-big-endian-mask:
    $ref: /schemas/types.yaml#/definitions/uint32
    description: the mask to set the PDI (PHY) registers for this PHY instance to big endian

  big-endian:
    description: Configures the PDI (PHY) registers in big-endian mode
    type: boolean

  little-endian:
    description: Configures the PDI (PHY) registers in big-endian mode
    type: boolean

required:
  - "#phy-cells"
  - compatible
  - reg
  - clocks
  - clock-names
  - resets
  - reset-names
  - lantiq,rcu
  - lantiq,rcu-endian-offset
  - lantiq,rcu-big-endian-mask

additionalProperties: false

examples:
  - |
    pcie0_phy: phy@106800 {
        compatible = "lantiq,vrx200-pcie-phy";
        reg = <0x106800 0x100>;
        lantiq,rcu = <&rcu0>;
        lantiq,rcu-endian-offset = <0x4c>;
        lantiq,rcu-big-endian-mask = <0x80>; /* bit 7 */
        big-endian;
        clocks = <&pmu 32>, <&pmu 36>;
        clock-names = "phy", "pdi";
        resets = <&reset0 12 24>, <&reset0 22 22>;
        reset-names = "phy", "pcie";
        #phy-cells = <1>;
    };

...
```

## Documentation/devicetree/bindings/phy/marvell,armada-3700-utmi-phy.yaml
```yaml
# SPDX-License-Identifier: (GPL-2.0 OR BSD-2-Clause)

%YAML 1.2
---
$id: http://devicetree.org/schemas/phy/marvell,armada-3700-utmi-phy.yaml#
$schema: http://devicetree.org/meta-schemas/core.yaml#

title: Marvell Armada UTMI/UTMI+ PHY

maintainers:
  - Miquel Raynal <miquel.raynal@bootlin.com>

description:
  On Armada 3700, there are two USB controllers, one is compatible with
  the USB2 and USB3 specifications and supports OTG. The other one is USB2
  compliant and only supports host mode. Both of these controllers come with
  a slightly different UTMI PHY.

properties:
  compatible:
    enum:
      - marvell,a3700-utmi-host-phy
      - marvell,a3700-utmi-otg-phy
  reg:
    maxItems: 1

  "#phy-cells":
    const: 0

  marvell,usb-misc-reg:
    description:
      Phandle on the "USB miscellaneous registers" shared region
      covering registers related to both the host controller and
      the PHY.
    $ref: /schemas/types.yaml#/definitions/phandle

required:
  - compatible
  - reg
  - "#phy-cells"
  - marvell,usb-misc-reg

additionalProperties: false

examples:
  - |
    usb2_utmi_host_phy: phy@5f000 {
      compatible = "marvell,a3700-utmi-host-phy";
      reg = <0x5f000 0x800>;
      marvell,usb-misc-reg = <&usb2_syscon>;
      #phy-cells = <0>;
    };

    usb2_syscon: system-controller@5f800 {
      compatible = "marvell,armada-3700-usb2-host-misc", "syscon";
      reg = <0x5f800 0x800>;
    };
```

## Documentation/devicetree/bindings/phy/marvell,armada-375-usb-cluster.yaml
```yaml
# SPDX-License-Identifier: (GPL-2.0-only OR BSD-2-Clause)
%YAML 1.2
---
$id: http://devicetree.org/schemas/phy/marvell,armada-375-usb-cluster.yaml#
$schema: http://devicetree.org/meta-schemas/core.yaml#

title: Armada 375 USB Cluster

maintainers:
  - Andrew Lunn <andrew@lunn.ch>
  - Gregory Clement <gregory.clement@bootlin.com>

description:
  Control register for the Armada 375 USB cluster, managing USB2 and USB3 features.

properties:
  compatible:
    const: marvell,armada-375-usb-cluster

  reg:
    maxItems: 1

  '#phy-cells':
    description: Number of PHY cells in specifier. 1 for USB2, 2 for USB3.
    const: 1

required:
  - compatible
  - reg
  - '#phy-cells'

additionalProperties: false

examples:
  - |
    usbcluster: usb-cluster@18400 {
        compatible = "marvell,armada-375-usb-cluster";
        reg = <0x18400 0x4>;
        #phy-cells = <1>;
    };
```

## Documentation/devicetree/bindings/phy/marvell,armada-380-comphy.yaml
```yaml
# SPDX-License-Identifier: (GPL-2.0-only OR BSD-2-Clause)
%YAML 1.2
---
$id: http://devicetree.org/schemas/phy/marvell,armada-380-comphy.yaml#
$schema: http://devicetree.org/meta-schemas/core.yaml#

title: Marvell Armada 38x COMPHY controller

maintainers:
  - Andrew Lunn <andrew@lunn.ch>
  - Gregory Clement <gregory.clement@bootlin.com>

description:
  This comphy controller can be found on Marvell Armada 38x. It provides a
  number of shared PHYs used by various interfaces (network, sata, usb,
  PCIe...).

properties:
  compatible:
    items:
      - const: marvell,armada-380-comphy

  reg:
    items:
      - description: COMPHY register location and length
      - description: Configuration register location and length

  reg-names:
    items:
      - const: comphy
      - const: conf

  '#address-cells':
    const: 1

  '#size-cells':
    const: 0

patternProperties:
  '^phy@[0-5]$':
    description: A COMPHY lane
    type: object
    additionalProperties: false

    properties:
      reg:
        maximum: 1

      '#phy-cells':
        description: Input port index for the PHY lane
        const: 1

    required:
      - reg
      - '#phy-cells'

required:
  - compatible
  - reg
  - '#address-cells'
  - '#size-cells'

additionalProperties: false

examples:
  - |
    comphy: phy@18300 {
        compatible = "marvell,armada-380-comphy";
        reg = <0x18300 0x100>, <0x18460 4>;
        reg-names = "comphy", "conf";
        #address-cells = <1>;
        #size-cells = <0>;

        cpm_comphy0: phy@0 {
            reg = <0>;
            #phy-cells = <1>;
        };

        cpm_comphy1: phy@1 {
            reg = <1>;
            #phy-cells = <1>;
        };
    };
```

## Documentation/devicetree/bindings/phy/marvell,armada-cp110-utmi-phy.yaml
```yaml
# SPDX-License-Identifier: (GPL-2.0 OR BSD-2-Clause)

%YAML 1.2
---
$id: "http://devicetree.org/schemas/phy/marvell,armada-cp110-utmi-phy.yaml#"
$schema: "http://devicetree.org/meta-schemas/core.yaml#"

title: Marvell Armada CP110/CP115 UTMI PHY

maintainers:
  - Konstantin Porotchkin <kostap@marvell.com>

description:
  On Armada 7k/8k and CN913x, there are two host and one device USB controllers.
  Each of two exiting UTMI PHYs could be connected to either USB host or USB device
  controller.
  The USB device controller can only be connected to a single UTMI PHY port
                      0.H----- USB HOST0
  UTMI PHY0  --------/
                      0.D-----0
                               \------ USB DEVICE
                      1.D-----1
  UTMI PHY1  --------\
                      1.H----- USB HOST1

properties:
  compatible:
    const: marvell,cp110-utmi-phy

  reg:
    maxItems: 1

  "#address-cells":
    const: 1

  "#size-cells":
    const: 0

  marvell,system-controller:
    description:
      Phandle to the system controller node
    $ref: /schemas/types.yaml#/definitions/phandle

#Required child nodes:

patternProperties:
  "^usb-phy@[0|1]$":
    type: object
    description:
      Each UTMI PHY port must be represented as a sub-node.

    properties:
      reg:
        description: phy port index.
        maxItems: 1

      "#phy-cells":
        const: 0

    required:
      - reg
      - "#phy-cells"

    additionalProperties: false

required:
  - compatible
  - reg
  - "#address-cells"
  - "#size-cells"
  - marvell,system-controller

additionalProperties: false

examples:
  - |
    cp0_utmi: utmi@580000 {
      compatible = "marvell,cp110-utmi-phy";
      reg = <0x580000 0x2000>;
      marvell,system-controller = <&cp0_syscon0>;
      #address-cells = <1>;
      #size-cells = <0>;

      cp0_utmi0: usb-phy@0 {
        reg = <0>;
        #phy-cells = <0>;
      };

      cp0_utmi1: usb-phy@1 {
        reg = <1>;
        #phy-cells = <0>;
      };
    };

    cp0_usb3_0 {
      usb-phy = <&cp0_usb3_0_phy0>;
      phys = <&cp0_utmi0>;
      phy-names = "utmi";
      /* UTMI0 is connected to USB host controller (default mode) */
      dr_mode = "host";
    };

    cp0_usb3_1 {
      usb-phy = <&cp0_usb3_0_phy1>;
      phys = <&cp0_utmi1>;
      phy-names = "utmi";
      /* UTMI1 is connected to USB device controller */
      dr_mode = "peripheral";
    };
```

## Documentation/devicetree/bindings/phy/marvell,berlin2-sata-phy.yaml
```yaml
# SPDX-License-Identifier: (GPL-2.0-only OR BSD-2-Clause)
%YAML 1.2
---
$id: http://devicetree.org/schemas/phy/marvell,berlin2-sata-phy.yaml#
$schema: http://devicetree.org/meta-schemas/core.yaml#

title: Marvell Berlin SATA PHY

maintainers:
  - Antoine Tenart <atenart@kernel.org>

properties:
  compatible:
    enum:
      - marvell,berlin2-sata-phy
      - marvell,berlin2q-sata-phy

  reg:
    maxItems: 1

  clocks:
    maxItems: 1

  '#address-cells':
    const: 1

  '#size-cells':
    const: 0

  '#phy-cells':
    const: 1

patternProperties:
  '^sata-phy@[0-1]$':
    description: A SATA PHY sub-node.
    type: object
    additionalProperties: false

    properties:
      reg:
        maximum: 1
        description: PHY index number.

    required:
      - reg

required:
  - compatible
  - reg
  - clocks
  - '#address-cells'
  - '#size-cells'
  - '#phy-cells'

additionalProperties: false

examples:
  - |
    #include <dt-bindings/clock/berlin2q.h>

    phy@f7e900a0 {
        compatible = "marvell,berlin2q-sata-phy";
        reg = <0xf7e900a0 0x200>;
        clocks = <&chip CLKID_SATA>;
        #address-cells = <1>;
        #size-cells = <0>;
        #phy-cells = <1>;

        sata-phy@0 {
            reg = <0>;
        };

        sata-phy@1 {
            reg = <1>;
        };
    };
```

## Documentation/devicetree/bindings/phy/marvell,berlin2-usb-phy.yaml
```yaml
# SPDX-License-Identifier: (GPL-2.0-only OR BSD-2-Clause)
%YAML 1.2
---
$id: http://devicetree.org/schemas/phy/marvell,berlin2-usb-phy.yaml#
$schema: http://devicetree.org/meta-schemas/core.yaml#

title: Marvell Berlin USB PHY

maintainers:
  - Antoine Tenart <atenart@kernel.org>

properties:
  compatible:
    enum:
      - marvell,berlin2-usb-phy
      - marvell,berlin2cd-usb-phy

  reg:
    maxItems: 1

  "#phy-cells":
    const: 0

  resets:
    maxItems: 1

required:
  - compatible
  - reg
  - "#phy-cells"
  - resets

additionalProperties: false

examples:
  - |
    usb-phy@f774000 {
      compatible = "marvell,berlin2-usb-phy";
      reg = <0xf774000 0x128>;
      #phy-cells = <0>;
      resets = <&chip 0x104 14>;
    };
```
