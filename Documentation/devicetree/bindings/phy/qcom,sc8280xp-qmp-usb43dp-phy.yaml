## Documentation/devicetree/bindings/phy/qcom,sc8280xp-qmp-usb43dp-phy.yaml
```yaml
# SPDX-License-Identifier: (GPL-2.0 OR BSD-2-Clause)
%YAML 1.2
---
$id: http://devicetree.org/schemas/phy/qcom,sc8280xp-qmp-usb43dp-phy.yaml#
$schema: http://devicetree.org/meta-schemas/core.yaml#

title: Qualcomm QMP USB4-USB3-DP PHY controller (SC8280XP)

maintainers:
  - Vinod Koul <vkoul@kernel.org>

description:
  The QMP PHY controller supports physical layer functionality for a number of
  controllers on Qualcomm chipsets, such as, PCIe, UFS and USB.

properties:
  compatible:
    enum:
      - qcom,sc7180-qmp-usb3-dp-phy
      - qcom,sc7280-qmp-usb3-dp-phy
      - qcom,sc8180x-qmp-usb3-dp-phy
      - qcom,sc8280xp-qmp-usb43dp-phy
      - qcom,sdm845-qmp-usb3-dp-phy
      - qcom,sm6350-qmp-usb3-dp-phy
      - qcom,sm8150-qmp-usb3-dp-phy
      - qcom,sm8250-qmp-usb3-dp-phy
      - qcom,sm8350-qmp-usb3-dp-phy
      - qcom,sm8450-qmp-usb3-dp-phy
      - qcom,sm8550-qmp-usb3-dp-phy

  reg:
    maxItems: 1

  clocks:
    minItems: 4
    maxItems: 5

  clock-names:
    minItems: 4
    items:
      - const: aux
      - const: ref
      - const: com_aux
      - const: usb3_pipe
      - const: cfg_ahb

  power-domains:
    maxItems: 1

  resets:
    maxItems: 2

  reset-names:
    items:
      - const: phy
      - const: common

  vdda-phy-supply: true

  vdda-pll-supply: true

  "#clock-cells":
    const: 1
    description:
      See include/dt-bindings/phy/phy-qcom-qmp.h

  "#phy-cells":
    const: 1
    description:
      See include/dt-bindings/phy/phy-qcom-qmp.h

  orientation-switch:
    description:
      Flag the PHY as possible handler of USB Type-C orientation switching
    type: boolean

  ports:
    $ref: /schemas/graph.yaml#/properties/ports
    properties:
      port@0:
        $ref: /schemas/graph.yaml#/properties/port
        description: Output endpoint of the PHY

      port@1:
        $ref: /schemas/graph.yaml#/properties/port
        description: Incoming endpoint from the USB controller

      port@2:
        $ref: /schemas/graph.yaml#/properties/port
        description: Incoming endpoint from the DisplayPort controller

required:
  - compatible
  - reg
  - clocks
  - clock-names
  - resets
  - reset-names
  - vdda-phy-supply
  - vdda-pll-supply
  - "#clock-cells"
  - "#phy-cells"

allOf:
  - if:
      properties:
        compatible:
          enum:
            - qcom,sc7180-qmp-usb3-dp-phy
            - qcom,sdm845-qmp-usb3-dp-phy
    then:
      properties:
        clocks:
          maxItems: 5
        clock-names:
          maxItems: 5
    else:
      properties:
        clocks:
          maxItems: 4
        clock-names:
          maxItems: 4

  - if:
      properties:
        compatible:
          enum:
            - qcom,sc8280xp-qmp-usb43dp-phy
            - qcom,sm6350-qmp-usb3-dp-phy
            - qcom,sm8550-qmp-usb3-dp-phy
    then:
      required:
        - power-domains
    else:
      properties:
        power-domains: false

additionalProperties: false

examples:
  - |
    #include <dt-bindings/clock/qcom,gcc-sc8280xp.h>

    phy@88eb000 {
      compatible = "qcom,sc8280xp-qmp-usb43dp-phy";
      reg = <0x088eb000 0x4000>;

      clocks = <&gcc GCC_USB3_PRIM_PHY_AUX_CLK>,
               <&gcc GCC_USB4_EUD_CLKREF_CLK>,
               <&gcc GCC_USB3_PRIM_PHY_COM_AUX_CLK>,
               <&gcc GCC_USB3_PRIM_PHY_PIPE_CLK>;
      clock-names = "aux", "ref", "com_aux", "usb3_pipe";

      power-domains = <&gcc USB30_PRIM_GDSC>;

      resets = <&gcc GCC_USB3_PHY_PRIM_BCR>,
               <&gcc GCC_USB4_DP_PHY_PRIM_BCR>;
      reset-names = "phy", "common";

      vdda-phy-supply = <&vreg_l9d>;
      vdda-pll-supply = <&vreg_l4d>;

      orientation-switch;

      #clock-cells = <1>;
      #phy-cells = <1>;

      ports {
          #address-cells = <1>;
          #size-cells = <0>;

          port@0 {
              reg = <0>;

              endpoint {
                  remote-endpoint = <&typec_connector_ss>;
              };
          };

          port@1 {
              reg = <1>;

              endpoint {
                  remote-endpoint = <&dwc3_ss_out>;
              };
          };

          port@2 {
              reg = <2>;

              endpoint {
                  remote-endpoint = <&mdss_dp_out>;
              };
          };
      };
    };
```

## Documentation/devicetree/bindings/phy/qcom,snps-eusb2-phy.yaml
```yaml
# SPDX-License-Identifier: (GPL-2.0 OR BSD-2-Clause)
%YAML 1.2
---
$id: http://devicetree.org/schemas/phy/qcom,snps-eusb2-phy.yaml#
$schema: http://devicetree.org/meta-schemas/core.yaml#

title: Qualcomm SNPS eUSB2 phy controller

maintainers:
  - Abel Vesa <abel.vesa@linaro.org>

description:
  eUSB2 controller supports LS/FS/HS usb connectivity on Qualcomm chipsets.

properties:
  compatible:
    oneOf:
      - items:
          - enum:
              - qcom,sdx75-snps-eusb2-phy
          - const: qcom,sm8550-snps-eusb2-phy
      - const: qcom,sm8550-snps-eusb2-phy

  reg:
    maxItems: 1

  "#phy-cells":
    const: 0

  clocks:
    items:
      - description: ref

  clock-names:
    items:
      - const: ref

  resets:
    maxItems: 1

  phys:
    maxItems: 1
    description:
      Phandle to eUSB2 to USB 2.0 repeater

  vdd-supply:
    description:
      Phandle to 0.88V regulator supply to PHY digital circuit.

  vdda12-supply:
    description:
      Phandle to 1.2V regulator supply to PHY refclk pll block.

required:
  - compatible
  - reg
  - "#phy-cells"
  - clocks
  - clock-names
  - vdd-supply
  - vdda12-supply
  - resets

additionalProperties: false

examples:
  - |
    #include <dt-bindings/clock/qcom,sm8550-gcc.h>
    #include <dt-bindings/clock/qcom,rpmh.h>
    #include <dt-bindings/clock/qcom,sm8550-tcsr.h>

    usb_1_hsphy: phy@88e3000 {
        compatible = "qcom,sm8550-snps-eusb2-phy";
        reg = <0x88e3000 0x154>;
        #phy-cells = <0>;

        clocks = <&tcsrcc TCSR_USB2_CLKREF_EN>;
        clock-names = "ref";

        vdd-supply = <&vreg_l1e_0p88>;
        vdda12-supply = <&vreg_l3e_1p2>;

        resets = <&gcc GCC_QUSB2PHY_PRIM_BCR>;
    };
```

## Documentation/devicetree/bindings/phy/qcom,snps-eusb2-repeater.yaml
```yaml
# SPDX-License-Identifier: (GPL-2.0 OR BSD-2-Clause)
%YAML 1.2
---
$id: http://devicetree.org/schemas/phy/qcom,snps-eusb2-repeater.yaml#
$schema: http://devicetree.org/meta-schemas/core.yaml#

title: Qualcomm Synopsis eUSB2 to USB 2.0 repeater

maintainers:
  - Abel Vesa <abel.vesa@linaro.org>

description:
  eUSB2 repeater converts between eUSB2 and USB 2.0 signaling levels and
  allows a eUSB2 PHY to connect to legacy USB 2.0 products

properties:
  compatible:
    oneOf:
      - items:
          - enum:
              - qcom,pm7550ba-eusb2-repeater
          - const: qcom,pm8550b-eusb2-repeater
      - enum:
          - qcom,pm8550b-eusb2-repeater
          - qcom,smb2360-eusb2-repeater

  reg:
    maxItems: 1

  "#phy-cells":
    const: 0

  vdd18-supply: true

  vdd3-supply: true

  qcom,tune-usb2-disc-thres:
    $ref: /schemas/types.yaml#/definitions/uint8
    description: High-Speed disconnect threshold
    minimum: 0
    maximum: 7
    default: 0

  qcom,tune-usb2-amplitude:
    $ref: /schemas/types.yaml#/definitions/uint8
    description: High-Speed trasmit amplitude
    minimum: 0
    maximum: 15
    default: 8

  qcom,tune-usb2-preem:
    $ref: /schemas/types.yaml#/definitions/uint8
    description: High-Speed TX pre-emphasis tuning
    minimum: 0
    maximum: 7
    default: 5

required:
  - compatible
  - reg
  - "#phy-cells"

additionalProperties: false

examples:
  - |
    #include <dt-bindings/spmi/spmi.h>

    pmic@7 {
      reg = <0x7 SPMI_USID>;
      #address-cells = <1>;
      #size-cells = <0>;

      pm8550b_eusb2_repeater: phy@fd00 {
        compatible = "qcom,pm8550b-eusb2-repeater";
        reg = <0xfd00>;
        #phy-cells = <0>;
      };
    };
...
```

## Documentation/devicetree/bindings/phy/qcom,usb-8x16-phy.txt
```
Qualcomm's APQ8016/MSM8916 USB transceiver controller

- compatible:
    Usage: required
    Value type: <string>
    Definition: Should contain "qcom,usb-8x16-phy".

- reg:
    Usage: required
    Value type: <prop-encoded-array>
    Definition: USB PHY base address and length of the register map

- clocks:
    Usage: required
    Value type: <prop-encoded-array>
    Definition: See clock-bindings.txt section "consumers". List of
                two clock specifiers for interface and core controller
                clocks.

- clock-names:
    Usage: required
    Value type: <string>
    Definition: Must contain "iface" and "core" strings.

- vddcx-supply:
    Usage: required
    Value type: <phandle>
    Definition: phandle to the regulator VDCCX supply node.

- v1p8-supply:
    Usage: required
    Value type: <phandle>
    Definition: phandle to the regulator 1.8V supply node.

- v3p3-supply:
    Usage: required
    Value type: <phandle>
    Definition: phandle to the regulator 3.3V supply node.

- resets:
    Usage: required
    Value type: <prop-encoded-array>
    Definition: See reset.txt section "consumers". PHY reset specifier.

- reset-names:
    Usage: required
    Value type: <string>
    Definition: Must contain "phy" string.

- switch-gpio:
    Usage: optional
    Value type: <prop-encoded-array>
    Definition: Some boards are using Dual SPDT USB Switch, witch is
                controlled by GPIO to de/multiplex D+/D- USB lines
                between connectors.

Example:
	usb_phy: phy@78d9000 {
		compatible = "qcom,usb-8x16-phy";
		reg = <0x78d9000 0x400>;

		vddcx-supply = <&pm8916_s1_corner>;
		v1p8-supply = <&pm8916_l7>;
		v3p3-supply = <&pm8916_l13>;

		clocks = <&gcc GCC_USB_HS_AHB_CLK>,
			     <&gcc GCC_USB_HS_SYSTEM_CLK>;
		clock-names = "iface", "core";

		resets = <&gcc GCC_USB2A_PHY_BCR>;
		reset-names = "phy";

		// D+/D- lines: 1 - Routed to HUB, 0 - Device connector
		switch-gpio = <&pm8916_gpios 4 GPIO_ACTIVE_HIGH>;
	};
```

## Documentation/devicetree/bindings/phy/qcom,usb-hs-28nm.yaml
```yaml
# SPDX-License-Identifier: (GPL-2.0-only OR BSD-2-Clause)
%YAML 1.2
---
$id: http://devicetree.org/schemas/phy/qcom,usb-hs-28nm.yaml#
$schema: http://devicetree.org/meta-schemas/core.yaml#

title: Qualcomm Synopsys DesignWare Core 28nm High-Speed PHY

maintainers:
  - Bryan O'Donoghue <bryan.odonoghue@linaro.org>

description: |
  Qualcomm Low-Speed, Full-Speed, Hi-Speed 28nm USB PHY

properties:
  compatible:
    enum:
      - qcom,usb-hs-28nm-femtophy

  reg:
    maxItems: 1

  "#phy-cells":
    const: 0

  clocks:
    items:
      - description: rpmcc ref clock
      - description: PHY AHB clock
      - description: Rentention clock

  clock-names:
    items:
      - const: ref
      - const: ahb
      - const: sleep

  resets:
    items:
      - description: PHY core reset
      - description: POR reset

  reset-names:
    items:
      - const: phy
      - const: por

  vdd-supply:
    description: phandle to the regulator VDD supply node.

  vdda1p8-supply:
    description: phandle to the regulator 1.8V supply node.

  vdda3p3-supply:
    description: phandle to the regulator 3.3V supply node.

required:
  - compatible
  - reg
  - "#phy-cells"
  - clocks
  - clock-names
  - resets
  - reset-names
  - vdd-supply
  - vdda1p8-supply
  - vdda3p3-supply

additionalProperties: false

examples:
  - |
    #include <dt-bindings/clock/qcom,gcc-qcs404.h>
    #include <dt-bindings/clock/qcom,rpmcc.h>
    usb2_phy_prim: phy@7a000 {
        compatible = "qcom,usb-hs-28nm-femtophy";
        reg = <0x0007a000 0x200>;
        #phy-cells = <0>;
        clocks = <&rpmcc RPM_SMD_LN_BB_CLK>,
                 <&gcc GCC_USB_HS_PHY_CFG_AHB_CLK>,
                 <&gcc GCC_USB2A_PHY_SLEEP_CLK>;
        clock-names = "ref", "ahb", "sleep";
        resets = <&gcc GCC_USB_HS_PHY_CFG_AHB_BCR>,
                 <&gcc GCC_USB2A_PHY_BCR>;
        reset-names = "phy", "por";
        vdd-supply = <&vreg_l4_1p2>;
        vdda1p8-supply = <&vreg_l5_1p8>;
        vdda3p3-supply = <&vreg_l12_3p3>;
    };
...
```

## Documentation/devicetree/bindings/phy/qcom,usb-hs-phy.txt
```
Qualcomm's USB HS PHY

PROPERTIES

- compatible:
    Usage: required
    Value type: <string>
    Definition: Should contain "qcom,usb-hs-phy" and more specifically one of the
                following:

                        "qcom,usb-hs-phy-apq8064"
                        "qcom,usb-hs-phy-msm8226"
                        "qcom,usb-hs-phy-msm8916"
                        "qcom,usb-hs-phy-msm8974"

- #phy-cells:
    Usage: required
    Value type: <u32>
    Definition: Should contain 0

- clocks:
    Usage: required
    Value type: <prop-encoded-array>
    Definition: Should contain clock specifier for the reference and sleep
                clocks

- clock-names:
    Usage: required
    Value type: <stringlist>
    Definition: Should contain "ref" and "sleep" for the reference and sleep
                clocks respectively

- resets:
    Usage: required
    Value type: <prop-encoded-array>
    Definition: Should contain the phy and POR resets

- reset-names:
    Usage: required
    Value type: <stringlist>
    Definition: Should contain "phy" and "por" for the phy and POR resets
                respectively

- v3p3-supply:
    Usage: required
    Value type: <phandle>
    Definition: Should contain a reference to the 3.3V supply

- v1p8-supply:
    Usage: required
    Value type: <phandle>
    Definition: Should contain a reference to the 1.8V supply

- extcon:
    Usage: optional
    Value type: <prop-encoded-array>
    Definition: Should contain the vbus extcon

- qcom,init-seq:
    Usage: optional
    Value type: <u8 array>
    Definition: Should contain a sequence of ULPI address and value pairs to
                program into the ULPI_EXT_VENDOR_SPECIFIC area. This is related
                to Device Mode Eye Diagram test. The addresses are offsets
                from the ULPI_EXT_VENDOR_SPECIFIC address, for example,
                <0x1 0x53> would mean "write the value 0x53 to address 0x81".

EXAMPLE

otg: usb-controller {
	ulpi {
		phy {
			compatible = "qcom,usb-hs-phy-msm8974", "qcom,usb-hs-phy";
			#phy-cells = <0>;
			clocks = <&xo_board>, <&gcc GCC_USB2A_PHY_SLEEP_CLK>;
			clock-names = "ref", "sleep";
			resets = <&gcc GCC_USB2A_PHY_BCR>, <&otg 0>;
			reset-names = "phy", "por";
			v3p3-supply = <&pm8941_l24>;
			v1p8-supply = <&pm8941_l6>;
			extcon = <&smbb>;
			qcom,init-seq = /bits/ 8 <0x1 0x63>;
		};
	};
};
```
