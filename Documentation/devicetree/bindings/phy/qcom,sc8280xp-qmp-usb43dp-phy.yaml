## Documentation/devicetree/bindings/phy/qcom,usb-hs-phy.yaml
```yaml
# SPDX-License-Identifier: GPL-2.0-only
%YAML 1.2
---
$id: http://devicetree.org/schemas/phy/qcom,usb-hs-phy.yaml#
$schema: http://devicetree.org/meta-schemas/core.yaml#

title: Qualcomm's USB HS PHY

maintainers:
  - Bjorn Andersson <bjorn.andersson@linaro.org>

if:
  properties:
    compatible:
      contains:
        const: qcom,usb-hs-phy-apq8064
then:
  properties:
    resets:
      maxItems: 1

    reset-names:
      const: por

else:
  properties:
    resets:
      minItems: 2
      maxItems: 2

    reset-names:
      items:
        - const: phy
        - const: por

properties:
  compatible:
    items:
      - enum:
          - qcom,usb-hs-phy-apq8064
          - qcom,usb-hs-phy-msm8226
          - qcom,usb-hs-phy-msm8916
          - qcom,usb-hs-phy-msm8974
      - const: qcom,usb-hs-phy

  clocks:
    minItems: 2
    maxItems: 2

  clock-names:
    maxItems: 2
    contains:
      items:
        - const: ref
        - const: sleep

  resets: true

  reset-names: true

  v1p8-supply: true

  v3p3-supply: true

  extcon: true

  "#phy-cells":
    const: 0

  qcom,init-seq:
    $ref: /schemas/types.yaml#/definitions/uint8-matrix
    description: >
      Sequence of ULPI address and value pairs to
      program into the ULPI_EXT_VENDOR_SPECIFIC area.
      This is related to Device Mode Eye Diagram test.
    maxItems: 32 # no hard limit
    items:
      items:
        - description: >
            the address is offset from the ULPI_EXT_VENDOR_SPECIFIC address
        - description: value

required:
  - clocks
  - clock-names
  - resets
  - reset-names
  - "#phy-cells"

additionalProperties: false

examples:
  - |
    otg: usb-controller {
      #reset-cells = <1>;

      ulpi {
        phy {
          compatible = "qcom,usb-hs-phy-msm8974", "qcom,usb-hs-phy";
          #phy-cells = <0>;
          clocks = <&clk 0>, <&clk 258>;
          clock-names = "ref", "sleep";
          resets = <&gcc 10>, <&otg 0>;
          reset-names = "phy", "por";
          v3p3-supply = <&pm8941_l24>;
          v1p8-supply = <&pm8941_l6>;
          extcon = <&smbb>;
          qcom,init-seq = /bits/ 8 <0x1 0x63>;
        };
      };
    };
```

## Documentation/devicetree/bindings/phy/qcom,usb-hsic-phy.txt
```
Qualcomm's USB HSIC PHY

PROPERTIES

- compatible:
    Usage: required
    Value type: <string>
    Definition: Should contain "qcom,usb-hsic-phy" and more specifically one of the
		following:

			"qcom,usb-hsic-phy-mdm9615"
			"qcom,usb-hsic-phy-msm8974"

- #phy-cells:
    Usage: required
    Value type: <u32>
    Definition: Should contain 0

- clocks:
    Usage: required
    Value type: <prop-encoded-array>
    Definition: Should contain clock specifier for phy, calibration and
                a calibration sleep clock

- clock-names:
    Usage: required
    Value type: <stringlist>
    Definition: Should contain "phy, "cal" and "cal_sleep"

- pinctrl-names:
    Usage: required
    Value type: <stringlist>
    Definition: Should contain "init" and "default" in that order

- pinctrl-0:
    Usage: required
    Value type: <prop-encoded-array>
    Definition: List of pinctrl settings to apply to keep HSIC pins in a glitch
                free state

- pinctrl-1:
    Usage: required
    Value type: <prop-encoded-array>
    Definition: List of pinctrl settings to apply to mux out the HSIC pins

EXAMPLE

usb-controller {
	ulpi {
		phy {
			compatible = "qcom,usb-hsic-phy-msm8974",
				     "qcom,usb-hsic-phy";
			#phy-cells = <0>;
			pinctrl-names = "init", "default";
			pinctrl-0 = <&hsic_sleep>;
			pinctrl-1 = <&hsic_default>;
			clocks = <&gcc GCC_USB_HSIC_CLK>,
				 <&gcc GCC_USB_HSIC_IO_CAL_CLK>,
				 <&gcc GCC_USB_HSIC_IO_CAL_SLEEP_CLK>;
			clock-names = "phy", "cal", "cal_sleep";
			assigned-clocks = <&gcc GCC_USB_HSIC_IO_CAL_CLK>;
			assigned-clock-rates = <960000>;
		};
	};
};
```

## Documentation/devicetree/bindings/phy/qcom,usb-hsic-phy.yaml
```yaml
# SPDX-License-Identifier: (GPL-2.0 OR BSD-2-Clause)
%YAML 1.2
---
$id: http://devicetree.org/schemas/phy/qcom,usb-hsic-phy.yaml#
$schema: http://devicetree.org/meta-schemas/core.yaml#

title: Qualcomm USB HSIC PHY Controller

maintainers:
  - Bjorn Andersson <andersson@kernel.org>
  - Vinod Koul <vkoul@kernel.org>

properties:
  compatible:
    items:
      - enum:
          - qcom,usb-hsic-phy-mdm9615
          - qcom,usb-hsic-phy-msm8974
      - const: qcom,usb-hsic-phy

  clocks:
    maxItems: 3

  clock-names:
    items:
      - const: phy
      - const: cal
      - const: cal_sleep

  "#phy-cells":
    const: 0

  pinctrl-0: true
  pinctrl-1: true

  pinctrl-names:
    items:
      - const: init
      - const: default

required:
  - compatible
  - clocks
  - clock-names
  - "#phy-cells"
  - pinctrl-0
  - pinctrl-1
  - pinctrl-names

additionalProperties: false

examples:
  - |
    #include <dt-bindings/clock/qcom,gcc-msm8974.h>

    phy {
        compatible = "qcom,usb-hsic-phy-msm8974",
                     "qcom,usb-hsic-phy";
        clocks = <&gcc GCC_USB_HSIC_CLK>,
                 <&gcc GCC_USB_HSIC_IO_CAL_CLK>,
                 <&gcc GCC_USB_HSIC_IO_CAL_SLEEP_CLK>;
        clock-names = "phy", "cal", "cal_sleep";
        #phy-cells = <0>;
        pinctrl-names = "init", "default";
        pinctrl-0 = <&hsic_sleep>;
        pinctrl-1 = <&hsic_default>;
    };
```

## Documentation/devicetree/bindings/phy/qcom,usb-snps-femto-v2.yaml
```yaml
# SPDX-License-Identifier: (GPL-2.0-only OR BSD-2-Clause)
%YAML 1.2
---
$id: "http://devicetree.org/schemas/phy/qcom,usb-snps-femto-v2.yaml#"
$schema: "http://devicetree.org/meta-schemas/core.yaml#"

title: Qualcomm Synopsys Femto High-Speed USB PHY V2

maintainers:
  - Wesley Cheng <quic_wcheng@quicinc.com>

description: |
  Qualcomm High-Speed USB PHY

properties:
  compatible:
    enum:
      - qcom,usb-snps-hs-5nm-phy
      - qcom,usb-snps-hs-7nm-phy
      - qcom,sc7280-usb-hs-phy
      - qcom,sc8180x-usb-hs-phy
      - qcom,sc8280xp-usb-hs-phy
      - qcom,sm6375-usb-hs-phy
      - qcom,sm8150-usb-hs-phy
      - qcom,sm8250-usb-hs-phy
      - qcom,sm8350-usb-hs-phy
      - qcom,sm8450-usb-hs-phy
      - qcom,usb-snps-femto-v2-phy

  reg:
    maxItems: 1

  "#phy-cells":
    const: 0

  clocks:
    items:
      - description: rpmhcc ref clock

  clock-names:
    items:
      - const: ref

  resets:
    items:
      - description: PHY core reset

  vdda-pll-supply:
    description: phandle to the regulator VDD supply node.

  vdda18-supply:
    description: phandle to the regulator 1.8V supply node.

  vdda33-supply:
    description: phandle to the regulator 3.3V supply node.

  qcom,hs-disconnect-bp:
    description:
      This adjusts the voltage level for the threshold used to
      detect a disconnect event at the host.
      The hardware accepts only discrete values. The value closest to the
      provided input will be chosen as the override value for this param.
    minimum: -272
    maximum: 2156

  qcom,squelch-detector-bp:
    description:
      This adjusts the voltage level for the threshold used to
      detect valid high-speed data.
      The hardware accepts only discrete values. The value closest to the
      provided input will be chosen as the override value for this param.
    minimum: -2090
    maximum: 1590

  qcom,hs-amplitude-bp:
    description:
      This adjusts the high-speed DC level voltage.
      The hardware accepts only discrete values. The value closest to the
      provided input will be chosen as the override value for this param.
    minimum: -660
    maximum: 2670

  qcom,pre-emphasis-duration-bp:
    description:
      This signal controls the duration for which the
      HS pre-emphasis current is sourced onto DP<#> or DM<#>.
      The HS Transmitter pre-emphasis duration is defined in terms of
      unit amounts. One unit of pre-emphasis duration is approximately
      650 ps and is defined as 1X pre-emphasis duration.
      The hardware accepts only discrete values. The value closest to the
      provided input will be chosen as the override value for this param.
    minimum: 10000
    maximum: 20000

  qcom,pre-emphasis-amplitude-bp:
    description:
      This signal controls the amount of current sourced to
      DP<#> and DM<#> after a J-to-K or K-to-J transition.
      The HS Transmitter pre-emphasis current is defined in terms of unit
      amounts. One unit amount is approximately 2 mA and is defined as
      1X pre-emphasis current.
      The hardware accepts only discrete values. The value closest to the
      provided input will be chosen as the override value for this param.
    minimum: 10000
    maximum: 40000

  qcom,hs-rise-fall-time-bp:
    description:
      This adjusts the rise/fall times of the high-speed waveform.
      The hardware accepts only discrete values. The value closest to the
      provided input will be chosen as the override value for this param.
    minimum: -4100
    maximum: 5430

  qcom,hs-crossover-voltage-microvolt:
    description:
      This adjusts the voltage at which the DP<#> and DM<#>
      signals cross while transmitting in HS mode.
      The hardware accepts only discrete values. The value closest to the
      provided input will be chosen as the override value for this param.
    minimum: -31000
    maximum: 28000

  qcom,hs-output-impedance-micro-ohms:
    description:
      In some applications, there can be significant series resistance
      on the D+ and D- paths between the transceiver and cable. This adjusts
      the driver source impedance to compensate for added series
      resistance on the USB. The hardware accepts only discrete values. The
      value closest to the provided input will be chosen as the override value
      for this param.
    minimum: -2300000
    maximum: 6100000

  qcom,ls-fs-output-impedance-bp:
    description:
      This adjusts the low- and full-speed single-ended source
      impedance while driving high. The following adjustment values are based
      on nominal process, voltage, and temperature.
      The hardware accepts only discrete values. The value closest to the
      provided input will be chosen as the override value for this param.
    minimum: -1053
    maximum: 1310

required:
  - compatible
  - reg
  - "#phy-cells"
  - clocks
  - clock-names
  - resets
  - vdda-pll-supply
  - vdda18-supply
  - vdda33-supply

additionalProperties: false

examples:
  - |
    #include <dt-bindings/clock/qcom,rpmh.h>
    #include <dt-bindings/clock/qcom,gcc-sm8150.h>
    phy@88e2000 {
        compatible = "qcom,sm8150-usb-hs-phy";
        reg = <0x088e2000 0x400>;
        #phy-cells = <0>;

        clocks = <&rpmhcc RPMH_CXO_CLK>;
        clock-names = "ref";

        resets = <&gcc GCC_QUSB2PHY_PRIM_BCR>;

        vdda-pll-supply = <&vdd_usb_hs_core>;
        vdda33-supply = <&vdda_usb_hs_3p1>;
        vdda18-supply = <&vdda_usb_hs_1p8>;
    };
...
```

## Documentation/devicetree/bindings/phy/qcom,usb-ss.yaml
```yaml
# SPDX-License-Identifier: (GPL-2.0-only OR BSD-2-Clause)
%YAML 1.2
---
$id: "http://devicetree.org/schemas/phy/qcom,usb-ss.yaml#"
$schema: "http://devicetree.org/meta-schemas/core.yaml#"

title: Qualcomm Synopsys 1.0.0 SuperSpeed USB PHY

maintainers:
  - Bryan O'Donoghue <bryan.odonoghue@linaro.org>

description: |
  Qualcomm Synopsys 1.0.0 SuperSpeed USB PHY

properties:
  compatible:
    enum:
      - qcom,usb-ss-28nm-phy

  reg:
    maxItems: 1

  "#phy-cells":
    const: 0

  clocks:
    items:
      - description: rpmcc clock
      - description: PHY AHB clock
      - description: SuperSpeed pipe clock

  clock-names:
    items:
      - const: ref
      - const: ahb
      - const: pipe

  vdd-supply:
    description: phandle to the regulator VDD supply node.

  vdda1p8-supply:
    description: phandle to the regulator 1.8V supply node.

  resets:
    items:
      - description: COM reset
      - description: PHY reset line

  reset-names:
    items:
      - const: com
      - const: phy

required:
  - compatible
  - reg
  - "#phy-cells"
  - clocks
  - clock-names
  - vdd-supply
  - vdda1p8-supply

additionalProperties: false

examples:
  - |
    #include <dt-bindings/clock/qcom,gcc-qcs404.h>
    #include <dt-bindings/clock/qcom,rpmcc.h>
    usb3_phy: usb3-phy@78000 {
        compatible = "qcom,usb-ss-28nm-phy";
        reg = <0x78000 0x400>;
        #phy-cells = <0>;
        clocks = <&rpmcc RPM_SMD_LN_BB_CLK>,
                 <&gcc GCC_USB_HS_PHY_CFG_AHB_CLK>,
                 <&gcc GCC_USB3_PHY_PIPE_CLK>;
        clock-names = "ref", "ahb", "pipe";
        resets = <&gcc GCC_USB3_PHY_BCR>,
                 <&gcc GCC_USB3PHY_PHY_BCR>;
        reset-names = "com", "phy";
        vdd-supply = <&vreg_l3_1p05>;
        vdda1p8-supply = <&vreg_l5_1p8>;
    };
...
```

## Documentation/devicetree/bindings/phy/qcom-apq8064-sata-phy.txt
```
Qualcomm APQ8064 SATA PHY Controller
------------------------------------

SATA PHY nodes are defined to describe on-chip SATA Physical layer controllers.
Each SATA PHY controller should have its own node.

Required properties:
- compatible: compatible list, contains "qcom,apq8064-sata-phy".
- reg: offset and length of the SATA PHY register set;
- #phy-cells: must be zero
- clocks: a list of phandles and clock-specifier pairs, one for each entry in
  clock-names.
- clock-names: must be "cfg" for phy config clock.

Example:
	sata_phy: sata-phy@1b400000 {
		compatible = "qcom,apq8064-sata-phy";
		reg = <0x1b400000 0x200>;

		clocks = <&gcc SATA_PHY_CFG_CLK>;
		clock-names = "cfg";

		#phy-cells = <0>;
	};
```

## Documentation/devicetree/bindings/phy/qcom-dwc3-usb-phy.txt
```
Qualcomm DWC3 HS AND SS PHY CONTROLLER
--------------------------------------

DWC3 PHY nodes are defined to describe on-chip Synopsis Physical layer
controllers.  Each DWC3 PHY controller should have its own node.

Required properties:
- compatible: should contain one of the following:
	- "qcom,dwc3-hs-usb-phy" for High Speed Synopsis PHY controller
	- "qcom,dwc3-ss-usb-phy" for Super Speed Synopsis PHY controller
- reg: offset and length of the DWC3 PHY controller register set
- #phy-cells: must be zero
- clocks: a list of phandles and clock-specifier pairs, one for each entry in
  clock-names.
- clock-names: Should contain "ref" for the PHY reference clock

Optional clocks:
  "xo"		External reference clock

Example:
		phy@100f8800 {
			compatible = "qcom,dwc3-hs-usb-phy";
			reg = <0x100f8800 0x30>;
			clocks = <&gcc USB30_0_UTMI_CLK>;
			clock-names = "ref";
			#phy-cells = <0>;

		};

		phy@100f8830 {
			compatible = "qcom,dwc3-ss-usb-phy";
			reg = <0x100f8830 0x30>;
			clocks = <&gcc USB30_0_MASTER_CLK>;
			clock-names = "ref";
			#phy-cells = <0>;

		};
```

## Documentation/devicetree/bindings/phy/qcom-ipq806x-sata-phy.txt
```
Qualcomm IPQ806x SATA PHY Controller
------------------------------------

SATA PHY nodes are defined to describe on-chip SATA Physical layer controllers.
Each SATA PHY controller should have its own node.

Required properties:
- compatible: compatible list, contains "qcom,ipq806x-sata-phy"
- reg: offset and length of the SATA PHY register set;
- #phy-cells: must be zero
- clocks: must be exactly one entry
- clock-names: must be "cfg"

Example:
	sata_phy: sata-phy@1b400000 {
		compatible = "qcom,ipq806x-sata-phy";
		reg = <0x1b400000 0x200>;

		clocks = <&gcc SATA_PHY_CFG_CLK>;
		clock-names = "cfg";

		#phy-cells = <0>;
	};
```
