## Documentation/devicetree/bindings/phy/rcar-gen2-phy.txt
```
* Renesas R-Car generation 2 USB PHY

This file provides information on what the device node for the R-Car generation
2 USB PHY contains.

Required properties:
- compatible: "renesas,usb-phy-r8a7743" if the device is a part of R8A7743 SoC.
	      "renesas,usb-phy-r8a7744" if the device is a part of R8A7744 SoC.
	      "renesas,usb-phy-r8a7745" if the device is a part of R8A7745 SoC.
	      "renesas,usb-phy-r8a7790" if the device is a part of R8A7790 SoC.
	      "renesas,usb-phy-r8a7791" if the device is a part of R8A7791 SoC.
	      "renesas,usb-phy-r8a7794" if the device is a part of R8A7794 SoC.
	      "renesas,rcar-gen2-usb-phy" for a generic R-Car Gen2 or
					  RZ/G1 compatible device.

	      When compatible with the generic version, nodes must list the
	      SoC-specific version corresponding to the platform first
	      followed by the generic version.

- reg: offset and length of the register block.
- #address-cells: number of address cells for the USB channel subnodes, must
		  be <1>.
- #size-cells: number of size cells for the USB channel subnodes, must be <0>.
- clocks: clock phandle and specifier pair.
- clock-names: string, clock input name, must be "usbhs".

The USB PHY device tree node should have the subnodes corresponding to the USB
channels. These subnodes must contain the following properties:
- reg: the USB controller selector; see the table below for the values.
- #phy-cells: see phy-bindings.txt in the same directory, must be <1>.

The phandle's argument in the PHY specifier is the USB controller selector for
the USB channel; see the selector meanings below:

+-----------+---------------+---------------+
|\ Selector |               |               |
+ --------- +       0       |       1       |
| Channel  \|               |               |
+-----------+---------------+---------------+
| 0         | PCI EHCI/OHCI | HS-USB        |
| 2         | PCI EHCI/OHCI | xHCI          |
+-----------+---------------+---------------+

Example (Lager board):

	usb-phy@e6590100 {
		compatible = "renesas,usb-phy-r8a7790", "renesas,rcar-gen2-usb-phy";
		reg = <0 0xe6590100 0 0x100>;
		#address-cells = <1>;
		#size-cells = <0>;
		clocks = <&mstp7_clks R8A7790_CLK_HSUSB>;
		clock-names = "usbhs";

		usb-channel@0 {
			reg = <0>;
			#phy-cells = <1>;
		};
		usb-channel@2 {
			reg = <2>;
			#phy-cells = <1>;
		};
	};
```

## Documentation/devicetree/bindings/phy/rcar-gen3-phy-pcie.txt
```
* Renesas R-Car generation 3 PCIe PHY

This file provides information on what the device node for the R-Car
generation 3 PCIe PHY contains.

Required properties:
- compatible: "renesas,r8a77980-pcie-phy" if the device is a part of the
	      R8A77980 SoC.
- reg: offset and length of the register block.
- clocks: clock phandle and specifier pair.
- power-domains: power domain phandle and specifier pair.
- resets: reset phandle and specifier pair.
- #phy-cells: see phy-bindings.txt in the same directory, must be <0>.

Example (R-Car V3H):

	pcie-phy@e65d0000 {
		compatible = "renesas,r8a77980-pcie-phy";
		reg = <0 0xe65d0000 0 0x8000>;
		#phy-cells = <0>;
		clocks = <&cpg CPG_MOD 319>;
		power-domains = <&sysc 32>;
		resets = <&cpg 319>;
	};
```

## Documentation/devicetree/bindings/phy/rcar-gen3-phy-usb2.txt
```
* Renesas R-Car generation 3 USB 2.0 PHY

This file provides information on what the device node for the R-Car generation
3, RZ/G1C and RZ/G2 USB 2.0 PHY contain.

Required properties:
- compatible: "renesas,usb2-phy-r8a77470" if the device is a part of an R8A77470
	      SoC.
	      "renesas,usb2-phy-r8a774a1" if the device is a part of an R8A774A1
	      SoC.
	      "renesas,usb2-phy-r8a774c0" if the device is a part of an R8A774C0
	      SoC.
	      "renesas,usb2-phy-r8a7795" if the device is a part of an R8A7795
	      SoC.
	      "renesas,usb2-phy-r8a7796" if the device is a part of an R8A7796
	      SoC.
	      "renesas,usb2-phy-r8a77965" if the device is a part of an
	      R8A77965 SoC.
	      "renesas,usb2-phy-r8a77990" if the device is a part of an
	      R8A77990 SoC.
	      "renesas,usb2-phy-r8a77995" if the device is a part of an
	      R8A77995 SoC.
	      "renesas,rcar-gen3-usb2-phy" for a generic R-Car Gen3 or RZ/G2
	      compatible device.

	      When compatible with the generic version, nodes must list the
	      SoC-specific version corresponding to the platform first
	      followed by the generic version.

- reg: offset and length of the partial USB 2.0 Host register block.
- clocks: clock phandle and specifier pair(s).
- #phy-cells: see phy-bindings.txt in the same directory, must be <1> (and
	      using <0> is deprecated).

The phandle's argument in the PHY specifier is the INT_STATUS bit of controller:
- 1 = USBH_INTA (OHCI)
- 2 = USBH_INTB (EHCI)
- 3 = UCOM_INT (OTG and BC)

Optional properties:
To use a USB channel where USB 2.0 Host and HSUSB (USB 2.0 Peripheral) are
combined, the device tree node should set interrupt properties to use the
channel as USB OTG:
- interrupts: interrupt specifier for the PHY.
- vbus-supply: Phandle to a regulator that provides power to the VBUS. This
	       regulator will be managed during the PHY power on/off sequence.
- renesas,no-otg-pins: boolean, specify when a board does not provide proper
		       otg pins.

Example (R-Car H3):

	usb-phy@ee080200 {
		compatible = "renesas,usb2-phy-r8a7795", "renesas,rcar-gen3-usb2-phy";
		reg = <0 0xee080200 0 0x700>;
		interrupts = <GIC_SPI 108 IRQ_TYPE_LEVEL_HIGH>;
		clocks = <&cpg CPG_MOD 703>;
	};

	usb-phy@ee0a0200 {
		compatible = "renesas,usb2-phy-r8a7795", "renesas,rcar-gen3-usb2-phy";
		reg = <0 0xee0a0200 0 0x700>;
		clocks = <&cpg CPG_MOD 702>;
	};
```

## Documentation/devicetree/bindings/phy/rcar-gen3-phy-usb3.txt
```
* Renesas R-Car generation 3 USB 3.0 PHY

This file provides information on what the device node for the R-Car generation
3 and RZ/G2 USB 3.0 PHY contain.
If you want to enable spread spectrum clock (ssc), you should use USB_EXTAL
instead of USB3_CLK. However, if you don't want to these features, you don't
need this driver.

Required properties:
- compatible: "renesas,r8a774a1-usb3-phy" if the device is a part of an R8A774A1
	      SoC.
	      "renesas,r8a7795-usb3-phy" if the device is a part of an R8A7795
	      SoC.
	      "renesas,r8a7796-usb3-phy" if the device is a part of an R8A7796
	      SoC.
	      "renesas,r8a77965-usb3-phy" if the device is a part of an
	      R8A77965 SoC.
	      "renesas,rcar-gen3-usb3-phy" for a generic R-Car Gen3 or RZ/G2
	      compatible device.

	      When compatible with the generic version, nodes must list the
	      SoC-specific version corresponding to the platform first
	      followed by the generic version.

- reg: offset and length of the USB 3.0 PHY register block.
- clocks: A list of phandles and clock-specifier pairs.
- clock-names: Name of the clocks.
  - The funcional clock must be "usb3-if".
  - The usb3's external clock must be "usb3s_clk".
  - The usb2's external clock must be "usb_extal". If you want to use the ssc,
    the clock-frequency must not be 0.
- #phy-cells: see phy-bindings.txt in the same directory, must be <0>.

Optional properties:
- renesas,ssc-range: Enable/disable spread spectrum clock (ssc) by using
		     the following values as u32:
			- 0 (or the property doesn't exist): disable the ssc
			- 4980: enable the ssc as -4980 ppm
			- 4492: enable the ssc as -4492 ppm
			- 4003: enable the ssc as -4003 ppm

Example (R-Car H3):

	usb-phy@e65ee000 {
		compatible = "renesas,r8a7795-usb3-phy",
			     "renesas,rcar-gen3-usb3-phy";
		reg = <0 0xe65ee000 0 0x90>;
		clocks = <&cpg CPG_MOD 328>, <&usb3s0_clk>, <&usb_extal>;
		clock-names = "usb3-if", "usb3s_clk", "usb_extal";
	};
```

## Documentation/devicetree/bindings/phy/realtek,usb2phy.yaml
```yaml
# SPDX-License-Identifier: (GPL-2.0 OR BSD-2-Clause)
# Copyright 2023 Realtek Semiconductor Corporation
%YAML 1.2
---
$id: http://devicetree.org/schemas/phy/realtek,usb2phy.yaml#
$schema: http://devicetree.org/meta-schemas/core.yaml#

title: Realtek DHC SoCs USB 2.0 PHY

maintainers:
  - Stanley Chang <stanley_chang@realtek.com>

description: |
  Realtek USB 2.0 PHY support the digital home center (DHC) RTD series SoCs.
  The USB 2.0 PHY driver is designed to support the XHCI controller. The SoCs
  support multiple XHCI controllers. One PHY device node maps to one XHCI
  controller.

  RTD1295/RTD1619 SoCs USB
  The USB architecture includes three XHCI controllers.
  Each XHCI maps to one USB 2.0 PHY and map one USB 3.0 PHY on some
  controllers.
  XHCI controller#0 -- usb2phy -- phy#0
                    |- usb3phy -- phy#0
  XHCI controller#1 -- usb2phy -- phy#0
  XHCI controller#2 -- usb2phy -- phy#0
                    |- usb3phy -- phy#0

  RTD1395 SoCs USB
  The USB architecture includes two XHCI controllers.
  The controller#0 has one USB 2.0 PHY. The controller#1 includes two USB 2.0
  PHY.
  XHCI controller#0 -- usb2phy -- phy#0
  XHCI controller#1 -- usb2phy -- phy#0
                               |- phy#1

  RTD1319/RTD1619b SoCs USB
  The USB architecture includes three XHCI controllers.
  Each XHCI maps to one USB 2.0 PHY and map one USB 3.0 PHY on controllers#2.
  XHCI controller#0 -- usb2phy -- phy#0
  XHCI controller#1 -- usb2phy -- phy#0
  XHCI controller#2 -- usb2phy -- phy#0
                    |- usb3phy -- phy#0

  RTD1319d SoCs USB
  The USB architecture includes three XHCI controllers.
  Each xhci maps to one USB 2.0 PHY and map one USB 3.0 PHY on controllers#0.
  XHCI controller#0 -- usb2phy -- phy#0
                    |- usb3phy -- phy#0
  XHCI controller#1 -- usb2phy -- phy#0
  XHCI controller#2 -- usb2phy -- phy#0

  RTD1312c/RTD1315e SoCs USB
  The USB architecture includes three XHCI controllers.
  Each XHCI maps to one USB 2.0 PHY.
  XHCI controller#0 -- usb2phy -- phy#0
  XHCI controller#1 -- usb2phy -- phy#0
  XHCI controller#2 -- usb2phy -- phy#0

properties:
  compatible:
    enum:
      - realtek,rtd1295-usb2phy
      - realtek,rtd1312c-usb2phy
      - realtek,rtd1315e-usb2phy
      - realtek,rtd1319-usb2phy
      - realtek,rtd1319d-usb2phy
      - realtek,rtd1395-usb2phy
      - realtek,rtd1395-usb2phy-2port
      - realtek,rtd1619-usb2phy
      - realtek,rtd1619b-usb2phy

  reg:
    items:
      - description: PHY data registers
      - description: PHY control registers

  "#phy-cells":
    const: 0

  nvmem-cells:
    maxItems: 2
    description:
      Phandles to nvmem cell that contains the trimming data.
      If unspecified, default value is used.

  nvmem-cell-names:
    items:
      - const: usb-dc-cal
      - const: usb-dc-dis
    description:
      The following names, which correspond to each nvmem-cells.
      usb-dc-cal is the driving level for each phy specified via efuse.
      usb-dc-dis is the disconnection level for each phy specified via efuse.

  realtek,inverse-hstx-sync-clock:
    description:
      For one of the phys of RTD1619b SoC, the synchronous clock of the
      high-speed tx must be inverted.
    type: boolean

  realtek,driving-level:
    description:
      Control the magnitude of High speed Dp/Dm output swing (mV).
      For a different board or port, the original magnitude maybe not meet
      the specification. In this situation we can adjust the value to meet
      the specification.
    $ref: /schemas/types.yaml#/definitions/uint32
    default: 8
    minimum: 0
    maximum: 31

  realtek,driving-level-compensate:
    description:
      For RTD1315e SoC, the driving level can be adjusted by reading the
      efuse table. This property provides drive compensation.
      If the magnitude of High speed Dp/Dm output swing still not meet the
      specification, then we can set this value to meet the specification.
    $ref: /schemas/types.yaml#/definitions/int32
    default: 0
    minimum: -8
    maximum: 8

  realtek,disconnection-compensate:
    description:
      This adjusts the disconnection level compensation for the different
      boards with different disconnection level.
    $ref: /schemas/types.yaml#/definitions/int32
    default: 0
    minimum: -8
    maximum: 8

required:
  - compatible
  - reg
  - "#phy-cells"

allOf:
  - if:
      not:
        properties:
          compatible:
            contains:
              enum:
                - realtek,rtd1619b-usb2phy
    then:
      properties:
        realtek,inverse-hstx-sync-clock: false

  - if:
      not:
        properties:
          compatible:
            contains:
              enum:
                - realtek,rtd1315e-usb2phy
    then:
      properties:
        realtek,driving-level-compensate: false

additionalProperties: false

examples:
  - |
    usb-phy@13214 {
        compatible = "realtek,rtd1619b-usb2phy";
        reg = <0x13214 0x4>, <0x28280 0x4>;
        #phy-cells = <0>;
        nvmem-cells = <&otp_usb_port0_dc_cal>, <&otp_usb_port0_dc_dis>;
        nvmem-cell-names = "usb-dc-cal", "usb-dc-dis";

        realtek,inverse-hstx-sync-clock;
        realtek,driving-level = <0xa>;
        realtek,disconnection-compensate = <(-1)>;
    };
```
