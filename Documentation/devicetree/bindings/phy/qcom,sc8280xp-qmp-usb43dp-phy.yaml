## Documentation/devicetree/bindings/phy/qcom-pcie2-phy.txt
```
Qualcomm PCIe2 PHY controller
=============================

The Qualcomm PCIe2 PHY is a Synopsys based phy found in a number of Qualcomm
platforms.

Required properties:
 - compatible: compatible list, should be:
	       "qcom,qcs404-pcie2-phy", "qcom,pcie2-phy"

 - reg: offset and length of the PHY register set.
 - #phy-cells: must be 0.

 - clocks: a clock-specifier pair for the "pipe" clock

 - vdda-vp-supply: phandle to low voltage regulator
 - vdda-vph-supply: phandle to high voltage regulator

 - resets: reset-specifier pairs for the "phy" and "pipe" resets
 - reset-names: list of resets, should contain:
		"phy" and "pipe"

 - clock-output-names: name of the outgoing clock signal from the PHY PLL
 - #clock-cells: must be 0

Example:
 phy@7786000 {
	compatible = "qcom,qcs404-pcie2-phy", "qcom,pcie2-phy";
	reg = <0x07786000 0xb8>;

	clocks = <&gcc GCC_PCIE_0_PIPE_CLK>;
	resets = <&gcc GCC_PCIEPHY_0_PHY_BCR>,
	         <&gcc GCC_PCIE_0_PIPE_ARES>;
	reset-names = "phy", "pipe";

	vdda-vp-supply = <&vreg_l3_1p05>;
	vdda-vph-supply = <&vreg_l5_1p8>;

	clock-output-names = "pcie_0_pipe_clk";
	#clock-cells = <0>;
	#phy-cells = <0>;
 };
```

## Documentation/devicetree/bindings/phy/qcom-qmp-phy.txt
```
Qualcomm QMP PHY controller
===========================

QMP phy controller supports physical layer functionality for a number of
controllers on Qualcomm chipsets, such as, PCIe, UFS, and USB.

Required properties:
 - compatible: compatible list, contains:
	       "qcom,ipq8074-qmp-pcie-phy" for PCIe phy on IPQ8074
	       "qcom,msm8996-qmp-pcie-phy" for 14nm PCIe phy on msm8996,
	       "qcom,msm8996-qmp-ufs-phy" for 14nm UFS phy on msm8996,
	       "qcom,msm8996-qmp-usb3-phy" for 14nm USB3 phy on msm8996,
	       "qcom,msm8998-qmp-usb3-phy" for USB3 QMP V3 phy on msm8998,
	       "qcom,msm8998-qmp-ufs-phy" for UFS QMP phy on msm8998,
	       "qcom,msm8998-qmp-pcie-phy" for PCIe QMP phy on msm8998,
	       "qcom,sdm845-qhp-pcie-phy" for QHP PCIe phy on sdm845,
	       "qcom,sdm845-qmp-pcie-phy" for QMP PCIe phy on sdm845,
	       "qcom,sdm845-qmp-usb3-phy" for USB3 QMP V3 phy on sdm845,
	       "qcom,sdm845-qmp-usb3-uni-phy" for USB3 QMP V3 UNI phy on sdm845,
	       "qcom,sdm845-qmp-ufs-phy" for UFS QMP phy on sdm845,
	       "qcom,sm8150-qmp-ufs-phy" for UFS QMP phy on sm8150.

- reg:
  - index 0: address and length of register set for PHY's common
             serdes block.
  - index 1: address and length of the DP_COM control block (for
             "qcom,sdm845-qmp-usb3-phy" only).

- reg-names:
  - For "qcom,sdm845-qmp-usb3-phy":
    - Should be: "reg-base", "dp_com"
  - For all others:
    - The reg-names property shouldn't be defined.

 - #address-cells: must be 1
 - #size-cells: must be 1
 - ranges: must be present

 - clocks: a list of phandles and clock-specifier pairs,
	   one for each entry in clock-names.
 - clock-names: "cfg_ahb" for phy config clock,
		"aux" for phy aux clock,
		"ref" for 19.2 MHz ref clk,
		"com_aux" for phy common block aux clock,
		"ref_aux" for phy reference aux clock,

		For "qcom,ipq8074-qmp-pcie-phy": no clocks are listed.
		For "qcom,msm8996-qmp-pcie-phy" must contain:
			"aux", "cfg_ahb", "ref".
		For "qcom,msm8996-qmp-ufs-phy" must contain:
			"ref".
		For "qcom,msm8996-qmp-usb3-phy" must contain:
			"aux", "cfg_ahb", "ref".
		For "qcom,msm8998-qmp-usb3-phy" must contain:
			"aux", "cfg_ahb", "ref".
		For "qcom,msm8998-qmp-ufs-phy" must contain:
			"ref", "ref_aux".
		For "qcom,msm8998-qmp-pcie-phy" must contain:
			"aux", "cfg_ahb", "ref".
		For "qcom,sdm845-qhp-pcie-phy" must contain:
			"aux", "cfg_ahb", "ref", "refgen".
		For "qcom,sdm845-qmp-pcie-phy" must contain:
			"aux", "cfg_ahb", "ref", "refgen".
		For "qcom,sdm845-qmp-usb3-phy" must contain:
			"aux", "cfg_ahb", "ref", "com_aux".
		For "qcom,sdm845-qmp-usb3-uni-phy" must contain:
			"aux", "cfg_ahb", "ref", "com_aux".
		For "qcom,sdm845-qmp-ufs-phy" must contain:
			"ref", "ref_aux".
		For "qcom,sm8150-qmp-ufs-phy" must contain:
			"ref", "ref_aux".

 - resets: a list of phandles and reset controller specifier pairs,
	   one for each entry in reset-names.
 - reset-names: "phy" for reset of phy block,
		"common" for phy common block reset,
		"cfg" for phy's ahb cfg block reset,
		"ufsphy" for the PHY reset in the UFS controller.

		For "qcom,ipq8074-qmp-pcie-phy" must contain:
			"phy", "common".
		For "qcom,msm8996-qmp-pcie-phy" must contain:
			"phy", "common", "cfg".
		For "qcom,msm8996-qmp-ufs-phy": must contain:
			"ufsphy".
		For "qcom,msm8996-qmp-usb3-phy" must contain
			"phy", "common".
		For "qcom,msm8998-qmp-usb3-phy" must contain
			"phy", "common".
		For "qcom,msm8998-qmp-ufs-phy": must contain:
			"ufsphy".
		For "qcom,msm8998-qmp-pcie-phy" must contain:
			"phy", "common".
		For "qcom,sdm845-qhp-pcie-phy" must contain:
			"phy".
		For "qcom,sdm845-qmp-pcie-phy" must contain:
			"phy".
		For "qcom,sdm845-qmp-usb3-phy" must contain:
			"phy", "common".
		For "qcom,sdm845-qmp-usb3-uni-phy" must contain:
			"phy", "common".
		For "qcom,sdm845-qmp-ufs-phy": must contain:
			"ufsphy".
		For "qcom,sm8150-qmp-ufs-phy": must contain:
			"ufsphy".

 - vdda-phy-supply: Phandle to a regulator supply to PHY core block.
 - vdda-pll-supply: Phandle to 1.8V regulator supply to PHY refclk pll block.

Optional properties:
 - vddp-ref-clk-supply: Phandle to a regulator supply to any specific refclk
			pll block.

Required nodes:
 - Each device node of QMP phy is required to have as many child nodes as
   the number of lanes the PHY has.

Required properties for child nodes of PCIe PHYs (one child per lane):
 - reg: list of offset and length pairs of register sets for PHY blocks -
	tx, rx, pcs, and pcs_misc (optional).
 - #phy-cells: must be 0

Required properties for a single "lanes" child node of non-PCIe PHYs:
 - reg: list of offset and length pairs of register sets for PHY blocks
	For 1-lane devices:
		tx, rx, pcs, and (optionally) pcs_misc
	For 2-lane devices:
		tx0, rx0, pcs, tx1, rx1, and (optionally) pcs_misc
 - #phy-cells: must be 0

Required properties for child node of PCIe and USB3 qmp phys:
 - clocks: a list of phandles and clock-specifier pairs,
	   one for each entry in clock-names.
 - clock-names: Must contain following:
		 "pipe<lane-number>" for pipe clock specific to each lane.
 - clock-output-names: Name of the PHY clock that will be the parent for
		       the above pipe clock.
	For "qcom,ipq8074-qmp-pcie-phy":
		- "pcie20_phy0_pipe_clk"	Pipe Clock parent
			(or)
		  "pcie20_phy1_pipe_clk"
 - #clock-cells: must be 0
    - Phy pll outputs pipe clocks for pipe based PHYs. These clocks are then
      gate-controlled by the gcc.

Required properties for child node of PHYs with lane reset, AKA:
	"qcom,msm8996-qmp-pcie-phy"
 - resets: a list of phandles and reset controller specifier pairs,
	   one for each entry in reset-names.
 - reset-names: Must contain following:
		 "lane<lane-number>" for reset specific to each lane.

Example:
	phy@34000 {
		compatible = "qcom,msm8996-qmp-pcie-phy";
		reg = <0x34000 0x488>;
		#address-cells = <1>;
		#size-cells = <1>;
		ranges;

		clocks = <&gcc GCC_PCIE_PHY_AUX_CLK>,
			<&gcc GCC_PCIE_PHY_CFG_AHB_CLK>,
			<&gcc GCC_PCIE_CLKREF_CLK>;
		clock-names = "aux", "cfg_ahb", "ref";

		vdda-phy-supply = <&pm8994_l28>;
		vdda-pll-supply = <&pm8994_l12>;

		resets = <&gcc GCC_PCIE_PHY_BCR>,
			<&gcc GCC_PCIE_PHY_COM_BCR>,
			<&gcc GCC_PCIE_PHY_COM_NOCSR_BCR>;
		reset-names = "phy", "common", "cfg";

		pciephy_0: lane@35000 {
			reg = <0x35000 0x130>,
				<0x35200 0x200>,
				<0x35400 0x1dc>;
			#clock-cells = <0>;
			#phy-cells = <0>;

			clocks = <&gcc GCC_PCIE_0_PIPE_CLK>;
			clock-names = "pipe0";
			clock-output-names = "pcie_0_pipe_clk_src";
			resets = <&gcc GCC_PCIE_0_PHY_BCR>;
			reset-names = "lane0";
		};

		pciephy_1: lane@36000 {
		...
		...
	};

	phy@88eb000 {
		compatible = "qcom,sdm845-qmp-usb3-uni-phy";
		reg = <0x88eb000 0x18c>;
		#address-cells = <1>;
		#size-cells = <1>;
		ranges;

		clocks = <&gcc GCC_USB3_SEC_PHY_AUX_CLK>,
			 <&gcc GCC_USB_PHY_CFG_AHB2PHY_CLK>,
			 <&gcc GCC_USB3_SEC_CLKREF_CLK>,
			 <&gcc GCC_USB3_SEC_PHY_COM_AUX_CLK>;
		clock-names = "aux", "cfg_ahb", "ref", "com_aux";

		resets = <&gcc GCC_USB3PHY_PHY_SEC_BCR>,
			 <&gcc GCC_USB3_PHY_SEC_BCR>;
		reset-names = "phy", "common";

		lane@88eb200 {
			reg = <0x88eb200 0x128>,
			      <0x88eb400 0x1fc>,
			      <0x88eb800 0x218>,
			      <0x88eb600 0x70>;
			#clock-cells = <0>;
			#phy-cells = <0>;
			clocks = <&gcc GCC_USB3_SEC_PHY_PIPE_CLK>;
			clock-names = "pipe0";
			clock-output-names = "usb3_uni_phy_pipe_clk_src";
		};
	};

	phy@1d87000 {
		compatible = "qcom,sdm845-qmp-ufs-phy";
		reg = <0x1d87000 0x18c>;
		#address-cells = <1>;
		#size-cells = <1>;
		ranges;
		clock-names = "ref",
			      "ref_aux";
		clocks = <&gcc GCC_UFS_MEM_CLKREF_CLK>,
			 <&gcc GCC_UFS_PHY_PHY_AUX_CLK>;

		lanes@1d87400 {
			reg = <0x1d87400 0x108>,
			      <0x1d87600 0x1e0>,
			      <0x1d87c00 0x1dc>,
			      <0x1d87800 0x108>,
			      <0x1d87a00 0x1e0>;
			#phy-cells = <0>;
		};
	};
```

## Documentation/devicetree/bindings/phy/qcom-qusb2-phy.txt
```
Qualcomm QUSB2 phy controller
=============================

QUSB2 controller supports LS/FS/HS usb connectivity on Qualcomm chipsets.

Required properties:
 - compatible: compatible list, contains
	       "qcom,msm8996-qusb2-phy" for 14nm PHY on msm8996,
	       "qcom,sdm845-qusb2-phy" for 10nm PHY on sdm845.

 - reg: offset and length of the PHY register set.
 - #phy-cells: must be 0.

 - clocks: a list of phandles and clock-specifier pairs,
	   one for each entry in clock-names.
 - clock-names: must be "cfg_ahb" for phy config clock,
			"ref" for 19.2 MHz ref clk,
			"iface" for phy interface clock (Optional).

 - vdda-pll-supply: Phandle to 1.8V regulator supply to PHY refclk pll block.
 - vdda-phy-dpdm-supply: Phandle to 3.1V regulator supply to Dp/Dm port signals.

 - resets: Phandle to reset to phy block.

Optional properties:
 - nvmem-cells: Phandle to nvmem cell that contains 'HS Tx trim'
		tuning parameter value for qusb2 phy.

 - qcom,tcsr-syscon: Phandle to TCSR syscon register region.
 - qcom,imp-res-offset-value: It is a 6 bit value that specifies offset to be
		added to PHY refgen RESCODE via IMP_CTRL1 register. It is a PHY
		tuning parameter that may vary for different boards of same SOC.
		This property is applicable to only QUSB2 v2 PHY (sdm845).
 - qcom,hstx-trim-value: It is a 4 bit value that specifies tuning for HSTX
		output current.
		Possible range is - 15mA to 24mA (stepsize of 600 uA).
		See dt-bindings/phy/phy-qcom-qusb2.h for applicable values.
		This property is applicable to only QUSB2 v2 PHY (sdm845).
		Default value is 22.2mA for sdm845.
 - qcom,preemphasis-level: It is a 2 bit value that specifies pre-emphasis level.
		Possible range is 0 to 15% (stepsize of 5%).
		See dt-bindings/phy/phy-qcom-qusb2.h for applicable values.
		This property is applicable to only QUSB2 v2 PHY (sdm845).
		Default value is 10% for sdm845.
- qcom,preemphasis-width: It is a 1 bit value that specifies how long the HSTX
		pre-emphasis (specified using qcom,preemphasis-level) must be in
		effect. Duration could be half-bit of full-bit.
		See dt-bindings/phy/phy-qcom-qusb2.h for applicable values.
		This property is applicable to only QUSB2 v2 PHY (sdm845).
		Default value is full-bit width for sdm845.

Example:
	hsusb_phy: phy@7411000 {
		compatible = "qcom,msm8996-qusb2-phy";
		reg = <0x7411000 0x180>;
		#phy-cells = <0>;

		clocks = <&gcc GCC_USB_PHY_CFG_AHB2PHY_CLK>,
			<&gcc GCC_RX1_USB2_CLKREF_CLK>,
		clock-names = "cfg_ahb", "ref";

		vdda-pll-supply = <&pm8994_l12>;
		vdda-phy-dpdm-supply = <&pm8994_l24>;

		resets = <&gcc GCC_QUSB2PHY_PRIM_BCR>;
		nvmem-cells = <&qusb2p_hstx_trim>;
        };
```

## Documentation/devicetree/bindings/phy/qcom-usb-ipq4019-phy.yaml
```yaml
# SPDX-License-Identifier: (GPL-2.0 OR BSD-2-Clause)
%YAML 1.2
---
$id: "http://devicetree.org/schemas/phy/qcom-usb-ipq4019-phy.yaml#"
$schema: "http://devicetree.org/meta-schemas/core.yaml#"

title: Qualcom IPQ40xx Dakota HS/SS USB PHY

maintainers:
  - Robert Marko <robert.marko@sartura.hr>

properties:
  compatible:
    enum:
      - qcom,usb-ss-ipq4019-phy
      - qcom,usb-hs-ipq4019-phy

  reg:
    maxItems: 1

  resets:
    maxItems: 2

  reset-names:
    items:
      - const: por_rst
      - const: srif_rst

  "#phy-cells":
    const: 0

required:
  - compatible
  - reg
  - resets
  - reset-names
  - "#phy-cells"

examples:
  - |
    #include <dt-bindings/clock/qcom,gcc-ipq4019.h>

    hsphy@a8000 {
      #phy-cells = <0>;
      compatible = "qcom,usb-hs-ipq4019-phy";
      reg = <0xa8000 0x40>;
      resets = <&gcc USB2_HSPHY_POR_ARES>,
               <&gcc USB2_HSPHY_S_ARES>;
      reset-names = "por_rst", "srif_rst";
    };
```

## Documentation/devicetree/bindings/phy/ralink-usb-phy.txt
```
Mediatek/Ralink USB PHY

Required properties:
 - compatible: "ralink,rt3352-usbphy"
	       "mediatek,mt7620-usbphy"
	       "mediatek,mt7628-usbphy"
 - reg: required for "mediatek,mt7628-usbphy", unused otherwise
 - #phy-cells: should be 0
 - ralink,sysctl: a phandle to a ralink syscon register region
 - resets: the two reset controllers for host and device
 - reset-names: the names of the 2 reset controllers

Example:

usbphy: phy {
	compatible = "mediatek,mt7628-usbphy";
	reg = <0x10120000 0x1000>;
	#phy-cells = <0>;

	ralink,sysctl = <&sysc>;
	resets = <&rstctrl 22 &rstctrl 25>;
	reset-names = "host", "device";
};
```
