## Documentation/devicetree/bindings/phy/phy-common-props.yaml
```yaml
# SPDX-License-Identifier: (GPL-2.0 OR BSD-2-Clause)
%YAML 1.2
---
$id: http://devicetree.org/schemas/phy/phy-common-props.yaml#
$schema: http://devicetree.org/meta-schemas/core.yaml#

title: Common PHY and network PCS properties

description:
  Common PHY and network PCS properties, such as peak-to-peak transmit
  amplitude.

maintainers:
  - Marek Behún <kabel@kernel.org>

$defs:
  protocol-names:
    description:
      Names of the PHY modes. If a value of 'default' is provided, the system
      should use it for any PHY mode that is otherwise not defined here. If
      'default' is not provided, the system should use manufacturer default value.
    minItems: 1
    maxItems: 16
    uniqueItems: true
    items:
      enum:
        - default

        # ethernet modes
        - sgmii
        - qsgmii
        - xgmii
        - 1000base-x
        - 2500base-x
        - 5gbase-r
        - rxaui
        - xaui
        - 10gbase-kr
        - usxgmii
        - 10gbase-r
        - 25gbase-r

        # PCIe modes
        - pcie
        - pcie1
        - pcie2
        - pcie3
        - pcie4
        - pcie5
        - pcie6

        # USB modes
        - usb
        - usb-ls
        - usb-fs
        - usb-hs
        - usb-ss
        - usb-ss+
        - usb-4

        # storage modes
        - sata
        - ufs-hs
        - ufs-hs-a
        - ufs-hs-b

        # display modes
        - lvds
        - dp
        - dp-rbr
        - dp-hbr
        - dp-hbr2
        - dp-hbr3
        - dp-uhbr-10
        - dp-uhbr-13.5
        - dp-uhbr-20

        # camera modes
        - mipi-dphy
        - mipi-dphy-univ
        - mipi-dphy-v2.5-univ

properties:
  tx-p2p-microvolt:
    description:
      Transmit amplitude voltages in microvolts, peak-to-peak. If this property
      contains multiple values for various PHY modes, the
      'tx-p2p-microvolt-names' property must be provided and contain
      corresponding mode names.

  tx-p2p-microvolt-names:
    description:
      Names of the modes corresponding to voltages in the 'tx-p2p-microvolt'
      property. Required only if multiple voltages are provided.
    $ref: "#/$defs/protocol-names"

  rx-polarity:
    description:
      An array of values indicating whether the differential receiver's
      polarity is inverted. Each value can be one of
      PHY_POL_NORMAL (0) which means the negative signal is decoded from the
      RXN input, and the positive signal from the RXP input;
      PHY_POL_INVERT (1) which means the negative signal is decoded from the
      RXP input, and the positive signal from the RXN input;
      PHY_POL_AUTO (2) which means the receiver performs automatic polarity
      detection and correction, which is a mandatory part of link training for
      some protocols (PCIe, USB SS).

      The values are defined in <dt-bindings/phy/phy.h>. If the property is
      absent, the default value is undefined.

      Note that the RXP and RXN inputs refer to the block that this property is
      under, and do not necessarily directly translate to external pins.

      If this property contains multiple values for various protocols, the
      'rx-polarity-names' property must be provided.
    $ref: /schemas/types.yaml#/definitions/uint32-array
    minItems: 1
    maxItems: 16
    items:
      enum: [0, 1, 2]

  rx-polarity-names:
    $ref: '#/$defs/protocol-names'

  tx-polarity:
    description:
      Like 'rx-polarity', except it applies to differential transmitters,
      and only the values of PHY_POL_NORMAL and PHY_POL_INVERT are possible.
    $ref: /schemas/types.yaml#/definitions/uint32-array
    minItems: 1
    maxItems: 16
    items:
      enum: [0, 1]

  tx-polarity-names:
    $ref: '#/$defs/protocol-names'

dependencies:
  tx-p2p-microvolt-names: [ tx-p2p-microvolt ]
  rx-polarity-names: [ rx-polarity ]
  tx-polarity-names: [ tx-polarity ]

additionalProperties: true

examples:
  - |
    #include <dt-bindings/phy/phy.h>

    phy: phy {
      #phy-cells = <1>;
      tx-p2p-microvolt = <915000>, <1100000>, <1200000>;
      tx-p2p-microvolt-names = "2500base-x", "usb-hs", "usb-ss";
      rx-polarity = <PHY_POL_AUTO>, <PHY_POL_NORMAL>;
      rx-polarity-names = "usb-ss", "default";
      tx-polarity = <PHY_POL_INVERT>;
    };
```

## Documentation/devicetree/bindings/phy/phy-cpcap-usb.txt
```
Motorola CPCAP PMIC USB PHY binding

Required properties:
compatible: Shall be either "motorola,cpcap-usb-phy" or
	    "motorola,mapphone-cpcap-usb-phy"
#phy-cells: Shall be 0
interrupts: CPCAP PMIC interrupts used by the USB PHY
interrupt-names: Interrupt names
io-channels: IIO ADC channels used by the USB PHY
io-channel-names: IIO ADC channel names
vusb-supply: Regulator for the PHY

Optional properties:
pinctrl: Optional alternate pin modes for the PHY
pinctrl-names: Names for optional pin modes
mode-gpios: Optional GPIOs for configuring alternate modes

Example:
cpcap_usb2_phy: phy {
	compatible = "motorola,mapphone-cpcap-usb-phy";
	pinctrl-0 = <&usb_gpio_mux_sel1 &usb_gpio_mux_sel2>;
	pinctrl-1 = <&usb_ulpi_pins>;
	pinctrl-2 = <&usb_utmi_pins>;
	pinctrl-3 = <&uart3_pins>;
	pinctrl-names = "default", "ulpi", "utmi", "uart";
	#phy-cells = <0>;
	interrupts-extended = <
		&cpcap 15 0 &cpcap 14 0 &cpcap 28 0 &cpcap 19 0
		&cpcap 18 0 &cpcap 17 0 &cpcap 16 0 &cpcap 49 0
		&cpcap 48 1
	>;
	interrupt-names =
		"id_ground", "id_float", "se0conn", "vbusvld",
		"sessvld", "sessend", "se1", "dm", "dp";
	mode-gpios = <&gpio2 28 GPIO_ACTIVE_HIGH
		      &gpio1 0 GPIO_ACTIVE_HIGH>;
	io-channels = <&cpcap_adc 2>, <&cpcap_adc 7>;
	io-channel-names = "vbus", "id";
	vusb-supply = <&vusb>;
};
```

## Documentation/devicetree/bindings/phy/phy-da8xx-usb.txt
```
TI DA8xx/OMAP-L1xx/AM18xx USB PHY

Required properties:
 - compatible: must be "ti,da830-usb-phy".
 - #phy-cells: must be 1.

This device controls the PHY for both the USB 1.1 OHCI and USB 2.0 OTG
controllers on DA8xx SoCs. Consumers of this device should use index 0 for
the USB 2.0 phy device and index 1 for the USB 1.1 phy device.

It also requires a "syscon" node with compatible = "ti,da830-cfgchip", "syscon"
to access the CFGCHIP2 register.

Example:

	cfgchip: cfgchip@1417c {
		compatible = "ti,da830-cfgchip", "syscon";
		reg = <0x1417c 0x14>;
	};

	usb_phy: usb-phy {
		compatible = "ti,da830-usb-phy";
		#phy-cells = <1>;
	};

	usb20: usb@200000 {
		compatible = "ti,da830-musb";
		reg = <0x200000 0x1000>;
		interrupts = <58>;
		phys = <&usb_phy 0>;
		phy-names = "usb-phy";
	};

	usb11: usb@225000 {
		compatible = "ti,da830-ohci";
		reg = <0x225000 0x1000>;
		interrupts = <59>;
		phys = <&usb_phy 1>;
		phy-names = "usb-phy";
	};
```

## Documentation/devicetree/bindings/phy/phy-hi3660-usb3.txt
```
Hisilicon hi3660 USB PHY
-----------------------

Required properties:
- compatible: should be "hisilicon,hi3660-usb-phy"
- #phy-cells: must be 0
- hisilicon,pericrg-syscon: phandle of syscon used to control phy.
- hisilicon,pctrl-syscon: phandle of syscon used to control phy.
- hisilicon,eye-diagram-param: parameter set for phy
Refer to phy/phy-bindings.txt for the generic PHY binding properties

This is a subnode of usb3_otg_bc register node.

Example:
	usb3_otg_bc: usb3_otg_bc@ff200000 {
		compatible = "syscon", "simple-mfd";
		reg = <0x0 0xff200000 0x0 0x1000>;

		usb-phy {
			compatible = "hisilicon,hi3660-usb-phy";
			#phy-cells = <0>;
			hisilicon,pericrg-syscon = <&crg_ctrl>;
			hisilicon,pctrl-syscon = <&pctrl>;
			hisilicon,eye-diagram-param = <0x22466e4>;
		};
	};
```

## Documentation/devicetree/bindings/phy/phy-hi3798cv200-combphy.txt
```
HiSilicon STB PCIE/SATA/USB3 PHY

Required properties:
- compatible: Should be "hisilicon,hi3798cv200-combphy"
- reg: Should be the address space for COMBPHY configuration and state
  registers in peripheral controller, e.g. PERI_COMBPHY0_CFG and
  PERI_COMBPHY0_STATE for COMBPHY0 Hi3798CV200 SoC.
- #phy-cells: Should be 1.  The cell number is used to select the phy mode
  as defined in <dt-bindings/phy/phy.h>.
- clocks: The phandle to clock provider and clock specifier pair.
- resets: The phandle to reset controller and reset specifier pair.

Refer to phy/phy-bindings.txt for the generic PHY binding properties.

Optional properties:
- hisilicon,fixed-mode: If the phy device doesn't support mode select
  but a fixed mode setting, the property should be present to specify
  the particular mode.
- hisilicon,mode-select-bits: If the phy device support mode select,
  this property should be present to specify the register bits in
  peripheral controller, as a 3 integers tuple:
  <register_offset bit_shift bit_mask>.

Notes:
- Between hisilicon,fixed-mode and hisilicon,mode-select-bits, one and only
  one of them should be present.
- The device node should be a child of peripheral controller that contains
  COMBPHY configuration/state and PERI_CTRL register used to select PHY mode.
  Refer to arm/hisilicon/hisilicon.txt for the parent peripheral controller
  bindings.

Examples:

perictrl: peripheral-controller@8a20000 {
	compatible = "hisilicon,hi3798cv200-perictrl", "syscon",
		     "simple-mfd";
	reg = <0x8a20000 0x1000>;
	#address-cells = <1>;
	#size-cells = <1>;
	ranges = <0x0 0x8a20000 0x1000>;

	combphy0: phy@850 {
		compatible = "hisilicon,hi3798cv200-combphy";
		reg = <0x850 0x8>;
		#phy-cells = <1>;
		clocks = <&crg HISTB_COMBPHY0_CLK>;
		resets = <&crg 0x188 4>;
		hisilicon,fixed-mode = <PHY_TYPE_USB3>;
	};

	combphy1: phy@858 {
		compatible = "hisilicon,hi3798cv200-combphy";
		reg = <0x858 0x8>;
		#phy-cells = <1>;
		clocks = <&crg HISTB_COMBPHY1_CLK>;
		resets = <&crg 0x188 12>;
		hisilicon,mode-select-bits = <0x0008 11 (0x3 << 11)>;
	};
};
```

## Documentation/devicetree/bindings/phy/phy-hi6220-usb.txt
```
Hisilicon hi6220 usb PHY
-----------------------

Required properties:
- compatible: should be "hisilicon,hi6220-usb-phy"
- #phy-cells: must be 0
- hisilicon,peripheral-syscon: phandle of syscon used to control phy.
Refer to phy/phy-bindings.txt for the generic PHY binding properties

Example:
	usb_phy: usbphy {
		compatible = "hisilicon,hi6220-usb-phy";
		#phy-cells = <0>;
		phy-supply = <&fixed_5v_hub>;
		hisilicon,peripheral-syscon = <&sys_ctrl>;
	};
```

## Documentation/devicetree/bindings/phy/phy-hisi-inno-usb2.txt
```
Device tree bindings for HiSilicon INNO USB2 PHY

Required properties:
- compatible: Should be one of the following strings:
	"hisilicon,inno-usb2-phy",
	"hisilicon,hi3798cv200-usb2-phy".
- reg: Should be the address space for PHY configuration register in peripheral
  controller, e.g. PERI_USB0 for USB 2.0 PHY01 on Hi3798CV200 SoC.
- clocks: The phandle and clock specifier pair for INNO USB2 PHY device
  reference clock.
- resets: The phandle and reset specifier pair for INNO USB2 PHY device reset
  signal.
- #address-cells: Must be 1.
- #size-cells: Must be 0.

The INNO USB2 PHY device should be a child node of peripheral controller that
contains the PHY configuration register, and each device suppports up to 2 PHY
ports which are represented as child nodes of INNO USB2 PHY device.

Required properties for PHY port node:
- reg: The PHY port instance number.
- #phy-cells: Defined by generic PHY bindings.  Must be 0.
- resets: The phandle and reset specifier pair for PHY port reset signal.

Refer to phy/phy-bindings.txt for the generic PHY binding properties

Example:

perictrl: peripheral-controller@8a20000 {
	compatible = "hisilicon,hi3798cv200-perictrl", "simple-mfd";
	reg = <0x8a20000 0x1000>;
	#address-cells = <1>;
	#size-cells = <1>;
	ranges = <0x0 0x8a20000 0x1000>;

	usb2_phy1: usb2-phy@120 {
		compatible = "hisilicon,hi3798cv200-usb2-phy";
		reg = <0x120 0x4>;
		clocks = <&crg HISTB_USB2_PHY1_REF_CLK>;
		resets = <&crg 0xbc 4>;
		#address-cells = <1>;
		#size-cells = <0>;

		usb2_phy1_port0: phy@0 {
			reg = <0>;
			#phy-cells = <0>;
			resets = <&crg 0xbc 8>;
		};

		usb2_phy1_port1: phy@1 {
			reg = <1>;
			#phy-cells = <0>;
			resets = <&crg 0xbc 9>;
		};
	};

	usb2_phy2: usb2-phy@124 {
		compatible = "hisilicon,hi3798cv200-usb2-phy";
		reg = <0x124 0x4>;
		clocks = <&crg HISTB_USB2_PHY2_REF_CLK>;
		resets = <&crg 0xbc 6>;
		#address-cells = <1>;
		#size-cells = <0>;

		usb2_phy2_port0: phy@0 {
			reg = <0>;
			#phy-cells = <0>;
			resets = <&crg 0xbc 10>;
		};
	};
};
```

## Documentation/devicetree/bindings/phy/phy-lantiq-rcu-usb2.txt
```
Lantiq XWAY SoC RCU USB 1.1/2.0 PHY binding
===========================================

This binding describes the USB PHY hardware provided by the RCU module on the
Lantiq XWAY SoCs.

This node has to be a sub node of the Lantiq RCU block.

-------------------------------------------------------------------------------
Required properties (controller (parent) node):
- compatible	: Should be one of
			"lantiq,ase-usb2-phy"
			"lantiq,danube-usb2-phy"
			"lantiq,xrx100-usb2-phy"
			"lantiq,xrx200-usb2-phy"
			"lantiq,xrx300-usb2-phy"
- reg		: Defines the following sets of registers in the parent
		  syscon device
			- Offset of the USB PHY configuration register
			- Offset of the USB Analog configuration
			  register (only for xrx200 and xrx200)
- clocks	: References to the (PMU) "phy" clk gate.
- clock-names	: Must be "phy"
- resets	: References to the RCU USB configuration reset bits.
- reset-names	: Must be one of the following:
			"phy" (optional)
			"ctrl" (shared)

-------------------------------------------------------------------------------
Example for the USB PHYs on an xRX200 SoC:
	usb_phy0: usb2-phy@18 {
		compatible = "lantiq,xrx200-usb2-phy";
		reg = <0x18 4>, <0x38 4>;

		clocks = <&pmu PMU_GATE_USB0_PHY>;
		clock-names = "phy";
		resets = <&reset1 4 4>, <&reset0 4 4>;
		reset-names = "phy", "ctrl";
		#phy-cells = <0>;
	};
```

## Documentation/devicetree/bindings/phy/phy-lpc18xx-usb-otg.txt
```
NXP LPC18xx/43xx internal USB OTG PHY binding
---------------------------------------------

This file contains documentation for the internal USB OTG PHY found
in NXP LPC18xx and LPC43xx SoCs.

Required properties:
- compatible	: must be "nxp,lpc1850-usb-otg-phy"
- clocks	: must be exactly one entry
See: Documentation/devicetree/bindings/clock/clock-bindings.txt
- #phy-cells	: must be 0 for this phy
See: Documentation/devicetree/bindings/phy/phy-bindings.txt

The phy node must be a child of the creg syscon node.

Example:
creg: syscon@40043000 {
	compatible = "nxp,lpc1850-creg", "syscon", "simple-mfd";
	reg = <0x40043000 0x1000>;

	usb0_otg_phy: phy {
		compatible = "nxp,lpc1850-usb-otg-phy";
		clocks = <&ccu1 CLK_USB0>;
		#phy-cells = <0>;
	};
};
```

## Documentation/devicetree/bindings/phy/phy-mapphone-mdm6600.txt
```
Device tree binding documentation for Motorola Mapphone MDM6600 USB PHY

Required properties:
- compatible		Must be "motorola,mapphone-mdm6600"
- enable-gpios		GPIO to enable the USB PHY
- power-gpios		GPIO to power on the device
- reset-gpios		GPIO to reset the device
- motorola,mode-gpios	Two GPIOs to configure MDM6600 USB start-up mode for
			normal mode versus USB flashing mode
- motorola,cmd-gpios	Three GPIOs to control the power state of the MDM6600
- motorola,status-gpios	Three GPIOs to read the power state of the MDM6600

Example:

usb-phy {
	compatible = "motorola,mapphone-mdm6600";
	enable-gpios = <&gpio3 31 GPIO_ACTIVE_LOW>;
	power-gpios = <&gpio2 22 GPIO_ACTIVE_HIGH>;
	reset-gpios = <&gpio2 17 GPIO_ACTIVE_HIGH>;
	motorola,mode-gpios = <&gpio5 20 GPIO_ACTIVE_HIGH>,
			      <&gpio5 21 GPIO_ACTIVE_HIGH>;
	motorola,cmd-gpios = <&gpio4 7 GPIO_ACTIVE_HIGH>,
			     <&gpio4 8 GPIO_ACTIVE_HIGH>,
			     <&gpio5 14 GPIO_ACTIVE_HIGH>;
	motorola,status-gpios = <&gpio2 20 GPIO_ACTIVE_HIGH>,
				<&gpio2 21 GPIO_ACTIVE_HIGH>,
				<&gpio2 23 GPIO_ACTIVE_HIGH>;
	#phy-cells = <0>;
};
```
