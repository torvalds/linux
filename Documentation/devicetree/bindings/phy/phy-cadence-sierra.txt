## Documentation/devicetree/bindings/phy/phy-mtk-tphy.txt
```
MediaTek T-PHY binding
--------------------------

T-phy controller supports physical layer functionality for a number of
controllers on MediaTek SoCs, such as, USB2.0, USB3.0, PCIe, and SATA.

Required properties (controller (parent) node):
 - compatible	: should be one of
		  "mediatek,generic-tphy-v1"
		  "mediatek,generic-tphy-v2"
		  "mediatek,mt2701-u3phy" (deprecated)
		  "mediatek,mt2712-u3phy" (deprecated)
		  "mediatek,mt8173-u3phy";
		  make use of "mediatek,generic-tphy-v1" on mt2701 instead and
		  "mediatek,generic-tphy-v2" on mt2712 instead.
 - clocks	: (deprecated, use port's clocks instead) a list of phandle +
		  clock-specifier pairs, one for each entry in clock-names
 - clock-names	: (deprecated, use port's one instead) must contain
		  "u3phya_ref": for reference clock of usb3.0 analog phy.

Required nodes	: a sub-node is required for each port the controller
		  provides. Address range information including the usual
		  'reg' property is used inside these nodes to describe
		  the controller's topology.

Optional properties (controller (parent) node):
 - reg		: offset and length of register shared by multiple ports,
		  exclude port's private register. It is needed on mt2701
		  and mt8173, but not on mt2712.
 - mediatek,src-ref-clk-mhz	: frequency of reference clock for slew rate
		  calibrate
 - mediatek,src-coef	: coefficient for slew rate calibrate, depends on
		  SoC process

Required properties (port (child) node):
- reg		: address and length of the register set for the port.
- clocks	: a list of phandle + clock-specifier pairs, one for each
		  entry in clock-names
- clock-names	: must contain
		  "ref": 48M reference clock for HighSpeed analog phy; and 26M
			reference clock for SuperSpeed analog phy, sometimes is
			24M, 25M or 27M, depended on platform.
- #phy-cells	: should be 1 (See second example)
		  cell after port phandle is phy type from:
			- PHY_TYPE_USB2
			- PHY_TYPE_USB3
			- PHY_TYPE_PCIE
			- PHY_TYPE_SATA

Optional properties (PHY_TYPE_USB2 port (child) node):
- mediatek,eye-src	: u32, the value of slew rate calibrate
- mediatek,eye-vrt	: u32, the selection of VRT reference voltage
- mediatek,eye-term	: u32, the selection of HS_TX TERM reference voltage
- mediatek,bc12	: bool, enable BC12 of u2phy if support it
- mediatek,discth	: u32, the selection of disconnect threshold
- mediatek,intr	: u32, the selection of internal R (resistance)

Example:

u3phy: usb-phy@11290000 {
	compatible = "mediatek,mt8173-u3phy";
	reg = <0 0x11290000 0 0x800>;
	#address-cells = <2>;
	#size-cells = <2>;
	ranges;

	u2port0: usb-phy@11290800 {
		reg = <0 0x11290800 0 0x100>;
		clocks = <&apmixedsys CLK_APMIXED_REF2USB_TX>;
		clock-names = "ref";
		#phy-cells = <1>;
	};

	u3port0: usb-phy@11290900 {
		reg = <0 0x11290800 0 0x700>;
		clocks = <&clk26m>;
		clock-names = "ref";
		#phy-cells = <1>;
	};

	u2port1: usb-phy@11291000 {
		reg = <0 0x11291000 0 0x100>;
		clocks = <&apmixedsys CLK_APMIXED_REF2USB_TX>;
		clock-names = "ref";
		#phy-cells = <1>;
	};
};

Specifying phy control of devices
---------------------------------

Device nodes should specify the configuration required in their "phys"
property, containing a phandle to the phy port node and a device type;
phy-names for each port are optional.

Example:

#include <dt-bindings/phy/phy.h>

usb30: usb@11270000 {
	...
	phys = <&u2port0 PHY_TYPE_USB2>, <&u3port0 PHY_TYPE_USB3>;
	phy-names = "usb2-0", "usb3-0";
	...
};


Layout differences of banks between mt8173/mt2701 and mt2712
-------------------------------------------------------------
mt8173 and mt2701:
port        offset    bank
shared      0x0000    SPLLC
            0x0100    FMREG
u2 port0    0x0800    U2PHY_COM
u3 port0    0x0900    U3PHYD
            0x0a00    U3PHYD_BANK2
            0x0b00    U3PHYA
            0x0c00    U3PHYA_DA
u2 port1    0x1000    U2PHY_COM
u3 port1    0x1100    U3PHYD
            0x1200    U3PHYD_BANK2
            0x1300    U3PHYA
            0x1400    U3PHYA_DA
u2 port2    0x1800    U2PHY_COM
            ...

mt2712:
port        offset    bank
u2 port0    0x0000    MISC
            0x0100    FMREG
            0x0300    U2PHY_COM
u3 port0    0x0700    SPLLC
            0x0800    CHIP
            0x0900    U3PHYD
            0x0a00    U3PHYD_BANK2
            0x0b00    U3PHYA
            0x0c00    U3PHYA_DA
u2 port1    0x1000    MISC
            0x1100    FMREG
            0x1300    U2PHY_COM
u3 port1    0x1700    SPLLC
            0x1800    CHIP
            0x1900    U3PHYD
            0x1a00    U3PHYD_BANK2
            0x1b00    U3PHYA
            0x1c00    U3PHYA_DA
u2 port2    0x2000    MISC
            ...

    SPLLC shared by u3 ports and FMREG shared by u2 ports on
mt8173/mt2701 are put back into each port; a new bank MISC for
u2 ports and CHIP for u3 ports are added on mt2712.
```

## Documentation/devicetree/bindings/phy/phy-mtk-ufs.txt
```
MediaTek Universal Flash Storage (UFS) M-PHY binding
--------------------------------------------------------

UFS M-PHY nodes are defined to describe on-chip UFS M-PHY hardware macro.
Each UFS M-PHY node should have its own node.

To bind UFS M-PHY with UFS host controller, the controller node should
contain a phandle reference to UFS M-PHY node.

Required properties for UFS M-PHY nodes:
- compatible         : Compatible list, contains the following controller:
                       "mediatek,mt8183-ufsphy" for ufs phy
                       persent on MT81xx chipsets.
- reg                : Address and length of the UFS M-PHY register set.
- #phy-cells         : This property shall be set to 0.
- clocks             : List of phandle and clock specifier pairs.
- clock-names        : List of clock input name strings sorted in the same
                       order as the clocks property. Following clocks are
                       mandatory.
                       "unipro": Unipro core control clock.
                       "mp": M-PHY core control clock.

Example:

	ufsphy: phy@11fa0000 {
		compatible = "mediatek,mt8183-ufsphy";
		reg = <0 0x11fa0000 0 0xc000>;
		#phy-cells = <0>;

		clocks = <&infracfg_ao INFRACFG_AO_UNIPRO_SCK_CG>,
			 <&infracfg_ao INFRACFG_AO_UFS_MP_SAP_BCLK_CG>;
		clock-names = "unipro", "mp";
	};

	ufshci@11270000 {
		...
		phys = <&ufsphy>;
	};
```

## Documentation/devicetree/bindings/phy/phy-mtk-xsphy.txt
```
MediaTek XS-PHY binding
--------------------------

The XS-PHY controller supports physical layer functionality for USB3.1
GEN2 controller on MediaTek SoCs.

Required properties (controller (parent) node):
 - compatible	: should be "mediatek,<soc-model>-xsphy", "mediatek,xsphy",
		  soc-model is the name of SoC, such as mt3611 etc;
		  when using "mediatek,xsphy" compatible string, you need SoC specific
		  ones in addition, one of:
		  - "mediatek,mt3611-xsphy"

 - #address-cells, #size-cells : should use the same values as the root node
 - ranges: must be present

Optional properties (controller (parent) node):
 - reg		: offset and length of register shared by multiple U3 ports,
		  exclude port's private register, if only U2 ports provided,
		  shouldn't use the property.
 - mediatek,src-ref-clk-mhz	: u32, frequency of reference clock for slew rate
		  calibrate
 - mediatek,src-coef	: u32, coefficient for slew rate calibrate, depends on
		  SoC process

Required nodes	: a sub-node is required for each port the controller
		  provides. Address range information including the usual
		  'reg' property is used inside these nodes to describe
		  the controller's topology.

Required properties (port (child) node):
- reg		: address and length of the register set for the port.
- clocks	: a list of phandle + clock-specifier pairs, one for each
		  entry in clock-names
- clock-names	: must contain
		  "ref": 48M reference clock for HighSpeed analog phy; and 26M
			reference clock for SuperSpeedPlus analog phy, sometimes is
			24M, 25M or 27M, depended on platform.
- #phy-cells	: should be 1
		  cell after port phandle is phy type from:
			- PHY_TYPE_USB2
			- PHY_TYPE_USB3

The following optional properties are only for debug or HQA test
Optional properties (PHY_TYPE_USB2 port (child) node):
- mediatek,eye-src	: u32, the value of slew rate calibrate
- mediatek,eye-vrt	: u32, the selection of VRT reference voltage
- mediatek,eye-term	: u32, the selection of HS_TX TERM reference voltage
- mediatek,efuse-intr	: u32, the selection of Internal Resistor

Optional properties (PHY_TYPE_USB3 port (child) node):
- mediatek,efuse-intr	: u32, the selection of Internal Resistor
- mediatek,efuse-tx-imp	: u32, the selection of TX Impedance
- mediatek,efuse-rx-imp	: u32, the selection of RX Impedance

Banks layout of xsphy
-------------------------------------------------------------
port        offset    bank
u2 port0    0x0000    MISC
            0x0100    FMREG
            0x0300    U2PHY_COM
u2 port1    0x1000    MISC
            0x1100    FMREG
            0x1300    U2PHY_COM
u2 port2    0x2000    MISC
            ...
u31 common  0x3000    DIG_GLB
            0x3100    PHYA_GLB
u31 port0   0x3400    DIG_LN_TOP
            0x3500    DIG_LN_TX0
            0x3600    DIG_LN_RX0
            0x3700    DIG_LN_DAIF
            0x3800    PHYA_LN
u31 port1   0x3a00    DIG_LN_TOP
            0x3b00    DIG_LN_TX0
            0x3c00    DIG_LN_RX0
            0x3d00    DIG_LN_DAIF
            0x3e00    PHYA_LN
            ...

DIG_GLB & PHYA_GLB are shared by U31 ports.

Example:

u3phy: usb-phy@11c40000 {
	compatible = "mediatek,mt3611-xsphy", "mediatek,xsphy";
	reg = <0 0x11c43000 0 0x0200>;
	mediatek,src-ref-clk-mhz = <26>;
	mediatek,src-coef = <17>;
	#address-cells = <2>;
	#size-cells = <2>;
	ranges;

	u2port0: usb-phy@11c40000 {
		reg = <0 0x11c40000 0 0x0400>;
		clocks = <&clk48m>;
		clock-names = "ref";
		mediatek,eye-src = <4>;
		#phy-cells = <1>;
	};

	u3port0: usb-phy@11c43000 {
		reg = <0 0x11c43400 0 0x0500>;
		clocks = <&clk26m>;
		clock-names = "ref";
		mediatek,efuse-intr = <28>;
		#phy-cells = <1>;
	};
};
```

## Documentation/devicetree/bindings/phy/phy-mvebu-comphy.txt
```
MVEBU comphy drivers
--------------------

COMPHY controllers can be found on the following Marvell MVEBU SoCs:
* Armada 7k/8k (on the CP110)
* Armada 3700
It provides a number of shared PHYs used by various interfaces (network, SATA,
USB, PCIe...).

Required properties:

- compatible: should be one of:
  * "marvell,comphy-cp110" for Armada 7k/8k
  * "marvell,comphy-a3700" for Armada 3700
- reg: should contain the COMPHY register(s) location(s) and length(s).
  * 1 entry for Armada 7k/8k
  * 4 entries for Armada 3700 along with the corresponding reg-names
    properties, memory areas are:
    * Generic COMPHY registers
    * Lane 1 (PCIe/GbE)
    * Lane 0 (USB3/GbE)
    * Lane 2 (SATA/USB3)
- marvell,system-controller: should contain a phandle to the system
			     controller node (only for Armada 7k/8k)
- #address-cells: should be 1.
- #size-cells: should be 0.

A sub-node is required for each comphy lane provided by the comphy.

Required properties (child nodes):

- reg: COMPHY lane number.
- #phy-cells : from the generic PHY bindings, must be 1. Defines the
               input port to use for a given comphy lane.

Examples:

	cpm_comphy: phy@120000 {
		compatible = "marvell,comphy-cp110";
		reg = <0x120000 0x6000>;
		marvell,system-controller = <&cpm_syscon0>;
		#address-cells = <1>;
		#size-cells = <0>;

		cpm_comphy0: phy@0 {
			reg = <0>;
			#phy-cells = <1>;
		};

		cpm_comphy1: phy@1 {
			reg = <1>;
			#phy-cells = <1>;
		};
	};

	comphy: phy@18300 {
		compatible = "marvell,comphy-a3700";
		reg = <0x18300 0x300>,
		<0x1F000 0x400>,
		<0x5C000 0x400>,
		<0xe0178 0x8>;
		reg-names = "comphy",
		"lane1_pcie_gbe",
		"lane0_usb3_gbe",
		"lane2_sata_usb3";
		#address-cells = <1>;
		#size-cells = <0>;


		comphy0: phy@0 {
			reg = <0>;
			#phy-cells = <1>;
		};

		comphy1: phy@1 {
			reg = <1>;
			#phy-cells = <1>;
		};

		comphy2: phy@2 {
			reg = <2>;
			#phy-cells = <1>;
		};
	};
```

## Documentation/devicetree/bindings/phy/phy-mvebu-utmi.txt
```
MVEBU A3700 UTMI PHY
--------------------

USB2 UTMI+ PHY controllers can be found on the following Marvell MVEBU SoCs:
* Armada 3700

On Armada 3700, there are two USB controllers, one is compatible with the USB2
and USB3 specifications and supports OTG. The other one is USB2 compliant and
only supports host mode. Both of these controllers come with a slightly
different UTMI PHY.

Required Properties:

- compatible: Should be one of:
	      * "marvell,a3700-utmi-host-phy" for the PHY connected to
	        the USB2 host-only controller.
	      * "marvell,a3700-utmi-otg-phy" for the PHY connected to
	        the USB3 and USB2 OTG capable controller.
- reg: PHY IP register range.
- marvell,usb-misc-reg: handle on the "USB miscellaneous registers" shared
			region covering registers related to both the host
			controller and the PHY.
- #phy-cells: Standard property (Documentation: phy-bindings.txt) Should be 0.


Example:

	usb2_utmi_host_phy: phy@5f000 {
		compatible = "marvell,armada-3700-utmi-host-phy";
		reg = <0x5f000 0x800>;
		marvell,usb-misc-reg = <&usb2_syscon>;
		#phy-cells = <0>;
	};

	usb2_syscon: system-controller@5f800 {
		compatible = "marvell,armada-3700-usb2-host-misc", "syscon";
		reg = <0x5f800 0x800>;
	};
```

## Documentation/devicetree/bindings/phy/phy-mvebu.txt
```
* Marvell MVEBU SATA PHY

Power control for the SATA phy found on Marvell MVEBU SoCs.

This document extends the binding described in phy-bindings.txt

Required properties :

 - reg		   : Offset and length of the register set for the SATA device
 - compatible	   : Should be "marvell,mvebu-sata-phy"
 - clocks	   : phandle of clock and specifier that supplies the device
 - clock-names	   : Should be "sata"

Example:
		sata-phy@84000 {
			compatible = "marvell,mvebu-sata-phy";
			reg = <0x84000 0x0334>;
			clocks = <&gate_clk 15>;
			clock-names = "sata";
			#phy-cells = <0>;
		};

Armada 375 USB cluster
----------------------

Armada 375 comes with an USB2 host and device controller and an USB3
controller. The USB cluster control register allows to manage common
features of both USB controllers.

Required properties:

- compatible: "marvell,armada-375-usb-cluster"
- reg: Should contain usb cluster register location and length.
- #phy-cells : from the generic phy bindings, must be 1. Possible
values are 1 (USB2), 2 (USB3).

Example:
		usbcluster: usb-cluster@18400 {
			compatible = "marvell,armada-375-usb-cluster";
			reg = <0x18400 0x4>;
			#phy-cells = <1>
		};
```
