## Documentation/devicetree/bindings/ufs/qcom,ufs.yaml
```yaml
# SPDX-License-Identifier: GPL-2.0-only OR BSD-2-Clause
%YAML 1.2
---
$id: http://devicetree.org/schemas/ufs/qcom,ufs.yaml#
$schema: http://devicetree.org/meta-schemas/core.yaml#

title: Qualcomm Universal Flash Storage (UFS) Controller

maintainers:
  - Bjorn Andersson <bjorn.andersson@linaro.org>
  - Andy Gross <agross@kernel.org>

# Select only our matches, not all jedec,ufs-2.0
select:
  properties:
    compatible:
      contains:
        const: qcom,ufshc
  required:
    - compatible

properties:
  compatible:
    items:
      - enum:
          - qcom,msm8994-ufshc
          - qcom,msm8996-ufshc
          - qcom,msm8998-ufshc
          - qcom,sc8280xp-ufshc
          - qcom,sdm845-ufshc
          - qcom,sm6350-ufshc
          - qcom,sm8150-ufshc
          - qcom,sm8250-ufshc
          - qcom,sm8350-ufshc
          - qcom,sm8450-ufshc
      - const: qcom,ufshc
      - const: jedec,ufs-2.0

  clocks:
    minItems: 8
    maxItems: 11

  clock-names:
    minItems: 8
    maxItems: 11

  interconnects:
    minItems: 2
    maxItems: 2

  interconnect-names:
    items:
      - const: ufs-ddr
      - const: cpu-ufs

  iommus:
    minItems: 1
    maxItems: 2

  phys:
    maxItems: 1

  phy-names:
    items:
      - const: ufsphy

  power-domains:
    maxItems: 1

  reg:
    minItems: 1
    maxItems: 2

  resets:
    maxItems: 1

  '#reset-cells':
    const: 1

  reset-names:
    items:
      - const: rst

  reset-gpios:
    maxItems: 1
    description:
      GPIO connected to the RESET pin of the UFS memory device.

required:
  - compatible
  - reg

allOf:
  - $ref: ufs-common.yaml

  - if:
      properties:
        compatible:
          contains:
            enum:
              - qcom,msm8998-ufshc
              - qcom,sc8280xp-ufshc
              - qcom,sm8250-ufshc
              - qcom,sm8350-ufshc
              - qcom,sm8450-ufshc
    then:
      properties:
        clocks:
          minItems: 8
          maxItems: 8
        clock-names:
          items:
            - const: core_clk
            - const: bus_aggr_clk
            - const: iface_clk
            - const: core_clk_unipro
            - const: ref_clk
            - const: tx_lane0_sync_clk
            - const: rx_lane0_sync_clk
            - const: rx_lane1_sync_clk
        reg:
          minItems: 1
          maxItems: 1

  - if:
      properties:
        compatible:
          contains:
            enum:
              - qcom,sdm845-ufshc
              - qcom,sm6350-ufshc
              - qcom,sm8150-ufshc
    then:
      properties:
        clocks:
          minItems: 9
          maxItems: 9
        clock-names:
          items:
            - const: core_clk
            - const: bus_aggr_clk
            - const: iface_clk
            - const: core_clk_unipro
            - const: ref_clk
            - const: tx_lane0_sync_clk
            - const: rx_lane0_sync_clk
            - const: rx_lane1_sync_clk
            - const: ice_core_clk
        reg:
          minItems: 2
          maxItems: 2

  - if:
      properties:
        compatible:
          contains:
            enum:
              - qcom,msm8996-ufshc
    then:
      properties:
        clocks:
          minItems: 11
          maxItems: 11
        clock-names:
          items:
            - const: core_clk_src
            - const: core_clk
            - const: bus_clk
            - const: bus_aggr_clk
            - const: iface_clk
            - const: core_clk_unipro_src
            - const: core_clk_unipro
            - const: core_clk_ice
            - const: ref_clk
            - const: tx_lane0_sync_clk
            - const: rx_lane0_sync_clk
        reg:
          minItems: 1
          maxItems: 1

    # TODO: define clock bindings for qcom,msm8994-ufshc

unevaluatedProperties: false

examples:
  - |
    #include <dt-bindings/clock/qcom,gcc-sm8450.h>
    #include <dt-bindings/clock/qcom,rpmh.h>
    #include <dt-bindings/gpio/gpio.h>
    #include <dt-bindings/interconnect/qcom,sm8450.h>
    #include <dt-bindings/interrupt-controller/arm-gic.h>

    soc {
        #address-cells = <2>;
        #size-cells = <2>;

        ufs@1d84000 {
            compatible = "qcom,sm8450-ufshc", "qcom,ufshc",
                         "jedec,ufs-2.0";
            reg = <0 0x01d84000 0 0x3000>;
            interrupts = <GIC_SPI 265 IRQ_TYPE_LEVEL_HIGH>;
            phys = <&ufs_mem_phy_lanes>;
            phy-names = "ufsphy";
            lanes-per-direction = <2>;
            #reset-cells = <1>;
            resets = <&gcc GCC_UFS_PHY_BCR>;
            reset-names = "rst";
            reset-gpios = <&tlmm 210 GPIO_ACTIVE_LOW>;

            vcc-supply = <&vreg_l7b_2p5>;
            vcc-max-microamp = <1100000>;
            vccq-supply = <&vreg_l9b_1p2>;
            vccq-max-microamp = <1200000>;

            power-domains = <&gcc UFS_PHY_GDSC>;
            iommus = <&apps_smmu 0xe0 0x0>;
            interconnects = <&aggre1_noc MASTER_UFS_MEM &mc_virt SLAVE_EBI1>,
                            <&gem_noc MASTER_APPSS_PROC &config_noc SLAVE_UFS_MEM_CFG>;
            interconnect-names = "ufs-ddr", "cpu-ufs";

            clock-names = "core_clk",
                          "bus_aggr_clk",
                          "iface_clk",
                          "core_clk_unipro",
                          "ref_clk",
                          "tx_lane0_sync_clk",
                          "rx_lane0_sync_clk",
                          "rx_lane1_sync_clk";
            clocks = <&gcc GCC_UFS_PHY_AXI_CLK>,
                     <&gcc GCC_AGGRE_UFS_PHY_AXI_CLK>,
                     <&gcc GCC_UFS_PHY_AHB_CLK>,
                     <&gcc GCC_UFS_PHY_UNIPRO_CORE_CLK>,
                     <&rpmhcc RPMH_CXO_CLK>,
                     <&gcc GCC_UFS_PHY_TX_SYMBOL_0_CLK>,
                     <&gcc GCC_UFS_PHY_RX_SYMBOL_0_CLK>,
                     <&gcc GCC_UFS_PHY_RX_SYMBOL_1_CLK>;
            freq-table-hz = <75000000 300000000>,
                            <0 0>,
                            <0 0>,
                            <75000000 300000000>,
                            <75000000 300000000>,
                            <0 0>,
                            <0 0>,
                            <0 0>;
        };
    };
```

## Documentation/devicetree/bindings/ufs/renesas,ufs.yaml
```yaml
# SPDX-License-Identifier: (GPL-2.0-only OR BSD-2-Clause)
%YAML 1.2
---
$id: http://devicetree.org/schemas/ufs/renesas,ufs.yaml#
$schema: http://devicetree.org/meta-schemas/core.yaml#

title: Renesas R-Car UFS Host Controller

maintainers:
  - Yoshihiro Shimoda <yoshihiro.shimoda.uh@renesas.com>

allOf:
  - $ref: ufs-common.yaml

properties:
  compatible:
    const: renesas,r8a779f0-ufs

  reg:
    maxItems: 1

  clocks:
    maxItems: 2

  clock-names:
    items:
      - const: fck
      - const: ref_clk

  power-domains:
    maxItems: 1

  resets:
    maxItems: 1

required:
  - compatible
  - reg
  - clocks
  - clock-names
  - power-domains
  - resets

unevaluatedProperties: false

examples:
  - |
    #include <dt-bindings/clock/r8a779f0-cpg-mssr.h>
    #include <dt-bindings/interrupt-controller/arm-gic.h>
    #include <dt-bindings/power/r8a779f0-sysc.h>

    ufs: ufs@e686000 {
        compatible = "renesas,r8a779f0-ufs";
        reg = <0xe6860000 0x100>;
        interrupts = <GIC_SPI 235 IRQ_TYPE_LEVEL_HIGH>;
        clocks = <&cpg CPG_MOD 1514>, <&ufs30_clk>;
        clock-names = "fck", "ref_clk";
        freq-table-hz = <200000000 200000000>, <38400000 38400000>;
        power-domains = <&sysc R8A779F0_PD_ALWAYS_ON>;
        resets = <&cpg 1514>;
    };
```

## Documentation/devicetree/bindings/ufs/rockchip,rk3576-ufshc.yaml
```yaml
# SPDX-License-Identifier: (GPL-2.0-only OR BSD-2-Clause)
%YAML 1.2
---
$id: http://devicetree.org/schemas/ufs/rockchip,rk3576-ufshc.yaml#
$schema: http://devicetree.org/meta-schemas/core.yaml#

title: Rockchip UFS Host Controller

maintainers:
  - Shawn Lin <shawn.lin@rock-chips.com>

allOf:
  - $ref: ufs-common.yaml

properties:
  compatible:
    const: rockchip,rk3576-ufshc

  reg:
    maxItems: 5

  reg-names:
    items:
      - const: hci
      - const: mphy
      - const: hci_grf
      - const: mphy_grf
      - const: hci_apb

  clocks:
    maxItems: 4

  clock-names:
    items:
      - const: core
      - const: pclk
      - const: pclk_mphy
      - const: ref_out

  power-domains:
    maxItems: 1

  resets:
    maxItems: 4

  reset-names:
    items:
      - const: biu
      - const: sys
      - const: ufs
      - const: grf

  reset-gpios:
    maxItems: 1
    description: |
      GPIO specifiers for host to reset the whole UFS device including PHY and
      memory. This gpio is active low and should choose the one whose high output
      voltage is lower than 1.5V based on the UFS spec.

required:
  - compatible
  - reg
  - reg-names
  - clocks
  - clock-names
  - interrupts
  - power-domains
  - resets
  - reset-names
  - reset-gpios

unevaluatedProperties: false

examples:
  - |
    #include <dt-bindings/clock/rockchip,rk3576-cru.h>
    #include <dt-bindings/reset/rockchip,rk3576-cru.h>
    #include <dt-bindings/interrupt-controller/arm-gic.h>
    #include <dt-bindings/power/rockchip,rk3576-power.h>
    #include <dt-bindings/pinctrl/rockchip.h>
    #include <dt-bindings/gpio/gpio.h>

    soc {
        #address-cells = <2>;
        #size-cells = <2>;

        ufshc: ufshc@2a2d0000 {
            compatible = "rockchip,rk3576-ufshc";
            reg = <0x0 0x2a2d0000 0x0 0x10000>,
                  <0x0 0x2b040000 0x0 0x10000>,
                  <0x0 0x2601f000 0x0 0x1000>,
                  <0x0 0x2603c000 0x0 0x1000>,
                  <0x0 0x2a2e0000 0x0 0x10000>;
            reg-names = "hci", "mphy", "hci_grf", "mphy_grf", "hci_apb";
            clocks = <&cru ACLK_UFS_SYS>, <&cru PCLK_USB_ROOT>, <&cru PCLK_MPHY>,
                     <&cru CLK_REF_UFS_CLKOUT>;
            clock-names = "core", "pclk", "pclk_mphy", "ref_out";
            interrupts = <GIC_SPI 361 IRQ_TYPE_LEVEL_HIGH>;
            power-domains = <&power RK3576_PD_USB>;
            resets = <&cru SRST_A_UFS_BIU>, <&cru SRST_A_UFS_SYS>, <&cru SRST_A_UFS>,
                     <&cru SRST_P_UFS_GRF>;
            reset-names = "biu", "sys", "ufs", "grf";
            reset-gpios = <&gpio4 RK_PD0 GPIO_ACTIVE_LOW>;
        };
    };
```

## Documentation/devicetree/bindings/ufs/samsung,exynos-ufs.yaml
```yaml
# SPDX-License-Identifier: GPL-2.0-only OR BSD-2-Clause
%YAML 1.2
---
$id: http://devicetree.org/schemas/ufs/samsung,exynos-ufs.yaml#
$schema: http://devicetree.org/meta-schemas/core.yaml#

title: Samsung SoC series UFS host controller

maintainers:
  - Alim Akhtar <alim.akhtar@samsung.com>

description: |
  Each Samsung UFS host controller instance should have its own node.

properties:
  compatible:
    enum:
      - google,gs101-ufs
      - samsung,exynos7-ufs
      - samsung,exynosautov9-ufs
      - samsung,exynosautov9-ufs-vh
      - tesla,fsd-ufs

  reg:
    items:
      - description: HCI register
      - description: vendor specific register
      - description: unipro register
      - description: UFS protector register

  reg-names:
    items:
      - const: hci
      - const: vs_hci
      - const: unipro
      - const: ufsp

  clocks:
    minItems: 2
    items:
      - description: ufs link core clock
      - description: unipro main clock
      - description: fmp clock
      - description: ufs aclk clock
      - description: ufs pclk clock
      - description: sysreg clock

  clock-names:
    minItems: 2
    items:
      - const: core_clk
      - const: sclk_unipro_main
      - const: fmp
      - const: aclk
      - const: pclk
      - const: sysreg

  phys:
    maxItems: 1

  phy-names:
    const: ufs-phy

  samsung,sysreg:
    $ref: /schemas/types.yaml#/definitions/phandle-array
    items:
      - items:
          - description: phandle to FSYSx sysreg node
          - description: offset of the control register for UFS io coherency setting
    description:
      Phandle and offset to the FSYSx sysreg for UFS io coherency setting.

  dma-coherent: true

required:
  - compatible
  - reg
  - phys
  - phy-names
  - clocks
  - clock-names

allOf:
  - $ref: ufs-common.yaml
  - if:
      properties:
        compatible:
          contains:
            const: google,gs101-ufs

    then:
      properties:
        clocks:
          minItems: 6

        clock-names:
          minItems: 6

    else:
      properties:
        clocks:
          maxItems: 2

        clock-names:
          maxItems: 2

unevaluatedProperties: false

examples:
  - |
    #include <dt-bindings/interrupt-controller/arm-gic.h>
    #include <dt-bindings/clock/exynos7-clk.h>

    ufs: ufs@15570000 {
       compatible = "samsung,exynos7-ufs";
       reg = <0x15570000 0x100>,
             <0x15570100 0x100>,
             <0x15571000 0x200>,
             <0x15572000 0x300>;
       reg-names = "hci", "vs_hci", "unipro", "ufsp";
       interrupts = <GIC_SPI 200 IRQ_TYPE_LEVEL_HIGH>;
       clocks = <&clock_fsys1 ACLK_UFS20_LINK>,
                <&clock_fsys1 SCLK_UFSUNIPRO20_USER>;
       clock-names = "core_clk", "sclk_unipro_main";
       pinctrl-names = "default";
       pinctrl-0 = <&ufs_rst_n &ufs_refclk_out>;
       phys = <&ufs_phy>;
       phy-names = "ufs-phy";
    };
...
```

## Documentation/devicetree/bindings/ufs/snps,tc-dwc-g210.yaml
```yaml
# SPDX-License-Identifier: GPL-2.0-only OR BSD-2-Clause
%YAML 1.2
---
$id: http://devicetree.org/schemas/ufs/snps,tc-dwc-g210.yaml#
$schema: http://devicetree.org/meta-schemas/core.yaml#

title: Synopsys DesignWare Universal Flash Storage (UFS) Controller

maintainers:
  - Li Wei <liwei213@huawei.com>

# Select only our matches, not all jedec,ufs
select:
  properties:
    compatible:
      contains:
        enum:
          - snps,dwc-ufshcd-1.40a
  required:
    - compatible

allOf:
  - $ref: ufs-common.yaml

properties:
  compatible:
    items:
      - enum:
          - snps,g210-tc-6.00-20bit
          - snps,g210-tc-6.00-40bit
      - const: snps,dwc-ufshcd-1.40a
      - const: jedec,ufs-2.0

  reg:
    maxItems: 1

required:
  - compatible
  - reg

unevaluatedProperties: false

examples:
  - |
    ufs@d0000000 {
        compatible = "snps,g210-tc-6.00-40bit",
                     "snps,dwc-ufshcd-1.40a",
                     "jedec,ufs-2.0";
        reg = <0xd0000000 0x10000>;
        interrupts = <24>;
    };
```
