## Documentation/devicetree/bindings/ufs/mediatek,ufs.yaml
```yaml
# SPDX-License-Identifier: GPL-2.0-only OR BSD-2-Clause
%YAML 1.2
---
$id: http://devicetree.org/schemas/ufs/mediatek,ufs.yaml#
$schema: http://devicetree.org/meta-schemas/core.yaml#

title: Mediatek Universal Flash Storage (UFS) Controller

maintainers:
  - Stanley Chu <stanley.chu@mediatek.com>

properties:
  compatible:
    enum:
      - mediatek,mt8183-ufshci
      - mediatek,mt8192-ufshci
      - mediatek,mt8195-ufshci

  clocks:
    minItems: 1
    maxItems: 8

  clock-names:
    minItems: 1
    maxItems: 8

  phys:
    maxItems: 1

  reg:
    maxItems: 1

  vcc-supply: true

  mediatek,ufs-disable-mcq:
    $ref: /schemas/types.yaml#/definitions/flag
    description: The mask to disable MCQ (Multi-Circular Queue) for UFS host.

required:
  - compatible
  - clocks
  - clock-names
  - phys
  - reg
  - vcc-supply

unevaluatedProperties: false

allOf:
  - $ref: ufs-common.yaml

  - if:
      properties:
        compatible:
          contains:
            enum:
              - mediatek,mt8195-ufshci
    then:
      properties:
        clocks:
          minItems: 8
        clock-names:
          items:
            - const: ufs
            - const: ufs_aes
            - const: ufs_tick
            - const: unipro_sysclk
            - const: unipro_tick
            - const: unipro_mp_bclk
            - const: ufs_tx_symbol
            - const: ufs_mem_sub
    else:
      properties:
        clocks:
          maxItems: 1
        clock-names:
          items:
            - const: ufs

examples:
  - |
    #include <dt-bindings/clock/mt8183-clk.h>
    #include <dt-bindings/interrupt-controller/arm-gic.h>

    soc {
        #address-cells = <2>;
        #size-cells = <2>;

        ufs@ff3c0000 {
            compatible = "mediatek,mt8183-ufshci";
            reg = <0 0x11270000 0 0x2300>;
            interrupts = <GIC_SPI 104 IRQ_TYPE_LEVEL_LOW>;
            phys = <&ufsphy>;

            clocks = <&infracfg_ao CLK_INFRA_UFS>;
            clock-names = "ufs";
            freq-table-hz = <0 0>;

            vcc-supply = <&mt_pmic_vemc_ldo_reg>;
        };
    };
```

## Documentation/devicetree/bindings/ufs/qcom,sa8255p-ufshc.yaml
```yaml
# SPDX-License-Identifier: GPL-2.0-only OR BSD-2-Clause
%YAML 1.2
---
$id: http://devicetree.org/schemas/ufs/qcom,sa8255p-ufshc.yaml#
$schema: http://devicetree.org/meta-schemas/core.yaml#

title: Qualcomm SA8255P UFS Host Controller

maintainers:
  - Ram Kumar Dwivedi <ram.dwivedi@oss.qualcomm.com>

properties:
  compatible:
    const: qcom,sa8255p-ufshc

  reg:
    maxItems: 1

  interrupts:
    maxItems: 1

  iommus:
    maxItems: 1

  dma-coherent: true

  power-domains:
    maxItems: 1

required:
  - compatible
  - reg
  - interrupts
  - power-domains
  - iommus
  - dma-coherent

allOf:
  - $ref: ufs-common.yaml

unevaluatedProperties: false

examples:
  - |
    #include <dt-bindings/interrupt-controller/arm-gic.h>

    ufshc@1d84000 {
        compatible = "qcom,sa8255p-ufshc";
        reg = <0x01d84000 0x3000>;
        interrupts = <GIC_SPI 265 IRQ_TYPE_LEVEL_HIGH>;
        lanes-per-direction = <2>;

        iommus = <&apps_smmu 0x100 0x0>;
        power-domains = <&scmi3_pd 0>;
        dma-coherent;
    };
```

## Documentation/devicetree/bindings/ufs/qcom,sc7180-ufshc.yaml
```yaml
# SPDX-License-Identifier: GPL-2.0-only OR BSD-2-Clause
%YAML 1.2
---
$id: http://devicetree.org/schemas/ufs/qcom,sc7180-ufshc.yaml#
$schema: http://devicetree.org/meta-schemas/core.yaml#

title: Qualcomm SC7180 and Other SoCs UFS Controllers

maintainers:
  - Bjorn Andersson <bjorn.andersson@linaro.org>

# Select only our matches, not all jedec,ufs-2.0
select:
  properties:
    compatible:
      contains:
        enum:
          - qcom,msm8998-ufshc
          - qcom,qcs8300-ufshc
          - qcom,sa8775p-ufshc
          - qcom,sc7180-ufshc
          - qcom,sc7280-ufshc
          - qcom,sc8180x-ufshc
          - qcom,sc8280xp-ufshc
          - qcom,sm8250-ufshc
          - qcom,sm8350-ufshc
          - qcom,sm8450-ufshc
          - qcom,sm8550-ufshc
  required:
    - compatible

properties:
  compatible:
    items:
      - enum:
          - qcom,msm8998-ufshc
          - qcom,qcs8300-ufshc
          - qcom,sa8775p-ufshc
          - qcom,sc7180-ufshc
          - qcom,sc7280-ufshc
          - qcom,sc8180x-ufshc
          - qcom,sc8280xp-ufshc
          - qcom,sm8250-ufshc
          - qcom,sm8350-ufshc
          - qcom,sm8450-ufshc
          - qcom,sm8550-ufshc
      - const: qcom,ufshc
      - const: jedec,ufs-2.0

  reg:
    maxItems: 1

  reg-names:
    items:
      - const: std

  clocks:
    minItems: 7
    maxItems: 8

  clock-names:
    minItems: 7
    items:
      - const: core_clk
      - const: bus_aggr_clk
      - const: iface_clk
      - const: core_clk_unipro
      - const: ref_clk
      - const: tx_lane0_sync_clk
      - const: rx_lane0_sync_clk
      - const: rx_lane1_sync_clk

  qcom,ice:
    $ref: /schemas/types.yaml#/definitions/phandle
    description: phandle to the Inline Crypto Engine node

required:
  - compatible
  - reg

allOf:
  - $ref: qcom,ufs-common.yaml

  - if:
      properties:
        compatible:
          contains:
            enum:
              - qcom,sc7180-ufshc
    then:
      properties:
        clocks:
          maxItems: 7
        clock-names:
          maxItems: 7
    else:
      properties:
        clocks:
          minItems: 8
        clock-names:
          minItems: 8

unevaluatedProperties: false

examples:
  - |
    #include <dt-bindings/clock/qcom,gcc-sm8450.h>
    #include <dt-bindings/clock/qcom,rpmh.h>
    #include <dt-bindings/gpio/gpio.h>
    #include <dt-bindings/interconnect/qcom,sm8450.h>
    #include <dt-bindings/interrupt-controller/arm-gic.h>

    soc {
        #address-cells = <2>;
        #size-cells = <2>;

        ufs@1d84000 {
            compatible = "qcom,sm8450-ufshc", "qcom,ufshc",
                         "jedec,ufs-2.0";
            reg = <0x0 0x01d84000 0x0 0x3000>;
            interrupts = <GIC_SPI 265 IRQ_TYPE_LEVEL_HIGH>;
            phys = <&ufs_mem_phy_lanes>;
            phy-names = "ufsphy";
            lanes-per-direction = <2>;
            #reset-cells = <1>;
            resets = <&gcc GCC_UFS_PHY_BCR>;
            reset-names = "rst";
            reset-gpios = <&tlmm 210 GPIO_ACTIVE_LOW>;

            vcc-supply = <&vreg_l7b_2p5>;
            vcc-max-microamp = <1100000>;
            vccq-supply = <&vreg_l9b_1p2>;
            vccq-max-microamp = <1200000>;

            power-domains = <&gcc UFS_PHY_GDSC>;
            iommus = <&apps_smmu 0xe0 0x0>;
            interconnects = <&aggre1_noc MASTER_UFS_MEM &mc_virt SLAVE_EBI1>,
                            <&gem_noc MASTER_APPSS_PROC &config_noc SLAVE_UFS_MEM_CFG>;
            interconnect-names = "ufs-ddr", "cpu-ufs";

            clocks = <&gcc GCC_UFS_PHY_AXI_CLK>,
                     <&gcc GCC_AGGRE_UFS_PHY_AXI_CLK>,
                     <&gcc GCC_UFS_PHY_AHB_CLK>,
                     <&gcc GCC_UFS_PHY_UNIPRO_CORE_CLK>,
                     <&rpmhcc RPMH_CXO_CLK>,
                     <&gcc GCC_UFS_PHY_TX_SYMBOL_0_CLK>,
                     <&gcc GCC_UFS_PHY_RX_SYMBOL_0_CLK>,
                     <&gcc GCC_UFS_PHY_RX_SYMBOL_1_CLK>;
            clock-names = "core_clk",
                          "bus_aggr_clk",
                          "iface_clk",
                          "core_clk_unipro",
                          "ref_clk",
                          "tx_lane0_sync_clk",
                          "rx_lane0_sync_clk",
                          "rx_lane1_sync_clk";
            freq-table-hz = <75000000 300000000>,
                            <0 0>,
                            <0 0>,
                            <75000000 300000000>,
                            <75000000 300000000>,
                            <0 0>,
                            <0 0>,
                            <0 0>;
            qcom,ice = <&ice>;
        };
    };
```

## Documentation/devicetree/bindings/ufs/qcom,sm8650-ufshc.yaml
```yaml
# SPDX-License-Identifier: GPL-2.0-only OR BSD-2-Clause
%YAML 1.2
---
$id: http://devicetree.org/schemas/ufs/qcom,sm8650-ufshc.yaml#
$schema: http://devicetree.org/meta-schemas/core.yaml#

title: Qualcomm SM8650 and Other SoCs UFS Controllers

maintainers:
  - Bjorn Andersson <bjorn.andersson@linaro.org>

# Select only our matches, not all jedec,ufs-2.0
select:
  properties:
    compatible:
      contains:
        enum:
          - qcom,kaanapali-ufshc
          - qcom,sm8650-ufshc
          - qcom,sm8750-ufshc
  required:
    - compatible

properties:
  compatible:
    items:
      - enum:
          - qcom,kaanapali-ufshc
          - qcom,sm8650-ufshc
          - qcom,sm8750-ufshc
      - const: qcom,ufshc
      - const: jedec,ufs-2.0

  reg:
    minItems: 1
    maxItems: 2

  reg-names:
    minItems: 1
    items:
      - const: std
      - const: mcq

  clocks:
    minItems: 8
    maxItems: 8

  clock-names:
    items:
      - const: core_clk
      - const: bus_aggr_clk
      - const: iface_clk
      - const: core_clk_unipro
      - const: ref_clk
      - const: tx_lane0_sync_clk
      - const: rx_lane0_sync_clk
      - const: rx_lane1_sync_clk

  qcom,ice:
    $ref: /schemas/types.yaml#/definitions/phandle
    description: phandle to the Inline Crypto Engine node

required:
  - compatible
  - reg

allOf:
  - $ref: qcom,ufs-common.yaml

unevaluatedProperties: false

examples:
  - |
    #include <dt-bindings/clock/qcom,sm8650-gcc.h>
    #include <dt-bindings/clock/qcom,sm8650-tcsr.h>
    #include <dt-bindings/clock/qcom,rpmh.h>
    #include <dt-bindings/gpio/gpio.h>
    #include <dt-bindings/interconnect/qcom,icc.h>
    #include <dt-bindings/interconnect/qcom,sm8650-rpmh.h>
    #include <dt-bindings/interrupt-controller/arm-gic.h>

    soc {
        #address-cells = <2>;
        #size-cells = <2>;

        ufshc@1d84000 {
            compatible = "qcom,sm8650-ufshc", "qcom,ufshc", "jedec,ufs-2.0";
            reg = <0x0 0x01d84000 0x0 0x3000>;

            interrupts = <GIC_SPI 265 IRQ_TYPE_LEVEL_HIGH 0>;

            clocks = <&gcc GCC_UFS_PHY_AXI_CLK>,
                     <&gcc GCC_AGGRE_UFS_PHY_AXI_CLK>,
                     <&gcc GCC_UFS_PHY_AHB_CLK>,
                     <&gcc GCC_UFS_PHY_UNIPRO_CORE_CLK>,
                     <&tcsr TCSR_UFS_PAD_CLKREF_EN>,
                     <&gcc GCC_UFS_PHY_TX_SYMBOL_0_CLK>,
                     <&gcc GCC_UFS_PHY_RX_SYMBOL_0_CLK>,
                     <&gcc GCC_UFS_PHY_RX_SYMBOL_1_CLK>;
            clock-names = "core_clk",
                          "bus_aggr_clk",
                          "iface_clk",
                          "core_clk_unipro",
                          "ref_clk",
                          "tx_lane0_sync_clk",
                          "rx_lane0_sync_clk",
                          "rx_lane1_sync_clk";

            resets = <&gcc GCC_UFS_PHY_BCR>;
            reset-names = "rst";
            reset-gpios = <&tlmm 210 GPIO_ACTIVE_LOW>;

            interconnects = <&aggre1_noc MASTER_UFS_MEM QCOM_ICC_TAG_ALWAYS
                             &mc_virt SLAVE_EBI1 QCOM_ICC_TAG_ALWAYS>,
                            <&gem_noc MASTER_APPSS_PROC QCOM_ICC_TAG_ACTIVE_ONLY
                             &config_noc SLAVE_UFS_MEM_CFG QCOM_ICC_TAG_ACTIVE_ONLY>;
            interconnect-names = "ufs-ddr",
                         "cpu-ufs";

            power-domains = <&gcc UFS_PHY_GDSC>;
            required-opps = <&rpmhpd_opp_nom>;

            operating-points-v2 = <&ufs_opp_table>;

            iommus = <&apps_smmu 0x60 0>;

            lanes-per-direction = <2>;
            qcom,ice = <&ice>;

            phys = <&ufs_mem_phy>;
            phy-names = "ufsphy";

            #reset-cells = <1>;

            vcc-supply = <&vreg_l7b_2p5>;
            vcc-max-microamp = <1100000>;
            vccq-supply = <&vreg_l9b_1p2>;
            vccq-max-microamp = <1200000>;

            ufs_opp_table: opp-table {
                compatible = "operating-points-v2";

                opp-100000000 {
                    opp-hz = /bits/ 64 <100000000>,
                             /bits/ 64 <0>,
                             /bits/ 64 <0>,
                             /bits/ 64 <100000000>,
                             /bits/ 64 <0>,
                             /bits/ 64 <0>,
                             /bits/ 64 <0>,
                             /bits/ 64 <0>;
                    required-opps = <&rpmhpd_opp_low_svs>;
                };

                opp-201500000 {
                    opp-hz = /bits/ 64 <201500000>,
                             /bits/ 64 <0>,
                             /bits/ 64 <0>,
                             /bits/ 64 <201500000>,
                             /bits/ 64 <0>,
                             /bits/ 64 <0>,
                             /bits/ 64 <0>,
                             /bits/ 64 <0>;
                    required-opps = <&rpmhpd_opp_svs>;
                };

                opp-403000000 {
                    opp-hz = /bits/ 64 <403000000>,
                             /bits/ 64 <0>,
                             /bits/ 64 <0>,
                             /bits/ 64 <403000000>,
                             /bits/ 64 <0>,
                             /bits/ 64 <0>,
                             /bits/ 64 <0>,
                             /bits/ 64 <0>;
                    required-opps = <&rpmhpd_opp_nom>;
                };
            };
        };
    };
```

## Documentation/devicetree/bindings/ufs/qcom,ufs-common.yaml
```yaml
# SPDX-License-Identifier: GPL-2.0-only OR BSD-2-Clause
%YAML 1.2
---
$id: http://devicetree.org/schemas/ufs/qcom,ufs-common.yaml#
$schema: http://devicetree.org/meta-schemas/core.yaml#

title: Qualcomm Universal Flash Storage (UFS) Controller Common Properties

maintainers:
  - Bjorn Andersson <bjorn.andersson@linaro.org>

properties:
  clocks:
    minItems: 7
    maxItems: 9

  clock-names:
    minItems: 7
    maxItems: 9

  dma-coherent: true

  interconnects:
    minItems: 2
    maxItems: 2

  interconnect-names:
    items:
      - const: ufs-ddr
      - const: cpu-ufs

  iommus:
    minItems: 1
    maxItems: 2

  phys:
    maxItems: 1

  phy-names:
    items:
      - const: ufsphy

  power-domains:
    maxItems: 1

  required-opps:
    maxItems: 1

  resets:
    maxItems: 1

  '#reset-cells':
    const: 1

  reset-names:
    items:
      - const: rst

  reset-gpios:
    maxItems: 1
    description:
      GPIO connected to the RESET pin of the UFS memory device.

allOf:
  - $ref: ufs-common.yaml

additionalProperties: true
```
