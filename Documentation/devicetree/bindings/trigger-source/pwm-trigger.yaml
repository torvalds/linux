## Documentation/devicetree/bindings/tty/newhaven_lcd.txt
```
* TTY on a Newhaven NHD‐0216K3Z‐NSW‐BBW LCD connected to I2C

Required properties:
- compatible: Should be "newhaven,nhd‐0216k3z‐nsw‐bbw";
- reg: i2c address
- height: should be 2 lines
- width: should be 16 characters
- brightness: backlight brightness. Range is 1 to 8, where
              1=OFF and 8=maximum brightness.

Example:

&i2c0 {
	lcd: lcd@28 {
		compatible = "newhaven,nhd‐0216k3z‐nsw‐bbw";
		reg = <0x28>;
		height = <2>;
		width = <16>;
		brightness = <8>;
	};
```

## Documentation/devicetree/bindings/tty/serial/arc-uart.txt
```
* Synopsys ARC UART : Non standard UART used in some of the ARC FPGA boards

Required properties:
- compatible		: "snps,arc-uart"
- reg			: offset and length of the register set for the device.
- interrupts		: device interrupt
- clock-frequency	: the input clock frequency for the UART
- current-speed		: baud rate for UART

e.g.

arcuart0: serial@c0fc1000 {
	compatible = "snps,arc-uart";
	reg = <0xc0fc1000 0x100>;
	interrupts = <5>;
	clock-frequency = <80000000>;
	current-speed = <115200>;
	status = "okay";
};

Note: Each port should have an alias correctly numbered in "aliases" node.

e.g.
aliases {
	serial0 = &arcuart0;
};
```

## Documentation/devicetree/bindings/tty/serial/atmel-usart.txt
```
* Atmel Universal Synchronous Asynchronous Receiver/Transmitter (USART)

Required properties:
- compatible: Should be "atmel,<chip>-usart"
  The compatible <chip> indicated will be the first SoC to support an
  additional mode or an USART new feature.
- reg: Should contain registers location and length
- interrupts: Should contain interrupt

Optional properties:
- atmel,use-dma-rx: use of PDC or DMA for receiving data
- atmel,use-dma-tx: use of PDC or DMA for transmitting data

<chip> compatible description:
- at91rm9200:  legacy USART support
- at91sam9260: generic USART implementation for SAM9 SoCs

Example:

	usart0: serial@fff8c000 {
		compatible = "atmel,at91sam9260-usart";
		reg = <0xfff8c000 0x4000>;
		interrupts = <7>;
		atmel,use-dma-rx;
		atmel,use-dma-tx;
	};
```

## Documentation/devicetree/bindings/tty/serial/efm32-uart.txt
```
* Energymicro efm32 UART

Required properties:
- compatible : Should be "efm32,uart"
- reg : Address and length of the register set
- interrupts : Should contain uart interrupt

Optional properties:
- location : Decides the location of the USART I/O pins.
  Allowed range : [0 .. 5]
  Default: 0

Example:

uart@0x4000c400 {
	compatible = "efm32,uart";
	reg = <0x4000c400 0x400>;
	interrupts = <15>;
	location = <0>;
};
```

## Documentation/devicetree/bindings/tty/serial/fsl-imx-uart.txt
```
* Freescale i.MX Universal Asynchronous Receiver/Transmitter (UART)

Required properties:
- compatible : Should be "fsl,<soc>-uart"
- reg : Address and length of the register set for the device
- interrupts : Should contain uart interrupt

Optional properties:
- fsl,uart-has-rtscts : Indicate the uart has rts and cts
- fsl,irda-mode : Indicate the uart supports irda mode
- fsl,dte-mode : Indicate the uart works in DTE mode. The uart works
                  is DCE mode by default.

Example:

serial@73fbc000 {
	compatible = "fsl,imx51-uart", "fsl,imx21-uart";
	reg = <0x73fbc000 0x4000>;
	interrupts = <31>;
	fsl,uart-has-rtscts;
	fsl,dte-mode;
};
```

## Documentation/devicetree/bindings/tty/serial/fsl-mxs-auart.txt
```
* Freescale MXS Application UART (AUART)

Required properties:
- compatible : Should be "fsl,<soc>-auart". The supported SoCs include
  imx23 and imx28.
- reg : Address and length of the register set for the device
- interrupts : Should contain the auart interrupt numbers

Optional properties:
- fsl,auart-dma-channel : The DMA channels, the first is for RX, the other
		is for TX. If you add this property, it also means that you
		will enable the DMA support for the auart.
		Note: due to the hardware bug in imx23(see errata : 2836),
		only the imx28 can enable the DMA support for the auart.

Example:
auart0: serial@8006a000 {
	compatible = "fsl,imx28-auart", "fsl,imx23-auart";
	reg = <0x8006a000 0x2000>;
	interrupts = <112 70 71>;
	fsl,auart-dma-channel = <8 9>;
};

Note: Each auart port should have an alias correctly numbered in "aliases"
node.

Example:

aliases {
	serial0 = &auart0;
	serial1 = &auart1;
	serial2 = &auart2;
	serial3 = &auart3;
	serial4 = &auart4;
};
```

## Documentation/devicetree/bindings/tty/serial/msm_serial.txt
```
* Qualcomm MSM UART

Required properties:
- compatible :
	- "qcom,msm-uart", and one of "qcom,msm-hsuart" or
	  "qcom,msm-lsuart".
- reg : offset and length of the register set for the device
	for the hsuart operating in compatible mode, there should be a
	second pair describing the gsbi registers.
- interrupts : should contain the uart interrupt.

There are two different UART blocks used in MSM devices,
"qcom,msm-hsuart" and "qcom,msm-lsuart".  The msm-serial driver is
able to handle both of these, and matches against the "qcom,msm-uart"
as the compatibility.

The registers for the "qcom,msm-hsuart" device need to specify both
register blocks, even for the common driver.

Example:

	uart@19c400000 {
		compatible = "qcom,msm-hsuart", "qcom,msm-uart";
		reg = <0x19c40000 0x1000>,
		      <0x19c00000 0x1000>;
		interrupts = <195>;
	};
```

## Documentation/devicetree/bindings/tty/serial/of-serial.txt
```
* UART (Universal Asynchronous Receiver/Transmitter)

Required properties:
- compatible : one of:
	- "ns8250"
	- "ns16450"
	- "ns16550a"
	- "ns16550"
	- "ns16750"
	- "ns16850"
	- "nvidia,tegra20-uart"
	- "nxp,lpc3220-uart"
	- "ibm,qpace-nwp-serial"
	- "serial" if the port type is unknown.
- reg : offset and length of the register set for the device.
- interrupts : should contain uart interrupt.
- clock-frequency : the input clock frequency for the UART.

Optional properties:
- current-speed : the current active speed of the UART.
- reg-offset : offset to apply to the mapbase from the start of the registers.
- reg-shift : quantity to shift the register offsets by.
- reg-io-width : the size (in bytes) of the IO accesses that should be
  performed on the device.  There are some systems that require 32-bit
  accesses to the UART (e.g. TI davinci).
- used-by-rtas : set to indicate that the port is in use by the OpenFirmware
  RTAS and should not be registered.

Example:

	uart@80230000 {
		compatible = "ns8250";
		reg = <0x80230000 0x100>;
		clock-frequency = <3686400>;
		interrupts = <10>;
		reg-shift = <2>;
	};
```

## Documentation/devicetree/bindings/tty/serial/sccnxp-serial.txt
```
* NXP (Philips) SCC+++(SCN+++) serial driver

Required properties:
- compatible: Should be "nxp,<ictype>". The supported ICs include sc2681,
  sc2691, sc2692, sc2891, sc2892, sc28202, sc68681 and sc68692.
- reg: Address and length of the register set for the device.
- interrupts: Should contain the interrupt number. If omitted,
  polling mode will be used instead, so "poll-interval" property should
  be populated in this case.

Optional properties:
- clocks: Phandle to input clock. If omitted, default IC frequency will be
  used instead.
- poll-interval: Poll interval time in nanoseconds.
- vcc-supply: The regulator supplying the VCC to drive the chip.
- nxp,sccnxp-io-cfg: Array contains values for the emulated modem signals.
  The number of values depends on the UART-number in the selected chip.
  Each value should be composed according to the following rules:
  (LINE1 << SIGNAL1) | ... | (LINEX << SIGNALX), where:
   LINE - VALUE:
    OP0 - 1
    OP1 - 2
    OP2 - 3
    OP3 - 4
    OP4 - 5
    OP5 - 6
    OP6 - 7
    OP7 - 8
    IP0 - 9
    IP1 - 10
    IP2 - 11
    IP3 - 12
    IP4 - 13
    IP5 - 14
    IP6 - 15
   SIGNAL - VALUE:
    DTR - 0
    RTS - 4
    DSR - 8
    CTS - 12
    DCD - 16
    RNG - 20
    DIR - 24

Example (Dual UART with direction control on OP0 & OP1):
sc2892@10100000 {
	compatible = "nxp,sc2892";
	reg = <0x10100000 0x10>;
	poll-interval = <10000>;
	clocks = <&sc2892_clk>;
	vcc-supply = <&sc2892_reg>;
	nxp,sccnxp-io-cfg = <0x01000000 0x02000000>;
};
```

## Documentation/devicetree/bindings/ufs/amd,versal2-ufs.yaml
```yaml
# SPDX-License-Identifier: (GPL-2.0-only OR BSD-2-Clause)
%YAML 1.2
---
$id: http://devicetree.org/schemas/ufs/amd,versal2-ufs.yaml#
$schema: http://devicetree.org/meta-schemas/core.yaml#

title: AMD Versal Gen 2 UFS Host Controller

maintainers:
  - Sai Krishna Potthuri <sai.krishna.potthuri@amd.com>

allOf:
  - $ref: ufs-common.yaml

properties:
  compatible:
    const: amd,versal2-ufs

  reg:
    maxItems: 1

  clocks:
    maxItems: 1

  clock-names:
    items:
      - const: core

  power-domains:
    maxItems: 1

  resets:
    maxItems: 2

  reset-names:
    items:
      - const: host
      - const: phy

required:
  - reg
  - clocks
  - clock-names
  - resets
  - reset-names

unevaluatedProperties: false

examples:
  - |
    #include <dt-bindings/interrupt-controller/arm-gic.h>
    ufs@f10b0000 {
        compatible = "amd,versal2-ufs";
        reg = <0xf10b0000 0x1000>;
        clocks = <&ufs_core_clk>;
        clock-names = "core";
        resets = <&scmi_reset 4>, <&scmi_reset 35>;
        reset-names = "host", "phy";
        interrupts = <GIC_SPI 234 IRQ_TYPE_LEVEL_HIGH>;
        freq-table-hz = <0 0>;
    };
```

## Documentation/devicetree/bindings/ufs/cdns,ufshc.txt
```
* Cadence Universal Flash Storage (UFS) Controller

UFS nodes are defined to describe on-chip UFS host controllers.
Each UFS controller instance should have its own node.
Please see the ufshcd-pltfrm.txt for a list of all available properties.

Required properties:
- compatible	: Compatible list, contains the following controller:
			"cdns,ufshc"
		  complemented with the JEDEC version:
			"jedec,ufs-2.0"

- reg		: Address and length of the UFS register set.
- interrupts	: One interrupt mapping.
- freq-table-hz	: Clock frequency table.
		  See the ufshcd-pltfrm.txt for details.
- clocks	: List of phandle and clock specifier pairs.
- clock-names	: List of clock input name strings sorted in the same
		  order as the clocks property. "core_clk" is mandatory.
		  Depending on a type of a PHY,
		  the "phy_clk" clock can also be added, if needed.

Example:
	ufs@fd030000 {
		compatible = "cdns,ufshc", "jedec,ufs-2.0";
		reg = <0xfd030000 0x10000>;
		interrupts = <0 1 IRQ_TYPE_LEVEL_HIGH>;
		freq-table-hz = <0 0>, <0 0>;
		clocks = <&ufs_core_clk>, <&ufs_phy_clk>;
		clock-names = "core_clk", "phy_clk";
	};
```

## Documentation/devicetree/bindings/ufs/cdns,ufshc.yaml
```yaml
# SPDX-License-Identifier: GPL-2.0-only OR BSD-2-Clause
%YAML 1.2
---
$id: http://devicetree.org/schemas/ufs/cdns,ufshc.yaml#
$schema: http://devicetree.org/meta-schemas/core.yaml#

title: Cadence Universal Flash Storage (UFS) Controller

maintainers:
  - Jan Kotas <jank@cadence.com>

# Select only our matches, not all jedec,ufs-2.0
select:
  properties:
    compatible:
      contains:
        enum:
          - cdns,ufshc
          - cdns,ufshc-m31-16nm
  required:
    - compatible

allOf:
  - $ref: ufs-common.yaml

properties:
  compatible:
    items:
      - enum:
          - cdns,ufshc
            # CDNS UFS HC + M31 16nm PHY
          - cdns,ufshc-m31-16nm
      - const: jedec,ufs-2.0

  clocks:
    minItems: 1
    maxItems: 3

  clock-names:
    minItems: 1
    items:
      - const: core_clk
      - const: phy_clk
      - const: ref_clk

  power-domains:
    maxItems: 1

  reg:
    maxItems: 1

  dma-coherent: true

required:
  - compatible
  - clocks
  - clock-names
  - reg

unevaluatedProperties: false

examples:
  - |
    #include <dt-bindings/interrupt-controller/arm-gic.h>

    ufs@fd030000 {
        compatible = "cdns,ufshc", "jedec,ufs-2.0";
        reg = <0xfd030000 0x10000>;
        interrupts = <GIC_SPI 1 IRQ_TYPE_LEVEL_HIGH>;
        freq-table-hz = <0 0>, <0 0>;
        clocks = <&ufs_core_clk>, <&ufs_phy_clk>;
        clock-names = "core_clk", "phy_clk";
    };
```

## Documentation/devicetree/bindings/ufs/hisilicon,ufs.yaml
```yaml
# SPDX-License-Identifier: GPL-2.0-only OR BSD-2-Clause
%YAML 1.2
---
$id: http://devicetree.org/schemas/ufs/hisilicon,ufs.yaml#
$schema: http://devicetree.org/meta-schemas/core.yaml#

title: HiSilicon Universal Flash Storage (UFS) Controller

maintainers:
  - Li Wei <liwei213@huawei.com>

# Select only our matches, not all jedec,ufs
select:
  properties:
    compatible:
      contains:
        enum:
          - hisilicon,hi3660-ufs
          - hisilicon,hi3670-ufs
  required:
    - compatible

allOf:
  - $ref: ufs-common.yaml

properties:
  compatible:
    oneOf:
      - items:
          - const: hisilicon,hi3660-ufs
          - const: jedec,ufs-1.1
      - items:
          - enum:
              - hisilicon,hi3670-ufs
          - const: jedec,ufs-2.1

  clocks:
    minItems: 2
    maxItems: 2

  clock-names:
    items:
      - const: ref_clk
      - const: phy_clk

  reg:
    items:
      - description: UFS register address space
      - description: UFS SYS CTRL register address space

  resets:
    maxItems: 1

  reset-names:
    items:
      - const: rst

required:
  - compatible
  - reg
  - resets
  - reset-names

unevaluatedProperties: false

examples:
  - |
    #include <dt-bindings/clock/hi3670-clock.h>
    #include <dt-bindings/interrupt-controller/arm-gic.h>

    soc {
        #address-cells = <2>;
        #size-cells = <2>;

        ufs@ff3c0000 {
            compatible = "hisilicon,hi3670-ufs", "jedec,ufs-2.1";
            reg = <0x0 0xff3c0000 0x0 0x1000>,
                  <0x0 0xff3e0000 0x0 0x1000>;
            interrupt-parent = <&gic>;
            interrupts = <GIC_SPI 278 IRQ_TYPE_LEVEL_HIGH>;
            clocks = <&crg_ctrl HI3670_CLK_GATE_UFSIO_REF>,
                     <&crg_ctrl HI3670_CLK_GATE_UFS_SUBSYS>;
            clock-names = "ref_clk", "phy_clk";
            freq-table-hz = <0 0>,
                            <0 0>;

            resets = <&crg_rst 0x84 12>;
            reset-names = "rst";
        };
    };
```
