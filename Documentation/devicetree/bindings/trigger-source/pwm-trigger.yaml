## Documentation/devicetree/bindings/trigger-source/pwm-trigger.yaml
```yaml
# SPDX-License-Identifier: (GPL-2.0-only OR BSD-2-Clause)
%YAML 1.2
---
$id: http://devicetree.org/schemas/trigger-source/pwm-trigger.yaml#
$schema: http://devicetree.org/meta-schemas/core.yaml#

title: Generic trigger source using PWM

description: Remaps a PWM channel as a trigger source.

maintainers:
  - David Lechner <dlechner@baylibre.com>

properties:
  compatible:
    const: pwm-trigger

  '#trigger-source-cells':
    const: 0

  pwms:
    maxItems: 1

required:
  - compatible
  - '#trigger-source-cells'
  - pwms

additionalProperties: false

examples:
  - |
    trigger {
        compatible = "pwm-trigger";
        #trigger-source-cells = <0>;
        pwms = <&pwm 0 1000000 0>;
    };
```
