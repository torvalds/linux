## Documentation/devicetree/bindings/misc/nvidia,tegra20-apbmisc.txt
```
NVIDIA Tegra APBMISC block

Required properties:
- compatible: Must be:
  - Tegra20: "nvidia,tegra20-apbmisc"
  - Tegra30: "nvidia,tegra30-apbmisc", "nvidia,tegra20-apbmisc"
  - Tegra114: "nvidia,tegra114-apbmisc", "nvidia,tegra20-apbmisc"
  - Tegra124: "nvidia,tegra124-apbmisc", "nvidia,tegra20-apbmisc"
  - Tegra132: "nvidia,tegra124-apbmisc", "nvidia,tegra20-apbmisc"
  - Tegra210: "nvidia,tegra210-apbmisc", "nvidia,tegra20-apbmisc"
- reg: Should contain 2 entries: the first entry gives the physical address
       and length of the registers which contain revision and debug features.
       The second entry gives the physical address and length of the
       registers indicating the strapping options.

Optional properties:
- nvidia,long-ram-code: If present, the RAM code is long (4 bit). If not, short (2 bit).
```

## Documentation/devicetree/bindings/misc/nvidia,tegra20-apbmisc.yaml
```yaml
# SPDX-License-Identifier: (GPL-2.0-only OR BSD-2-Clause)
%YAML 1.2
---
$id: http://devicetree.org/schemas/misc/nvidia,tegra20-apbmisc.yaml#
$schema: http://devicetree.org/meta-schemas/core.yaml#

title: NVIDIA Tegra APBMISC block

maintainers:
  - Thierry Reding <thierry.reding@gmail.com>
  - Jon Hunter <jonathanh@nvidia.com>

properties:
  compatible:
    oneOf:
      - items:
          - enum:
              - nvidia,tegra210-apbmisc
              - nvidia,tegra124-apbmisc
              - nvidia,tegra114-apbmisc
              - nvidia,tegra30-apbmisc
          - const: nvidia,tegra20-apbmisc

      - items:
          - const: nvidia,tegra20-apbmisc

  reg:
    items:
      - description: physical address and length of the registers which
          contain revision and debug features
      - description: physical address and length of the registers which
          indicate strapping options

  nvidia,long-ram-code:
    description: If present, the RAM code is long (4 bit). If not, short
      (2 bit).
    type: boolean

additionalProperties: false

required:
  - compatible
  - reg

examples:
  - |
    apbmisc@70000800 {
        compatible = "nvidia,tegra20-apbmisc";
        reg = <0x70000800 0x64>, /* Chip revision */
              <0x70000008 0x04>; /* Strapping options */
    };
```

## Documentation/devicetree/bindings/misc/olpc,xo1.75-ec.txt
```
OLPC XO-1.75 Embedded Controller

Required properties:
- compatible: Should be "olpc,xo1.75-ec".
- cmd-gpios: gpio specifier of the CMD pin

The embedded controller requires the SPI controller driver to signal readiness
to receive a transfer (that is, when TX FIFO contains the response data) by
strobing the ACK pin with the ready signal. See the "ready-gpios" property of the
SSP binding as documented in:
<Documentation/devicetree/bindings/spi/spi-pxa2xx.txt>.

Example:
	&ssp3 {
		spi-slave;
		ready-gpios = <&gpio 125 GPIO_ACTIVE_HIGH>;

		slave {
			compatible = "olpc,xo1.75-ec";
			spi-cpha;
			cmd-gpios = <&gpio 155 GPIO_ACTIVE_HIGH>;
		};
	};
```

## Documentation/devicetree/bindings/misc/olpc,xo1.75-ec.yaml
```yaml
# SPDX-License-Identifier: GPL-2.0-only OR BSD-2-Clause
# Copyright (C) 2019,2020 Lubomir Rintel <lkundrak@v3.sk>
%YAML 1.2
---
$id: http://devicetree.org/schemas/misc/olpc,xo1.75-ec.yaml#
$schema: http://devicetree.org/meta-schemas/core.yaml#

title: OLPC XO-1.75 Embedded Controller bindings

description: |
  This binding describes the Embedded Controller acting as a SPI bus master
  on a OLPC XO-1.75 laptop computer.

  The embedded controller requires the SPI controller driver to signal
  readiness to receive a transfer (that is, when TX FIFO contains the
  response data) by strobing the ACK pin with the ready signal. See the
  "ready-gpios" property of the SSP binding as documented in:
  <Documentation/devicetree/bindings/spi/marvell,mmp2-ssp.yaml>.

maintainers:
  - Lubomir Rintel <lkundrak@v3.sk>

properties:
  compatible:
    const: olpc,xo1.75-ec

  cmd-gpios:
    description: GPIO uspecifier of the CMD pin
    maxItems: 1

  spi-cpha: true

required:
  - compatible
  - cmd-gpios

additionalProperties: false

examples:
  - |
    #include <dt-bindings/gpio/gpio.h>

    spi {
      spi-slave;
      #address-cells = <0>;
      #size-cells = <0>;
      ready-gpios = <&gpio 125 GPIO_ACTIVE_HIGH>;

      slave {
        compatible = "olpc,xo1.75-ec";
        spi-cpha;
        cmd-gpios = <&gpio 155 GPIO_ACTIVE_HIGH>;
      };
    };

...
```

## Documentation/devicetree/bindings/misc/pci1de4,1.yaml
```yaml
# SPDX-License-Identifier: (GPL-2.0-only OR BSD-2-Clause)
%YAML 1.2
---
$id: http://devicetree.org/schemas/misc/pci1de4,1.yaml#
$schema: http://devicetree.org/meta-schemas/core.yaml#

title: RaspberryPi RP1 MFD PCI device

maintainers:
  - A. della Porta <andrea.porta@suse.com>

description:
  The RaspberryPi RP1 is a PCI multi function device containing
  peripherals ranging from Ethernet to USB controller, I2C, SPI
  and others.
  The peripherals are accessed by addressing the PCI BAR1 region.

allOf:
  - $ref: /schemas/pci/pci-ep-bus.yaml

properties:
  compatible:
    additionalItems: true
    maxItems: 3
    items:
      - const: pci1de4,1

  '#interrupt-cells':
    const: 2
    description: |
      Specifies respectively the interrupt number and flags as defined
      in include/dt-bindings/interrupt-controller/irq.h.
      Since all interrupts are active high, only IRQ_TYPE_LEVEL_HIGH
      and IRQ_TYPE_EDGE_RISING can be specified as type flags.
      The supported values for the interrupt number are:
        - IO BANK0: 0
        - IO BANK1: 1
        - IO BANK2: 2
        - AUDIO IN: 3
        - AUDIO OUT: 4
        - PWM0: 5
        - ETH: 6
        - I2C0: 7
        - I2C1: 8
        - I2C2: 9
        - I2C3: 10
        - I2C4: 11
        - I2C5: 12
        - I2C6: 13
        - I2S0: 14
        - I2S1: 15
        - I2S2: 16
        - SDIO0: 17
        - SDIO1: 18
        - SPI0: 19
        - SPI1: 20
        - SPI2: 21
        - SPI3: 22
        - SPI4: 23
        - SPI5: 24
        - UART0: 25
        - TIMER0: 26
        - TIMER1: 27
        - TIMER2: 28
        - TIMER3: 29
        - USB HOST0: 30
        - USB HOST0-0: 31
        - USB HOST0-1: 32
        - USB HOST0-2: 33
        - USB HOST0-3: 34
        - USB HOST1: 35
        - USB HOST1-0: 36
        - USB HOST1-1: 37
        - USB HOST1-2: 38
        - USB HOST1-3: 39
        - DMA: 40
        - PWM1: 41
        - UART1: 42
        - UART2: 43
        - UART3: 44
        - UART4: 45
        - UART5: 46
        - MIPI0: 47
        - MIPI1: 48
        - VIDEO OUT: 49
        - PIO0: 50
        - PIO1: 51
        - ADC FIFO: 52
        - PCIE OUT: 53
        - SPI6: 54
        - SPI7: 55
        - SPI8: 56
        - PROC MISC: 57
        - SYSCFG: 58
        - CLOCKS DEFAULT: 59
        - VBUSCTRL: 60

  interrupt-controller: true

unevaluatedProperties: false

required:
  - compatible
  - '#interrupt-cells'
  - interrupt-controller
  - pci-ep-bus@1

examples:
  - |
    pci {
        #address-cells = <3>;
        #size-cells = <2>;

        rp1@0,0 {
            compatible = "pci1de4,1";
            ranges = <0x01 0x00 0x00000000  0x82010000 0x00 0x00  0x00 0x400000>;
            #address-cells = <3>;
            #size-cells = <2>;
            interrupt-controller;
            #interrupt-cells = <2>;

            pci_ep_bus: pci-ep-bus@1 {
                compatible = "simple-bus";
                ranges = <0x00 0x40000000  0x01 0x00 0x00000000  0x00 0x00400000>;
                dma-ranges = <0x10 0x00000000  0x43000000 0x10 0x00000000  0x10 0x00000000>;
                #address-cells = <2>;
                #size-cells = <2>;

                rp1_clocks: clocks@40018000 {
                    compatible = "raspberrypi,rp1-clocks";
                    reg = <0x00 0x40018000 0x0 0x10038>;
                    #clock-cells = <1>;
                    clocks = <&clk_rp1_xosc>;
                };
            };
        };
    };
```

## Documentation/devicetree/bindings/misc/pvpanic-mmio.txt
```
* QEMU PVPANIC MMIO Configuration bindings

QEMU's emulation / virtualization targets provide the following PVPANIC
MMIO Configuration interface on the "virt" machine.
type:

- a read-write, 16-bit wide data register.

QEMU exposes the data register to guests as memory mapped registers.

Required properties:

- compatible: "qemu,pvpanic-mmio".
- reg: the MMIO region used by the device.
  * Bytes 0x0  Write panic event to the reg when guest OS panics.
  * Bytes 0x1  Reserved.

Example:

/ {
        #size-cells = <0x2>;
        #address-cells = <0x2>;

        pvpanic-mmio@9060000 {
                compatible = "qemu,pvpanic-mmio";
                reg = <0x0 0x9060000 0x0 0x2>;
        };
};
```

## Documentation/devicetree/bindings/misc/qcom,fastrpc.txt
```
Qualcomm Technologies, Inc. FastRPC Driver

The FastRPC implements an IPC (Inter-Processor Communication)
mechanism that allows for clients to transparently make remote method
invocations across DSP and APPS boundaries. This enables developers
to offload tasks to the DSP and free up the application processor for
other tasks.

- compatible:
	Usage: required
	Value type: <stringlist>
	Definition: must be "qcom,fastrpc"

- label
	Usage: required
	Value type: <string>
	Definition: should specify the dsp domain name this fastrpc
	corresponds to. must be one of this: "adsp", "mdsp", "sdsp", "cdsp"

- #address-cells
	Usage: required
	Value type: <u32>
	Definition: Must be 1

- #size-cells
	Usage: required
	Value type: <u32>
	Definition: Must be 0

= COMPUTE BANKS
Each subnode of the Fastrpc represents compute context banks available
on the dsp.
- All Compute context banks MUST contain the following properties:

- compatible:
	Usage: required
	Value type: <stringlist>
	Definition: must be "qcom,fastrpc-compute-cb"

- reg
	Usage: required
	Value type: <u32>
	Definition: Context Bank ID.

- qcom,nsessions:
	Usage: Optional
	Value type: <u32>
	Defination: A value indicating how many sessions can share this
		    context bank. Defaults to 1 when this property
		    is not specified.

Example:

adsp-pil {
	compatible = "qcom,msm8996-adsp-pil";
	...
	smd-edge {
		label = "lpass";
		fastrpc {
			compatible = "qcom,fastrpc";
			qcom,smd-channels = "fastrpcsmd-apps-dsp";
			label = "adsp";
			#address-cells = <1>;
			#size-cells = <0>;

			cb@1 {
				compatible = "qcom,fastrpc-compute-cb";
				reg = <1>;
			};

			cb@2 {
				compatible = "qcom,fastrpc-compute-cb";
				reg = <2>;
			};
			...
		};
	};
};
```

## Documentation/devicetree/bindings/misc/qcom,fastrpc.yaml
```yaml
# SPDX-License-Identifier: (GPL-2.0-only OR BSD-2-Clause)
%YAML 1.2
---
$id: http://devicetree.org/schemas/misc/qcom,fastrpc.yaml#
$schema: http://devicetree.org/meta-schemas/core.yaml#

title: Qualcomm FastRPC Driver

maintainers:
  - Srinivas Kandagatla <srinivas.kandagatla@linaro.org>

description: |
  The FastRPC implements an IPC (Inter-Processor Communication)
  mechanism that allows for clients to transparently make remote method
  invocations across DSP and APPS boundaries. This enables developers
  to offload tasks to the DSP and free up the application processor for
  other tasks.

properties:
  compatible:
    const: qcom,fastrpc

  label:
    enum:
      - adsp
      - mdsp
      - sdsp
      - cdsp
      - cdsp1
      - gdsp0
      - gdsp1

  memory-region:
    maxItems: 1
    description:
      Phandle to a node describing memory to be used for remote heap CMA.

  qcom,glink-channels:
    description:
      A list of channels tied to this function, used for matching
      the function to a set of virtual channels.
    $ref: /schemas/types.yaml#/definitions/string-array
    items:
      - const: fastrpcglink-apps-dsp

  qcom,non-secure-domain:
    description:
      Used to mark the current domain as non-secure.
    type: boolean

  qcom,smd-channels:
    description:
      Channel name used for the RPM communication
    $ref: /schemas/types.yaml#/definitions/string-array
    items:
      - const: fastrpcsmd-apps-dsp

  qcom,vmids:
    description:
      Virtual machine IDs for remote processor.
    $ref: /schemas/types.yaml#/definitions/uint32-array

  "#address-cells":
    const: 1

  "#size-cells":
    const: 0

patternProperties:
  "(compute-)?cb@[0-9]*$":
    type: object

    description: >
      Each subnode of the Fastrpc represents compute context banks available on the dsp.

    properties:
      compatible:
        const: qcom,fastrpc-compute-cb

      reg:
        maxItems: 1

      dma-coherent: true

      iommus:
        minItems: 1
        maxItems: 10

      qcom,nsessions:
        $ref: /schemas/types.yaml#/definitions/uint32
        default: 1
        description: >
          A value indicating how many sessions can share this context bank.

    required:
      - compatible
      - reg

    additionalProperties: false

required:
  - compatible
  - label
  - "#address-cells"
  - "#size-cells"

additionalProperties: false

examples:
  - |
    #include <dt-bindings/interrupt-controller/arm-gic.h>
    #include <dt-bindings/mailbox/qcom-ipcc.h>

    glink-edge {
        interrupts-extended = <&ipcc IPCC_CLIENT_LPASS
                                     IPCC_MPROC_SIGNAL_GLINK_QMP
                                     IRQ_TYPE_EDGE_RISING>;
        mboxes = <&ipcc IPCC_CLIENT_LPASS
                        IPCC_MPROC_SIGNAL_GLINK_QMP>;
        label = "lpass";
        qcom,remote-pid = <2>;

        fastrpc {
            compatible = "qcom,fastrpc";
            qcom,glink-channels = "fastrpcglink-apps-dsp";
            label = "sdsp";
            qcom,non-secure-domain;
            #address-cells = <1>;
            #size-cells = <0>;

            compute-cb@1 {
                compatible = "qcom,fastrpc-compute-cb";
                reg = <1>;
                iommus = <&apps_smmu 0x0541 0x0>;
            };

            compute-cb@2 {
                compatible = "qcom,fastrpc-compute-cb";
                reg = <2>;
                iommus = <&apps_smmu 0x0542 0x0>;
            };

            compute-cb@3 {
                compatible = "qcom,fastrpc-compute-cb";
                reg = <3>;
                iommus = <&apps_smmu 0x0543 0x0>;
            };
        };
    };
```

## Documentation/devicetree/bindings/misc/qemu,vcpu-stall-detector.yaml
```yaml
# SPDX-License-Identifier: (GPL-2.0-only OR BSD-2-Clause)
%YAML 1.2
---
$id: http://devicetree.org/schemas/misc/qemu,vcpu-stall-detector.yaml#
$schema: http://devicetree.org/meta-schemas/core.yaml#

title: VCPU stall detector

description:
  This binding describes a CPU stall detector mechanism for virtual CPUs
  which is accessed through MMIO.

maintainers:
  - Sebastian Ene <sebastianene@google.com>

properties:
  compatible:
    enum:
      - qemu,vcpu-stall-detector

  reg:
    maxItems: 1

  clock-frequency:
    $ref: /schemas/types.yaml#/definitions/uint32
    description: |
      The internal clock of the stall detector peripheral measure in Hz used
      to decrement its internal counter register on each tick.
      Defaults to 10 if unset.
    default: 10

  interrupts:
    maxItems: 1

  timeout-sec:
    description: |
      The stall detector expiration timeout measured in seconds.
      Defaults to 8 if unset. Please note that it also takes into account the
      time spent while the VCPU is not running.
    default: 8

required:
  - compatible

additionalProperties: false

examples:
  - |
    #include <dt-bindings/interrupt-controller/arm-gic.h>

    vmwdt@9030000 {
      compatible = "qemu,vcpu-stall-detector";
      reg = <0x9030000 0x10000>;
      clock-frequency = <10>;
      timeout-sec = <8>;
      interrupts = <GIC_PPI 15 IRQ_TYPE_EDGE_RISING>;
    };
```
