## Documentation/devicetree/bindings/misc/xlnx,tmr-inject.yaml
```yaml
# SPDX-License-Identifier: (GPL-2.0 OR BSD-2-Clause)
%YAML 1.2
---
$id: http://devicetree.org/schemas/misc/xlnx,tmr-inject.yaml#
$schema: http://devicetree.org/meta-schemas/core.yaml#

title: Xilinx Triple Modular Redundancy(TMR) Inject IP

maintainers:
  - Appana Durga Kedareswara rao <appana.durga.kedareswara.rao@amd.com>

description: |
  The Triple Modular Redundancy(TMR) Inject core provides functional fault
  injection by changing selected MicroBlaze instructions, which provides the
  possibility to verify that the TMR subsystem error detection and fault
  recovery logic is working properly.

properties:
  compatible:
    enum:
      - xlnx,tmr-inject-1.0

  reg:
    maxItems: 1

  xlnx,magic:
    minimum: 0
    maximum: 255
    description: |
      Magic number, When configured it allows the controller to perform
      recovery.
    $ref: /schemas/types.yaml#/definitions/uint32

required:
  - compatible
  - reg
  - xlnx,magic

additionalProperties: false

examples:
  - |
    fault-inject@44a30000 {
        compatible = "xlnx,tmr-inject-1.0";
        reg = <0x44a10000 0x10000>;
        xlnx,magic = <0x46>;
    };
```

## Documentation/devicetree/bindings/misc/xlnx,tmr-manager.yaml
```yaml
# SPDX-License-Identifier: (GPL-2.0 OR BSD-2-Clause)
%YAML 1.2
---
$id: http://devicetree.org/schemas/misc/xlnx,tmr-manager.yaml#
$schema: http://devicetree.org/meta-schemas/core.yaml#

title: Xilinx Triple Modular Redundancy(TMR) Manager IP

maintainers:
  - Appana Durga Kedareswara rao <appana.durga.kedareswara.rao@amd.com>

description: |
  The Triple Modular Redundancy(TMR) Manager is responsible for handling the
  TMR subsystem state, including fault detection and error recovery. The core
  is triplicated in each of the sub-blocks in the TMR subsystem, and provides
  majority voting of its internal state.

properties:
  compatible:
    enum:
      - xlnx,tmr-manager-1.0

  reg:
    maxItems: 1

  xlnx,magic1:
    minimum: 0
    maximum: 255
    description:
      Magic byte 1, When configured it allows the controller to perform
      recovery.
    $ref: /schemas/types.yaml#/definitions/uint32

required:
  - compatible
  - reg
  - xlnx,magic1

additionalProperties: false

examples:
  - |
    tmr-manager@44a10000 {
        compatible = "xlnx,tmr-manager-1.0";
        reg = <0x44a10000 0x10000>;
        xlnx,magic1 = <0x46>;
    };
```

## Documentation/devicetree/bindings/mmc/allwinner,sun4i-a10-mmc.yaml
```yaml
# SPDX-License-Identifier: GPL-2.0
%YAML 1.2
---
$id: http://devicetree.org/schemas/mmc/allwinner,sun4i-a10-mmc.yaml#
$schema: http://devicetree.org/meta-schemas/core.yaml#

title: Allwinner A10 MMC Controller Device Tree Bindings

allOf:
  - $ref: "mmc-controller.yaml"

maintainers:
  - Chen-Yu Tsai <wens@csie.org>
  - Maxime Ripard <mripard@kernel.org>

properties:
  "#address-cells": true
  "#size-cells": true

  compatible:
    oneOf:
      - const: allwinner,sun4i-a10-mmc
      - const: allwinner,sun5i-a13-mmc
      - const: allwinner,sun7i-a20-mmc
      - const: allwinner,sun8i-a83t-emmc
      - const: allwinner,sun9i-a80-mmc
      - const: allwinner,sun50i-a64-emmc
      - const: allwinner,sun50i-a64-mmc
      - items:
          - const: allwinner,sun8i-a83t-mmc
          - const: allwinner,sun7i-a20-mmc
      - items:
          - const: allwinner,sun8i-r40-emmc
          - const: allwinner,sun50i-a64-emmc
      - items:
          - const: allwinner,sun8i-r40-mmc
          - const: allwinner,sun50i-a64-mmc
      - items:
          - const: allwinner,sun50i-h5-emmc
          - const: allwinner,sun50i-a64-emmc
      - items:
          - const: allwinner,sun50i-h5-mmc
          - const: allwinner,sun50i-a64-mmc
      - items:
          - const: allwinner,sun50i-h6-emmc
          - const: allwinner,sun50i-a64-emmc
      - items:
          - const: allwinner,sun50i-h6-mmc
          - const: allwinner,sun50i-a64-mmc

  reg:
    maxItems: 1

  interrupts:
    maxItems: 1

  clocks:
    minItems: 2
    maxItems: 4
    items:
      - description: Bus Clock
      - description: Module Clock
      - description: Output Clock
      - description: Sample Clock

  clock-names:
    minItems: 2
    maxItems: 4
    items:
      - const: ahb
      - const: mmc
      - const: output
      - const: sample

  resets:
    maxItems: 1

  reset-names:
    const: ahb

required:
  - compatible
  - reg
  - interrupts
  - clocks
  - clock-names

unevaluatedProperties: false

examples:
  - |
    mmc0: mmc@1c0f000 {
        compatible = "allwinner,sun5i-a13-mmc";
        reg = <0x01c0f000 0x1000>;
        clocks = <&ahb_gates 8>, <&mmc0_clk>;
        clock-names = "ahb", "mmc";
        interrupts = <32>;
        bus-width = <4>;
        cd-gpios = <&pio 7 1 0>;
    };

...
```

## Documentation/devicetree/bindings/mmc/amlogic,meson-gx.txt
```
Amlogic SD / eMMC controller for S905/GXBB family SoCs

The MMC 5.1 compliant host controller on Amlogic provides the
interface for SD, eMMC and SDIO devices.

This file documents the properties in addition to those available in
the MMC core bindings, documented by mmc.txt.

Required properties:
- compatible : contains one of:
  - "amlogic,meson-gx-mmc"
  - "amlogic,meson-gxbb-mmc"
  - "amlogic,meson-gxl-mmc"
  - "amlogic,meson-gxm-mmc"
  - "amlogic,meson-axg-mmc"
- clocks     : A list of phandle + clock-specifier pairs for the clocks listed in clock-names.
- clock-names: Should contain the following:
	"core" - Main peripheral bus clock
	"clkin0" - Parent clock of internal mux
	"clkin1" - Other parent clock of internal mux
  The driver has an internal mux clock which switches between clkin0 and clkin1 depending on the
  clock rate requested by the MMC core.
- resets     : phandle of the internal reset line

Example:

	sd_emmc_a: mmc@70000 {
		compatible = "amlogic,meson-gxbb-mmc";
		reg = <0x0 0x70000 0x0 0x2000>;
		interrupts = < GIC_SPI 216 IRQ_TYPE_EDGE_RISING>;
		clocks = <&clkc CLKID_SD_EMMC_A>, <&xtal>, <&clkc CLKID_FCLK_DIV2>;
		clock-names = "core", "clkin0", "clkin1";
		pinctrl-0 = <&emmc_pins>;
		resets = <&reset RESET_SD_EMMC_A>;
	};
```

## Documentation/devicetree/bindings/mmc/amlogic,meson-mx-sdhc.yaml
```yaml
# SPDX-License-Identifier: (GPL-2.0-only OR BSD-2-Clause)
%YAML 1.2
---
$id: http://devicetree.org/schemas/mmc/amlogic,meson-mx-sdhc.yaml#
$schema: http://devicetree.org/meta-schemas/core.yaml#

title: Amlogic Meson SDHC controller Device Tree Bindings

allOf:
  - $ref: "mmc-controller.yaml"

maintainers:
  - Martin Blumenstingl <martin.blumenstingl@googlemail.com>

description: |
  The SDHC MMC host controller on Amlogic SoCs provides an eMMC and MMC
  card interface with 1/4/8-bit bus width.
  It supports eMMC spec 4.4x/4.5x including HS200 (up to 100MHz clock).

properties:
  compatible:
    items:
      - enum:
          - amlogic,meson8-sdhc
          - amlogic,meson8b-sdhc
          - amlogic,meson8m2-sdhc
      - const: amlogic,meson-mx-sdhc

  reg:
    minItems: 1

  interrupts:
    minItems: 1

  clocks:
    minItems: 5

  clock-names:
    items:
      - const: clkin0
      - const: clkin1
      - const: clkin2
      - const: clkin3
      - const: pclk

required:
  - compatible
  - reg
  - interrupts
  - clocks
  - clock-names

examples:
  - |
    #include <dt-bindings/interrupt-controller/irq.h>
    #include <dt-bindings/interrupt-controller/arm-gic.h>

    sdhc: mmc@8e00 {
      compatible = "amlogic,meson8-sdhc", "amlogic,meson-mx-sdhc";
      reg = <0x8e00 0x42>;
      interrupts = <GIC_SPI 78 IRQ_TYPE_EDGE_RISING>;
      clocks = <&xtal>,
               <&fclk_div4>,
               <&fclk_div3>,
               <&fclk_div5>,
               <&sdhc_pclk>;
      clock-names = "clkin0", "clkin1", "clkin2", "clkin3", "pclk";
    };
```

## Documentation/devicetree/bindings/mmc/amlogic,meson-mx-sdio.txt
```
* Amlogic Meson6, Meson8 and Meson8b SDIO/MMC controller

The highspeed MMC host controller on Amlogic SoCs provides an interface
for MMC, SD, SDIO and SDHC types of memory cards.

Supported maximum speeds are the ones of the eMMC standard 4.41 as well
as the speed of SD standard 2.0.

The hardware provides an internal "mux" which allows up to three slots
to be controlled. Only one slot can be accessed at a time.

Required properties:
 - compatible : must be one of
	- "amlogic,meson8-sdio"
	- "amlogic,meson8b-sdio"
	along with the generic "amlogic,meson-mx-sdio"
 - reg : mmc controller base registers
 - interrupts : mmc controller interrupt
 - #address-cells : must be 1
 - size-cells : must be 0
 - clocks : phandle to clock providers
 - clock-names : must contain "core" and "clkin"

Required child nodes:
A node for each slot provided by the MMC controller is required.
NOTE: due to a driver limitation currently only one slot (= child node)
      is supported!

Required properties on each child node (= slot):
 - compatible : must be "mmc-slot" (see mmc.txt within this directory)
 - reg : the slot (or "port") ID

Optional properties on each child node (= slot):
 - bus-width : must be 1 or 4 (8-bit bus is not supported)
 - for cd and all other additional generic mmc parameters
   please refer to mmc.txt within this directory

Examples:
	mmc@c1108c20 {
		compatible = "amlogic,meson8-sdio", "amlogic,meson-mx-sdio";
		reg = <0xc1108c20 0x20>;
		interrupts = <0 28 1>;
		#address-cells = <1>;
		#size-cells = <0>;
		clocks = <&clkc CLKID_SDIO>, <&clkc CLKID_CLK81>;
		clock-names = "core", "clkin";

		slot@1 {
			compatible = "mmc-slot";
			reg = <1>;

			bus-width = <4>;
		};
	};
```
