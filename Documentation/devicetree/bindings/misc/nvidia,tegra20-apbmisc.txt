## Documentation/devicetree/bindings/misc/ramoops.txt
```
Ramoops oops/panic logger
=========================

ramoops provides persistent RAM storage for oops and panics, so they can be
recovered after a reboot.

Parts of this storage may be set aside for other persistent log buffers, such
as kernel log messages, or for optional ECC error-correction data.  The total
size of these optional buffers must fit in the reserved region.

Any remaining space will be used for a circular buffer of oops and panic
records.  These records have a configurable size, with a size of 0 indicating
that they should be disabled.


Required properties:

- compatible: must be "ramoops"

- memory-region: phandle to a region of memory that is preserved between reboots


Optional properties:

- ecc-size: enables ECC support and specifies ECC buffer size in bytes
  (defaults to no ECC)

- record-size: maximum size in bytes of each dump done on oops/panic
  (defaults to 0)

- console-size: size in bytes of log buffer reserved for kernel messages
  (defaults to 0)

- ftrace-size: size in bytes of log buffer reserved for function tracing and
  profiling (defaults to 0)

- pmsg-size: size in bytes of log buffer reserved for userspace messages
  (defaults to 0)

- unbuffered: if present, use unbuffered mappings to map the reserved region
  (defaults to buffered mappings)

- no-dump-oops: if present, only dump panics (defaults to panics and oops)
```

## Documentation/devicetree/bindings/misc/rockchip-scr.txt
```
* Rockchip Smartcard Reader Controller driver.

Required properties:
- compatible: should be "rockchip-scr"
	support smart card reader controller for SoC
	such as RK3128, RK322x, RK3288, RK3368, RK3366 and etc.
- reg: Should contain SCR registers location and length
- interrupts: Should contain SCR interrupt

Example:
scr: rkscr@20048000 {
	compatible = "rockchip-scr";
	reg = <0x20048000 0x4000>;
	interrupts = <GIC_SPI 63 IRQ_TYPE_LEVEL_HIGH>;
};
```

## Documentation/devicetree/bindings/misc/smc.txt
```
Broadcom Secure Monitor Bounce buffer
-----------------------------------------------------
This binding defines the location of the bounce buffer
used for non-secure to secure communications.

Required properties:
- compatible : "bcm,kona-smc"
- reg : Location and size of bounce buffer

Example:
	smc@0x3404c000 {
		compatible = "bcm,bcm11351-smc", "bcm,kona-smc";
		reg = <0x3404c000 0x400>; //1 KiB in SRAM
	};
```

## Documentation/devicetree/bindings/misc/sram.txt
```
Generic on-chip SRAM

Simple IO memory regions to be managed by the genalloc API.

Required properties:

- compatible : mmio-sram

- reg : SRAM iomem address range

Optional properties:

- map-exec: Map range to allow code execution
- map-cacheable: Map range as cacheable

Example:

sram: sram@5c000000 {
	compatible = "mmio-sram";
	reg = <0x5c000000 0x40000>; /* 256 KiB SRAM at address 0x5c000000 */
};
```

## Documentation/devicetree/bindings/misc/ti,dac7512.txt
```
TI DAC7512 DEVICETREE BINDINGS

Required properties:

	- "compatible"		Must be set to "ti,dac7512"

Property rules described in Documentation/devicetree/bindings/spi/spi-bus.txt
apply. In particular, "reg" and "spi-max-frequency" properties must be given.


Example:

	spi_master {
		dac7512: dac7512@0 {
			compatible = "ti,dac7512";
			reg = <0>; /* CS0 */
			spi-max-frequency = <1000000>;
		};
	};
```

## Documentation/devicetree/bindings/misc/ti,fpc202.yaml
```yaml
# SPDX-License-Identifier: (GPL-2.0-only OR BSD-2-Clause)
%YAML 1.2
---
$id: http://devicetree.org/schemas/misc/ti,fpc202.yaml#
$schema: http://devicetree.org/meta-schemas/core.yaml#

title: TI FPC202 dual port controller with expanded IOs

maintainers:
  - Romain Gantois <romain.gantois@bootlin.com>

allOf:
  - $ref: /schemas/i2c/i2c-atr.yaml#

properties:
  compatible:
    const: ti,fpc202

  reg:
    maxItems: 1

  gpio-controller: true

  "#gpio-cells":
    const: 2

  enable-gpios:
    description:
      Specifier for the GPIO connected to the EN pin.
    maxItems: 1

  '#address-cells':
    const: 1

  '#size-cells':
    const: 0

patternProperties:
  "^i2c@[0-1]$":
    $ref: /schemas/i2c/i2c-controller.yaml#
    description: Downstream device ports 0 and 1

    properties:
      reg:
        maxItems: 1
        description:
          Downstream port ID

    required:
      - "#address-cells"
      - "#size-cells"
      - reg

    unevaluatedProperties: false

required:
  - compatible
  - reg
  - gpio-controller
  - "#gpio-cells"
  - "#address-cells"
  - "#size-cells"

unevaluatedProperties: false

examples:
  - |
    i2c {
        #address-cells = <1>;
        #size-cells = <0>;

        i2c-atr@f {
            compatible = "ti,fpc202";
            reg = <0xf>;
            #address-cells = <1>;
            #size-cells = <0>;

            gpio-controller;
            #gpio-cells = <2>;

            i2c@0 {
                #address-cells = <1>;
                #size-cells = <0>;
                reg = <0>;
            };

            i2c@1 {
                #address-cells = <1>;
                #size-cells = <0>;
                reg = <1>;
            };
        };
    };
...
```

## Documentation/devicetree/bindings/misc/ti,j721e-esm.yaml
```yaml
# SPDX-License-Identifier: (GPL-2.0-only OR BSD-2-Clause)
# Copyright (C) 2022 Texas Instruments Incorporated
%YAML 1.2
---
$id: http://devicetree.org/schemas/misc/ti,j721e-esm.yaml#
$schema: http://devicetree.org/meta-schemas/core.yaml#

title: Texas Instruments K3 ESM

maintainers:
  - Neha Malcom Francis <n-francis@ti.com>

description:
  The ESM (Error Signaling Module) is an IP block on TI K3 devices
  that allows handling of safety events somewhat similar to what interrupt
  controller would do. The safety signals have their separate paths within
  the SoC, and they are handled by the ESM, which routes them to the proper
  destination, which can be system reset, interrupt controller, etc. In the
  simplest configuration the signals are just routed to reset the SoC.

properties:
  compatible:
    const: ti,j721e-esm

  reg:
    maxItems: 1

  ti,esm-pins:
    $ref: /schemas/types.yaml#/definitions/uint32-array
    description:
      integer array of ESM interrupt pins to route to external event pin
      which can be used to reset the SoC.
    minItems: 1
    maxItems: 255

required:
  - compatible
  - reg
  - ti,esm-pins

additionalProperties: false

examples:
  - |
    bus {
        #address-cells = <2>;
        #size-cells = <2>;
        esm@700000 {
            compatible = "ti,j721e-esm";
            reg = <0x0 0x700000 0x0 0x1000>;
            ti,esm-pins = <344>, <345>;
        };
    };
```

## Documentation/devicetree/bindings/misc/usb_cam_gpio.txt
```
* Rockchip USB camera GPIO control driver

Required properties:
- compatible: should be "usb-cam-gpio"
- hd-cam-pin: HD camera on gpio pin
- ir-cam-pin: IR camera on gpio pin

Example:
	usb_cam_gpio: usb-cam-gpio {
		compatible = "usb-cam-gpio";
		pinctrl-names = "default";
		pinctrl-0 = <&usb_cam_on_gpio>;
		hd-cam-pin = <&gpio3 GPIO_A1 GPIO_ACTIVE_LOW>;
		ir-cam-pin = <&gpio3 GPIO_A2 GPIO_ACTIVE_HIGH>;
		status = "okay";
	};
```

## Documentation/devicetree/bindings/misc/xlnx,sd-fec.txt
```
* Xilinx SDFEC(16nm) IP *

The Soft Decision Forward Error Correction (SDFEC) Engine is a Hard IP block
which provides high-throughput LDPC and Turbo Code implementations.
The LDPC decode & encode functionality is capable of covering a range of
customer specified Quasi-cyclic (QC) codes. The Turbo decode functionality
principally covers codes used by LTE. The FEC Engine offers significant
power and area savings versus implementations done in the FPGA fabric.


Required properties:
- compatible: Must be "xlnx,sd-fec-1.1"
- clock-names : List of input clock names from the following:
    - "core_clk", Main processing clock for processing core (required)
    - "s_axi_aclk", AXI4-Lite memory-mapped slave interface clock (required)
    - "s_axis_din_aclk", DIN AXI4-Stream Slave interface clock (optional)
    - "s_axis_din_words-aclk", DIN_WORDS AXI4-Stream Slave interface clock (optional)
    - "s_axis_ctrl_aclk",  Control input AXI4-Stream Slave interface clock (optional)
    - "m_axis_dout_aclk", DOUT AXI4-Stream Master interface clock (optional)
    - "m_axis_dout_words_aclk", DOUT_WORDS AXI4-Stream Master interface clock (optional)
    - "m_axis_status_aclk", Status output AXI4-Stream Master interface clock (optional)
- clocks : Clock phandles (see clock_bindings.txt for details).
- reg: Should contain Xilinx SDFEC 16nm Hardened IP block registers
  location and length.
- xlnx,sdfec-code : Should contain "ldpc" or "turbo" to describe the codes
  being used.
- xlnx,sdfec-din-words : A value 0 indicates that the DIN_WORDS interface is
  driven with a fixed value and is not present on the device, a value of 1
  configures the DIN_WORDS to be block based, while a value of 2 configures the
  DIN_WORDS input to be supplied for each AXI transaction.
- xlnx,sdfec-din-width : Configures the DIN AXI stream where a value of 1
  configures a width of "1x128b", 2 a width of "2x128b" and 4 configures a width
  of "4x128b".
- xlnx,sdfec-dout-words : A value 0 indicates that the DOUT_WORDS interface is
  driven with a fixed value and is not present on the device, a value of 1
  configures the DOUT_WORDS to be block based, while a value of 2 configures the
  DOUT_WORDS input to be supplied for each AXI transaction.
- xlnx,sdfec-dout-width : Configures the DOUT AXI stream where a value of 1
  configures a width of "1x128b", 2 a width of "2x128b" and 4 configures a width
  of "4x128b".
Optional properties:
- interrupts: should contain SDFEC interrupt number

Example
---------------------------------------
	sd_fec_0: sd-fec@a0040000 {
		compatible = "xlnx,sd-fec-1.1";
		clock-names = "core_clk","s_axi_aclk","s_axis_ctrl_aclk","s_axis_din_aclk","m_axis_status_aclk","m_axis_dout_aclk";
		clocks = <&misc_clk_2>,<&misc_clk_0>,<&misc_clk_1>,<&misc_clk_1>,<&misc_clk_1>, <&misc_clk_1>;
		reg = <0x0 0xa0040000 0x0 0x40000>;
		interrupt-parent = <&axi_intc>;
		interrupts = <1 0>;
		xlnx,sdfec-code = "ldpc";
		xlnx,sdfec-din-words = <0>;
		xlnx,sdfec-din-width = <2>;
		xlnx,sdfec-dout-words = <0>;
		xlnx,sdfec-dout-width = <1>;
	};
```

## Documentation/devicetree/bindings/misc/xlnx,sd-fec.yaml
```yaml
# SPDX-License-Identifier: (GPL-2.0 OR BSD-2-Clause)
%YAML 1.2
---
$id: http://devicetree.org/schemas/misc/xlnx,sd-fec.yaml#
$schema: http://devicetree.org/meta-schemas/core.yaml#

title: Xilinx SDFEC(16nm) IP

maintainers:
  - Cvetic, Dragan <dragan.cvetic@amd.com>
  - Erim, Salih <salih.erim@amd.com>

description:
  The Soft Decision Forward Error Correction (SDFEC) Engine is a Hard IP block
  which provides high-throughput LDPC and Turbo Code implementations.
  The LDPC decode & encode functionality is capable of covering a range of
  customer specified Quasi-cyclic (QC) codes. The Turbo decode functionality
  principally covers codes used by LTE. The FEC Engine offers significant
  power and area savings versus implementations done in the FPGA fabric.

properties:
  compatible:
    const: xlnx,sd-fec-1.1

  reg:
    maxItems: 1

  clocks:
    minItems: 2
    maxItems: 8
    additionalItems: true
    items:
      - description: Main processing clock for processing core
      - description: AXI4-Lite memory-mapped slave interface clock
      - description: Control input AXI4-Stream Slave interface clock
      - description: DIN AXI4-Stream Slave interface clock
      - description: Status output AXI4-Stream Master interface clock
      - description: DOUT AXI4-Stream Master interface clock
      - description: DIN_WORDS AXI4-Stream Slave interface clock
      - description: DOUT_WORDS AXI4-Stream Master interface clock

  clock-names:
    allOf:
      - minItems: 2
        maxItems: 8
        additionalItems: true
        items:
          - const: core_clk
          - const: s_axi_aclk
      - items:
          enum:
            - core_clk
            - s_axi_aclk
            - s_axis_ctrl_aclk
            - s_axis_din_aclk
            - m_axis_status_aclk
            - m_axis_dout_aclk
            - s_axis_din_words_aclk
            - m_axis_dout_words_aclk

  interrupts:
    maxItems: 1

  xlnx,sdfec-code:
    description:
      The SD-FEC integrated block supports Low Density Parity Check (LDPC)
      decoding and encoding and Turbo code decoding. The LDPC codes used are
      highly configurable, and the specific code used can be specified on
      a codeword-by-codeword basis. The Turbo code decoding is required by LTE
      standard.
    $ref: /schemas/types.yaml#/definitions/string
    items:
      enum: [ ldpc, turbo ]

  xlnx,sdfec-din-width:
    description:
      Configures the DIN AXI stream where a value of 1
      configures a width of "1x128b", 2 a width of "2x128b" and 4 configures a width
      of "4x128b".
    $ref: /schemas/types.yaml#/definitions/uint32
    enum: [ 1, 2, 4 ]

  xlnx,sdfec-din-words:
    description:
      A value 0 indicates that the DIN_WORDS interface is
      driven with a fixed value and is not present on the device, a value of 1
      configures the DIN_WORDS to be block based, while a value of 2 configures the
      DIN_WORDS input to be supplied for each AXI transaction.
    $ref: /schemas/types.yaml#/definitions/uint32
    enum: [ 0, 1, 2 ]

  xlnx,sdfec-dout-width:
    description:
      Configures the DOUT AXI stream where a value of 1 configures a width of "1x128b",
      2 a width of "2x128b" and 4 configures a width of "4x128b".
    $ref: /schemas/types.yaml#/definitions/uint32
    enum: [ 1, 2, 4 ]

  xlnx,sdfec-dout-words:
    description:
      A value 0 indicates that the DOUT_WORDS interface is
      driven with a fixed value and is not present on the device, a value of 1
      configures the DOUT_WORDS to be block based, while a value of 2 configures the
      DOUT_WORDS input to be supplied for each AXI transaction.
    $ref: /schemas/types.yaml#/definitions/uint32
    enum: [ 0, 1, 2 ]

required:
  - compatible
  - reg
  - clocks
  - clock-names
  - xlnx,sdfec-code
  - xlnx,sdfec-din-width
  - xlnx,sdfec-din-words
  - xlnx,sdfec-dout-width
  - xlnx,sdfec-dout-words

additionalProperties: false

examples:
  - |
    #include <dt-bindings/interrupt-controller/irq.h>

    sd-fec@a0040000 {
        compatible = "xlnx,sd-fec-1.1";
        reg = <0xa0040000 0x40000>;
        clocks = <&misc_clk_2>, <&misc_clk_0>, <&misc_clk_1>, <&misc_clk_1>,
                 <&misc_clk_1>, <&misc_clk_1>;
        clock-names = "core_clk", "s_axi_aclk", "s_axis_ctrl_aclk",
                      "s_axis_din_aclk", "m_axis_status_aclk",
                      "m_axis_dout_aclk";
        interrupts = <1 IRQ_TYPE_LEVEL_HIGH>;
        xlnx,sdfec-code = "ldpc";
        xlnx,sdfec-din-width = <2>;
        xlnx,sdfec-din-words = <0>;
        xlnx,sdfec-dout-width = <1>;
        xlnx,sdfec-dout-words = <0>;
    };
```
