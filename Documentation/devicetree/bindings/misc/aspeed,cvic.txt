## Documentation/devicetree/bindings/misc/aspeed,cvic.txt
```
* ASPEED AST2400 and AST2500 coprocessor interrupt controller

This file describes the bindings for the interrupt controller present
in the AST2400 and AST2500 BMC SoCs which provides interrupt to the
ColdFire coprocessor.

It is not a normal interrupt controller and it would be rather
inconvenient to create an interrupt tree for it as it somewhat shares
some of the same sources as the main ARM interrupt controller but with
different numbers.

The AST2500 supports a SW generated interrupt

Required properties:
- reg: address and length of the register for the device.
- compatible: "aspeed,cvic" and one of:
		"aspeed,ast2400-cvic"
	      or
		"aspeed,ast2500-cvic"

- valid-sources: One cell, bitmap of supported sources for the implementation

Optional properties;
- copro-sw-interrupts: List of interrupt numbers that can be used as
		       SW interrupts from the ARM to the coprocessor.
		       (AST2500 only)

Example:

	cvic: copro-interrupt-controller@1e6c2000 {
		compatible = "aspeed,ast2500-cvic";
		valid-sources = <0xffffffff>;
		copro-sw-interrupts = <1>;
		reg = <0x1e6c2000 0x80>;
	};
```

## Documentation/devicetree/bindings/misc/aspeed-p2a-ctrl.txt
```
======================================================================
Device tree bindings for Aspeed AST2400/AST2500 PCI-to-AHB Bridge Control Driver
======================================================================

The bridge is available on platforms with the VGA enabled on the Aspeed device.
In this case, the host has access to a 64KiB window into all of the BMC's
memory.  The BMC can disable this bridge.  If the bridge is enabled, the host
has read access to all the regions of memory, however the host only has read
and write access depending on a register controlled by the BMC.

Required properties:
===================

 - compatible: must be one of:
	- "aspeed,ast2400-p2a-ctrl"
	- "aspeed,ast2500-p2a-ctrl"

Optional properties:
===================

- memory-region: A phandle to a reserved_memory region to be used for the PCI
		to AHB mapping

The p2a-control node should be the child of a syscon node with the required
property:

- compatible : Should be one of the following:
		"aspeed,ast2400-scu", "syscon", "simple-mfd"
		"aspeed,ast2500-scu", "syscon", "simple-mfd"

Example
===================

g4 Example
----------

syscon: scu@1e6e2000 {
	compatible = "aspeed,ast2400-scu", "syscon", "simple-mfd";
	reg = <0x1e6e2000 0x1a8>;

	p2a: p2a-control {
		compatible = "aspeed,ast2400-p2a-ctrl";
		memory-region = <&reserved_memory>;
	};
};
```

## Documentation/devicetree/bindings/misc/at25.txt
```
Atmel AT25 eeprom

Required properties:
- compatible : "atmel,at25".
- reg : chip select number
- spi-max-frequency : max spi frequency to use

- at25,byte-len : total eeprom size in bytes
- at25,addr-mode : addr-mode flags, as defined in include/linux/spi/eeprom.h
- at25,page-size : size of the eeprom page

Examples:
at25@0 {
	compatible = "atmel,at25";
	reg = <0>
	spi-max-frequency = <5000000>;

	at25,byte-len = <0x8000>;
	at25,addr-mode = <2>;
	at25,page-size = <64>;
};
```

## Documentation/devicetree/bindings/misc/atmel-ssc.txt
```
* Atmel SSC driver.

Required properties:
- compatible: "atmel,at91rm9200-ssc" or "atmel,at91sam9g45-ssc"
	- atmel,at91rm9200-ssc: support pdc transfer
	- atmel,at91sam9g45-ssc: support dma transfer
- reg: Should contain SSC registers location and length
- interrupts: Should contain SSC interrupt
- clock-names: tuple listing input clock names.
	Required elements: "pclk"
- clocks: phandles to input clocks.


Required properties for devices compatible with "atmel,at91sam9g45-ssc":
- dmas: DMA specifier, consisting of a phandle to DMA controller node,
  the memory interface and SSC DMA channel ID (for tx and rx).
  See Documentation/devicetree/bindings/dma/atmel-dma.txt for details.
- dma-names: Must be "tx", "rx".

Optional properties:
  - atmel,clk-from-rk-pin: bool property.
     - When SSC works in slave mode, according to the hardware design, the
       clock can get from TK pin, and also can get from RK pin. So, add
       this parameter to choose where the clock from.
     - By default the clock is from TK pin, if the clock from RK pin, this
       property is needed.
  - #sound-dai-cells: Should contain <0>.
     - This property makes the SSC into an automatically registered DAI.

Examples:
- PDC transfer:
ssc0: ssc@fffbc000 {
	compatible = "atmel,at91rm9200-ssc";
	reg = <0xfffbc000 0x4000>;
	interrupts = <14 4 5>;
	clocks = <&ssc0_clk>;
	clock-names = "pclk";
};

- DMA transfer:
ssc0: ssc@f0010000 {
      compatible = "atmel,at91sam9g45-ssc";
      reg = <0xf0010000 0x4000>;
      interrupts = <28 4 5>;
      dmas = <&dma0 1 13>,
	     <&dma0 1 14>;
      dma-names = "tx", "rx";
      pinctrl-names = "default";
      pinctrl-0 = <&pinctrl_ssc0_tx &pinctrl_ssc0_rx>;
      status = "disabled";
};
```

## Documentation/devicetree/bindings/misc/bmp085.txt
```
BMP085/BMP18x digital pressure sensors

Required properties:
- compatible: bosch,bmp085

Optional properties:
- chip-id: configurable chip id for non-default chip revisions
- temp-measurement-period: temperature measurement period (milliseconds)
- default-oversampling: default oversampling value to be used at startup,
  value range is 0-3 with rising sensitivity.
- interrupt-parent: should be the phandle for the interrupt controller
- interrupts: interrupt mapping for IRQ

Example:

pressure@77 {
	compatible = "bosch,bmp085";
	reg = <0x77>;
	chip-id = <10>;
	temp-measurement-period = <100>;
	default-oversampling = <2>;
	interrupt-parent = <&gpio0>;
	interrupts = <25 IRQ_TYPE_EDGE_RISING>;
};
```

## Documentation/devicetree/bindings/misc/eeprom-93xx46.txt
```
EEPROMs (SPI) compatible with Microchip Technology 93xx46 family.

Required properties:
- compatible : shall be one of:
    "atmel,at93c46d"
    "eeprom-93xx46"
    "microchip,93lc46b"
- data-size : number of data bits per word (either 8 or 16)

Optional properties:
- read-only : parameter-less property which disables writes to the EEPROM
- select-gpios : if present, specifies the GPIO that will be asserted prior to
  each access to the EEPROM (e.g. for SPI bus multiplexing)

Property rules described in Documentation/devicetree/bindings/spi/spi-bus.txt
apply.  In particular, "reg" and "spi-max-frequency" properties must be given.

Example:
	eeprom@0 {
		compatible = "eeprom-93xx46";
		reg = <0>;
		spi-max-frequency = <1000000>;
		spi-cs-high;
		data-size = <8>;
		select-gpios = <&gpio4 4 GPIO_ACTIVE_HIGH>;
	};
```

## Documentation/devicetree/bindings/misc/eeprom-93xx46.yaml
```yaml
# SPDX-License-Identifier: (GPL-2.0 OR BSD-2-Clause)
%YAML 1.2
---
$id: http://devicetree.org/schemas/misc/eeprom-93xx46.yaml#
$schema: http://devicetree.org/meta-schemas/core.yaml#

title: Microchip 93xx46 SPI compatible EEPROM family dt bindings

maintainers:
  - Cory Tusar <cory.tusar@pid1solutions.com>

properties:
  compatible:
    enum:
      - atmel,at93c46
      - atmel,at93c46d
      - atmel,at93c56
      - atmel,at93c66
      - eeprom-93xx46
      - microchip,93lc46b

  data-size:
    description: number of data bits per word
    $ref: /schemas/types.yaml#/definitions/uint32
    enum: [8, 16]

  reg:
    description: chip select of EEPROM
    maxItems: 1

  spi-max-frequency: true
  spi-cs-high: true

  read-only:
    description:
      parameter-less property which disables writes to the EEPROM
    type: boolean

  select-gpios:
    description:
      specifies the GPIO that needs to be asserted prior to each access
      of EEPROM (e.g. for SPI bus multiplexing)
    maxItems: 1


required:
  - compatible
  - reg
  - data-size
  - spi-max-frequency

additionalProperties: false

examples:
  - |
    #include <dt-bindings/gpio/gpio.h>

    spi {
      #address-cells = <1>;
      #size-cells = <0>;

      eeprom@0 {
        compatible = "eeprom-93xx46";
        reg = <0>;
        spi-max-frequency = <1000000>;
        spi-cs-high;
        data-size = <8>;
        select-gpios = <&gpio4 4 GPIO_ACTIVE_HIGH>;
      };
    };
```

## Documentation/devicetree/bindings/misc/fsl,dpaa2-console.txt
```
DPAA2 console support

Required properties:

    - compatible
        Value type: <string>
        Definition: Must be "fsl,dpaa2-console".
    - reg
        Value type: <prop-encoded-array>
        Definition: A standard property.  Specifies the region where the MCFBA
                    (MC firmware base address) register can be found.
```

## Documentation/devicetree/bindings/misc/fsl,dpaa2-console.yaml
```yaml
# SPDX-License-Identifier: (GPL-2.0 OR BSD-2-Clause)
# Copyright 2020 NXP
%YAML 1.2
---
$id: http://devicetree.org/schemas/misc/fsl,dpaa2-console.yaml#
$schema: http://devicetree.org/meta-schemas/core.yaml#

title: DPAA2 console support

maintainers:
  - Laurentiu Tudor <laurentiu.tudor@nxp.com>

properties:
  compatible:
    const: "fsl,dpaa2-console"

  reg:
    description: A standard property. Specifies the region where the MCFBA
                (MC firmware base address) register can be found.

required:
  - compatible
  - reg

additionalProperties: false
```

## Documentation/devicetree/bindings/misc/fsl,qoriq-mc.txt
```
* Freescale Management Complex

The Freescale Management Complex (fsl-mc) is a hardware resource
manager that manages specialized hardware objects used in
network-oriented packet processing applications. After the fsl-mc
block is enabled, pools of hardware resources are available, such as
queues, buffer pools, I/O interfaces. These resources are building
blocks that can be used to create functional hardware objects/devices
such as network interfaces, crypto accelerator instances, L2 switches,
etc.

For an overview of the DPAA2 architecture and fsl-mc bus see:
Documentation/networking/dpaa2/overview.rst

As described in the above overview, all DPAA2 objects in a DPRC share the
same hardware "isolation context" and a 10-bit value called an ICID
(isolation context id) is expressed by the hardware to identify
the requester.

The generic 'iommus' property is insufficient to describe the relationship
between ICIDs and IOMMUs, so an iommu-map property is used to define
the set of possible ICIDs under a root DPRC and how they map to
an IOMMU.

For generic IOMMU bindings, see
Documentation/devicetree/bindings/iommu/iommu.txt.

For arm-smmu binding, see:
Documentation/devicetree/bindings/iommu/arm,smmu.txt.

Required properties:

    - compatible
        Value type: <string>
        Definition: Must be "fsl,qoriq-mc".  A Freescale Management Complex
                    compatible with this binding must have Block Revision
                    Registers BRR1 and BRR2 at offset 0x0BF8 and 0x0BFC in
                    the MC control register region.

    - reg
        Value type: <prop-encoded-array>
        Definition: A standard property.  Specifies one or two regions
                    defining the MC's registers:

                       -the first region is the command portal for the
                        this machine and must always be present

                       -the second region is the MC control registers. This
                        region may not be present in some scenarios, such
                        as in the device tree presented to a virtual machine.

    - msi-parent
        Value type: <phandle>
        Definition: Must be present and point to the MSI controller node
                    handling message interrupts for the MC.

    - ranges
        Value type: <prop-encoded-array>
        Definition: A standard property.  Defines the mapping between the child
                    MC address space and the parent system address space.

                    The MC address space is defined by 3 components:
                       <region type> <offset hi> <offset lo>

                    Valid values for region type are
                       0x0 - MC portals
                       0x1 - QBMAN portals

    - #address-cells
        Value type: <u32>
        Definition: Must be 3.  (see definition in 'ranges' property)

    - #size-cells
        Value type: <u32>
        Definition: Must be 1.

Sub-nodes:

        The fsl-mc node may optionally have dpmac sub-nodes that describe
        the relationship between the Ethernet MACs which belong to the MC
        and the Ethernet PHYs on the system board.

        The dpmac nodes must be under a node named "dpmacs" which contains
        the following properties:

            - #address-cells
              Value type: <u32>
              Definition: Must be present if dpmac sub-nodes are defined and must
                          have a value of 1.

            - #size-cells
              Value type: <u32>
              Definition: Must be present if dpmac sub-nodes are defined and must
                          have a value of 0.

        These nodes must have the following properties:

            - compatible
              Value type: <string>
              Definition: Must be "fsl,qoriq-mc-dpmac".

            - reg
              Value type: <prop-encoded-array>
              Definition: Specifies the id of the dpmac.

            - phy-handle
              Value type: <phandle>
              Definition: Specifies the phandle to the PHY device node associated
                          with the this dpmac.
Optional properties:

- iommu-map: Maps an ICID to an IOMMU and associated iommu-specifier
  data.

  The property is an arbitrary number of tuples of
  (icid-base,iommu,iommu-base,length).

  Any ICID i in the interval [icid-base, icid-base + length) is
  associated with the listed IOMMU, with the iommu-specifier
  (i - icid-base + iommu-base).

Example:

        smmu: iommu@5000000 {
               compatible = "arm,mmu-500";
               #iommu-cells = <1>;
               stream-match-mask = <0x7C00>;
               ...
        };

        fsl_mc: fsl-mc@80c000000 {
                compatible = "fsl,qoriq-mc";
                reg = <0x00000008 0x0c000000 0 0x40>,    /* MC portal base */
                      <0x00000000 0x08340000 0 0x40000>; /* MC control reg */
                msi-parent = <&its>;
                /* define map for ICIDs 23-64 */
                iommu-map = <23 &smmu 23 41>;
                #address-cells = <3>;
                #size-cells = <1>;

                /*
                 * Region type 0x0 - MC portals
                 * Region type 0x1 - QBMAN portals
                 */
                ranges = <0x0 0x0 0x0 0x8 0x0c000000 0x4000000
                          0x1 0x0 0x0 0x8 0x18000000 0x8000000>;

                dpmacs {
                    #address-cells = <1>;
                    #size-cells = <0>;

                    dpmac@1 {
                        compatible = "fsl,qoriq-mc-dpmac";
                        reg = <1>;
                        phy-handle = <&mdio0_phy0>;
                    }
                }
        };
```
