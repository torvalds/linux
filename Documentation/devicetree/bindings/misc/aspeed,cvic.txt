## Documentation/devicetree/bindings/misc/fsl,qoriq-mc.yaml
```yaml
# SPDX-License-Identifier: (GPL-2.0-only OR BSD-2-Clause)
%YAML 1.2
---
$id: http://devicetree.org/schemas/misc/fsl,qoriq-mc.yaml#
$schema: http://devicetree.org/meta-schemas/core.yaml#

title: Freescale Management Complex

maintainers:
  - Frank Li <Frank.Li@nxp.com>

description: |
  The Freescale Management Complex (fsl-mc) is a hardware resource
  manager that manages specialized hardware objects used in
  network-oriented packet processing applications. After the fsl-mc
  block is enabled, pools of hardware resources are available, such as
  queues, buffer pools, I/O interfaces. These resources are building
  blocks that can be used to create functional hardware objects/devices
  such as network interfaces, crypto accelerator instances, L2 switches,
  etc.

  For an overview of the DPAA2 architecture and fsl-mc bus see:
  Documentation/networking/device_drivers/ethernet/freescale/dpaa2/overview.rst

  As described in the above overview, all DPAA2 objects in a DPRC share the
  same hardware "isolation context" and a 10-bit value called an ICID
  (isolation context id) is expressed by the hardware to identify
  the requester.

  The generic 'iommus' property is insufficient to describe the relationship
  between ICIDs and IOMMUs, so an iommu-map property is used to define
  the set of possible ICIDs under a root DPRC and how they map to
  an IOMMU.

  For generic IOMMU bindings, see
  Documentation/devicetree/bindings/iommu/iommu.txt.

  For arm-smmu binding, see:
  Documentation/devicetree/bindings/iommu/arm,smmu.yaml.

  The MSI writes are accompanied by sideband data which is derived from the ICID.
  The msi-map property is used to associate the devices with both the ITS
  controller and the sideband data which accompanies the writes.

  For generic MSI bindings, see
  Documentation/devicetree/bindings/interrupt-controller/msi.txt.

  For GICv3 and GIC ITS bindings, see:
  Documentation/devicetree/bindings/interrupt-controller/arm,gic-v3.yaml.

properties:
  compatible:
    enum:
      - fsl,qoriq-mc
    description:
      Must be "fsl,qoriq-mc".  A Freescale Management Complex
      compatible with this binding must have Block Revision
      Registers BRR1 and BRR2 at offset 0x0BF8 and 0x0BFC in
      the MC control register region.

  reg:
    items:
      - description:
          the first region is the command portal for the
          this machine and must always be present

      - description:
          the second region is the MC control registers. This
          region may not be present in some scenarios, such
          as in the device tree presented to a virtual machine.

  ranges:
    description: |
      A standard property.  Defines the mapping between the child
      MC address space and the parent system address space.

      The MC address space is defined by 3 components:
        <region type> <offset hi> <offset lo>

      Valid values for region type are
        0x0 - MC portals
        0x1 - QBMAN portals

  "#address-cells":
    const: 3

  "#size-cells":
    const: 1

  iommu-map:
    description: |
      Maps an ICID to an IOMMU and associated iommu-specifier
      data.

      The property is an arbitrary number of tuples of
      (icid-base,iommu,iommu-base,length).

      Any ICID i in the interval [icid-base, icid-base + length) is
      associated with the listed IOMMU, with the iommu-specifier
      (i - icid-base + iommu-base).

  msi-map:
    description: |
      Maps an ICID to a GIC ITS and associated msi-specifier
      data.

      The property is an arbitrary number of tuples of
      (icid-base,gic-its,msi-base,length).

      Any ICID in the interval [icid-base, icid-base + length) is
      associated with the listed GIC ITS, with the msi-specifier
      (i - icid-base + msi-base).

  msi-parent:
    deprecated: true
    $ref: /schemas/types.yaml#/definitions/phandle
    description:
      Describes the MSI controller node handling message
      interrupts for the MC. When there is no translation
      between the ICID and deviceID this property can be used
      to describe the MSI controller used by the devices on the
      mc-bus.
      The use of this property for mc-bus is deprecated. Please
      use msi-map.

  dma-coherent: true

  dpmacs:
    type: object
    description:
      The fsl-mc node may optionally have dpmac sub-nodes that describe
      the relationship between the Ethernet MACs which belong to the MC
      and the Ethernet PHYs on the system board.

    properties:
      "#address-cells":
        const: 1

      "#size-cells":
        const: 0

    patternProperties:
      '^ethernet@[a-f0-9]+$':
        $ref: /schemas/net/fsl,qoriq-mc-dpmac.yaml

    additionalProperties: false

required:
  - compatible
  - reg
  - ranges
  - "#address-cells"
  - "#size-cells"

additionalProperties: false

examples:
  - |
    fsl-mc@80c000000 {
        compatible = "fsl,qoriq-mc";
        reg = <0x0c000000 0x40>,    /* MC portal base */
              <0x08340000 0x40000>; /* MC control reg */
        /*
         * Region type 0x0 - MC portals
         * Region type 0x1 - QBMAN portals
         */
        ranges = <0x0 0x0 0x8 0x0c000000 0x4000000
                 0x1 0x0 0x8 0x18000000 0x8000000>;
        
        /* define map for ICIDs 23-64 */
        iommu-map = <23 &smmu 23 41>;
        /* define msi map for ICIDs 23-64 */
        msi-map = <23 &its 23 41>;
        #address-cells = <3>;
        #size-cells = <1>;

        dpmacs {
            #address-cells = <1>;
            #size-cells = <0>;

            ethernet@1 {
                compatible = "fsl,qoriq-mc-dpmac";
                reg = <1>;
                phy-handle = <&mdio0_phy0>;
            };
        };
    };
```

## Documentation/devicetree/bindings/misc/ge-achc.txt
```
* GE Healthcare USB Management Controller

A device which handles data aquisition from compatible USB based peripherals.
SPI is used for device management.

Note: This device does not expose the peripherals as USB devices.

Required properties:

- compatible : Should be "ge,achc"

Required SPI properties:

- reg : Should be address of the device chip select within
  the controller.

- spi-max-frequency : Maximum SPI clocking speed of device in Hz, should be
  1MHz for the GE ACHC.

Example:

spidev0: spi@0 {
	compatible = "ge,achc";
	reg = <0>;
	spi-max-frequency = <1000000>;
};
```

## Documentation/devicetree/bindings/misc/ge-achc.yaml
```yaml
# SPDX-License-Identifier: GPL-2.0 OR BSD-2-Clause
# Copyright (C) 2021 GE Inc.
# Copyright (C) 2021 Collabora Ltd.
%YAML 1.2
---
$id: http://devicetree.org/schemas/misc/ge-achc.yaml#
$schema: http://devicetree.org/meta-schemas/core.yaml#

title: GE Healthcare USB Management Controller

description: |
  A device which handles data acquisition from compatible USB based peripherals.
  SPI is used for device management.

  Note: This device does not expose the peripherals as USB devices.

maintainers:
  - Sebastian Reichel <sre@kernel.org>

properties:
  compatible:
    items:
      - const: ge,achc
      - const: nxp,kinetis-k20

  clocks:
    maxItems: 1

  vdd-supply:
    description: Digital power supply regulator on VDD pin

  vdda-supply:
    description: Analog power supply regulator on VDDA pin

  reg:
    items:
      - description: Control interface
      - description: Firmware programming interface

  reset-gpios:
    description: GPIO used for hardware reset.
    maxItems: 1

required:
  - compatible
  - clocks
  - reg
  - reset-gpios

additionalProperties: false

examples:
  - |
    #include <dt-bindings/gpio/gpio.h>
    spi {
        #address-cells = <1>;
        #size-cells = <0>;

        spi@1 {
            compatible = "ge,achc", "nxp,kinetis-k20";
            reg = <1>, <0>;
            clocks = <&achc_24M>;
            reset-gpios = <&gpio3 6 GPIO_ACTIVE_LOW>;
        };
    };
```

## Documentation/devicetree/bindings/misc/google,android-pipe.yaml
```yaml
# SPDX-License-Identifier: (GPL-2.0-only OR BSD-2-Clause)
%YAML 1.2
---
$id: http://devicetree.org/schemas/misc/google,android-pipe.yaml#
$schema: http://devicetree.org/meta-schemas/core.yaml#

title: Android Goldfish QEMU Pipe

maintainers:
  - Kuan-Wei Chiu <visitorckw@gmail.com>

description:
  Android QEMU pipe virtual device generated by Android emulator.

properties:
  compatible:
    const: google,android-pipe

  reg:
    maxItems: 1

  interrupts:
    maxItems: 1

required:
  - compatible
  - reg
  - interrupts

additionalProperties: false

examples:
  - |
    pipe@ff018000 {
        compatible = "google,android-pipe";
        reg = <0xff018000 0x2000>;
        interrupts = <18>;
    };
```

## Documentation/devicetree/bindings/misc/hisilicon-hikey-usb.yaml
```yaml
# SPDX-License-Identifier: (GPL-2.0 OR BSD-2-Clause)
# Copyright 2019 Linaro Ltd.
%YAML 1.2
---
$id: "http://devicetree.org/schemas/misc/hisilicon-hikey-usb.yaml#"
$schema: "http://devicetree.org/meta-schemas/core.yaml#"

title: HiKey960 onboard USB GPIO Hub

maintainers:
  - John Stultz <john.stultz@linaro.org>

description: |
  Supports the onboard HiKey960 USB GPIO hub, which acts as a
  role-switch intermediary to detect the state of the USB-C
  port, to switch the hub into dual-role USB-C or host mode,
  which enables the onboard USB-A host ports.

  Schematics about the hub can be found here:
    https://github.com/96boards/documentation/raw/master/consumer/hikey/hikey960/hardware-docs/HiKey960_Schematics.pdf

properties:
  compatible:
    items:
      - const: hisilicon,gpio_hubv1

  typec-vbus-gpios:
    $ref: /schemas/types.yaml#/definitions/phandle
    description: phandle to the typec-vbus gpio

  otg-switch-gpios:
    $ref: /schemas/types.yaml#/definitions/phandle
    description: phandle to the otg-switch gpio

  hub-vdd33-en-gpios:
    $ref: /schemas/types.yaml#/definitions/phandle
    description: phandle to the hub 3.3v power enablement gpio

  usb-role-switch:
    $ref: /schemas/types.yaml#/definitions/flag
    description: Support role switch.

  port:
    description: |
      any connector to the data bus of this controller should be modelled
      using the OF graph bindings specified, if the "usb-role-switch"
      property is used. Note for this driver, two ports are supported,
      the first being the endpoint that will be notified by this driver,
      and the second being the endpoint that notifies this driver of a
      role switch.


required:
  - compatible
  - typec-vbus-gpios
  - otg-switch-gpios
  - hub-vdd33-en-gpios
  - usb-role-switch
  - port

additionalProperties: false

examples:
  - |
    hisi_hikey_usb: hisi_hikey_usb {
        compatible = "hisilicon,gpio_hubv1";
        typec-vbus-gpios = <&gpio25 2 GPIO_ACTIVE_HIGH>;
        otg-switch-gpios = <&gpio25 6 GPIO_ACTIVE_HIGH>;
        hub-vdd33-en-gpios = <&gpio5 6 GPIO_ACTIVE_HIGH>;
        usb-role-switch;

        port {
            #address-cells = <1>;
            #size-cells = <0>;

            hikey_usb_ep0: endpoint@0 {
                reg = <0>;
                remote-endpoint = <&dwc3_role_switch>;
            };
            hikey_usb_ep1: endpoint@1 {
                reg = <1>;
                remote-endpoint = <&rt1711h_ep>;
            };
        };
    };
```

## Documentation/devicetree/bindings/misc/idt,89hpesx.yaml
```yaml
# SPDX-License-Identifier: GPL-2.0-only OR BSD-2-Clause
%YAML 1.2
---
$id: http://devicetree.org/schemas/misc/idt,89hpesx.yaml#
$schema: http://devicetree.org/meta-schemas/core.yaml#

title: EEPROM / CSR SMBus-slave interface of IDT 89HPESx devices

maintainers:
  - Serge Semin <fancer.lancer@gmail.com>

select:
  properties:
    compatible:
      contains:
        pattern: '^idt,89hpes'
  required:
    - compatible

properties:
  compatible:
    oneOf:
      - pattern: '^idt,89hpes(8nt2|12nt3|12n3a?|24n3a?|(12|24)t3g2|4t4g2|10t4g2|[56]t5|8t5a?)$'
      - pattern: '^idt,89hpes(6t6g2|16t7|(24t6|32t8|48t12|16t4a?)(g2)?)$'
      - pattern: '^idt,89hpes(24nt6a|32nt8[ab]|12nt12|16nt16|24nt24|32nt24[ab])g2$'
      - pattern: '^idt,89hpes((32h8|48h12a?|22h16|34h16|64h16a?)(g2)?|16h16)$'

  reg:
    maxItems: 1

  '#address-cells':
    const: 1
  
  '#size-cells':
    const: 0

patternProperties:
  '^eeprom@':
    $ref: /schemas/eeprom/at24.yaml#
    unevaluatedProperties: false

    properties:
      compatible:
        description: Only a subset of devices are supported
        pattern: ',24c(32|64|128|256|512)$'

required:
  - compatible
  - reg

additionalProperties: false

examples:
  - |
    i2c {
        #address-cells = <1>;
        #size-cells = <0>;

        idt@74 {
            compatible = "idt,89hpes32nt8ag2";
            reg = <0x74>;
            #address-cells = <1>;
            #size-cells = <0>;

            eeprom@50 {
                compatible = "atmel,24c64";
                reg = <0x50>;
                read-only;
            };
        };
    };
...
```

## Documentation/devicetree/bindings/misc/idt_89hpesx.txt
```
EEPROM / CSR SMBus-slave interface of IDT 89HPESx devices

Required properties:
  - compatible : should be "<manufacturer>,<type>"
		 Basically there is only one manufacturer: idt, but some
		 compatible devices may be produced in future. Following devices
		 are supported: 89hpes8nt2, 89hpes12nt3, 89hpes24nt6ag2,
		 89hpes32nt8ag2, 89hpes32nt8bg2, 89hpes12nt12g2, 89hpes16nt16g2,
		 89hpes24nt24g2, 89hpes32nt24ag2, 89hpes32nt24bg2;
		 89hpes12n3, 89hpes12n3a, 89hpes24n3, 89hpes24n3a;
		 89hpes32h8, 89hpes32h8g2, 89hpes48h12, 89hpes48h12g2,
		 89hpes48h12ag2, 89hpes16h16, 89hpes22h16, 89hpes22h16g2,
		 89hpes34h16, 89hpes34h16g2, 89hpes64h16, 89hpes64h16g2,
		 89hpes64h16ag2;
		 89hpes12t3g2, 89hpes24t3g2, 89hpes16t4, 89hpes4t4g2,
		 89hpes10t4g2, 89hpes16t4g2, 89hpes16t4ag2, 89hpes5t5,
		 89hpes6t5, 89hpes8t5, 89hpes8t5a, 89hpes24t6, 89hpes6t6g2,
		 89hpes24t6g2, 89hpes16t7, 89hpes32t8, 89hpes32t8g2,
		 89hpes48t12, 89hpes48t12g2.
  - reg :	 I2C address of the IDT 89HPESx device.

Optionally there can be EEPROM-compatible subnode:
  - compatible:  There are five EEPROM devices supported: 24c32, 24c64, 24c128,
		 24c256 and 24c512 differed by size.
  - reg:         Custom address of EEPROM device (If not specified IDT 89HPESx
    (optional)	 device will try to communicate with EEPROM sited by default
		 address - 0x50)
  - read-only :	 Parameterless property disables writes to the EEPROM
    (optional)

Example:
	idt@60 {
		compatible = "idt,89hpes32nt8ag2";
		reg = <0x74>;
		#address-cells = <1>;
		#size-cells = <0>;

		eeprom@50 {
			compatible = "onsemi,24c64";
			reg = <0x50>;
			read-only;
		};
	};
```
