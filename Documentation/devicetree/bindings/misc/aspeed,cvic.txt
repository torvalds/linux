## Documentation/devicetree/bindings/misc/ifm-csi.txt
```
IFM camera sensor interface on mpc5200 LocalPlus bus

Required properties:
- compatible: "ifm,o2d-csi"
- reg: specifies sensor chip select number and associated address range
- interrupts: external interrupt line number and interrupt sense mode
  of the interrupt line signaling frame valid events
- gpios: three gpio-specifiers for "capture", "reset" and "master enable"
  GPIOs (strictly in this order).
- ifm,csi-clk-handle: the phandle to a node in the DT describing the sensor
  clock generator. This node is usually a general purpose timer controller.
- ifm,csi-addr-bus-width: address bus width (valid values are 16, 24, 25)
- ifm,csi-data-bus-width: data bus width (valid values are 8 and 16)
- ifm,csi-wait-cycles: sensor bus wait cycles

Optional properties:
- ifm,csi-byte-swap: if this property is present, the byte swapping on
  the bus will be enabled.

Example:

	csi@3,0 {
		compatible = "ifm,o2d-csi";
		reg = <3 0 0x00100000>;		/* CS 3, 1 MiB range */
		interrupts = <1 1 2>;		/* IRQ1, edge falling */

		ifm,csi-clk-handle = <&timer7>;
		gpios = <&gpio_simple 23 0	/* image_capture */
			 &gpio_simple 26 0	/* image_reset */
			 &gpio_simple 29 0>;	/* image_master_en */

		ifm,csi-addr-bus-width = <24>;
		ifm,csi-data-bus-width = <8>;
		ifm,csi-wait-cycles = <0>;
	};

The base address of the used chip select is specified in the
ranges property of the parent localbus node, for example:

	ranges = <0 0 0xff000000 0x01000000
		  3 0 0xe3000000 0x00100000>;
```

## Documentation/devicetree/bindings/misc/intel,ixp4xx-ahb-queue-manager.yaml
```yaml
# SPDX-License-Identifier: (GPL-2.0 OR BSD-2-Clause)
# Copyright 2019 Linaro Ltd.
%YAML 1.2
---
$id: http://devicetree.org/schemas/misc/intel,ixp4xx-ahb-queue-manager.yaml#
$schema: http://devicetree.org/meta-schemas/core.yaml#

title: Intel IXP4xx AHB Queue Manager

maintainers:
  - Linus Walleij <linus.walleij@linaro.org>

description: |
  The IXP4xx AHB Queue Manager maintains queues as circular buffers in
  an 8KB embedded SRAM along with hardware pointers. It is used by both
  the XScale processor and the NPEs (Network Processing Units) in the
  IXP4xx for accelerating queues, especially for networking. Clients pick
  queues from the queue manager with foo-queue = <&qmgr N> where the
  &qmgr is a phandle to the queue manager and N is the queue resource
  number. The queue resources available and their specific purpose
  on a certain IXP4xx system will vary.

properties:
  compatible:
    items:
      - const: intel,ixp4xx-ahb-queue-manager

  reg:
    maxItems: 1

  interrupts:
    items:
      - description: Interrupt for queues 0-31
      - description: Interrupt for queues 32-63

required:
  - compatible
  - reg
  - interrupts

additionalProperties: false

examples:
  - |
    #include <dt-bindings/interrupt-controller/irq.h>

    qmgr: queue-manager@60000000 {
         compatible = "intel,ixp4xx-ahb-queue-manager";
         reg = <0x60000000 0x4000>;
         interrupts = <3 IRQ_TYPE_LEVEL_HIGH>, <4 IRQ_TYPE_LEVEL_HIGH>;
    };
```

## Documentation/devicetree/bindings/misc/lwn,bk4-spi.yaml
```yaml
# SPDX-License-Identifier: (GPL-2.0-only OR BSD-2-Clause)
%YAML 1.2
---
$id: http://devicetree.org/schemas/misc/lwn,bk4-spi.yaml#
$schema: http://devicetree.org/meta-schemas/core.yaml#

title: Liebherr's BK4 external SPI controller

maintainers:
  - Lukasz Majewski <lukma@denx.de>

description: |
  Liebherr's BK4 external SPI controller is a device which handles data
  acquisition from compatible industrial peripherals.
  The SPI is used for data and management purposes in both master and
  slave modes.

allOf:
  - $ref: /schemas/spi/spi-peripheral-props.yaml#

properties:
  compatible:
    const: lwn,bk4-spi

  reg:
    maxItems: 1

  spi-max-frequency:
    maximum: 30000000

  fsl,spi-cs-sck-delay: true

  fsl,spi-sck-cs-delay: true

required:
  - compatible
  - spi-max-frequency

additionalProperties: false

examples:
  - |
    spi {
        #address-cells = <1>;
        #size-cells = <0>;

        spidev@0 {
            compatible = "lwn,bk4-spi";
            reg = <0>;
            spi-max-frequency = <30000000>;
            fsl,spi-cs-sck-delay = <200>;
            fsl,spi-sck-cs-delay = <400>;
        };
    };
```

## Documentation/devicetree/bindings/misc/lwn-bk4.txt
```
* Liebherr's BK4 controller external SPI

A device which handles data acquisition from compatible industrial
peripherals.
The SPI is used for data and management purposes in both master and
slave modes.

Required properties:

- compatible : Should be "lwn,bk4"

Required SPI properties:

- reg : Should be address of the device chip select within
  the controller.

- spi-max-frequency : Maximum SPI clocking speed of device in Hz, should be
  30MHz at most for the Liebherr's BK4 external bus.

Example:

spidev0: spi@0 {
	compatible = "lwn,bk4";
	spi-max-frequency = <30000000>;
	reg = <0>;
};
```

## Documentation/devicetree/bindings/misc/memory-state-time.txt
```
Memory bandwidth and frequency state tracking

Required properties:
- compatible : should be:
       "memory-state-time"
- freq-tbl: Should contain entries with each frequency in Hz.
- bw-buckets: Should contain upper-bound limits for each bandwidth bucket in Mbps.
       Must match the framework power_profile.xml for the device.
```

## Documentation/devicetree/bindings/misc/mstar,l3bridge.yaml
```yaml
# SPDX-License-Identifier: (GPL-2.0 OR BSD-2-Clause)
# Copyright 2020 thingy.jp.
%YAML 1.2
---
$id: "http://devicetree.org/schemas/misc/mstar,l3bridge.yaml#"
$schema: "http://devicetree.org/meta-schemas/core.yaml#"

title: MStar/SigmaStar Armv7 SoC l3bridge

maintainers:
  - Daniel Palmer <daniel@thingy.jp>

description: |
  MStar/SigmaStar's Armv7 SoCs have a pipeline in the interface
  between the CPU and memory. This means that before DMA capable
  devices are allowed to run the pipeline must be flushed to ensure
  everything is in memory.

  The l3bridge region contains registers that allow such a flush
  to be triggered.

  This node is used by the platform code to find where the registers
  are and install a barrier that triggers the required pipeline flush.

properties:
  compatible:
    items:
      - const: mstar,l3bridge

  reg:
    maxItems: 1

required:
  - compatible
  - reg

additionalProperties: false

examples:
  - |
    l3bridge: l3bridge@1f204400 {
        compatible = "mstar,l3bridge";
        reg = <0x1f204400 0x200>;
    };
```

## Documentation/devicetree/bindings/misc/nvidia,tegra186-misc.txt
```
NVIDIA Tegra186 MISC register block

The MISC register block found on Tegra186 SoCs contains registers that can be
used to identify a given chip and various strapping options.

Required properties:
- compatible: Must be:
  - Tegra186: "nvidia,tegra186-misc"
- reg: Should contain 2 entries: The first entry gives the physical address
       and length of the register region which contains revision and debug
       features. The second entry specifies the physical address and length
       of the register region indicating the strapping options.
```

## Documentation/devicetree/bindings/misc/nvidia,tegra186-misc.yaml
```yaml
# SPDX-License-Identifier: (GPL-2.0-only OR BSD-2-Clause)
%YAML 1.2
---
$id: http://devicetree.org/schemas/misc/nvidia,tegra186-misc.yaml#
$schema: http://devicetree.org/meta-schemas/core.yaml#

title: NVIDIA Tegra186 (and later) MISC register block

maintainers:
  - Thierry Reding <thierry.reding@gmail.com>
  - Jon Hunter <jonathanh@nvidia.com>

description: The MISC register block found on Tegra186 and later SoCs contains
  registers that can be used to identify a given chip and various strapping
  options.

properties:
  compatible:
    enum:
      - nvidia,tegra186-misc
      - nvidia,tegra194-misc
      - nvidia,tegra234-misc

  reg:
    items:
      - description: physical address and length of the registers which
          contain revision and debug features
      - description: physical address and length of the registers which
          indicate strapping options

additionalProperties: false

required:
  - compatible
  - reg

examples:
  - |
    misc@100000 {
        compatible = "nvidia,tegra186-misc";
        reg = <0x00100000 0xf000>,
              <0x0010f000 0x1000>;
    };
```
