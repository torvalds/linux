## Documentation/devicetree/bindings/leds/backlight/qcom-wled.yaml
```yaml
# SPDX-License-Identifier: (GPL-2.0 OR BSD-2-Clause)
%YAML 1.2
---
$id: http://devicetree.org/schemas/leds/backlight/qcom-wled.yaml#
$schema: http://devicetree.org/meta-schemas/core.yaml#

title: Qualcomm Technologies, Inc. WLED driver

maintainers:
  - Bjorn Andersson <andersson@kernel.org>
  - Kiran Gunda <quic_kgunda@quicinc.com>

description: |
  WLED (White Light Emitting Diode) driver is used for controlling display
  backlight that is part of PMIC on Qualcomm Technologies, Inc. reference
  platforms. The PMIC is connected to the host processor via SPMI bus.

properties:
  compatible:
    enum:
      - qcom,pm8941-wled
      - qcom,pmi8950-wled
      - qcom,pmi8994-wled
      - qcom,pmi8998-wled
      - qcom,pm660l-wled
      - qcom,pm6150l-wled
      - qcom,pm8150l-wled

  reg:
    minItems: 1
    maxItems: 2

  default-brightness:
    description: |
      brightness value on boot.

  label: true

  max-brightness:
    description: |
      Maximum brightness level.

  qcom,cs-out:
    description: |
      enable current sink output.
      This property is supported only for WLED3.
    type: boolean

  qcom,cabc:
    description: |
      enable content adaptive backlight control.
    type: boolean

  qcom,ext-gen:
    description: |
      use externally generated modulator signal to dim.
      This property is supported only for WLED3.
    type: boolean

  qcom,current-limit:
    description: |
      mA; per-string current limit.
      This property is supported only for WLED3.
    $ref: /schemas/types.yaml#/definitions/uint32
    default: 20
    minimum: 0
    maximum: 25

  qcom,current-limit-microamp:
    description: |
      uA; per-string current limit.
    default: 25
    minimum: 0
    maximum: 30000
    multipleOf: 25

  qcom,current-boost-limit:
    description: |
      mA; boost current limit.
    $ref: /schemas/types.yaml#/definitions/uint32

  qcom,switching-freq:
    description: |
      kHz; switching frequency.
    $ref: /schemas/types.yaml#/definitions/uint32
    enum: [ 600, 640, 685, 738, 800, 872, 960, 1066, 1200, 1371, 1600, 1920,
            2400, 3200, 4800, 9600 ]

  qcom,ovp:
    description: |
      V; Over-voltage protection limit.
      This property is supported only for WLED3.
    $ref: /schemas/types.yaml#/definitions/uint32
    enum: [ 27, 29, 32, 35 ]
    default: 29

  qcom,ovp-millivolt:
    description: |
      Over-voltage protection limit. This property is for WLED4 only.
    $ref: /schemas/types.yaml#/definitions/uint32
    enum: [ 18100, 19600, 29600, 31100 ]
    default: 29600

  qcom,num-strings:
    description: |
      number of led strings attached.
    $ref: /schemas/types.yaml#/definitions/uint32

  qcom,enabled-strings:
    description: |
      Array of the WLED strings numbered from 0 to 3. Each
      string of leds are operated individually. Specify the
      list of strings used by the device. Any combination of
      led strings can be used.
    $ref: /schemas/types.yaml#/definitions/uint32-array
    minItems: 1
    maxItems: 4

  qcom,external-pfet:
    description: |
      Specify if external PFET control for short circuit
      protection is used. This property is supported only
      for WLED4.
    type: boolean

  qcom,auto-string-detection:
    description: |
      Enables auto-detection of the WLED string configuration.
      This feature is not supported for WLED3.
    type: boolean

  interrupts:
    minItems: 1
    items:
      - description: over voltage protection interrupt.
      - description: short circuit interrupt.

  interrupt-names:
    minItems: 1
    items:
      - const: ovp
      - const: short

  qcom,modulator-sel:
    description: |
      Selects the modulator used for brightness modulation.
      Allowed values are,
           0 - Modulator A
           1 - Modulator B
      This property is applicable only to WLED5 peripheral.
    $ref: /schemas/types.yaml#/definitions/uint32
    enum: [ 0, 1 ]
    default: 0

  qcom,cabc-sel:
    description: |
      Selects the CABC pin signal used for brightness modulation.
      Allowed values are,
           0 - CABC disabled
           1 - CABC 1
           2 - CABC 2
           3 - External signal (e.g. LPG) is used for dimming
      This property is applicable only to WLED5 peripheral.
    $ref: /schemas/types.yaml#/definitions/uint32
    enum: [ 0, 1, 2, 3 ]

allOf:
  - if:
      properties:
        compatible:
          contains:
            const: qcom,pm8941-wled

    then:
      properties:
        reg:
          maxItems: 1

        qcom,current-boost-limit:
          enum: [ 105, 385, 525, 805, 980, 1260, 1400, 1680 ]
          default: 805

        qcom,switching-freq:
          default: 1600

        qcom,num-strings:
          enum: [ 1, 2, 3 ]

        interrupts:
          maxItems: 1

        interrupt-names:
          maxItems: 1

    else:
      properties:
        reg:
          minItems: 2

        qcom,current-boost-limit:
          enum: [ 105, 280, 450, 620, 970, 1150, 1300, 1500 ]
          default: 970

        qcom,switching-freq:
          default: 800

        qcom,num-strings:
          enum: [ 1, 2, 3, 4 ]

        interrupts:
          minItems: 2

        interrupt-names:
          minItems: 2
  - if:
      properties:
        compatible:
          contains:
            enum:
              - qcom,pm8150l-wled

    then:
      properties:
        default-brightness:
          minimum: 0
          maximum: 32767

        max-brightness:
          minimum: 0
          maximum: 32767

    else:
      properties:
        default-brightness:
          minimum: 0
          maximum: 4095

        max-brightness:
          minimum: 0
          maximum: 4095

required:
  - compatible
  - reg
  - label

additionalProperties: false

examples:
  - |
    backlight@d800 {
        compatible = "qcom,pm8941-wled";
        reg = <0xd800 0x100>;
        label = "backlight";

        qcom,cs-out;
        qcom,current-limit = <20>;
        qcom,current-boost-limit = <805>;
        qcom,switching-freq = <1600>;
        qcom,ovp = <29>;
        qcom,num-strings = <2>;
        qcom,enabled-strings = <0 1>;
     };
```

## Documentation/devicetree/bindings/leds/backlight/richtek,rt4831-backlight.yaml
```yaml
# SPDX-License-Identifier: (GPL-2.0-only OR BSD-2-Clause)
%YAML 1.2
---
$id: http://devicetree.org/schemas/leds/backlight/richtek,rt4831-backlight.yaml#
$schema: http://devicetree.org/meta-schemas/core.yaml#

title: Richtek RT4831 Backlight

maintainers:
  - ChiYuan Huang <cy_huang@richtek.com>

description: |
  RT4831 is a mutifunctional device that can provide power to the LCD display
  and LCD backlight.

  For the LCD backlight, it can provide four channel WLED driving capability.
  Each channel driving current is up to 30mA

  Datasheet is available at
  https://www.richtek.com/assets/product_file/RT4831A/DS4831A-05.pdf

allOf:
  - $ref: common.yaml#

properties:
  compatible:
    const: richtek,rt4831-backlight

  default-brightness:
    minimum: 0
    maximum: 2048

  max-brightness:
    minimum: 0
    maximum: 2048

  richtek,pwm-enable:
    description: |
      Specify the backlight dimming following by PWM duty or by SW control.
    type: boolean

  richtek,bled-ovp-sel:
    description: |
      Backlight OVP level selection, currently support 17V/21V/25V/29V.
    $ref: /schemas/types.yaml#/definitions/uint8
    default: 1
    minimum: 0
    maximum: 3

  richtek,bled-ocp-microamp:
    description: |
      Backlight over current protection level.
    enum: [900000, 1200000, 1500000, 1800000]

  richtek,channel-use:
    description: |
      Backlight LED channel to be used.
      BIT 0/1/2/3 is used to indicate led channel 1/2/3/4 enable or disable.
    $ref: /schemas/types.yaml#/definitions/uint8
    minimum: 1
    maximum: 15

required:
  - compatible
  - richtek,channel-use

additionalProperties: false
```

## Documentation/devicetree/bindings/leds/backlight/silergy,sy7758.yaml
```yaml
# SPDX-License-Identifier: (GPL-2.0 OR BSD-2-Clause)
%YAML 1.2
---
$id: http://devicetree.org/schemas/leds/backlight/silergy,sy7758.yaml#
$schema: http://devicetree.org/meta-schemas/core.yaml#

title: Silergy SY7758 6-channel High Efficiency LED Driver

maintainers:
  - Neil Armstrong <neil.armstrong@linaro.org>

description:
  Silergy SY7758 is a high efficiency 6-channels LED backlight
  driver with I2C brightness control.

allOf:
  - $ref: common.yaml#

properties:
  compatible:
    const: silergy,sy7758

  reg:
    maxItems: 1

  vdd-supply: true

  enable-gpios:
    maxItems: 1

required:
  - compatible
  - reg
  - enable-gpios

unevaluatedProperties: false

examples:
  - |
    #include <dt-bindings/gpio/gpio.h>

    i2c {
        #address-cells = <1>;
        #size-cells = <0>;

        backlight@11 {
            compatible = "silergy,sy7758";
            reg = <0x11>;
            vdd-supply = <&bl_vdd>;
            enable-gpios = <&gpio 16 GPIO_ACTIVE_HIGH>;
        };
    };
```

## Documentation/devicetree/bindings/leds/backlight/sky81452-backlight.txt
```
SKY81452-backlight bindings

Required properties:
- compatible		: Must be "skyworks,sky81452-backlight"

Optional properties:
- name			: Name of backlight device. Default is 'lcd-backlight'.
- gpios			: GPIO to use to EN pin.
			See Documentation/devicetree/bindings/gpio/gpio.txt
- led-sources		: List of enabled channels from 0 to 5.
			See Documentation/devicetree/bindings/leds/common.txt
- skyworks,ignore-pwm	: Ignore both PWM input
- skyworks,dpwm-mode	: Enable DPWM dimming mode, otherwise Analog dimming.
- skyworks,phase-shift	: Enable phase shift mode
- skyworks,short-detection-threshold-volt
			: It should be one of 4, 5, 6 and 7V.
- skyworks,current-limit-mA
			: It should be 2300mA or 2750mA.

Example:

	backlight {
		compatible = "skyworks,sky81452-backlight";
		name = "pwm-backlight";
		led-sources = <0 1 2 5>;
		skyworks,ignore-pwm;
		skyworks,phase-shift;
		skyworks,current-limit-mA = <2300>;
	};
```

## Documentation/devicetree/bindings/leds/backlight/ti,lm3509.yaml
```yaml
# SPDX-License-Identifier: (GPL-2.0 OR BSD-2-Clause)
%YAML 1.2
---
$id: http://devicetree.org/schemas/leds/backlight/ti,lm3509.yaml#
$schema: http://devicetree.org/meta-schemas/core.yaml#

title: TI LM3509 High Efficiency Boost for White LED's and/or OLED Displays

maintainers:
  - Patrick Gansterer <paroga@paroga.com>

description:
  The LM3509 current mode boost converter offers two separate outputs.
  https://www.ti.com/product/LM3509

properties:
  compatible:
    const: ti,lm3509

  reg:
    maxItems: 1

  "#address-cells":
    const: 1

  "#size-cells":
    const: 0

  reset-gpios:
    maxItems: 1

  ti,brightness-rate-of-change-us:
    description: Brightness Rate of Change in microseconds.
    enum: [51, 13000, 26000, 52000]

  ti,oled-mode:
    description: Enable OLED mode.
    type: boolean

patternProperties:
  "^led@[01]$":
    type: object
    description: Properties for a string of connected LEDs.
    $ref: common.yaml#

    properties:
      reg:
        description:
          The control register that is used to program the two current sinks.
          The LM3509 has two registers (BMAIN and BSUB) and are represented
          as 0 or 1 in this property. The two current sinks can be controlled
          independently with both registers, or register BMAIN can be
          configured to control both sinks with the led-sources property.
        minimum: 0
        maximum: 1

      label: true

      led-sources:
        minItems: 1
        maxItems: 2
        items:
          minimum: 0
          maximum: 1

      default-brightness:
        minimum: 0
        maximum: 31
        default: 18

      max-brightness:
        minimum: 0
        maximum: 31
        default: 31

    required:
      - reg

    additionalProperties: false

required:
  - compatible
  - reg

additionalProperties: false

examples:
  - |
    #include <dt-bindings/gpio/gpio.h>
    i2c {
        #address-cells = <1>;
        #size-cells = <0>;

        backlight@36 {
            compatible = "ti,lm3509";
            reg = <0x36>;
            reset-gpios = <&gpio2 5 GPIO_ACTIVE_LOW>;

            ti,oled-mode;
            ti,brightness-rate-of-change-us = <52000>;

            #address-cells = <1>;
            #size-cells = <0>;

            led@0 {
                reg = <0>;
                led-sources = <0 1>;
                label = "lcd-backlight";
                default-brightness = <12>;
                max-brightness = <31>;
            };
        };
    };
  - |
    i2c {
        #address-cells = <1>;
        #size-cells = <0>;

        backlight@36 {
            compatible = "ti,lm3509";
            reg = <0x36>;

            #address-cells = <1>;
            #size-cells = <0>;

            led@0 {
                reg = <0>;
                default-brightness = <12>;
            };

            led@1 {
                reg = <1>;
                default-brightness = <15>;
            };
        };
    };
```

## Documentation/devicetree/bindings/leds/backlight/ti,lp8864.yaml
```yaml
# SPDX-License-Identifier: (GPL-2.0 OR BSD-2-Clause)
%YAML 1.2
---
$id: http://devicetree.org/schemas/leds/backlight/ti,lp8864.yaml#
$schema: http://devicetree.org/meta-schemas/core.yaml#

title: Texas Instruments - LP8864/LP8866 4/6-Channel LED Driver family

maintainers:
  - Andrew Davis <afd@ti.com>
  - Alexander Sverdlin <alexander.sverdlin@siemens.com>

description: |
  LP8866-Q1, LP8866S-Q1, LP8864-Q1, LP8864S-Q1 are display LED-backlight drivers
  with 4/6 channels. LED brightness can be controlled globally through the I2C
  interface or PWM input.

  For more product information please see the links below:
    https://www.ti.com/product/LP8864-Q1
    https://www.ti.com/product/LP8864S-Q1
    https://www.ti.com/product/LP8866-Q1
    https://www.ti.com/product/LP8866S-Q1

properties:
  compatible:
    const: ti,lp8864

  reg:
    maxItems: 1
    description: I2C slave address

  enable-gpios:
    maxItems: 1
    description: GPIO pin to enable (active high) / disable the device

  vled-supply:
    description: LED supply

  led:
    type: object
    $ref: common.yaml#
    properties:
      function: true
      color: true
      label: true
      linux,default-trigger: true

    additionalProperties: false

required:
  - compatible
  - reg
  - led

additionalProperties: false

examples:
  - |
    #include <dt-bindings/gpio/gpio.h>
    #include <dt-bindings/leds/common.h>

    i2c {
        #address-cells = <1>;
        #size-cells = <0>;

        led-controller@3a {
            compatible = "ti,lp8864";
            reg = <0x3a>;
            enable-gpios = <&gpio1 28 GPIO_ACTIVE_HIGH>;
            vled-supply = <&vbatt>;

            led {
                function = LED_FUNCTION_BACKLIGHT;
                color = <LED_COLOR_ID_WHITE>;
                linux,default-trigger = "backlight";
            };
        };
    };

...
```

## Documentation/devicetree/bindings/leds/backlight/tps65217-backlight.txt
```
TPS65217 family of regulators

The TPS65217 chip contains a boost converter and current sinks which can be
used to drive LEDs for use as backlights.

Required properties:
- compatible: "ti,tps65217"
- reg: I2C slave address
- backlight: node for specifying WLED1 and WLED2 lines in TPS65217
- isel: selection bit, valid values: 1 for ISEL1 (low-level) and 2 for ISEL2 (high-level)
- fdim: PWM dimming frequency, valid values: 100, 200, 500, 1000
- default-brightness: valid values: 0-100

Each regulator is defined using the standard binding for regulators.

Example:

	tps: tps@24 {
		reg = <0x24>;
		compatible = "ti,tps65217";
		backlight {
			isel = <1>;  /* 1 - ISET1, 2 ISET2 */
			fdim = <100>; /* TPS65217_BL_FDIM_100HZ */
			default-brightness = <50>;
		};
	};
```
