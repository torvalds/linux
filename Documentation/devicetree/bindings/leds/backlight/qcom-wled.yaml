## Documentation/devicetree/bindings/leds/irled/ir-spi-led.yaml
```yaml
# SPDX-License-Identifier: GPL-2.0-only OR BSD-2-Clause
%YAML 1.2
---
$id: http://devicetree.org/schemas/leds/irled/ir-spi-led.yaml#
$schema: http://devicetree.org/meta-schemas/core.yaml#

title: IR LED connected through SPI bus

maintainers:
  - Sean Young <sean@mess.org>

description:
  IR LED switch is connected to the MOSI line of the SPI device and the data
  is delivered through that.

allOf:
  - $ref: /schemas/spi/spi-peripheral-props.yaml#

properties:
  compatible:
    const: ir-spi-led

  reg:
    maxItems: 1

  duty-cycle:
    $ref: /schemas/types.yaml#/definitions/uint8
    enum: [50, 60, 70, 75, 80, 90]
    description:
      Percentage of one period in which the signal is active.

  led-active-low:
    type: boolean
    description:
      Output is negated with a NOT gate.

  power-supply: true

required:
  - compatible
  - reg

unevaluatedProperties: false

examples:
  - |
    spi {
        #address-cells = <1>;
        #size-cells = <0>;

        irled@0 {
            compatible = "ir-spi-led";
            reg = <0x0>;

            duty-cycle = /bits/ 8 <60>;
            led-active-low;
            power-supply = <&irda_regulator>;
            spi-max-frequency = <5000000>;
        };
    };
```

## Documentation/devicetree/bindings/leds/irled/pwm-ir-tx.txt
```
Device tree bindings for IR LED connected through pwm pin which is used as
remote controller transmitter.

Required properties:
	- compatible: should be "pwm-ir-tx".
	- pwms : PWM property to point to the PWM device (phandle)/port (id)
	  and to specify the period time to be used: <&phandle id period_ns>;

Example:
	irled {
		compatible = "pwm-ir-tx";
		pwms = <&pwm0 0 10000000>;
	};
```

## Documentation/devicetree/bindings/leds/irled/pwm-ir-tx.yaml
```yaml
# SPDX-License-Identifier: GPL-2.0-only OR BSD-2-Clause
%YAML 1.2
---
$id: http://devicetree.org/schemas/leds/irled/pwm-ir-tx.yaml#
$schema: http://devicetree.org/meta-schemas/core.yaml#

title: IR LED connected through PWM pin

maintainers:
  - Sean Young <sean@mess.org>

description:
  IR LED connected through PWM pin which is used as remote controller
  transmitter.

properties:
  compatible:
    const: pwm-ir-tx

  pwms:
    maxItems: 1

required:
  - compatible
  - pwms

additionalProperties: false

examples:
  - |
    irled {
        compatible = "pwm-ir-tx";
        pwms = <&pwm0 0 10000000>;
    };
```

## Documentation/devicetree/bindings/leds/irled/spi-ir-led.txt
```
Device tree bindings for IR LED connected through SPI bus which is used as
remote controller.

The IR LED switch is connected to the MOSI line of the SPI device and the data
are delivered thourgh that.

Required properties:
	- compatible: should be "ir-spi-led".

Optional properties:
	- duty-cycle: 8 bit value that represents the percentage of one period
	  in which the signal is active.  It can be 50, 60, 70, 75, 80 or 90.
	- led-active-low: boolean value that specifies whether the output is
	  negated with a NOT gate.
	- power-supply: specifies the power source. It can either be a regulator
	  or a gpio which enables a regulator, i.e. a regulator-fixed as
	  described in
	  Documentation/devicetree/bindings/regulator/fixed-regulator.yaml

Example:

	irled@0 {
		compatible = "ir-spi-led";
		reg = <0x0>;
		spi-max-frequency = <5000000>;
		power-supply = <&vdd_led>;
		led-active-low;
		duty-cycle = /bits/ 8 <60>;
	};
```

## Documentation/devicetree/bindings/leds/issi,is31fl319x.yaml
```yaml
# SPDX-License-Identifier: (GPL-2.0-only OR BSD-2-Clause)
%YAML 1.2
---
$id: http://devicetree.org/schemas/leds/issi,is31fl319x.yaml#
$schema: http://devicetree.org/meta-schemas/core.yaml#

title: ISSI LED Controllers for IS31FL319{0,1,3,6,9}

maintainers:
  - Vincent Knecht <vincent.knecht@mailoo.org>

description: |
  The IS31FL319X are LED controllers with I2C interface.
  Previously known as Si-En SN319{0,1,3,6,9}.

  For more product information please see the links below:
    https://lumissil.com/assets/pdf/core/IS31FL3190_DS.pdf
    https://lumissil.com/assets/pdf/core/IS31FL3191_DS.pdf
    https://lumissil.com/assets/pdf/core/IS31FL3193_DS.pdf
    https://lumissil.com/assets/pdf/core/IS31FL3196_DS.pdf
    https://lumissil.com/assets/pdf/core/IS31FL3199_DS.pdf

properties:
  compatible:
    enum:
      - issi,is31fl3190
      - issi,is31fl3191
      - issi,is31fl3193
      - issi,is31fl3196
      - issi,is31fl3199
      - si-en,sn3190
      - si-en,sn3191
      - si-en,sn3193
      - si-en,sn3196
      - si-en,sn3199

  reg:
    maxItems: 1

  shutdown-gpios:
    maxItems: 1
    description: GPIO attached to the SDB pin.

  audio-gain-db:
    $ref: /schemas/types.yaml#/definitions/uint32
    default: 0
    description: Audio gain selection for external analog modulation input.
    enum: [0, 3, 6, 9, 12, 15, 18, 21]

  "#address-cells":
    const: 1

  "#size-cells":
    const: 0

patternProperties:
  "^led@[1-9]$":
    type: object
    $ref: common.yaml#
    unevaluatedProperties: false

    properties:
      reg:
        description: Index of the LED.
        minimum: 1
        maximum: 9

      led-max-microamp:
        description:
          Note that a driver will take the lowest of all LED limits
          since the chip has a single global setting. The lowest value
          will be chosen due to the PWM specificity, where lower
          brightness is achieved by reducing the duty-cycle of pulses
          and not the current, which will always have its peak value
          equal to led-max-microamp.

allOf:
  - if:
      properties:
        compatible:
          contains:
            enum:
              - issi,is31fl3190
              - issi,is31fl3191
              - issi,is31fl3193
              - si-en,sn3190
              - si-en,sn3191
              - si-en,sn3193
    then:
      properties:
        reg:
          enum: [0x68, 0x69, 0x6a, 0x6b]

        audio-gain-db: false

      patternProperties:
        "^led@[1-9]$":
          properties:
            led-max-microamp:
              default: 42000
              enum: [5000, 10000, 17500, 30000, 42000]
    else:
      properties:
        reg:
          enum: [0x64, 0x65, 0x66, 0x67]

      patternProperties:
        "^led@[1-9]$":
          properties:
            led-max-microamp:
              default: 20000
              enum: [5000, 10000, 15000, 20000, 25000, 30000, 35000, 40000]
  - if:
      properties:
        compatible:
          contains:
            enum:
              - issi,is31fl3190
              - issi,is31fl3191
              - si-en,sn3190
              - si-en,sn3191
    then:
      patternProperties:
        "^led@[1-9]$":
          properties:
            reg:
              maximum: 1
  - if:
      properties:
        compatible:
          contains:
            enum:
              - issi,is31fl3193
              - si-en,sn3193
    then:
      patternProperties:
        "^led@[1-9]$":
          properties:
            reg:
              maximum: 3
  - if:
      properties:
        compatible:
          contains:
            enum:
              - issi,is31fl3196
              - si-en,sn3196
    then:
      patternProperties:
        "^led@[1-9]$":
          properties:
            reg:
              maximum: 6

required:
  - compatible
  - reg
  - "#address-cells"
  - "#size-cells"

additionalProperties: false

examples:
  - |
    #include <dt-bindings/gpio/gpio.h>
    #include <dt-bindings/leds/common.h>

    i2c {
        #address-cells = <1>;
        #size-cells = <0>;

        led-controller@65 {
            compatible = "issi,is31fl3196";
            reg = <0x65>;
            #address-cells = <1>;
            #size-cells = <0>;

            shutdown-gpios = <&gpio0 11 GPIO_ACTIVE_HIGH>;

            led@1 {
                reg = <1>;
                label = "red:aux";
                led-max-microamp = <10000>;
            };

            led@5 {
                reg = <5>;
                label = "green:power";
                linux,default-trigger = "default-on";
            };
        };
    };
...
```

## Documentation/devicetree/bindings/leds/kinetic,ktd202x.yaml
```yaml
# SPDX-License-Identifier: (GPL-2.0-only OR BSD-2-Clause)
%YAML 1.2
---
$id: http://devicetree.org/schemas/leds/kinetic,ktd202x.yaml#
$schema: http://devicetree.org/meta-schemas/core.yaml#

title: Kinetic KTD2026/7 RGB/White LED Driver

maintainers:
  - André Apitzsch <git@apitzsch.eu>

description: |
  The KTD2026/7 is a RGB/White LED driver with I2C interface.

  The data sheet can be found at:
    https://www.kinet-ic.com/uploads/KTD2026-7-04h.pdf

properties:
  compatible:
    enum:
      - kinetic,ktd2026
      - kinetic,ktd2027

  reg:
    maxItems: 1

  vin-supply:
    description: Regulator providing power to the "VIN" pin.

  vio-supply:
    description: Regulator providing power for pull-up of the I/O lines.
      Note that this regulator does not directly connect to KTD2026, but is
      needed for the correct operation of the status ("ST") and I2C lines.

  "#address-cells":
    const: 1

  "#size-cells":
    const: 0

  multi-led:
    type: object
    $ref: leds-class-multicolor.yaml#
    unevaluatedProperties: false

    properties:
      "#address-cells":
        const: 1

      "#size-cells":
        const: 0

    patternProperties:
      "^led@[0-3]$":
        type: object
        $ref: common.yaml#
        unevaluatedProperties: false

        properties:
          reg:
            description: Index of the LED.
            minimum: 0
            maximum: 3

        required:
          - reg
          - color

    required:
      - "#address-cells"
      - "#size-cells"

patternProperties:
  "^led@[0-3]$":
    type: object
    $ref: common.yaml#
    unevaluatedProperties: false

    properties:
      reg:
        description: Index of the LED.
        minimum: 0
        maximum: 3

    required:
      - reg

required:
  - compatible
  - reg
  - "#address-cells"
  - "#size-cells"

additionalProperties: false

examples:
  - |
    #include <dt-bindings/leds/common.h>

    i2c {
        #address-cells = <1>;
        #size-cells = <0>;

        led-controller@30 {
            compatible = "kinetic,ktd2026";
            reg = <0x30>;
            #address-cells = <1>;
            #size-cells = <0>;

            vin-supply = <&pm8916_l17>;
            vio-supply = <&pm8916_l6>;

            led@0 {
                reg = <0>;
                function = LED_FUNCTION_STATUS;
                color = <LED_COLOR_ID_RED>;
            };

            led@1 {
                reg = <1>;
                function = LED_FUNCTION_STATUS;
                color = <LED_COLOR_ID_GREEN>;
            };

            led@2 {
                reg = <2>;
                function = LED_FUNCTION_STATUS;
                color = <LED_COLOR_ID_BLUE>;
            };
        };
    };
  - |
    #include <dt-bindings/leds/common.h>

    i2c {
        #address-cells = <1>;
        #size-cells = <0>;

        led-controller@30 {
            compatible = "kinetic,ktd2026";
            reg = <0x30>;
            #address-cells = <1>;
            #size-cells = <0>;

            vin-supply = <&pm8916_l17>;
            vio-supply = <&pm8916_l6>;

            multi-led {
                color = <LED_COLOR_ID_RGB>;
                function = LED_FUNCTION_STATUS;

                #address-cells = <1>;
                #size-cells = <0>;

                led@0 {
                    reg = <0>;
                    color = <LED_COLOR_ID_RED>;
                };

                led@1 {
                    reg = <1>;
                    color = <LED_COLOR_ID_GREEN>;
                };

                led@2 {
                    reg = <2>;
                    color = <LED_COLOR_ID_BLUE>;
                };
            };
        };
    };
```

## Documentation/devicetree/bindings/leds/kinetic,ktd2692.yaml
```yaml
# SPDX-License-Identifier: (GPL-2.0-only OR BSD-2-Clause)
%YAML 1.2
---
$id: http://devicetree.org/schemas/leds/kinetic,ktd2692.yaml#
$schema: http://devicetree.org/meta-schemas/core.yaml#

title: KTD2692 Flash LED Driver from Kinetic Technologies

maintainers:
  - Markuss Broks <markuss.broks@gmail.com>

description: |
  KTD2692 is the ideal power solution for high-power flash LEDs.
  It uses ExpressWire single-wire programming for maximum flexibility.

  The ExpressWire interface through CTRL pin can control LED on/off and
  enable/disable the IC, Movie(max 1/3 of Flash current) / Flash mode current,
  Flash timeout, LVP(low voltage protection).

  Also, When the AUX pin is pulled high while CTRL pin is high,
  LED current will be ramped up to the flash-mode current level.

properties:
  compatible:
    const: kinetic,ktd2692

  ctrl-gpios:
    maxItems: 1
    description: Specifier of the GPIO connected to CTRL pin.

  aux-gpios:
    maxItems: 1
    description: Specifier of the GPIO connected to CTRL pin.

  vin-supply:
    description: LED supply (2.7V to 5.5V).

  led:
    type: object
    $ref: common.yaml#
    description: Properties for the LED.
    properties:
      function: true
      color: true
      flash-max-timeout-us:
        description: Flash LED maximum timeout.

      led-max-microamp:
        maximum: 300000
        description: Minimum Threshold for Timer protection
          is defined internally (Maximum 300mA).

      flash-max-microamp:
        maximum: 300000
        description: Flash LED maximum current
          Formula - I(uA) = 15000000 / Rset.

    additionalProperties: false

required:
  - compatible
  - ctrl-gpios
  - led

additionalProperties: false

examples:
  - |
    #include <dt-bindings/gpio/gpio.h>
    #include <dt-bindings/leds/common.h>

    ktd2692 {
      compatible = "kinetic,ktd2692";
      ctrl-gpios = <&gpc0 1 0>;
      aux-gpios = <&gpc0 2 0>;
      vin-supply = <&vbat>;

      led {
        function = LED_FUNCTION_FLASH;
        color = <LED_COLOR_ID_WHITE>;
        flash-max-timeout-us = <250000>;
        flash-max-microamp = <150000>;
        led-max-microamp = <25000>;
      };
    };

...
```
