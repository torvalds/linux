## Documentation/devicetree/bindings/leds/backlight/pwm-backlight.yaml
```yaml
# SPDX-License-Identifier: GPL-2.0-only
%YAML 1.2
---
$id: http://devicetree.org/schemas/leds/backlight/pwm-backlight.yaml#
$schema: http://devicetree.org/meta-schemas/core.yaml#

title: pwm-backlight

maintainers:
  - Lee Jones <lee@kernel.org>
  - Daniel Thompson <daniel.thompson@linaro.org>
  - Jingoo Han <jingoohan1@gmail.com>

properties:
  compatible:
    const: pwm-backlight

  pwms:
    maxItems: 1

  pwm-names: true

  power-supply:
    description: regulator for supply voltage

  enable-gpios:
    description:
      Contains a single GPIO specifier for the GPIO which enables and disables
      the backlight.
    maxItems: 1

  post-pwm-on-delay-ms:
    description:
      Delay in ms between setting an initial (non-zero) PWM and enabling the
      backlight using GPIO.

  pwm-off-delay-ms:
    description:
      Delay in ms between disabling the backlight using GPIO and setting PWM
      value to 0.

  brightness-levels:
    description:
      Array of distinct brightness levels. Typically these are in the range
      from 0 to 255, but any range starting at 0 will do. The actual brightness
      level (PWM duty cycle) will be interpolated from these values. 0 means a
      0% duty cycle (darkest/off), while the last value in the array represents
      a 100% duty cycle (brightest).
    $ref: /schemas/types.yaml#/definitions/uint32-array

  default-brightness-level:
    description:
      The default brightness level (index into the array defined by the
      "brightness-levels" property).
    $ref: /schemas/types.yaml#/definitions/uint32

  num-interpolated-steps:
    description:
      Number of interpolated steps between each value of brightness-levels
      table. This way a high resolution pwm duty cycle can be used without
      having to list out every possible value in the brightness-level array.
    $ref: /schemas/types.yaml#/definitions/uint32

dependencies:
  default-brightness-level: [brightness-levels]
  num-interpolated-steps: [brightness-levels]

required:
  - compatible
  - pwms
  - power-supply

additionalProperties: false

examples:
  - |
    backlight {
        compatible = "pwm-backlight";
        pwms = <&pwm 0 5000000>;

        brightness-levels = <0 4 8 16 32 64 128 255>;
        default-brightness-level = <6>;

        power-supply = <&vdd_bl_reg>;
        enable-gpios = <&gpio 58 0>;
        post-pwm-on-delay-ms = <10>;
        pwm-off-delay-ms = <10>;
    };

  - |
    // Example using num-interpolation-steps:
    backlight {
        compatible = "pwm-backlight";
        pwms = <&pwm 0 5000000>;

        brightness-levels = <0 2048 4096 8192 16384 65535>;
        num-interpolated-steps = <2048>;
        default-brightness-level = <4096>;

        power-supply = <&vdd_bl_reg>;
        enable-gpios = <&gpio 58 0>;
    };

...
```

## Documentation/devicetree/bindings/leds/backlight/qcom-wled.txt
```
Binding for Qualcomm Technologies, Inc. WLED driver

WLED (White Light Emitting Diode) driver is used for controlling display
backlight that is part of PMIC on Qualcomm Technologies, Inc. reference
platforms. The PMIC is connected to the host processor via SPMI bus.

- compatible
	Usage:        required
	Value type:   <string>
	Definition:   should be one of:
			"qcom,pm8941-wled"
			"qcom,pmi8998-wled"
			"qcom,pm660l-wled"

- reg
	Usage:        required
	Value type:   <prop encoded array>
	Definition:   Base address of the WLED modules.

- default-brightness
	Usage:        optional
	Value type:   <u32>
	Definition:   brightness value on boot, value from: 0-4095.
		      Default: 2048

- label
	Usage:        required
	Value type:   <string>
	Definition:   The name of the backlight device

- qcom,cs-out
	Usage:        optional
	Value type:   <bool>
	Definition:   enable current sink output.
		      This property is supported only for PM8941.

- qcom,cabc
	Usage:        optional
	Value type:   <bool>
	Definition:   enable content adaptive backlight control.

- qcom,ext-gen
	Usage:        optional
	Value type:   <bool>
	Definition:   use externally generated modulator signal to dim.
		      This property is supported only for PM8941.

- qcom,current-limit
	Usage:        optional
	Value type:   <u32>
	Definition:   mA; per-string current limit; value from 0 to 25 with
		      1 mA step. Default 20 mA.
		      This property is supported only for pm8941.

- qcom,current-limit-microamp
	Usage:        optional
	Value type:   <u32>
	Definition:   uA; per-string current limit; value from 0 to 30000 with
		      2500 uA step. Default 25 mA.

- qcom,current-boost-limit
	Usage:        optional
	Value type:   <u32>
	Definition:   mA; boost current limit.
		      For pm8941: one of: 105, 385, 525, 805, 980, 1260, 1400,
		      1680. Default: 805 mA.
		      For pmi8998: one of: 105, 280, 450, 620, 970, 1150, 1300,
		      1500. Default: 970 mA.

- qcom,switching-freq
	Usage:        optional
	Value type:   <u32>
	 Definition:   kHz; switching frequency; one of: 600, 640, 685, 738,
		       800, 872, 960, 1066, 1200, 1371, 1600, 1920, 2400, 3200,
		       4800, 9600.
		       Default: for pm8941: 1600 kHz
				for pmi8998: 800 kHz

- qcom,ovp
	Usage:        optional
	Value type:   <u32>
	Definition:   V; Over-voltage protection limit; one of:
		      27, 29, 32, 35. Default: 29V
		      This property is supported only for PM8941.

- qcom,ovp-millivolt
	Usage:        optional
	Value type:   <u32>
	Definition:   mV; Over-voltage protection limit;
		      For pmi8998: one of 18100, 19600, 29600, 31100.
		      Default 29600 mV.
		      If this property is not specified for PM8941, it
		      falls back to "qcom,ovp" property.

- qcom,num-strings
	Usage:        optional
	Value type:   <u32>
	Definition:   #; number of led strings attached;
		      value: For PM8941 from 1 to 3. Default: 2
			     For PMI8998 from 1 to 4.

- interrupts
	Usage:        optional
	Value type:   <prop encoded array>
	Definition:   Interrupts associated with WLED. This should be
		      "short" and "ovp" interrupts. Interrupts can be
		      specified as per the encoding listed under
		      Documentation/devicetree/bindings/spmi/
		      qcom,spmi-pmic-arb.txt.

- interrupt-names
	Usage:        optional
	Value type:   <string>
	Definition:   Interrupt names associated with the interrupts.
		      Must be "short" and "ovp". The short circuit detection
		      is not supported for PM8941.

- qcom,enabled-strings
	Usage:        optional
	Value tyoe:   <u32 array>
	Definition:   Array of the WLED strings numbered from 0 to 3. Each
		      string of leds are operated individually. Specify the
		      list of strings used by the device. Any combination of
		      led strings can be used.

- qcom,external-pfet
	Usage:        optional
	Value type:   <bool>
	Definition:   Specify if external PFET control for short circuit
		      protection is used. This property is supported only
		      for PMI8998.

- qcom,auto-string-detection
	Usage:        optional
	Value type:   <bool>
	Definition:   Enables auto-detection of the WLED string configuration.
		      This feature is not supported for PM8941.


Example:

pm8941-wled@d800 {
	compatible = "qcom,pm8941-wled";
	reg = <0xd800>;
	label = "backlight";

	qcom,cs-out;
	qcom,current-limit = <20>;
	qcom,current-boost-limit = <805>;
	qcom,switching-freq = <1600>;
	qcom,ovp = <29>;
	qcom,num-strings = <2>;
	qcom,enabled-strings = <0 1>;
};
```
