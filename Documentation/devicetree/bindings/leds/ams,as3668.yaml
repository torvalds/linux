## Documentation/devicetree/bindings/leds/backlight/common.yaml
```yaml
# SPDX-License-Identifier: (GPL-2.0-only OR BSD-2-Clause)
%YAML 1.2
---
$id: http://devicetree.org/schemas/leds/backlight/common.yaml#
$schema: http://devicetree.org/meta-schemas/core.yaml#

title: Common backlight properties

maintainers:
  - Lee Jones <lee@kernel.org>
  - Daniel Thompson <daniel.thompson@linaro.org>
  - Jingoo Han <jingoohan1@gmail.com>

description:
  Backlight devices provide backlight for different types of graphical
  displays. They are typically but not necessarily implemented using a white
  LED powered by a boost converter.

properties:
  default-brightness:
    description:
      The default brightness that should be applied to the LED by the operating
      system on start-up. The brightness should not exceed the brightness the
      LED can provide.
    $ref: /schemas/types.yaml#/definitions/uint32

  max-brightness:
    description:
      Normally the maximum brightness is determined by the hardware and this
      property is not required. This property is used to put a software limit
      on the brightness apart from what the driver says, as it could happen
      that a LED can be made so bright that it gets damaged or causes damage
      due to restrictions in a specific system, such as mounting conditions.
    $ref: /schemas/types.yaml#/definitions/uint32

  brightness-levels:
    description:
      Array of distinct brightness levels. The levels must be in the range
      accepted by the underlying LED device. Typically these are in the range
      from 0 to 255, but any range starting at 0 will do, as long as they are
      accepted by the LED.
      The 0 value means a 0% of brightness (darkest/off), while the last value
      in the array represents a full 100% brightness (brightest).
      If this array is not provided, the driver default mapping is used.
    $ref: /schemas/types.yaml#/definitions/uint32-array

  default-brightness-level:
    description:
      The default brightness level (index into the array defined by the
      "brightness-levels" property).
    $ref: /schemas/types.yaml#/definitions/uint32

additionalProperties: true
```

## Documentation/devicetree/bindings/leds/backlight/gpio-backlight.txt
```
gpio-backlight bindings

Required properties:
  - compatible: "gpio-backlight"
  - gpios: describes the gpio that is used for enabling/disabling the backlight.
    refer to bindings/gpio/gpio.txt for more details.

Optional properties:
  - default-on: enable the backlight at boot.

Example:
	backlight {
		compatible = "gpio-backlight";
		gpios = <&gpio3 4 GPIO_ACTIVE_HIGH>;
		default-on;
	};
```

## Documentation/devicetree/bindings/leds/backlight/gpio-backlight.yaml
```yaml
# SPDX-License-Identifier: GPL-2.0-only
%YAML 1.2
---
$id: http://devicetree.org/schemas/leds/backlight/gpio-backlight.yaml#
$schema: http://devicetree.org/meta-schemas/core.yaml#

title: gpio-backlight bindings

maintainers:
  - Lee Jones <lee@kernel.org>
  - Daniel Thompson <daniel.thompson@linaro.org>
  - Jingoo Han <jingoohan1@gmail.com>

properties:
  compatible:
    const: gpio-backlight

  gpios:
    description: The gpio that is used for enabling/disabling the backlight.
    maxItems: 1

  default-on:
    description: enable the backlight at boot.
    type: boolean

required:
  - compatible
  - gpios

additionalProperties: false

examples:
  - |
    #include <dt-bindings/gpio/gpio.h>
    backlight {
        compatible = "gpio-backlight";
        gpios = <&gpio3 4 GPIO_ACTIVE_HIGH>;
        default-on;
    };

...
```

## Documentation/devicetree/bindings/leds/backlight/kinetic,ktd253.yaml
```yaml
# SPDX-License-Identifier: (GPL-2.0 OR BSD-2-Clause)
%YAML 1.2
---
$id: http://devicetree.org/schemas/leds/backlight/kinetic,ktd253.yaml#
$schema: http://devicetree.org/meta-schemas/core.yaml#

title: Kinetic Technologies KTD253 one-wire backlight

maintainers:
  - Linus Walleij <linus.walleij@linaro.org>

description: |
  The Kinetic Technologies KTD253 is a white LED backlight that is
  controlled by a single GPIO line. If you just turn on the backlight
  it goes to maximum backlight then you can set the level of backlight
  using pulses on the enable wire. This is sometimes referred to as
  "expresswire".

allOf:
  - $ref: common.yaml#

properties:
  compatible:
    const: kinetic,ktd253

  enable-gpios:
    description: GPIO to use to enable/disable and dim the backlight.
    maxItems: 1

  default-brightness: true
  max-brightness: true

required:
  - compatible
  - enable-gpios

additionalProperties: false

examples:
  - |
    #include <dt-bindings/gpio/gpio.h>
    backlight {
        compatible = "kinetic,ktd253";
        enable-gpios = <&gpio2 5 GPIO_ACTIVE_HIGH>;
        default-brightness = <13>;
    };
```

## Documentation/devicetree/bindings/leds/backlight/kinetic,ktd2801.yaml
```yaml
# SPDX-License-Identifier: (GPL-2.0 OR BSD-2-Clause)
%YAML 1.2
---
$id: http://devicetree.org/schemas/leds/backlight/kinetic,ktd2801.yaml#
$schema: http://devicetree.org/meta-schemas/core.yaml#

title: Kinetic Technologies KTD2801 one-wire backlight

maintainers:
  - Duje Mihanović <duje.mihanovic@skole.hr>

description: |
  The Kinetic Technologies KTD2801 is a LED backlight driver controlled
  by a single GPIO line. The driver can be controlled with a PWM signal
  or by pulsing the GPIO line to set the backlight level. This is called
  "ExpressWire".

allOf:
  - $ref: common.yaml#

properties:
  compatible:
    const: kinetic,ktd2801

  ctrl-gpios:
    maxItems: 1

  default-brightness: true
  max-brightness: true

required:
  - compatible
  - ctrl-gpios

additionalProperties: false

examples:
  - |
    #include <dt-bindings/gpio/gpio.h>

    backlight {
        compatible = "kinetic,ktd2801";
        ctrl-gpios = <&gpio 97 GPIO_ACTIVE_HIGH>;
        max-brightness = <210>;
        default-brightness = <100>;
    };
```

## Documentation/devicetree/bindings/leds/backlight/kinetic,ktz8866.yaml
```yaml
# SPDX-License-Identifier: (GPL-2.0 OR BSD-2-Clause)
%YAML 1.2
---
$id: http://devicetree.org/schemas/leds/backlight/kinetic,ktz8866.yaml#
$schema: http://devicetree.org/meta-schemas/core.yaml#

title: Kinetic Technologies KTZ8866 backlight

maintainers:
  - Jianhua Lu <lujianhua000@gmail.com>

description: |
  The Kinetic Technologies KTZ8866 is a high efficiency 6-channels-current-sinks
  led backlight with dual lcd bias power.
  https://www.kinet-ic.com/ktz8866/

allOf:
  - $ref: common.yaml#

properties:
  compatible:
    const: kinetic,ktz8866

  vddpos-supply:
    description: positive boost supply regulator.

  vddneg-supply:
    description: negative boost supply regulator.

  enable-gpios:
    description: GPIO to use to enable/disable the backlight (HWEN pin).
    maxItems: 1

  current-num-sinks:
    description: number of the LED current sinks' channels.
    $ref: /schemas/types.yaml#/definitions/uint32
    enum: [1, 2, 3, 4, 5, 6]

  kinetic,current-ramp-delay-ms:
    description: |
      LED current ramping delay time in milliseconds, note that the
      case 1 will be mapped to 1μs.
    enum: [1, 2, 4, 8, 16, 32, 64, 128, 192, 256, 320, 384, 448, 512, 576, 640]

  kinetic,led-enable-ramp-delay-ms:
    description: |
      LED on/off ramping delay time in milliseconds, note that the case 0 will be
      mapped to 512μs because ktz8866 can't ramp faster than it.
    enum: [0, 1, 2, 4, 8, 16, 32, 64, 128, 256, 512, 1024, 2048, 4096, 8192, 16384]

  kinetic,enable-lcd-bias:
    description: Set if we want to output bias power supply for LCD.
    type: boolean

required:
  - compatible
  - vddpos-supply
  - vddneg-supply
  - enable-gpios

unevaluatedProperties: false

examples:
  - |
    #include <dt-bindings/gpio/gpio.h>

    backlight {
        compatible = "kinetic,ktz8866";

        vddpos-supply = <&bl_vddpos_5p5>;
        vddneg-supply = <&bl_vddneg_5p5>;
        enable-gpios = <&tlmm 139 GPIO_ACTIVE_HIGH>;
        current-num-sinks = <5>;
        kinetic,current-ramp-delay-ms = <128>;
        kinetic,led-enable-ramp-delay-ms = <1>;
        kinetic,enable-lcd-bias;
    };
```

## Documentation/devicetree/bindings/leds/backlight/led-backlight.txt
```
led-backlight bindings

This binding is used to describe a basic backlight device made of LEDs.
It can also be used to describe a backlight device controlled by the output of
a LED driver.

Required properties:
  - compatible: "led-backlight"
  - leds: a list of LEDs

Optional properties:
  - brightness-levels: Array of distinct brightness levels. The levels must be
                       in the range accepted by the underlying LED devices.
                       This is used to translate a backlight brightness level
                       into a LED brightness level. If it is not provided, the
                       identity mapping is used.

  - default-brightness-level: The default brightness level.

Example:

	backlight {
		compatible = "led-backlight";

		leds = <&led1>, <&led2>;
		brightness-levels = <0 4 8 16 32 64 128 255>;
		default-brightness-level = <6>;
	};
```

## Documentation/devicetree/bindings/leds/backlight/led-backlight.yaml
```yaml
# SPDX-License-Identifier: GPL-2.0-only
%YAML 1.2
---
$id: http://devicetree.org/schemas/leds/backlight/led-backlight.yaml#
$schema: http://devicetree.org/meta-schemas/core.yaml#

title: led-backlight

maintainers:
  - Lee Jones <lee@kernel.org>
  - Daniel Thompson <daniel.thompson@linaro.org>
  - Jingoo Han <jingoohan1@gmail.com>

description:
  This binding is used to describe a basic backlight device made of LEDs. It
  can also be used to describe a backlight device controlled by the output of
  a LED driver.

allOf:
  - $ref: common.yaml#

properties:
  compatible:
    const: led-backlight

  leds:
    description: A list of LED nodes
    $ref: /schemas/types.yaml#/definitions/phandle-array
    items:
      maxItems: 1

required:
  - compatible
  - leds

unevaluatedProperties: false

examples:
  - |
    backlight {
        compatible = "led-backlight";

        leds = <&led1>, <&led2>;
        brightness-levels = <0 4 8 16 32 64 128 255>;
        default-brightness-level = <6>;
    };

...
```

## Documentation/devicetree/bindings/leds/backlight/lm3630a-backlight.yaml
```yaml
# SPDX-License-Identifier: (GPL-2.0 OR BSD-2-Clause)
%YAML 1.2
---
$id: http://devicetree.org/schemas/leds/backlight/lm3630a-backlight.yaml#
$schema: http://devicetree.org/meta-schemas/core.yaml#

title: TI LM3630A High-Efficiency Dual-String White LED

maintainers:
  - Lee Jones <lee.jones@linaro.org>
  - Daniel Thompson <daniel.thompson@linaro.org>
  - Jingoo Han <jingoohan1@gmail.com>

description: |
  The LM3630A is a current-mode boost converter which supplies the power and
  controls the current in up to two strings of 10 LEDs per string.
  https://www.ti.com/product/LM3630A

properties:
  compatible:
    const: ti,lm3630a

  reg:
    maxItems: 1

  '#address-cells':
    const: 1

  '#size-cells':
    const: 0

  enable-gpios:
    description: GPIO to use to enable/disable the backlight (HWEN pin).
    maxItems: 1

required:
  - compatible
  - reg
  - '#address-cells'
  - '#size-cells'

patternProperties:
  "^led@[01]$":
    type: object
    description: |
      Properties for a string of connected LEDs.

    properties:
      reg:
        description: |
          The control bank that is used to program the two current sinks. The
          LM3630A has two control banks (A and B) and are represented as 0 or 1
          in this property. The two current sinks can be controlled
          independently with both banks, or bank A can be configured to control
          both sinks with the led-sources property.
        minimum: 0
        maximum: 1

      label:
        maxItems: 1

      led-sources:
        allOf:
          - minItems: 1
            maxItems: 2
            items:
              minimum: 0
              maximum: 1

      default-brightness:
        description: Default brightness level on boot.
        minimum: 0
        maximum: 255

      max-brightness:
        description: Maximum brightness that is allowed during runtime.
        minimum: 0
        maximum: 255

      ti,linear-mapping-mode:
        description: |
          Enable linear mapping mode. If disabled, then it will use exponential
          mapping mode in which the ramp up/down appears to have a more uniform
          transition to the human eye.
        type: boolean

    required:
      - reg

    additionalProperties: false

additionalProperties: false

examples:
  - |
    i2c {
        #address-cells = <1>;
        #size-cells = <0>;

        led-controller@38 {
                compatible = "ti,lm3630a";
                reg = <0x38>;
                enable-gpios = <&gpio2 5 GPIO_ACTIVE_HIGH>;

                #address-cells = <1>;
                #size-cells = <0>;

                led@0 {
                        reg = <0>;
                        led-sources = <0 1>;
                        label = "lcd-backlight";
                        default-brightness = <200>;
                        max-brightness = <255>;
                };
        };
    };
  - |
    i2c {
        #address-cells = <1>;
        #size-cells = <0>;

        led-controller@38 {
                compatible = "ti,lm3630a";
                reg = <0x38>;

                #address-cells = <1>;
                #size-cells = <0>;

                led@0 {
                        reg = <0>;
                        default-brightness = <150>;
                        ti,linear-mapping-mode;
                };

                led@1 {
                        reg = <1>;
                        default-brightness = <225>;
                        ti,linear-mapping-mode;
                };
        };
    };
```
