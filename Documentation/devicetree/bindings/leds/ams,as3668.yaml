## Documentation/devicetree/bindings/leds/backlight/lp855x-backlight.yaml
```yaml
# SPDX-License-Identifier: (GPL-2.0 OR BSD-2-Clause)
%YAML 1.2
---
$id: http://devicetree.org/schemas/leds/backlight/lp855x-backlight.yaml#
$schema: http://devicetree.org/meta-schemas/core.yaml#

title: Texas Instruments LP855X backlight controllers

maintainers:
  - Artur Weber <aweber.kernel@gmail.com>

properties:
  compatible:
    enum:
      - ti,lp8550
      - ti,lp8551
      - ti,lp8552
      - ti,lp8553
      - ti,lp8555
      - ti,lp8556
      - ti,lp8557

  reg:
    maxItems: 1

  dev-ctrl:
    $ref: /schemas/types.yaml#/definitions/uint8
    description:
      Value of device control register. This is a device-specific value.

  bl-name:
    $ref: /schemas/types.yaml#/definitions/string
    description: Backlight device name.

  init-brt:
    $ref: /schemas/types.yaml#/definitions/uint8
    description: Initial value of backlight brightness.

  power-supply:
    description: Regulator which controls the 3V rail.

  enable-supply:
    description: Regulator which controls the EN/VDDIO input.

  pwms:
    maxItems: 1
    description: |
      PWM channel to use for controlling the backlight; setting this
      enables the PWM-based backlight control mode.

  pwm-names: true

  pwm-period:
    $ref: /schemas/types.yaml#/definitions/uint32
    description:
      PWM period value. Deprecated; set the period value in the pwms
      property instead.
    deprecated: true

patternProperties:
  "^rom-[0-9a-f]{2}h$":
    type: object
    description: Nodes containing the values of configuration registers.
    additionalProperties: false
    properties:
      rom-addr:
        $ref: /schemas/types.yaml#/definitions/uint8
        description: Register address of ROM area to be updated.

      rom-val:
        $ref: /schemas/types.yaml#/definitions/uint8
        description: Value to write to the ROM register.

required:
  - compatible
  - reg
  - dev-ctrl

unevaluatedProperties: false

examples:
  - |
    i2c {
        #address-cells = <1>;
        #size-cells = <0>;

        backlight@2c {
            compatible = "ti,lp8555";
            reg = <0x2c>;

            dev-ctrl = /bits/ 8 <0x00>;

            pwms = <&pwm 0 10000>;
            pwm-names = "lp8555";

            /* 4V OV, 4 output LED0 string enabled */
            rom-14h {
              rom-addr = /bits/ 8 <0x14>;
              rom-val = /bits/ 8 <0xcf>;
            };

            /* Heavy smoothing, 24ms ramp time step */
            rom-15h {
              rom-addr = /bits/ 8 <0x15>;
              rom-val = /bits/ 8 <0xc7>;
            };

            /* 4 output LED1 string enabled */
            rom-19h {
              rom-addr = /bits/ 8 <0x19>;
              rom-val = /bits/ 8 <0x0f>;
            };
        };
    };
  - |
    i2c {
        #address-cells = <1>;
        #size-cells = <0>;

        backlight@2c {
            compatible = "ti,lp8556";
            reg = <0x2c>;

            bl-name = "lcd-bl";
            dev-ctrl = /bits/ 8 <0x85>;
            init-brt = /bits/ 8 <0x10>;
        };
      };
  - |
    i2c {
        #address-cells = <1>;
        #size-cells = <0>;

        backlight@2c {
            compatible = "ti,lp8557";
            reg = <0x2c>;
            enable-supply = <&backlight_vddio>;
            power-supply = <&backlight_vdd>;

            dev-ctrl = /bits/ 8 <0x41>;
            init-brt = /bits/ 8 <0x0a>;

            /* 4V OV, 4 output LED string enabled */
            rom-14h {
              rom-addr = /bits/ 8 <0x14>;
              rom-val = /bits/ 8 <0xcf>;
            };
        };
    };
```

## Documentation/devicetree/bindings/leds/backlight/lp855x.txt
```
lp855x bindings

Required properties:
  - compatible: "ti,lp8550", "ti,lp8551", "ti,lp8552", "ti,lp8553",
                "ti,lp8555", "ti,lp8556", "ti,lp8557"
  - reg: I2C slave address (u8)
  - dev-ctrl: Value of DEVICE CONTROL register (u8). It depends on the device.

Optional properties:
  - bl-name: Backlight device name (string)
  - init-brt: Initial value of backlight brightness (u8)
  - pwm-period: PWM period value. Set only PWM input mode used (u32)
  - rom-addr: Register address of ROM area to be updated (u8)
  - rom-val: Register value to be updated (u8)
  - power-supply: Regulator which controls the 3V rail

Example:

	/* LP8555 */
	backlight@2c {
		compatible = "ti,lp8555";
		reg = <0x2c>;

		dev-ctrl = /bits/ 8 <0x00>;
		pwm-period = <10000>;

		/* 4V OV, 4 output LED0 string enabled */
		rom_14h {
			rom-addr = /bits/ 8 <0x14>;
			rom-val = /bits/ 8 <0xcf>;
		};

		/* Heavy smoothing, 24ms ramp time step */
		rom_15h {
			rom-addr = /bits/ 8 <0x15>;
			rom-val = /bits/ 8 <0xc7>;
		};

		/* 4 output LED1 string enabled */
		rom_19h {
			rom-addr = /bits/ 8 <0x19>;
			rom-val = /bits/ 8 <0x0f>;
		};
	};

	/* LP8556 */
	backlight@2c {
		compatible = "ti,lp8556";
		reg = <0x2c>;

		bl-name = "lcd-bl";
		dev-ctrl = /bits/ 8 <0x85>;
		init-brt = /bits/ 8 <0x10>;
	};

	/* LP8557 */
	backlight@2c {
		compatible = "ti,lp8557";
		reg = <0x2c>;
		power-supply = <&backlight_vdd>;

		dev-ctrl = /bits/ 8 <0x41>;
		init-brt = /bits/ 8 <0x0a>;

		/* 4V OV, 4 output LED string enabled */
		rom_14h {
			rom-addr = /bits/ 8 <0x14>;
			rom-val = /bits/ 8 <0xcf>;
		};
	};
```

## Documentation/devicetree/bindings/leds/backlight/max8925-backlight.txt
```
88pm860x-backlight bindings

Optional properties:
  - maxim,max8925-dual-string: whether support dual string

Example:

	backlights {
		maxim,max8925-dual-string = <0>;
	};
```

## Documentation/devicetree/bindings/leds/backlight/maxim,max25014.yaml
```yaml
# SPDX-License-Identifier: (GPL-2.0 OR BSD-2-Clause)
%YAML 1.2
---
$id: http://devicetree.org/schemas/leds/backlight/maxim,max25014.yaml#
$schema: http://devicetree.org/meta-schemas/core.yaml#

title: Maxim max25014 backlight controller

maintainers:
  - Maud Spierings <maudspierings@gocontroll.com>

properties:
  compatible:
    enum:
      - maxim,max25014

  reg:
    maxItems: 1

  default-brightness:
    minimum: 0
    maximum: 100
    default: 50

  enable-gpios:
    maxItems: 1

  interrupts:
    maxItems: 1

  power-supply:
    description: Regulator which controls the boost converter input rail.

  pwms:
    maxItems: 1

  maxim,iset:
    $ref: /schemas/types.yaml#/definitions/uint32
    maximum: 15
    default: 11
    description:
      Value of the ISET field in the ISET register. This controls the current
      scale of the outputs, a higher number means more current.

  maxim,strings:
    $ref: /schemas/types.yaml#/definitions/uint32-array
    description:
      A 4-bit bitfield that describes which led strings to turn on.
    minItems: 4
    maxItems: 4
    items:
      maximum: 1
    default:
      [1 1 1 1]

required:
  - compatible
  - reg

additionalProperties: false

examples:
  - |
    #include <dt-bindings/gpio/gpio.h>
    #include <dt-bindings/interrupt-controller/irq.h>

    i2c {
        #address-cells = <1>;
        #size-cells = <0>;

        backlight@6f {
            compatible = "maxim,max25014";
            reg = <0x6f>;
            default-brightness = <50>;
            enable-gpios = <&gpio1 4 GPIO_ACTIVE_HIGH>;
            interrupt-parent = <&gpio1>;
            interrupts = <2 IRQ_TYPE_EDGE_FALLING>;
            power-supply = <&reg_backlight>;
            pwms = <&pwm1>;
            maxim,iset = <7>;
            maxim,strings = <1 1 1 0>;
        };
    };
```

## Documentation/devicetree/bindings/leds/backlight/mediatek,mt6370-backlight.yaml
```yaml
# SPDX-License-Identifier: (GPL-2.0-only OR BSD-2-Clause)
%YAML 1.2
---
$id: http://devicetree.org/schemas/leds/backlight/mediatek,mt6370-backlight.yaml#
$schema: http://devicetree.org/meta-schemas/core.yaml#

title: MediaTek MT6370 Backlight

maintainers:
  - ChiaEn Wu <chiaen_wu@richtek.com>

description: |
  This module is part of the MT6370 MFD device.
  The MT6370 Backlight WLED driver supports up to a 29V output voltage for
  4 channels of 8 series WLEDs. Each channel supports up to 30mA of current
  capability with 2048 current steps (11 bits, only for MT6370/MT6371) or
  16384 current steps (14 bits, only for MT6372) in exponential or linear
  mapping curves.

allOf:
  - $ref: common.yaml#

properties:
  compatible:
    enum:
      - mediatek,mt6370-backlight
      - mediatek,mt6372-backlight

  default-brightness:
    minimum: 0

  max-brightness:
    minimum: 0

  enable-gpios:
    description: External backlight 'enable' pin
    maxItems: 1

  mediatek,bled-pwm-enable:
    description: |
      Enable external PWM input for backlight dimming
    type: boolean

  mediatek,bled-pwm-hys-enable:
    description: |
      Enable the backlight input-hysteresis for PWM mode
    type: boolean

  mediatek,bled-pwm-hys-input-th-steps:
    $ref: /schemas/types.yaml#/definitions/uint8
    enum: [1, 4, 16, 64]
    description: |
      The selection of the upper and lower bounds threshold of backlight
      PWM resolution. If we choose selection 64, the variation of PWM
      resolution needs more than 64 steps.

  mediatek,bled-ovp-shutdown:
    description: |
      Enable the backlight shutdown when OVP level triggered
    type: boolean

  mediatek,bled-ovp-microvolt:
    enum: [17000000, 21000000, 25000000, 29000000]
    description: |
      Backlight OVP level selection.

  mediatek,bled-ocp-shutdown:
    description: |
      Enable the backlight shutdown when OCP level triggerred.
    type: boolean

  mediatek,bled-ocp-microamp:
    enum: [900000, 1200000, 1500000, 1800000]
    description: |
      Backlight OC level selection.

  mediatek,bled-exponential-mode-enable:
    description: |
      Enable the exponential mode of backlight brightness. If this property
      is not enabled, the default is to use linear mode.
    type: boolean

  mediatek,bled-channel-use:
    $ref: /schemas/types.yaml#/definitions/uint8
    description: |
      Backlight LED channel to be used.
      Each bit mapping to:
        - 0: CH4
        - 1: CH3
        - 2: CH2
        - 3: CH1
    minimum: 1
    maximum: 15

if:
  properties:
    compatible:
      contains:
        const: mediatek,mt6372-backlight

then:
  properties:
    default-brightness:
      maximum: 16384

    max-brightness:
      maximum: 16384

else:
  properties:
    default-brightness:
      maximum: 2048

    max-brightness:
      maximum: 2048

required:
  - compatible
  - mediatek,bled-channel-use

additionalProperties: false
```

## Documentation/devicetree/bindings/leds/backlight/mps,mp3309c.yaml
```yaml
# SPDX-License-Identifier: (GPL-2.0 OR BSD-2-Clause)
%YAML 1.2
---
$id: http://devicetree.org/schemas/leds/backlight/mps,mp3309c.yaml#
$schema: http://devicetree.org/meta-schemas/core.yaml#

title: MPS MP3309C backlight

maintainers:
  - Flavio Suligoi <f.suligoi@asem.it>

description: |
  The Monolithic Power (MPS) MP3309C is a WLED step-up converter, featuring a
  programmable switching frequency to optimize efficiency.
  It supports two different dimming modes:

  - analog mode, via I2C commands, as default mode (32 dimming levels)
  - PWM controlled mode (optional)

  The datasheet is available at:
  https://www.monolithicpower.com/en/mp3309c.html

allOf:
  - $ref: common.yaml#

properties:
  compatible:
    const: mps,mp3309c

  reg:
    maxItems: 1

  pwms:
    description: if present, the backlight is controlled in PWM mode.
    maxItems: 1

  enable-gpios:
    description: GPIO used to enable the backlight in "analog-i2c" dimming mode.
    maxItems: 1

  mps,overvoltage-protection-microvolt:
    description: Overvoltage protection (13.5V, 24V or 35.5V).
    enum: [ 13500000, 24000000, 35500000 ]
    default: 35500000

  mps,no-sync-mode:
    description: disable synchronous rectification mode
    type: boolean

required:
  - compatible
  - reg

unevaluatedProperties: false

examples:
  - |
    i2c {
        #address-cells = <1>;
        #size-cells = <0>;

        /* Backlight with PWM control */
        backlight_pwm: backlight@17 {
            compatible = "mps,mp3309c";
            reg = <0x17>;
            pwms = <&pwm1 0 3333333 0>; /* 300 Hz --> (1/f) * 1*10^9 */
            brightness-levels = <0 4 8 16 32 64 128 255>;
            default-brightness = <6>;
            mps,overvoltage-protection-microvolt = <24000000>;
        };
    };
```

## Documentation/devicetree/bindings/leds/backlight/pm8941-wled.txt
```
Binding for Qualcomm PM8941 WLED driver

Required properties:
- compatible: should be "qcom,pm8941-wled"
- reg: slave address

Optional properties:
- default-brightness: brightness value on boot, value from: 0-4095
	default: 2048
- label: The name of the backlight device
- qcom,cs-out: bool; enable current sink output
- qcom,cabc: bool; enable content adaptive backlight control
- qcom,ext-gen: bool; use externally generated modulator signal to dim
- qcom,current-limit: mA; per-string current limit; value from 0 to 25
	default: 20mA
- qcom,current-boost-limit: mA; boost current limit; one of:
	105, 385, 525, 805, 980, 1260, 1400, 1680
	default: 805mA
- qcom,switching-freq: kHz; switching frequency; one of:
	600, 640, 685, 738, 800, 872, 960, 1066, 1200, 1371,
	1600, 1920, 2400, 3200, 4800, 9600,
	default: 1600kHz
- qcom,ovp: V; Over-voltage protection limit; one of:
	27, 29, 32, 35
	default: 29V
- qcom,num-strings: #; number of led strings attached; value from 1 to 3
	default: 2

Example:

pm8941-wled@d800 {
	compatible = "qcom,pm8941-wled";
	reg = <0xd800>;
	label = "backlight";

	qcom,cs-out;
	qcom,current-limit = <20>;
	qcom,current-boost-limit = <805>;
	qcom,switching-freq = <1600>;
	qcom,ovp = <29>;
	qcom,num-strings = <2>;
};
```
