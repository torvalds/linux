## Documentation/devicetree/bindings/leds/ams,as3668.yaml
```yaml
# SPDX-License-Identifier: (GPL-2.0-only OR BSD-2-Clause)
%YAML 1.2
---
$id: http://devicetree.org/schemas/leds/ams,as3668.yaml#
$schema: http://devicetree.org/meta-schemas/core.yaml#

title: Osram 4-channel i2c LED driver

maintainers:
  - Lukas Timmermann <linux@timmermann.space>

description:
  This IC can drive up to four separate LEDs.
  Having four channels suggests it could be used with a single RGBW LED.

properties:
  compatible:
    const: ams,as3668

  reg:
    maxItems: 1

  "#address-cells":
    const: 1

  "#size-cells":
    const: 0

patternProperties:
  "^led@[0-3]$":
    type: object
    $ref: common.yaml#
    unevaluatedProperties: false

    properties:
      reg:
        maxItems: 1

required:
  - compatible
  - reg
  - "#address-cells"
  - "#size-cells"

additionalProperties: false

examples:
  - |
    #include <dt-bindings/leds/common.h>

    i2c {
      #address-cells = <1>;
      #size-cells = <0>;

      led-controller@42 {
        compatible = "ams,as3668";
        reg = <0x42>;
        #address-cells = <1>;
        #size-cells = <0>;

        led@0 {
          reg = <0x0>;
          function = LED_FUNCTION_STATUS;
          color = <LED_COLOR_ID_RED>;
        };

        led@1 {
          reg = <0x1>;
          function = LED_FUNCTION_STATUS;
          color = <LED_COLOR_ID_GREEN>;
        };
      };
    };
```

## Documentation/devicetree/bindings/leds/awinic,aw200xx.yaml
```yaml
# SPDX-License-Identifier: (GPL-2.0-only OR BSD-2-Clause)
%YAML 1.2
---
$id: http://devicetree.org/schemas/leds/awinic,aw200xx.yaml#
$schema: http://devicetree.org/meta-schemas/core.yaml#

title: AWINIC AW200XX LED

maintainers:
  - Martin Kurbanov <mmkurbanov@sberdevices.ru>

description: |
  It is a matrix LED driver programmed via an I2C interface. Devices have
  a set of individually controlled leds and support 3 pattern controllers
  for auto breathing or group dimming control. Supported devices:
    - AW20036 (3x12) 36 LEDs
    - AW20054 (6x9)  54 LEDs
    - AW20072 (6x12) 72 LEDs
    - AW20108 (9x12) 108 LEDs

  For more product information please see the link below:
  aw20036 - https://www.awinic.com/en/productDetail/AW20036QNR#tech-docs
  aw20054 - https://www.awinic.com/en/productDetail/AW20054QNR#tech-docs
  aw20072 - https://www.awinic.com/en/productDetail/AW20072QNR#tech-docs
  aw20108 - https://www.awinic.com/en/productDetail/AW20108QNR#tech-docs

properties:
  compatible:
    enum:
      - awinic,aw20036
      - awinic,aw20054
      - awinic,aw20072
      - awinic,aw20108

  reg:
    maxItems: 1

  "#address-cells":
    const: 1

  "#size-cells":
    const: 0

  enable-gpios:
    maxItems: 1

patternProperties:
  "^led@[0-9a-f]+$":
    type: object
    $ref: common.yaml#
    unevaluatedProperties: false

    properties:
      reg:
        description:
          LED number
        maxItems: 1

      led-max-microamp:
        default: 9780
        description: |
          Note that a driver will take the minimum of all LED limits
          since the chip has a single global setting.
          The maximum output current of each LED is calculated by the
          following formula:
            IMAXled = 160000 * (592 / 600.5) * (1 / max-current-switch-number)
          And the minimum output current formula:
            IMINled = 3300 * (592 / 600.5) * (1 / max-current-switch-number)
          where max-current-switch-number is determinated by led configuration
          and depends on how leds are physically connected to the led driver.

allOf:
  - if:
      properties:
        compatible:
          contains:
            const: awinic,aw20036
    then:
      patternProperties:
        "^led@[0-9a-f]+$":
          properties:
            reg:
              items:
                minimum: 0
                maximum: 36

  - if:
      properties:
        compatible:
          contains:
            const: awinic,aw20054
    then:
      patternProperties:
        "^led@[0-9a-f]+$":
          properties:
            reg:
              items:
                minimum: 0
                maximum: 54

  - if:
      properties:
        compatible:
          contains:
            const: awinic,aw20072
    then:
      patternProperties:
        "^led@[0-9a-f]+$":
          properties:
            reg:
              items:
                minimum: 0
                maximum: 72

  - if:
      properties:
        compatible:
          contains:
            const: awinic,aw20108
    then:
      patternProperties:
        "^led@[0-9a-f]+$":
          properties:
            reg:
              items:
                minimum: 0
                maximum: 108

required:
  - compatible
  - reg
  - "#address-cells"
  - "#size-cells"

additionalProperties: false

examples:
  - |
    #include <dt-bindings/gpio/gpio.h>
    #include <dt-bindings/leds/common.h>

    i2c {
        #address-cells = <1>;
        #size-cells = <0>;

        led-controller@3a {
            compatible = "awinic,aw20036";
            reg = <0x3a>;
            #address-cells = <1>;
            #size-cells = <0>;
            enable-gpios = <&gpio 3 GPIO_ACTIVE_HIGH>;

            led@0 {
                reg = <0x0>;
                color = <LED_COLOR_ID_RED>;
                led-max-microamp = <9780>;
            };

            led@1 {
                reg = <0x1>;
                color = <LED_COLOR_ID_GREEN>;
                led-max-microamp = <9780>;
            };

            led@2 {
                reg = <0x2>;
                color = <LED_COLOR_ID_BLUE>;
                led-max-microamp = <9780>;
            };
        };
    };

...
```

## Documentation/devicetree/bindings/leds/backlight/88pm860x.txt
```
88pm860x-backlight bindings

Optional properties:
  - marvell,88pm860x-iset: Current supplies on backlight device.
  - marvell,88pm860x-pwm: PWM frequency on backlight device.

Example:

	backlights {
		backlight-0 {
			marvell,88pm860x-iset = <4>;
			marvell,88pm860x-pwm = <3>;
		};
		backlight-2 {
		};
```

## Documentation/devicetree/bindings/leds/backlight/apple,dwi-bl.yaml
```yaml
# SPDX-License-Identifier: (GPL-2.0 OR BSD-2-Clause)
%YAML 1.2
---
$id: http://devicetree.org/schemas/leds/backlight/apple,dwi-bl.yaml#
$schema: http://devicetree.org/meta-schemas/core.yaml#

title: Apple DWI 2-Wire Interface Backlight Controller

maintainers:
  - Nick Chan <towinchenmi@gmail.com>

description:
  Apple SoCs contain a 2-wire interface called DWI. On some Apple iPhones,
  iPads and iPod touches with a LCD display, 1-2 backlight controllers
  are connected via DWI. Interfacing with DWI controls all backlight
  controllers at the same time. As such, the backlight controllers are
  treated as a single controller regardless of the underlying
  configuration.

allOf:
  - $ref: common.yaml#

properties:
  compatible:
    items:
      - enum:
          - apple,s5l8960x-dwi-bl
          - apple,t7000-dwi-bl
          - apple,s8000-dwi-bl
          - apple,t8010-dwi-bl
          - apple,t8015-dwi-bl
      - const: apple,dwi-bl

  reg:
    maxItems: 1

  power-domains:
    maxItems: 1

required:
  - compatible
  - reg

unevaluatedProperties: false

examples:
  - |
    soc {
      #address-cells = <2>;
      #size-cells = <2>;

      dwi_bl: backlight@20e200010 {
        compatible = "apple,s5l8960x-dwi-bl", "apple,dwi-bl";
        reg = <0x2 0x0e200010 0x0 0x8>;
        power-domains = <&ps_dwi>;
      };
    };
```

## Documentation/devicetree/bindings/leds/backlight/arc,arc2c0608.yaml
```yaml
# SPDX-License-Identifier: (GPL-2.0 OR BSD-2-Clause)
%YAML 1.2
---
$id: http://devicetree.org/schemas/leds/backlight/arc,arc2c0608.yaml#
$schema: http://devicetree.org/meta-schemas/core.yaml#

title: ArcticSand arc2c0608 LED driver

description: |
  The ArcticSand arc2c0608 LED driver provides ultra
  efficient notebook backlighting. Optional properties not
  specified will default to values in IC EPROM.

  Datasheet:
  https://www.murata.com/-/media/webrenewal/products/power/power-semiconductor/overview/lineup/led-boost/arc2/arc2c0608.ashx.

maintainers:
  - Brian Dodge <bdodge@arcticsand.com>

allOf:
  - $ref: /schemas/leds/common.yaml

properties:
  compatible:
    const: arc,arc2c0608

  reg:
    maxItems: 1

  default-brightness:
    $ref: /schemas/types.yaml#/definitions/uint32
    minimum: 0
    maximum: 4095

  led-sources:
    $ref: /schemas/types.yaml#/definitions/uint32-array
    description: List of enabled channels
    items:
      enum: [0, 1, 2, 3, 4, 5]
    minItems: 1
    uniqueItems: true

  arc,led-config-0:
    $ref: /schemas/types.yaml#/definitions/uint32
    description: Fading speed (period between intensity
      steps)

  arc,led-config-1:
    $ref: /schemas/types.yaml#/definitions/uint32
    description: If set, sets ILED_CONFIG register. Used for
      fine tuning the maximum LED current.

  arc,dim-freq:
    $ref: /schemas/types.yaml#/definitions/uint32
    description: PWM mode frequency setting (bits [3:0] used)

  arc,comp-config:
    $ref: /schemas/types.yaml#/definitions/uint32
    description: Setting for register CONFIG_COMP which
      controls internal resitances, feed forward freqs,
      and initial VOUT at startup. Consult the datasheet.

  arc,filter-config:
    $ref: /schemas/types.yaml#/definitions/uint32
    description: RC and PWM Filter settings.
      Bit Assignment
      7654 3    2    1    0
      xxxx RCF1 RCF0 PWM1 PWM0
      RCF statuses        PWM Filter Statues
      00 = OFF (default)  00 = OFF (default)
      01 = LOW            01 = 2 STEPS
      10 - MEDIUM         10 = 4 STEPS
      11 = HIGH           11 = 8 STEPS

  arc,trim-config:
    $ref: /schemas/types.yaml#/definitions/uint32
    description: Sets percentage increase of Maximum LED
      Current.
      0x00 = 0% increase.
      0x20 = 20.2%.
      0x3F = 41.5%

  label: true

  linux,default-trigger: true

additionalProperties: false

required:
  - compatible
  - reg

examples:
  - |
    i2c {
        #address-cells = <1>;
        #size-cells = <0>;

        led-controller@30 {
            compatible = "arc,arc2c0608";
            reg = <0x30>;
            default-brightness = <500>;
            label = "lcd-backlight";
            linux,default-trigger = "backlight";
            led-sources = <0 1 2 5>;
        };
    };
...
```

## Documentation/devicetree/bindings/leds/backlight/arcxcnn_bl.txt
```
Binding for ArcticSand arc2c0608 LED driver

Required properties:
- compatible:		should be "arc,arc2c0608"
- reg:			slave address

Optional properties:
- default-brightness:	brightness value on boot, value from: 0-4095
- label:		The name of the backlight device
			See Documentation/devicetree/bindings/leds/common.txt
- led-sources:		List of enabled channels from 0 to 5.
			See Documentation/devicetree/bindings/leds/common.txt

- arc,led-config-0:	setting for register ILED_CONFIG_0
- arc,led-config-1:	setting for register ILED_CONFIG_1
- arc,dim-freq:		PWM mode frequence setting (bits [3:0] used)
- arc,comp-config:	setting for register CONFIG_COMP
- arc,filter-config:	setting for register FILTER_CONFIG
- arc,trim-config:	setting for register IMAXTUNE

Note: Optional properties not specified will default to values in IC EPROM

Example:

arc2c0608@30 {
	compatible = "arc,arc2c0608";
	reg = <0x30>;
	default-brightness = <500>;
	label = "lcd-backlight";
	linux,default-trigger = "backlight";
	led-sources = <0 1 2 5>;
};
```

## Documentation/devicetree/bindings/leds/backlight/awinic,aw99706.yaml
```yaml
# SPDX-License-Identifier: (GPL-2.0 OR BSD-2-Clause)
%YAML 1.2
---
$id: http://devicetree.org/schemas/leds/backlight/awinic,aw99706.yaml#
$schema: http://devicetree.org/meta-schemas/core.yaml#

title: Awinic AW99706 6-channel WLED Backlight Driver

maintainers:
  - Junjie Cao <caojunjie650@gmail.com>

allOf:
  - $ref: common.yaml#

properties:
  compatible:
    const: awinic,aw99706

  reg:
    maxItems: 1

  enable-gpios:
    description: GPIO to use to enable/disable the backlight (HWEN pin).
    maxItems: 1

  awinic,dim-mode:
    $ref: /schemas/types.yaml#/definitions/uint32
    description: >
      Select dimming mode of the device.
        0 = Bypass mode.
        1 = DC mode.
        2 = MIX mode(PWM at low brightness and DC at high brightness).
        3 = MIX-26k mode(MIX mode with different PWM frequency).
    enum: [ 0, 1, 2, 3 ]
    default: 1

  awinic,sw-freq-hz:
    description: Boost switching frequency in Hz.
    enum: [ 300000, 400000, 500000, 600000, 660000, 750000, 850000, 1000000,
            1200000, 1330000, 1500000, 1700000 ]
    default: 750000

  awinic,sw-ilmt-microamp:
    description: Switching current limitation in uA.
    enum: [ 1500000, 2000000, 2500000, 3000000 ]
    default: 3000000

  awinic,iled-max-microamp:
    description: Maximum LED current setting in uA.
    minimum: 5000
    maximum: 50000
    multipleOf: 500
    default: 20000

  awinic,uvlo-thres-microvolt:
    description: UVLO(Under Voltage Lock Out) in uV.
    enum: [ 2200000, 5000000 ]
    default: 2200000

  awinic,ramp-ctl:
    $ref: /schemas/types.yaml#/definitions/uint32
    description: >
      Select ramp control and filter of the device.
        0 = Fade in/fade out.
        1 = Light filter.
        2 = Medium filter.
        3 = Heavy filter.
    enum: [ 0, 1, 2, 3 ]
    default: 2

required:
  - compatible
  - reg
  - enable-gpios

unevaluatedProperties: false

examples:
  - |
    #include <dt-bindings/gpio/gpio.h>

    i2c {
        #address-cells = <1>;
        #size-cells = <0>;

        backlight@76 {
            compatible = "awinic,aw99706";
            reg = <0x76>;
            enable-gpios = <&tlmm 88 GPIO_ACTIVE_HIGH>;
            default-brightness = <2047>;
            max-brightness = <4095>;
            awinic,dim-mode = <1>;
            awinic,sw-freq-hz = <750000>;
            awinic,sw-ilmt-microamp = <3000000>;
            awinic,uvlo-thres-microvolt = <2200000>;
            awinic,iled-max-microamp = <20000>;
            awinic,ramp-ctl = <2>;
        };
    };

...
```
