## Documentation/devicetree/bindings/leds/ti,lm3560.yaml
```yaml
# SPDX-License-Identifier: (GPL-2.0-only OR BSD-2-Clause)
%YAML 1.2
---
$id: http://devicetree.org/schemas/leds/ti,lm3560.yaml#
$schema: http://devicetree.org/meta-schemas/core.yaml#

title: TI LM3560 Synchronous Boost Flash Driver

maintainers:
  - Svyatoslav Ryhel <clamor95@gmail.com>

description:
  The LM3560 is a 2-MHz fixed frequency synchronous boost converter with two
  1000-mA constant current drivers for high-current white LEDs. The dual high-
  side current sources allow for grounded cathode LED operation and can be
  tied together for providing flash currents at up to 2 A through a single LED.
  An adaptive regulation method ensures the current for each LED remains in
  regulation and maximizes efficiency.

properties:
  compatible:
    enum:
      - ti,lm3559
      - ti,lm3560

  reg:
    maxItems: 1

  '#address-cells':
    const: 1

  '#size-cells':
    const: 0

  enable-gpios:
    description: GPIO connected to the HWEN pin.
    maxItems: 1

  vin-supply:
    description: Supply connected to the IN line.

  flash-max-timeout-us:
    minimum: 32000
    maximum: 1024000
    default: 32000

  ti,peak-current-microamp:
    description:
      The LM3560 features 4 selectable current limits 1.6A, 2.3A, 3A, and 3.6A
      (in case of LM3559 - 1.4A, 2.1A, 2.7A, and 3.2A). When the current limit
      is reached, the LM3559/LM3560 stops switching for the remainder of the
      switching cycle.

patternProperties:
  '^led@[01]$':
    type: object
    $ref: /schemas/leds/common.yaml#
    description: LED control bank nodes.
    unevaluatedProperties: false

    properties:
      reg:
        description: Control bank selection (0 = bank A, 1 = bank B).
        maximum: 1

    required:
      - reg
      - flash-max-microamp
      - led-max-microamp

allOf:
  - $ref: /schemas/leds/common.yaml#
  - if:
      properties:
        compatible:
          contains:
            const: ti,lm3559
    then:
      properties:
        ti,peak-current-microamp:
          enum: [1400000, 2100000, 2700000, 3200000]
          default: 1400000
      patternProperties:
        '^led@[01]$':
          properties:
            flash-max-microamp:
              minimum: 56250
              maximum: 900000
            led-max-microamp:
              minimum: 28125
              maximum: 225000

  - if:
      properties:
        compatible:
          contains:
            const: ti,lm3560
    then:
      properties:
        ti,peak-current-microamp:
          enum: [1600000, 2300000, 3000000, 3600000]
          default: 1600000
      patternProperties:
        '^led@[01]$':
          properties:
            flash-max-microamp:
              minimum: 62500
              maximum: 1000000
            led-max-microamp:
              minimum: 31250
              maximum: 250000

required:
  - compatible
  - reg
  - '#address-cells'
  - '#size-cells'

additionalProperties: false

examples:
  - |
    #include <dt-bindings/gpio/gpio.h>
    #include <dt-bindings/leds/common.h>

    i2c {
        #address-cells = <1>;
        #size-cells = <0>;

        led-controller@53 {
            compatible = "ti,lm3560";
            reg = <0x53>;

            enable-gpios = <&gpio 28 GPIO_ACTIVE_HIGH>;
            vin-supply = <&vdd_3v3_sys>;

            flash-max-timeout-us = <1024000>;
            ti,peak-current-microamp = <1600000>;

            #address-cells = <1>;
            #size-cells = <0>;

            led@0 {
                reg = <0>;

                function = LED_FUNCTION_FLASH;
                color = <LED_COLOR_ID_WHITE>;

                flash-max-microamp = <562500>;
                led-max-microamp = <156250>;
            };

            led@1 {
                reg = <1>;

                function = LED_FUNCTION_FLASH;
                color = <LED_COLOR_ID_YELLOW>;

                flash-max-microamp = <562500>;
                led-max-microamp = <156250>;
            };
        };
    };
```

## Documentation/devicetree/bindings/leds/ti,lm3697.yaml
```yaml
# SPDX-License-Identifier: (GPL-2.0-only OR BSD-2-Clause)
%YAML 1.2
---
$id: http://devicetree.org/schemas/leds/ti,lm3697.yaml#
$schema: http://devicetree.org/meta-schemas/core.yaml#

title: TI LM3697 Highly Efficient White LED Driver

maintainers:
  - Dan Murphy <dmurphy@ti.com>

description: >
  The LM3697 11-bit LED driver provides high-performance backlight dimming for
  1, 2, or 3 series LED strings while delivering up to 90% efficiency.

  This device is suitable for display and keypad lighting.

properties:
  compatible:
    const: ti,lm3697

  reg:
    maxItems: 1

  '#address-cells':
    const: 1

  '#size-cells':
    const: 0

  enable-gpios:
    description: GPIO pin to enable or disable the device.
    maxItems: 1

  vled-supply:
    description: LED supply for the device.

patternProperties:
  '^led@[01]$':
    description: LED control bank nodes.
    $ref: common.yaml#
    unevaluatedProperties: false

    properties:
      reg:
        description: Control bank selection (0 = bank A, 1 = bank B).
        maximum: 1

      led-sources:
        description: >
          HVLED strings associated with this control bank:

            0 - HVLED1
            1 - HVLED2
            2 - HVLED3
        minItems: 1
        maxItems: 3
        items:
          maximum: 2

      ti,brightness-resolution:
        description: Brightness resolution for the LED string.
        $ref: /schemas/types.yaml#/definitions/uint32
        maximum: 2047

      ramp-up-us:
        description: Ramp-up time in microseconds.
        minimum: 117
        maximum: 2048

      ramp-down-us:
        description: Ramp-down time in microseconds.
        minimum: 117
        maximum: 2048

    required:
      - reg
      - led-sources

required:
  - compatible
  - reg
  - '#address-cells'
  - '#size-cells'

additionalProperties: false

examples:
  - |
    #include <dt-bindings/gpio/gpio.h>

    i2c {
        #address-cells = <1>;
        #size-cells = <0>;

        led-controller@36 {
            compatible = "ti,lm3697";
            #address-cells = <1>;
            #size-cells = <0>;
            reg = <0x36>;

            enable-gpios = <&gpio1 28 GPIO_ACTIVE_HIGH>;
            vled-supply = <&vbatt>;

            led@0 {
                reg = <0>;
                led-sources = <0 2>;
                ti,brightness-resolution = <2047>;
                ramp-up-us = <500>;
                ramp-down-us = <1000>;
                label = "white:first_backlight_cluster";
                linux,default-trigger = "backlight";
            };

            led@1 {
                reg = <1>;
                led-sources = <1>;
                ti,brightness-resolution = <255>;
                ramp-up-us = <500>;
                ramp-down-us = <1000>;
                label = "white:second_backlight_cluster";
                linux,default-trigger = "backlight";
            };
        };
    };
```

## Documentation/devicetree/bindings/leds/ti,lp5812.yaml
```yaml
# SPDX-License-Identifier: (GPL-2.0-only OR BSD-2-Clause)
%YAML 1.2
---
$id: http://devicetree.org/schemas/leds/ti,lp5812.yaml#
$schema: http://devicetree.org/meta-schemas/core.yaml#

title: TI LP5812 4x3 Matrix RGB LED Driver with Autonomous Control

maintainers:
  - Nam Tran <trannamatk@gmail.com>

description: |
  The LP5812 is a 4x3 matrix RGB LED driver with I2C interface
  and autonomous animation engine control.
  For more product information please see the link below:
  https://www.ti.com/product/LP5812#tech-docs

properties:
  compatible:
    const: ti,lp5812

  reg:
    maxItems: 1

  ti,scan-mode:
    description: |
      Selects the LED scan mode of the LP5812. The device supports
      three modes:
        - Direct-drive mode (by default if 'ti,scan-mode' is omitted)
        drives up to 4 LEDs directly by internal current sinks (LED0-LED3).
        - TCM-drive mode ("tcm:<n>:<order...>") drives up to 12 LEDs
        (4 RGB) using 1-4 scan multiplexing. The <n> specifies the number
        of scans (1-4), and <order...> defines the scan order of the outputs.
        - Mix-drive mode ("mix:<n>:<direct>:<order...>") combines
        direct-drive and TCM-drive outputs. The <n> specifies the number
        of scans, <direct> selects the direct-drive outputs, and <order...>
        defines the scan order.
    $ref: /schemas/types.yaml#/definitions/string
    pattern: '^(tcm|mix):[1-4](:[0-3]){1,4}$'

  vcc-supply:
    description: Regulator providing power to the 'VCC' pin.

  "#address-cells":
    const: 1

  "#size-cells":
    const: 0

patternProperties:
  "^led@[0-3]$":
    type: object
    $ref: common.yaml#
    unevaluatedProperties: false

    properties:
      reg:
        minimum: 0
        maximum: 3

    required:
      - reg

  "^multi-led@[4-7]$":
    type: object
    $ref: leds-class-multicolor.yaml#
    unevaluatedProperties: false

    properties:
      reg:
        minimum: 4
        maximum: 7

      "#address-cells":
        const: 1

      "#size-cells":
        const: 0

    patternProperties:
      "^led@[4-9a-f]$":
        type: object
        $ref: common.yaml#
        unevaluatedProperties: false

        properties:
          reg:
            minimum: 4
            maximum: 15

        required:
          - reg

required:
  - compatible
  - reg

additionalProperties: false

examples:
  - |
    #include <dt-bindings/leds/common.h>

    i2c {
        #address-cells = <1>;
        #size-cells = <0>;

        led-controller@1b {
            #address-cells = <1>;
            #size-cells = <0>;
            compatible = "ti,lp5812";
            reg = <0x1b>;
            ti,scan-mode = "tcm:4:0:1:2:3";
            vcc-supply = <&vdd_3v3_reg>;

            led@0 {
                reg = <0x0>;
                label = "LED0";
                led-max-microamp = <25500>;
            };

            led@1 {
                reg = <0x1>;
                label = "LED1";
                led-max-microamp = <25500>;
            };

            led@2 {
                reg = <0x2>;
                label = "LED2";
                led-max-microamp = <25500>;
            };

            led@3 {
                reg = <0x3>;
                label = "LED3";
                led-max-microamp = <25500>;
            };

            multi-led@4 {
                #address-cells = <1>;
                #size-cells = <0>;
                reg = <0x4>;
                color = <LED_COLOR_ID_RGB>;
                label = "LED_A";

                led@4 {
                    reg = <0x4>;
                    color = <LED_COLOR_ID_GREEN>;
                    led-max-microamp = <25500>;
                };

                led@5 {
                    reg = <0x5>;
                    color = <LED_COLOR_ID_RED>;
                    led-max-microamp = <25500>;
                };

                led@6 {
                    reg = <0x6>;
                    color = <LED_COLOR_ID_BLUE>;
                    led-max-microamp = <25500>;
                };
            };

            multi-led@5 {
                #address-cells = <1>;
                #size-cells = <0>;
                reg = <0x5>;
                color = <LED_COLOR_ID_RGB>;
                label = "LED_B";

                led@7 {
                    reg = <0x7>;
                    color = <LED_COLOR_ID_GREEN>;
                    led-max-microamp = <25500>;
                };

                led@8 {
                    reg = <0x8>;
                    color = <LED_COLOR_ID_RED>;
                    led-max-microamp = <25500>;
                };

                led@9 {
                    reg = <0x9>;
                    color = <LED_COLOR_ID_BLUE>;
                    led-max-microamp = <25500>;
                };
            };

            multi-led@6 {
                #address-cells = <1>;
                #size-cells = <0>;
                reg = <0x6>;
                color = <LED_COLOR_ID_RGB>;
                label = "LED_C";

                led@a {
                    reg = <0xa>;
                    color = <LED_COLOR_ID_GREEN>;
                    led-max-microamp = <25500>;
                };

                led@b {
                    reg = <0xb>;
                    color = <LED_COLOR_ID_RED>;
                    led-max-microamp = <25500>;
                };

                led@c {
                    reg = <0xc>;
                    color = <LED_COLOR_ID_BLUE>;
                    led-max-microamp = <25500>;
                };
            };

            multi-led@7 {
                #address-cells = <1>;
                #size-cells = <0>;
                reg = <0x7>;
                color = <LED_COLOR_ID_RGB>;
                label = "LED_D";

                led@d {
                    reg = <0xd>;
                    color = <LED_COLOR_ID_GREEN>;
                    led-max-microamp = <25500>;
                };

                led@e {
                    reg = <0xe>;
                    color = <LED_COLOR_ID_RED>;
                    led-max-microamp = <25500>;
                };

                led@f {
                    reg = <0xf>;
                    color = <LED_COLOR_ID_BLUE>;
                    led-max-microamp = <25500>;
                };
            };
        };
    };

...
```

## Documentation/devicetree/bindings/leds/ti,lp8860.yaml
```yaml
# SPDX-License-Identifier: (GPL-2.0 OR BSD-2-Clause)
%YAML 1.2
---
$id: http://devicetree.org/schemas/leds/ti,lp8860.yaml#
$schema: http://devicetree.org/meta-schemas/core.yaml#

title: Texas Instruments - lp8860 4-Channel LED Driver

maintainers:
  - Andrew Davis <afd@ti.com>

description: |
  The LP8860-Q1 is an high-efficiency LED driver with boost controller.
  It has 4 high-precision current sinks that can be controlled by a PWM input
  signal, a SPI/I2C master, or both.

  For more product information please see the link below:
    https://www.ti.com/product/lp8860-q1

properties:
  compatible:
    const: ti,lp8860

  reg:
    maxItems: 1
    description: I2C slave address

  "#address-cells":
    const: 1

  "#size-cells":
    const: 0

  enable-gpios:
    maxItems: 1
    description: GPIO pin to enable (active high) / disable the device

  vled-supply:
    description: LED supply

patternProperties:
  "^led(@[0-3])?$":
    type: object
    $ref: common.yaml#
    unevaluatedProperties: false

    properties:
      reg:
        description:
          Index of the LED.
        maxItems: 1

      function: true
      color: true
      label: true
      linux,default-trigger: true

required:
  - compatible
  - reg

additionalProperties: false

examples:
  - |
    #include <dt-bindings/gpio/gpio.h>
    #include <dt-bindings/leds/common.h>

    i2c {
        #address-cells = <1>;
        #size-cells = <0>;

        led-controller@2d {
            compatible = "ti,lp8860";
            #address-cells = <1>;
            #size-cells = <0>;
            reg = <0x2d>;
            enable-gpios = <&gpio1 28 GPIO_ACTIVE_HIGH>;
            vled-supply = <&vbatt>;

            led@0 {
                reg = <0>;
                function = LED_FUNCTION_BACKLIGHT;
                color = <LED_COLOR_ID_WHITE>;
                linux,default-trigger = "backlight";
            };
        };
    };

...
```
