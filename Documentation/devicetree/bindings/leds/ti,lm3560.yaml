## Documentation/devicetree/bindings/mailbox/altera-mailbox.txt
```
Altera Mailbox Driver
=====================

Required properties:
- compatible :	"altr,mailbox-1.0".
- reg : 	physical base address of the mailbox and length of
		memory mapped region.
- #mbox-cells:	Common mailbox binding property to identify the number
		of cells required for the mailbox specifier. Should be 1.

Optional properties:
- interrupt-parent :	interrupt source phandle.
- interrupts :		interrupt number. The interrupt specifier format
			depends on the interrupt controller parent.

Example:
	mbox_tx: mailbox@100 {
		compatible = "altr,mailbox-1.0";
		reg = <0x100 0x8>;
		interrupt-parent = < &gic_0 >;
		interrupts = <5>;
		#mbox-cells = <1>;
	};

	mbox_rx: mailbox@200 {
		compatible = "altr,mailbox-1.0";
		reg = <0x200 0x8>;
		interrupt-parent = < &gic_0 >;
		interrupts = <6>;
		#mbox-cells = <1>;
	};

Mailbox client
===============
"mboxes" and the optional "mbox-names" (please see
Documentation/devicetree/bindings/mailbox/mailbox.txt for details). Each value
of the mboxes property should contain a phandle to the mailbox controller
device node and second argument is the channel index. It must be 0 (hardware
support only one channel).The equivalent "mbox-names" property value can be
used to give a name to the communication channel to be used by the client user.

Example:
	mclient0: mclient0@400 {
		compatible = "client-1.0";
		reg = <0x400 0x10>;
		mbox-names = "mbox-tx", "mbox-rx";
		mboxes = <&mbox_tx 0>,
			 <&mbox_rx 0>;
	};
```

## Documentation/devicetree/bindings/mailbox/amlogic,meson-gxbb-mhu.yaml
```yaml
# SPDX-License-Identifier: (GPL-2.0 OR BSD-2-Clause)
# Copyright 2019 BayLibre, SAS
%YAML 1.2
---
$id: "http://devicetree.org/schemas/mailbox/amlogic,meson-gxbb-mhu.yaml#"
$schema: "http://devicetree.org/meta-schemas/core.yaml#"

title: Amlogic Meson Message-Handling-Unit Controller

maintainers:
  - Neil Armstrong <narmstrong@baylibre.com>

description: |
  The Amlogic's Meson SoCs Message-Handling-Unit (MHU) is a mailbox controller
  that has 3 independent channels/links to communicate with remote processor(s).
  MHU links are hardwired on a platform. A link raises interrupt for any
  received data. However, there is no specified way of knowing if the sent
  data has been read by the remote. This driver assumes the sender polls
  STAT register and the remote clears it after having read the data.

properties:
  compatible:
    enum:
      - amlogic,meson-gxbb-mhu

  reg:
    maxItems: 1

  interrupts:
    minItems: 3
    description:
      Contains the interrupt information corresponding to each of the 3 links
      of MHU.

  "#mbox-cells":
    const: 1

required:
  - compatible
  - reg
  - interrupts
  - "#mbox-cells"

additionalProperties: false

examples:
  - |
    mailbox@c883c404 {
          compatible = "amlogic,meson-gxbb-mhu";
          reg = <0xc883c404 0x4c>;
          interrupts = <208>, <209>, <210>;
          #mbox-cells = <1>;
    };
```

## Documentation/devicetree/bindings/mailbox/apm,xgene-slimpro-mbox.yaml
```yaml
# SPDX-License-Identifier: (GPL-2.0-only OR BSD-2-Clause)
%YAML 1.2
---
$id: http://devicetree.org/schemas/apm,xgene-slimpro-mbox.yaml#
$schema: http://devicetree.org/meta-schemas/core.yaml#

title: APM X-Gene SLIMpro mailbox

maintainers:
  - Khuong Dinh <khuong@os.amperecomputing.com>

description:
  The APM X-Gene SLIMpro mailbox is used to communicate messages between
  the ARM64 processors and the Cortex M3 (dubbed SLIMpro). It uses a simple
  interrupt based door bell mechanism and can exchange simple messages using the
  internal registers.

properties:
  compatible:
    const: apm,xgene-slimpro-mbox

  reg:
    maxItems: 1

  interrupts:
    items:
      - description: mailbox channel 0 doorbell
      - description: mailbox channel 1 doorbell
      - description: mailbox channel 2 doorbell
      - description: mailbox channel 3 doorbell
      - description: mailbox channel 4 doorbell
      - description: mailbox channel 5 doorbell
      - description: mailbox channel 6 doorbell
      - description: mailbox channel 7 doorbell

  '#mbox-cells':
    description: Number of mailbox channel.
    const: 1

required:
  - compatible
  - reg
  - interrupts
  - '#mbox-cells'

additionalProperties: false

examples:
  - |
    mailbox@10540000 {
        compatible = "apm,xgene-slimpro-mbox";
        reg = <0x10540000 0xa000>;
        #mbox-cells = <1>;
        interrupts = <0x0 0x0 0x4>,
                     <0x0 0x1 0x4>,
                     <0x0 0x2 0x4>,
                     <0x0 0x3 0x4>,
                     <0x0 0x4 0x4>,
                     <0x0 0x5 0x4>,
                     <0x0 0x6 0x4>,
                     <0x0 0x7 0x4>;
    };
```

## Documentation/devicetree/bindings/mailbox/apple,mailbox.yaml
```yaml
# SPDX-License-Identifier: GPL-2.0 OR BSD-2-Clause
%YAML 1.2
---
$id: http://devicetree.org/schemas/mailbox/apple,mailbox.yaml#
$schema: http://devicetree.org/meta-schemas/core.yaml#

title: Apple Mailbox Controller

maintainers:
  - Hector Martin <marcan@marcan.st>
  - Sven Peter <sven@svenpeter.dev>

description:
  The Apple mailbox consists of two FIFOs used to exchange 64+32 bit
  messages between the main CPU and a co-processor. Multiple instances
  of this mailbox can be found on Apple SoCs.
  One of the two FIFOs is used to send data to a co-processor while the other
  FIFO is used for the other direction.
  Various clients implement different IPC protocols based on these simple
  messages and shared memory buffers.

properties:
  compatible:
    oneOf:
      - description:
          ASC mailboxes are the most common variant found on the M1 used
          for example for the display controller, the system management
          controller and the NVMe coprocessor.
        items:
          - enum:
              - apple,t8103-asc-mailbox
              - apple,t8112-asc-mailbox
              - apple,t6000-asc-mailbox
              - apple,t6020-asc-mailbox
          - const: apple,asc-mailbox-v4

      - description:
          An older ASC mailbox interface found on T2 and A11 that is also
          used for the NVMe coprocessor and the system management
          controller.
        items:
          - const: apple,t8015-asc-mailbox

      - description:
          M3 mailboxes are an older variant with a slightly different MMIO
          interface still found on the M1. It is used for the Thunderbolt
          co-processors.
        items:
          - enum:
              - apple,t8103-m3-mailbox
              - apple,t8112-m3-mailbox
              - apple,t6000-m3-mailbox
          - const: apple,m3-mailbox-v2

  reg:
    maxItems: 1

  interrupts:
    items:
      - description: send fifo is empty interrupt
      - description: send fifo is not empty interrupt
      - description: receive fifo is empty interrupt
      - description: receive fifo is not empty interrupt

  interrupt-names:
    items:
      - const: send-empty
      - const: send-not-empty
      - const: recv-empty
      - const: recv-not-empty

  "#mbox-cells":
    const: 0

  power-domains:
    maxItems: 1

required:
  - compatible
  - reg
  - interrupts
  - interrupt-names
  - "#mbox-cells"

additionalProperties: false

examples:
  - |
    mailbox@77408000 {
        compatible = "apple,t8103-asc-mailbox", "apple,asc-mailbox-v4";
        reg = <0x77408000 0x4000>;
        interrupts = <1 583 4>, <1 584 4>, <1 585 4>, <1 586 4>;
        interrupt-names = "send-empty", "send-not-empty",
                          "recv-empty", "recv-not-empty";
        #mbox-cells = <0>;
    };
```

## Documentation/devicetree/bindings/mailbox/arm,mhu.yaml
```yaml
# SPDX-License-Identifier: (GPL-2.0-only OR BSD-2-Clause)
%YAML 1.2
---
$id: http://devicetree.org/schemas/mailbox/arm,mhu.yaml#
$schema: http://devicetree.org/meta-schemas/core.yaml#

title: ARM MHU Mailbox Controller

maintainers:
  - Jassi Brar <jaswinder.singh@linaro.org>

description: |
  The ARM's Message-Handling-Unit (MHU) is a mailbox controller that has 3
  independent channels/links to communicate with remote processor(s).  MHU links
  are hardwired on a platform. A link raises interrupt for any received data.
  However, there is no specified way of knowing if the sent data has been read
  by the remote. This driver assumes the sender polls STAT register and the
  remote clears it after having read the data.  The last channel is specified to
  be a 'Secure' resource, hence can't be used by Linux running NS.

  The MHU hardware also allows operations in doorbell mode. The MHU drives the
  interrupt signal using a 32-bit register, with all 32-bits logically ORed
  together. It provides a set of registers to enable software to set, clear and
  check the status of each of the bits of this register independently. The use
  of 32 bits per interrupt line enables software to provide more information
  about the source of the interrupt. For example, each bit of the register can
  be associated with a type of event that can contribute to raising the
  interrupt. Each of the 32-bits can be used as "doorbell" to alert the remote
  processor.

# We need a select here so we don't match all nodes with 'arm,primecell'
select:
  properties:
    compatible:
      contains:
        enum:
          - arm,mhu
          - arm,mhu-doorbell
  required:
    - compatible

properties:
  compatible:
    oneOf:
      - description: Data transfer mode
        items:
          - const: arm,mhu
          - const: arm,primecell

      - description: Doorbell mode
        items:
          - const: arm,mhu-doorbell
          - const: arm,primecell


  reg:
    maxItems: 1

  interrupts:
    minItems: 2
    items:
      - description: low-priority non-secure
      - description: high-priority non-secure
      - description: Secure

  clocks:
    maxItems: 1

  clock-names:
    items:
      - const: apb_pclk

  '#mbox-cells':
    description: |
      Set to 1 in data transfer mode and represents index of the channel.
      Set to 2 in doorbell mode and represents index of the channel and doorbell
      number.
    enum: [ 1, 2 ]

required:
  - compatible
  - reg
  - interrupts
  - '#mbox-cells'

additionalProperties: false

examples:
  # Data transfer mode.
  - |
    soc {
        #address-cells = <2>;
        #size-cells = <2>;

        mhuA: mailbox@2b1f0000 {
            #mbox-cells = <1>;
            compatible = "arm,mhu", "arm,primecell";
            reg = <0 0x2b1f0000 0 0x1000>;
            interrupts = <0 36 4>, /* LP-NonSecure */
                         <0 35 4>, /* HP-NonSecure */
                         <0 37 4>; /* Secure */
            clocks = <&clock 0 2 1>;
            clock-names = "apb_pclk";
        };
    };

    firmware {
        scpi {
            compatible = "arm,scpi";
            mboxes = <&mhuA 1>; /* HP-NonSecure */
            shmem = <&cpu_scp_hpri>; /* HP-NonSecure */

            scpi_devpd: power-controller {
                compatible = "arm,scpi-power-domains";
                num-domains = <2>;
                #power-domain-cells = <1>;
            };
        };
    };

  # Doorbell mode.
  - |
    soc {
        #address-cells = <2>;
        #size-cells = <2>;

        mhuB: mailbox@2b2f0000 {
            #mbox-cells = <2>;
            compatible = "arm,mhu-doorbell", "arm,primecell";
            reg = <0 0x2b2f0000 0 0x1000>;
            interrupts = <0 36 4>, /* LP-NonSecure */
                         <0 35 4>, /* HP-NonSecure */
                         <0 37 4>; /* Secure */
            clocks = <&clock 0 2 1>;
            clock-names = "apb_pclk";
        };
    };

    firmware {
        scmi {
            compatible = "arm,scmi";
            mboxes = <&mhuB 0 0>, /* LP-NonSecure, 1st doorbell */
                     <&mhuB 0 1>; /* LP-NonSecure, 2nd doorbell */
            mbox-names = "tx", "rx";
            shmem = <&cpu_scp_lpri0>,
                    <&cpu_scp_lpri1>;

            #address-cells = <1>;
            #size-cells = <0>;

            scmi_devpd: protocol@11 {
                reg = <0x11>;
                #power-domain-cells = <1>;
            };

            scmi_dvfs: protocol@13 {
                reg = <0x13>;
                #clock-cells = <1>;

                mboxes = <&mhuB 1 2>, /* HP-NonSecure, 3rd doorbell */
                         <&mhuB 1 3>; /* HP-NonSecure, 4th doorbell */
                mbox-names = "tx", "rx";
                shmem = <&cpu_scp_hpri0>,
                        <&cpu_scp_hpri1>;
            };
        };
    };

...
```
