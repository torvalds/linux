## Documentation/devicetree/bindings/leds/ti,tca6507.yaml
```yaml
# SPDX-License-Identifier: GPL-2.0-only
%YAML 1.2
---
$id: http://devicetree.org/schemas/leds/ti,tca6507.yaml#
$schema: http://devicetree.org/meta-schemas/core.yaml#

title: TCA6507 LED and GPIO controller

maintainers:
  - NeilBrown <neilb@suse.de>

description:
  The TCA6507 is a programmable LED controller connected via I2C that can drive
  7 separate lines either by holding them low, or by pulsing them with modulated
  width.

properties:
  compatible:
    const: ti,tca6507

  reg:
    description: I2C slave address of the controller.
    maxItems: 1

  "#address-cells":
    const: 1

  "#size-cells":
    const: 0

  gpio-controller: true

  "#gpio-cells":
    const: 2

  gpio-line-names: true

patternProperties:
  "^led@[0-6]$":
    type: object
    $ref: common.yaml#
    unevaluatedProperties: false

    properties:
      reg:
        minimum: 0
        maximum: 6

    required:
      - reg

  "^gpio@[0-6]$":
    type: object

    properties:
      compatible:
        const: gpio

      reg:
        minimum: 0
        maximum: 6

    additionalProperties: false

    required:
      - reg
      - compatible

if:
  patternProperties:
    "^gpio@[0-6]$":
      type: object
      properties:
        compatible:
          contains:
            const: gpio
then:
  required:
    - gpio-controller
    - "#gpio-cells"

additionalProperties: false

examples:
  - |

    #include <dt-bindings/gpio/gpio.h>
    #include <dt-bindings/leds/common.h>

    i2c0 {
        #address-cells = <1>;
        #size-cells = <0>;

        led-controller@45 {
            compatible = "ti,tca6507";
            #address-cells = <1>;
            #size-cells = <0>;
            reg = <0x45>;

            gpio-controller;
            #gpio-cells = <2>;

            gpio-line-names = "wifi_reset@6";

            led@0 {
                label = "gta04:red:aux";
                reg = <0x0>;
            };

            led@1 {
                label = "gta04:green:aux";
                reg = <0x1>;
            };

            led@3 {
                reg = <0x3>;
                color = <LED_COLOR_ID_RED>;
                function = LED_FUNCTION_POWER;
                linux,default-trigger = "default-on";
            };

            led@4 {
                color = <LED_COLOR_ID_GREEN>;
                function = LED_FUNCTION_POWER;
                reg = <0x4>;
            };

            gpio@6 {
                compatible = "gpio";
                reg = <0x6>;
            };
        };
    };

...
```

## Documentation/devicetree/bindings/leds/ti,tlc59116.yaml
```yaml
# SPDX-License-Identifier: (GPL-2.0-only OR BSD-2-Clause)
%YAML 1.2
---
$id: http://devicetree.org/schemas/leds/ti,tlc59116.yaml#
$schema: http://devicetree.org/meta-schemas/core.yaml#

title: LEDs connected to tlc59116 or tlc59108

maintainers:
  - Andrew Lunn <andrew@lunn.ch>

properties:
  compatible:
    enum:
      - ti,tlc59108
      - ti,tlc59116

  reg:
    maxItems: 1

  "#address-cells":
    const: 1

  "#size-cells":
    const: 0

patternProperties:
  "^led@[0-9a-f]$":
    type: object
    $ref: common.yaml#
    properties:
      reg:
        items:
          minimum: 0
          maximum: 15

    unevaluatedProperties: false

required:
  - compatible
  - reg
  - "#address-cells"
  - "#size-cells"

allOf:
  - if:
      properties:
        compatible:
          contains:
            const: ti,tlc59108
    then:
      patternProperties:
        "^led@[0-9a-f]$":
          properties:
            reg:
              items:
                maximum: 7

additionalProperties: false

examples:
  - |
    i2c {
        #address-cells = <1>;
        #size-cells = <0>;

        led-controller@68 {
            compatible = "ti,tlc59116";
            reg = <0x68>;
            #address-cells = <1>;
            #size-cells = <0>;

            led@0 {
                reg = <0x0>;
                label = "wrt1900ac:amber:wan";
            };

            led@2 {
                reg = <0x2>;
                label = "wrt1900ac:white:2g";
            };

            led@9 {
                reg = <0x9>;
                label = "wrt1900ac:green:alive";
                linux,default-trigger = "heartbeat";
            };
        };
    };
```

## Documentation/devicetree/bindings/leds/ti,tps61310.yaml
```yaml
# SPDX-License-Identifier: (GPL-2.0-only OR BSD-2-Clause)
%YAML 1.2
---
$id: http://devicetree.org/schemas/leds/ti,tps61310.yaml#
$schema: http://devicetree.org/meta-schemas/core.yaml#

title: Texas Instruments TPS6131X flash LED driver

maintainers:
  - Matthias Fend <matthias.fend@emfend.at>

description: |
  The TPS61310/TPS61311 is a flash LED driver with I2C interface.
  Its power stage is capable of supplying a maximum total current of roughly 1500mA.
  The TPS6131x provides three constant-current sinks, capable of sinking
  up to 2 x 400mA (LED1 and LED3) and 800mA (LED2) in flash mode.
  In torch mode, each sink (LED1, LED2, LED3) supports currents up to 175mA.
  Since the three current sinks share most of the control components such as
  flash timer, control logic, safety timer and the operating mode, they cannot
  be used completely independently of each other. Therefore, only one LED is
  supported, but the current sinks can be combined accordingly.

  The data sheet can be found at:
    https://www.ti.com/lit/ds/symlink/tps61310.pdf

properties:
  compatible:
    oneOf:
      - items:
          - enum:
              - ti,tps61311
          - const: ti,tps61310
      - items:
          - const: ti,tps61310

  reg:
    maxItems: 1

  reset-gpios:
    maxItems: 1
    description: GPIO connected to NRESET pin

  ti,valley-current-limit:
    type: boolean
    description:
      Reduce the valley peak current limit from 1750mA to 1250mA (TPS61310) or
      from 2480mA to 1800mA (TPS61311).

  led:
    type: object
    $ref: common.yaml#
    unevaluatedProperties: false

    properties:
      led-sources:
        minItems: 1
        maxItems: 3
        items:
          enum: [1, 2, 3]

      led-max-microamp:
        oneOf:
          - minimum: 50000
            maximum: 350000
            multipleOf: 50000
          - minimum: 25000
            maximum: 525000
            multipleOf: 25000

      flash-max-microamp:
        oneOf:
          - minimum: 50000
            maximum: 800000
            multipleOf: 50000
          - minimum: 25000
            maximum: 1500000
            multipleOf: 25000

      flash-max-timeout-us:
        enum: [ 5300, 10700, 16000, 21300, 26600, 32000, 37300, 68200, 71500,
                102200, 136300, 170400, 204500, 340800, 579300, 852000 ]

    required:
      - led-sources
      - led-max-microamp
      - flash-max-microamp
      - flash-max-timeout-us

required:
  - compatible
  - reg
  - led

additionalProperties: false

examples:
  - |
    #include <dt-bindings/leds/common.h>
    #include <dt-bindings/gpio/gpio.h>

    i2c {
      #address-cells = <1>;
      #size-cells = <0>;

      led-controller@33 {
        compatible = "ti,tps61311", "ti,tps61310";
        reg = <0x33>;

        reset-gpios = <&gpio1 0 GPIO_ACTIVE_LOW>;

        led {
          function = LED_FUNCTION_FLASH;
          color = <LED_COLOR_ID_WHITE>;
          led-sources = <1>, <2>, <3>;
          led-max-microamp = <525000>;
          flash-max-microamp = <1500000>;
          flash-max-timeout-us = <852000>;
        };
      };
    };
```

## Documentation/devicetree/bindings/leds/ti.lm36922.yaml
```yaml
# SPDX-License-Identifier: (GPL-2.0-only OR BSD-2-Clause)
%YAML 1.2
---
$id: http://devicetree.org/schemas/leds/ti.lm36922.yaml#
$schema: http://devicetree.org/meta-schemas/core.yaml#

title: Texas Instruments - LM3692x Highly Efficient White LED Driver

maintainers:
  - Dan Murphy <dmurphy@ti.com>

description: |
  The LM3692x is an ultra-compact, highly efficient,
  white-LED driver designed for LCD display backlighting.

  The main difference between the LM36922 and LM36923 is the number of
  LED strings it supports. The LM36922 supports two strings while the LM36923
  supports three strings.

  For more product information please see the link below:
  https://www.ti.com/lit/ds/snvsa29/snvsa29.pdf

properties:
  compatible:
    enum:
      - ti,lm36922
      - ti,lm36923

  reg:
    maxItems: 1

  "#address-cells":
    const: 1

  "#size-cells":
    const: 0

  enable-gpios:
    description: gpio pin to enable/disable the device.

  vled-supply:
    description: LED supply

  ti,ovp-microvolt:
    description: Overvoltage protection.
    default: 29000000
    enum: [17000000, 21000000, 25000000, 29000000]

patternProperties:
  '^led@[0-3]$':
    type: object
    $ref: common.yaml
    properties:
      reg:
        enum: [0, 1, 2, 3]
        description: |
          0 - Will enable all LED sync paths
          1 - Will enable the LED1 sync
          2 - Will enable the LED2 sync
          3 - Will enable the LED3 sync (LM36923 only)

    unevaluatedProperties: false

required:
  - compatible
  - reg
  - "#address-cells"
  - "#size-cells"

allOf:
  - if:
      properties:
        compatible:
          contains:
            const: ti,lm36922
    then:
      properties:
        led@3: false

additionalProperties: false

examples:
  - |
    #include <dt-bindings/gpio/gpio.h>
    #include <dt-bindings/leds/common.h>

    i2c {
        #address-cells = <1>;
        #size-cells = <0>;

        led-controller@36 {
            compatible = "ti,lm36922";
            reg = <0x36>;
            #address-cells = <1>;
            #size-cells = <0>;

            enable-gpios = <&gpio1 28 GPIO_ACTIVE_HIGH>;
            vled-supply = <&vbatt>;
            ti,ovp-microvolt = <29000000>;

            led@0 {
                reg = <0>;
                function = LED_FUNCTION_BACKLIGHT;
                color = <LED_COLOR_ID_WHITE>;
                linux,default-trigger = "backlight";
                led-max-microamp = <20000>;
            };
        };
    };
```

## Documentation/devicetree/bindings/leds/trigger-source.yaml
```yaml
# SPDX-License-Identifier: GPL-2.0-only
%YAML 1.2
---
$id: http://devicetree.org/schemas/leds/trigger-source.yaml#
$schema: http://devicetree.org/meta-schemas/core.yaml#

title: Trigger source providers

maintainers:
  - Jacek Anaszewski <jacek.anaszewski@gmail.com>
  - Pavel Machek <pavel@ucw.cz>

description:
  Each trigger source provider should be represented by a device tree node. It
  may be e.g. a USB port or an Ethernet device.

properties:
  '#trigger-source-cells':
    description:
      Number of cells in a source trigger. Typically 0 for nodes of simple
      trigger sources (e.g. a specific USB port).
    enum: [ 0, 1 ]

additionalProperties: true

...
```

## Documentation/devicetree/bindings/loongarch/cpus.yaml
```yaml
# SPDX-License-Identifier: (GPL-2.0-only OR BSD-2-Clause)
%YAML 1.2
---
$id: http://devicetree.org/schemas/loongarch/cpus.yaml#
$schema: http://devicetree.org/meta-schemas/core.yaml#

title: LoongArch CPUs

maintainers:
  - Binbin Zhou <zhoubinbin@loongson.cn>

description:
  This document describes the list of LoongArch CPU cores that support FDT,
  it describe the layout of CPUs in a system through the "cpus" node.

allOf:
  - $ref: /schemas/cpu.yaml#

properties:
  compatible:
    enum:
      - loongson,la264
      - loongson,la364

  reg:
    maxItems: 1

  clocks:
    maxItems: 1

required:
  - compatible
  - reg
  - clocks

unevaluatedProperties: false

examples:
  - |
    #include <dt-bindings/clock/loongson,ls2k-clk.h>

    cpus {
        #size-cells = <0>;
        #address-cells = <1>;

        cpu@0 {
            compatible = "loongson,la264";
            device_type = "cpu";
            reg = <0>;
            clocks = <&clk LOONGSON2_NODE_CLK>;
        };

        cpu@1 {
            compatible = "loongson,la264";
            device_type = "cpu";
            reg = <1>;
            clocks = <&clk LOONGSON2_NODE_CLK>;
        };
    };

...
```

## Documentation/devicetree/bindings/loongarch/loongson.yaml
```yaml
# SPDX-License-Identifier: (GPL-2.0-only OR BSD-2-Clause)
%YAML 1.2
---
$id: http://devicetree.org/schemas/loongarch/loongson.yaml#
$schema: http://devicetree.org/meta-schemas/core.yaml#

title: Loongson SoC-based boards

maintainers:
  - Binbin Zhou <zhoubinbin@loongson.cn>

properties:
  $nodename:
    const: '/'
  compatible:
    oneOf:
      - description: Loongson-2K0500 processor based boards
        items:
          - const: loongson,ls2k0500-ref
          - const: loongson,ls2k0500

      - description: Loongson-2K1000 processor based boards
        items:
          - const: loongson,ls2k1000-ref
          - const: loongson,ls2k1000

      - description: Loongson-2K2000 processor based boards
        items:
          - const: loongson,ls2k2000-ref
          - const: loongson,ls2k2000

additionalProperties: true

...
```

## Documentation/devicetree/bindings/mailbox/allwinner,sun6i-a31-msgbox.yaml
```yaml
# SPDX-License-Identifier: GPL-2.0
%YAML 1.2
---
$id: http://devicetree.org/schemas/mailbox/allwinner,sun6i-a31-msgbox.yaml#
$schema: http://devicetree.org/meta-schemas/core.yaml#

title: Allwinner sunxi Message Box

maintainers:
  - Samuel Holland <samuel@sholland.org>

description: |
  The hardware message box on sun6i, sun8i, sun9i, and sun50i SoCs is a
  two-user mailbox controller containing 8 unidirectional FIFOs. An interrupt
  is raised for received messages, but software must poll to know when a
  transmitted message has been acknowledged by the remote user. Each FIFO can
  hold four 32-bit messages; when a FIFO is full, clients must wait before
  attempting more transmissions.

  Refer to ./mailbox.txt for generic information about mailbox device-tree
  bindings.

properties:
  compatible:
    oneOf:
      - items:
          - enum:
              - allwinner,sun8i-a83t-msgbox
              - allwinner,sun8i-h3-msgbox
              - allwinner,sun9i-a80-msgbox
              - allwinner,sun50i-a64-msgbox
              - allwinner,sun50i-h6-msgbox
          - const: allwinner,sun6i-a31-msgbox
      - const: allwinner,sun6i-a31-msgbox

  reg:
    maxItems: 1

  clocks:
    maxItems: 1
    description: bus clock

  resets:
    maxItems: 1
    description: bus reset

  interrupts:
    maxItems: 1

  '#mbox-cells':
    const: 1
    description: first cell is the channel number (0-7)

required:
  - compatible
  - reg
  - clocks
  - resets
  - interrupts
  - '#mbox-cells'

additionalProperties: false

examples:
  - |
    #include <dt-bindings/clock/sun8i-h3-ccu.h>
    #include <dt-bindings/interrupt-controller/arm-gic.h>
    #include <dt-bindings/reset/sun8i-h3-ccu.h>

    msgbox: mailbox@1c17000 {
            compatible = "allwinner,sun8i-h3-msgbox",
                         "allwinner,sun6i-a31-msgbox";
            reg = <0x01c17000 0x1000>;
            clocks = <&ccu CLK_BUS_MSGBOX>;
            resets = <&ccu RST_BUS_MSGBOX>;
            interrupts = <GIC_SPI 49 IRQ_TYPE_LEVEL_HIGH>;
            #mbox-cells = <1>;
    };

...
```
