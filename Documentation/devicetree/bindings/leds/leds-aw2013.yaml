## Documentation/devicetree/bindings/leds/leds-lm3697.txt
```
* Texas Instruments - LM3697 Highly Efficient White LED Driver

The LM3697 11-bit LED driver provides high-
performance backlight dimming for 1, 2, or 3 series
LED strings while delivering up to 90% efficiency.

This device is suitable for display and keypad lighting

Required properties:
	- compatible:
		"ti,lm3697"
	- reg :  I2C slave address
	- #address-cells : 1
	- #size-cells : 0

Optional properties:
	- enable-gpios : GPIO pin to enable/disable the device
	- vled-supply : LED supply

Required child properties:
	- reg : 0 - LED is Controlled by bank A
		1 - LED is Controlled by bank B
	- led-sources : Indicates which HVLED string is associated to which
			control bank.  This is a zero based property so
			HVLED1 = 0, HVLED2 = 1, HVLED3 = 2.
			Additional information is contained
			in Documentation/devicetree/bindings/leds/common.txt

Optional child properties:
	- ti,brightness-resolution - see Documentation/devicetree/bindings/mfd/ti-lmu.txt
	- ramp-up-us: see Documentation/devicetree/bindings/mfd/ti-lmu.txt
	- ramp-down-us: see Documentation/devicetree/bindings/mfd/ti-lmu.txt
	- label : see Documentation/devicetree/bindings/leds/common.txt
	- linux,default-trigger :
	   see Documentation/devicetree/bindings/leds/common.txt

Example:

HVLED string 1 and 3 are controlled by control bank A and HVLED 2 string is
controlled by control bank B.

led-controller@36 {
	compatible = "ti,lm3697";
	#address-cells = <1>;
	#size-cells = <0>;
	reg = <0x36>;

	enable-gpios = <&gpio1 28 GPIO_ACTIVE_HIGH>;
	vled-supply = <&vbatt>;

	led@0 {
		reg = <0>;
		led-sources = <0 2>;
		ti,brightness-resolution = <2047>;
		ramp-up-us = <5000>;
		ramp-down-us = <1000>;
		label = "white:first_backlight_cluster";
		linux,default-trigger = "backlight";
	};

	led@1 {
		reg = <1>;
		led-sources = <1>;
		ti,brightness-resolution = <255>;
		ramp-up-us = <500>;
		ramp-down-us = <1000>;
		label = "white:second_backlight_cluster";
		linux,default-trigger = "backlight";
	};
}

For more product information please see the link below:
http://www.ti.com/lit/ds/symlink/lm3697.pdf
```

## Documentation/devicetree/bindings/leds/leds-lp50xx.yaml
```yaml
# SPDX-License-Identifier: (GPL-2.0-only OR BSD-2-Clause)
%YAML 1.2
---
$id: http://devicetree.org/schemas/leds/leds-lp50xx.yaml#
$schema: http://devicetree.org/meta-schemas/core.yaml#

title: LED driver for LP50XX RGB LED from Texas Instruments.

maintainers:
  - Dan Murphy <dmurphy@ti.com>

description: |
  The LP50XX is multi-channel, I2C RGB LED Drivers that can group RGB LEDs into
  a LED group or control them individually.

  The difference in these RGB LED drivers is the number of supported RGB
  modules.

  For more product information please see the link below:
  https://www.ti.com/lit/ds/symlink/lp5012.pdf
  https://www.ti.com/lit/ds/symlink/lp5024.pdf
  https://www.ti.com/lit/ds/symlink/lp5036.pdf

properties:
  compatible:
    enum:
      - ti,lp5009
      - ti,lp5012
      - ti,lp5018
      - ti,lp5024
      - ti,lp5030
      - ti,lp5036

  reg:
    maxItems: 1
    description:
      I2C slave address
      lp5009/12 - 0x14, 0x15, 0x16, 0x17
      lp5018/24 - 0x28, 0x29, 0x2a, 0x2b
      lp5030/36 - 0x30, 0x31, 0x32, 0x33

  enable-gpios:
    maxItems: 1
    description: GPIO pin to enable/disable the device.

  vled-supply:
    description: LED supply.

  '#address-cells':
    const: 1

  '#size-cells':
    const: 0

patternProperties:
  '^multi-led@[0-9a-f]$':
    type: object
    allOf:
      - $ref: leds-class-multicolor.yaml#
    properties:
      reg:
        minItems: 1
        maxItems: 12
        description:
          This property denotes the LED module number(s) that is used on the
          for the child node.  The LED modules can either be used stand alone
          or grouped into a module bank.

    patternProperties:
      "(^led-[0-9a-f]$|led)":
        type: object
        $ref: common.yaml#

required:
  - compatible
  - reg

additionalProperties: false

examples:
  - |
   #include <dt-bindings/gpio/gpio.h>
   #include <dt-bindings/leds/common.h>

   i2c {
       #address-cells = <1>;
       #size-cells = <0>;

       led-controller@14 {
           compatible = "ti,lp5009";
           reg = <0x14>;
           #address-cells = <1>;
           #size-cells = <0>;
           enable-gpios = <&gpio1 16>;

           multi-led@1 {
               #address-cells = <1>;
               #size-cells = <0>;
               reg = <0x1>;
               color = <LED_COLOR_ID_RGB>;
               function = LED_FUNCTION_CHARGING;

               led-0 {
                   color = <LED_COLOR_ID_RED>;
               };

               led-1 {
                   color = <LED_COLOR_ID_GREEN>;
               };

               led-2 {
                   color = <LED_COLOR_ID_BLUE>;
               };
          };

          multi-led@2 {
            #address-cells = <1>;
            #size-cells = <2>;
            reg = <0x2 0x3 0x5>;
            color = <LED_COLOR_ID_RGB>;
            function = LED_FUNCTION_STANDBY;

            led-6 {
              color = <LED_COLOR_ID_RED>;
            };

            led-7 {
              color = <LED_COLOR_ID_GREEN>;
            };

            led-8 {
              color = <LED_COLOR_ID_BLUE>;
            };
         };
       };
    };

...
```

## Documentation/devicetree/bindings/leds/leds-lp55xx.txt
```
Binding for TI/National Semiconductor LP55xx Led Drivers

Required properties:
- compatible: "national,lp5521" or "national,lp5523" or "ti,lp5562" or "ti,lp8501"
- reg: I2C slave address
- clock-mode: Input clock mode, (0: automode, 1: internal, 2: external)

Each child has own specific current settings
- led-cur: Current setting at each led channel (mA x10, 0 if led is not connected)
- max-cur: Maximun current at each led channel.

Optional properties:
- label: Used for naming LEDs
- pwr-sel: LP8501 specific property. Power selection for output channels.
         0: D1~9 are connected to VDD
         1: D1~6 with VDD, D7~9 with VOUT
         2: D1~6 with VOUT, D7~9 with VDD
         3: D1~9 are connected to VOUT

Alternatively, each child can have specific channel name
- chan-name: Name of each channel name

example 1) LP5521
3 LED channels, external clock used. Channel names are 'lp5521_pri:channel0',
'lp5521_pri:channel1' and 'lp5521_pri:channel2'

lp5521@32 {
	compatible = "national,lp5521";
	reg = <0x32>;
	label = "lp5521_pri";
	clock-mode = /bits/ 8 <2>;

	chan0 {
		led-cur = /bits/ 8 <0x2f>;
		max-cur = /bits/ 8 <0x5f>;
	};

	chan1 {
		led-cur = /bits/ 8 <0x2f>;
		max-cur = /bits/ 8 <0x5f>;
	};

	chan2 {
		led-cur = /bits/ 8 <0x2f>;
		max-cur = /bits/ 8 <0x5f>;
	};
};

example 2) LP5523
9 LED channels with specific name. Internal clock used.
The I2C slave address is configurable with ASEL1 and ASEL0 pins.
Available addresses are 32/33/34/35h.

ASEL1    ASEL0    Address
-------------------------
 GND      GND       32h
 GND      VEN       33h
 VEN      GND       34h
 VEN      VEN       35h

lp5523@32 {
	compatible = "national,lp5523";
	reg = <0x32>;
	clock-mode = /bits/ 8 <1>;

	chan0 {
		chan-name = "d1";
		led-cur = /bits/ 8 <0x14>;
		max-cur = /bits/ 8 <0x20>;
	};

	chan1 {
		chan-name = "d2";
		led-cur = /bits/ 8 <0x14>;
		max-cur = /bits/ 8 <0x20>;
	};

	chan2 {
		chan-name = "d3";
		led-cur = /bits/ 8 <0x14>;
		max-cur = /bits/ 8 <0x20>;
	};

	chan3 {
		chan-name = "d4";
		led-cur = /bits/ 8 <0x14>;
		max-cur = /bits/ 8 <0x20>;
	};

	chan4 {
		chan-name = "d5";
		led-cur = /bits/ 8 <0x14>;
		max-cur = /bits/ 8 <0x20>;
	};

	chan5 {
		chan-name = "d6";
		led-cur = /bits/ 8 <0x14>;
		max-cur = /bits/ 8 <0x20>;
	};

	chan6 {
		chan-name = "d7";
		led-cur = /bits/ 8 <0x14>;
		max-cur = /bits/ 8 <0x20>;
	};

	chan7 {
		chan-name = "d8";
		led-cur = /bits/ 8 <0x14>;
		max-cur = /bits/ 8 <0x20>;
	};

	chan8 {
		chan-name = "d9";
		led-cur = /bits/ 8 <0x14>;
		max-cur = /bits/ 8 <0x20>;
	};
};

example 3) LP5562
4 channels are defined.

lp5562@30 {
	compatible = "ti,lp5562";
	reg = <0x30>;
	clock-mode = /bits/8 <2>;

	chan0 {
		chan-name = "R";
		led-cur = /bits/ 8 <0x20>;
		max-cur = /bits/ 8 <0x60>;
	};

	chan1 {
		chan-name = "G";
		led-cur = /bits/ 8 <0x20>;
		max-cur = /bits/ 8 <0x60>;
	};

	chan2 {
		chan-name = "B";
		led-cur = /bits/ 8 <0x20>;
		max-cur = /bits/ 8 <0x60>;
	};

	chan3 {
		chan-name = "W";
		led-cur = /bits/ 8 <0x20>;
		max-cur = /bits/ 8 <0x60>;
	};
};

example 4) LP8501
9 channels are defined. The 'pwr-sel' is LP8501 specific property.
Others are same as LP5523.

lp8501@32 {
	compatible = "ti,lp8501";
	reg = <0x32>;
	clock-mode = /bits/ 8 <2>;
	pwr-sel = /bits/ 8 <3>;	/* D1~9 connected to VOUT */

	chan0 {
		chan-name = "d1";
		led-cur = /bits/ 8 <0x14>;
		max-cur = /bits/ 8 <0x20>;
	};

	chan1 {
		chan-name = "d2";
		led-cur = /bits/ 8 <0x14>;
		max-cur = /bits/ 8 <0x20>;
	};

	chan2 {
		chan-name = "d3";
		led-cur = /bits/ 8 <0x14>;
		max-cur = /bits/ 8 <0x20>;
	};

	chan3 {
		chan-name = "d4";
		led-cur = /bits/ 8 <0x14>;
		max-cur = /bits/ 8 <0x20>;
	};

	chan4 {
		chan-name = "d5";
		led-cur = /bits/ 8 <0x14>;
		max-cur = /bits/ 8 <0x20>;
	};

	chan5 {
		chan-name = "d6";
		led-cur = /bits/ 8 <0x14>;
		max-cur = /bits/ 8 <0x20>;
	};

	chan6 {
		chan-name = "d7";
		led-cur = /bits/ 8 <0x14>;
		max-cur = /bits/ 8 <0x20>;
	};

	chan7 {
		chan-name = "d8";
		led-cur = /bits/ 8 <0x14>;
		max-cur = /bits/ 8 <0x20>;
	};

	chan8 {
		chan-name = "d9";
		led-cur = /bits/ 8 <0x14>;
		max-cur = /bits/ 8 <0x20>;
	};
};
```
