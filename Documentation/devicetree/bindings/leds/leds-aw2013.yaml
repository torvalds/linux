## Documentation/devicetree/bindings/leds/leds-aw2013.yaml
```yaml
# SPDX-License-Identifier: (GPL-2.0-only OR BSD-2-Clause)
%YAML 1.2
---
$id: http://devicetree.org/schemas/leds/leds-aw2013.yaml#
$schema: http://devicetree.org/meta-schemas/core.yaml#

title: AWINIC AW2013 3-channel LED Driver

maintainers:
  - Nikita Travkin <nikitos.tr@gmail.com>

description: |
  The AW2013 is a 3-channel LED driver with I2C interface. It can control
  LED brightness with PWM output.

properties:
  compatible:
    const: awinic,aw2013

  reg:
    maxItems: 1

  interrupts:
    maxItems: 1
    description: Open-drain, low active interrupt pin "INTN".
      Used to report completion of operations (power up, LED breath effects).

  vcc-supply:
    description: Regulator providing power to the "VCC" pin.

  vio-supply:
    description: Regulator providing power for pull-up of the I/O lines.
      "VIO1" in the typical application circuit example of the datasheet.
      Note that this regulator does not directly connect to AW2013, but is
      needed for the correct operation of the interrupt and I2C lines.

  "#address-cells":
    const: 1

  "#size-cells":
    const: 0

patternProperties:
  "^led@[0-2]$":
    type: object
    $ref: common.yaml#
    unevaluatedProperties: false

    properties:
      reg:
        description: Index of the LED.
        minimum: 0
        maximum: 2

required:
  - compatible
  - reg
  - "#address-cells"
  - "#size-cells"

additionalProperties: false

examples:
  - |
    #include <dt-bindings/gpio/gpio.h>
    #include <dt-bindings/interrupt-controller/irq.h>
    #include <dt-bindings/leds/common.h>

    i2c {
        #address-cells = <1>;
        #size-cells = <0>;

        led-controller@45 {
            compatible = "awinic,aw2013";
            reg = <0x45>;
            interrupts = <42 IRQ_TYPE_LEVEL_LOW>;
            #address-cells = <1>;
            #size-cells = <0>;

            vcc-supply = <&pm8916_l17>;

            led@0 {
                reg = <0>;
                led-max-microamp = <5000>;
                function = LED_FUNCTION_INDICATOR;
                color = <LED_COLOR_ID_RED>;
            };

            led@1 {
                reg = <1>;
                led-max-microamp = <5000>;
                function = LED_FUNCTION_INDICATOR;
                color = <LED_COLOR_ID_GREEN>;
            };

            led@2 {
                reg = <2>;
                led-max-microamp = <5000>;
                function = LED_FUNCTION_INDICATOR;
                color = <LED_COLOR_ID_BLUE>;
            };
        };
    };
...
```

## Documentation/devicetree/bindings/leds/leds-bcm63138.yaml
```yaml
# SPDX-License-Identifier: GPL-2.0-only OR BSD-2-Clause
%YAML 1.2
---
$id: http://devicetree.org/schemas/leds/leds-bcm63138.yaml#
$schema: http://devicetree.org/meta-schemas/core.yaml#

title: Broadcom's BCM63138 LEDs controller

maintainers:
  - Rafał Miłecki <rafal@milecki.pl>

description: |
  This LEDs controller was first used on BCM63138 and later reused on BCM4908,
  BCM6848, BCM6858, BCM63138, BCM63148, BCM63381 and BCM68360 SoCs.

  It supports up to 32 LEDs that can be connected parallelly or serially. It
  also includes limited support for hardware blinking.

  Binding serially connected LEDs isn't documented yet.

properties:
  compatible:
    oneOf:
      - items:
          - enum:
              - brcm,bcm4908-leds
              - brcm,bcm6848-leds
              - brcm,bcm6858-leds
              - brcm,bcm63148-leds
              - brcm,bcm63381-leds
              - brcm,bcm68360-leds
          - const: brcm,bcm63138-leds
      - const: brcm,bcm63138-leds

  reg:
    maxItems: 1

  "#address-cells":
    const: 1

  "#size-cells":
    const: 0

patternProperties:
  "^led@[a-f0-9]+$":
    type: object

    $ref: common.yaml#

    properties:
      reg:
        maxItems: 1
        description: LED pin number

      active-low:
        type: boolean
        description: Makes LED active low

    required:
      - reg

    unevaluatedProperties: false

required:
  - reg
  - "#address-cells"
  - "#size-cells"

additionalProperties: false

examples:
  - |
    #include <dt-bindings/leds/common.h>

    leds@ff800800 {
        compatible = "brcm,bcm4908-leds", "brcm,bcm63138-leds";
        reg = <0xff800800 0xdc>;

        #address-cells = <1>;
        #size-cells = <0>;

        led@0 {
            reg = <0x0>;
            function = LED_FUNCTION_POWER;
            color = <LED_COLOR_ID_GREEN>;
            default-state = "on";
        };

        led@3 {
            reg = <0x3>;
            function = LED_FUNCTION_STATUS;
            color = <LED_COLOR_ID_GREEN>;
            active-low;
        };
    };
```

## Documentation/devicetree/bindings/leds/leds-bcm6328.txt
```
LEDs connected to Broadcom BCM6328 controller

This controller is present on BCM6318, BCM6328, BCM6362 and BCM63268.
In these SoCs it's possible to control LEDs both as GPIOs or by hardware.
However, on some devices there are Serial LEDs (LEDs connected to a 74x164
controller), which can either be controlled by software (exporting the 74x164
as spi-gpio. See Documentation/devicetree/bindings/gpio/fairchild,74hc595.yaml),
or by hardware using this driver.
Some of these Serial LEDs are hardware controlled (e.g. ethernet LEDs) and
exporting the 74x164 as spi-gpio prevents those LEDs to be hardware
controlled, so the only chance to keep them working is by using this driver.

BCM6328 LED controller has a HWDIS register, which controls whether a LED
should be controlled by a hardware signal instead of the MODE register value,
with 0 meaning hardware control enabled and 1 hardware control disabled. This
is usually 1:1 for hardware to LED signals, but through the activity/link
registers you have some limited control over rerouting the LEDs (as
explained later in brcm,link-signal-sources). Even if a LED is hardware
controlled you are still able to make it blink or light it up if it isn't,
but you can't turn it off if the hardware decides to light it up. For this
reason, hardware controlled LEDs aren't registered as LED class devices.

Required properties:
  - compatible : should be "brcm,bcm6328-leds".
  - #address-cells : must be 1.
  - #size-cells : must be 0.
  - reg : BCM6328 LED controller address and size.

Optional properties:
  - brcm,serial-leds : Boolean, enables Serial LEDs.
    Default : false
  - brcm,serial-mux : Boolean, enables Serial LEDs multiplexing.
    Default : false
  - brcm,serial-clk-low : Boolean, makes clock signal active low.
    Default : false
  - brcm,serial-dat-low : Boolean, makes data signal active low.
    Default : false
  - brcm,serial-shift-inv : Boolean, inverts Serial LEDs shift direction.
    Default : false

Each LED is represented as a sub-node of the brcm,bcm6328-leds device.

LED sub-node required properties:
  - reg : LED pin number (only LEDs 0 to 23 are valid).

LED sub-node optional properties:
  a) Optional properties for sub-nodes related to software controlled LEDs:
    - label : see Documentation/devicetree/bindings/leds/common.txt
    - active-low : Boolean, makes LED active low.
      Default : false
    - default-state : see
      Documentation/devicetree/bindings/leds/common.txt
    - linux,default-trigger : see
      Documentation/devicetree/bindings/leds/common.txt

  b) Optional properties for sub-nodes related to hardware controlled LEDs:
    - brcm,hardware-controlled : Boolean, makes this LED hardware controlled.
      Default : false
    - brcm,link-signal-sources : An array of hardware link
      signal sources. Up to four link hardware signals can get muxed into
      these LEDs. Only valid for LEDs 0 to 7, where LED signals 0 to 3 may
      be muxed to LEDs 0 to 3, and signals 4 to 7 may be muxed to LEDs
      4 to 7. A signal can be muxed to more than one LED, and one LED can
      have more than one source signal.
    - brcm,activity-signal-sources : An array of hardware activity
      signal sources. Up to four activity hardware signals can get muxed into
      these LEDs. Only valid for LEDs 0 to 7, where LED signals 0 to 3 may
      be muxed to LEDs 0 to 3, and signals 4 to 7 may be muxed to LEDs
      4 to 7. A signal can be muxed to more than one LED, and one LED can
      have more than one source signal.

Examples:
Scenario 1 : BCM6328 with 4 EPHY LEDs
	leds0: led-controller@10000800 {
		compatible = "brcm,bcm6328-leds";
		#address-cells = <1>;
		#size-cells = <0>;
		reg = <0x10000800 0x24>;

		alarm_red@2 {
			reg = <2>;
			active-low;
			label = "red:alarm";
		};
		inet_green@3 {
			reg = <3>;
			active-low;
			label = "green:inet";
		};
		power_green@4 {
			reg = <4>;
			active-low;
			label = "green:power";
			default-state = "on";
		};
		ephy0_spd@17 {
			reg = <17>;
			brcm,hardware-controlled;
		};
		ephy1_spd@18 {
			reg = <18>;
			brcm,hardware-controlled;
		};
		ephy2_spd@19 {
			reg = <19>;
			brcm,hardware-controlled;
		};
		ephy3_spd@20 {
			reg = <20>;
			brcm,hardware-controlled;
		};
	};

Scenario 2 : BCM63268 with Serial/GPHY0 LEDs
	leds0: led-controller@10001900 {
		compatible = "brcm,bcm6328-leds";
		#address-cells = <1>;
		#size-cells = <0>;
		reg = <0x10001900 0x24>;
		brcm,serial-leds;
		brcm,serial-dat-low;
		brcm,serial-shift-inv;

		gphy0_spd0@0 {
			reg = <0>;
			brcm,hardware-controlled;
			brcm,link-signal-sources = <0>;
		};
		gphy0_spd1@1 {
			reg = <1>;
			brcm,hardware-controlled;
			brcm,link-signal-sources = <1>;
		};
		inet_red@2 {
			reg = <2>;
			active-low;
			label = "red:inet";
		};
		dsl_green@3 {
			reg = <3>;
			active-low;
			label = "green:dsl";
		};
		usb_green@4 {
			reg = <4>;
			active-low;
			label = "green:usb";
		};
		wps_green@7 {
			reg = <7>;
			active-low;
			label = "green:wps";
		};
		inet_green@8 {
			reg = <8>;
			active-low;
			label = "green:inet";
		};
		ephy0_act@9 {
			reg = <9>;
			brcm,hardware-controlled;
		};
		ephy1_act@10 {
			reg = <10>;
			brcm,hardware-controlled;
		};
		ephy2_act@11 {
			reg = <11>;
			brcm,hardware-controlled;
		};
		gphy0_act@12 {
			reg = <12>;
			brcm,hardware-controlled;
		};
		ephy0_spd@13 {
			reg = <13>;
			brcm,hardware-controlled;
		};
		ephy1_spd@14 {
			reg = <14>;
			brcm,hardware-controlled;
		};
		ephy2_spd@15 {
			reg = <15>;
			brcm,hardware-controlled;
		};
		power_green@20 {
			reg = <20>;
			active-low;
			label = "green:power";
			default-state = "on";
		};
	};

Scenario 3 : BCM6362 with 1 LED for each EPHY
	leds0: led-controller@10001900 {
		compatible = "brcm,bcm6328-leds";
		#address-cells = <1>;
		#size-cells = <0>;
		reg = <0x10001900 0x24>;

		usb@0 {
			reg = <0>;
			brcm,hardware-controlled;
			brcm,link-signal-sources = <0>;
			brcm,activity-signal-sources = <0>;
			/* USB link/activity routed to USB LED */
		};
		inet@1 {
			reg = <1>;
			brcm,hardware-controlled;
			brcm,activity-signal-sources = <1>;
			/* INET activity routed to INET LED */
		};
		ephy0@4 {
			reg = <4>;
			brcm,hardware-controlled;
			brcm,link-signal-sources = <4>;
			/* EPHY0 link routed to EPHY0 LED */
		};
		ephy1@5 {
			reg = <5>;
			brcm,hardware-controlled;
			brcm,link-signal-sources = <5>;
			/* EPHY1 link routed to EPHY1 LED */
		};
		ephy2@6 {
			reg = <6>;
			brcm,hardware-controlled;
			brcm,link-signal-sources = <6>;
			/* EPHY2 link routed to EPHY2 LED */
		};
		ephy3@7 {
			reg = <7>;
			brcm,hardware-controlled;
			brcm,link-signal-sources = <7>;
			/* EPHY3 link routed to EPHY3 LED */
		};
		power_green@20 {
			reg = <20>;
			active-low;
			label = "green:power";
			default-state = "on";
		};
	};

Scenario 4 : BCM6362 with 1 LED for all EPHYs
	leds0: led-controller@10001900 {
		compatible = "brcm,bcm6328-leds";
		#address-cells = <1>;
		#size-cells = <0>;
		reg = <0x10001900 0x24>;

		usb@0 {
			reg = <0>;
			brcm,hardware-controlled;
			brcm,link-signal-sources = <0 1>;
			brcm,activity-signal-sources = <0 1>;
			/* USB/INET link/activity routed to USB LED */
		};
		ephy@4 {
			reg = <4>;
			brcm,hardware-controlled;
			brcm,link-signal-sources = <4 5 6 7>;
			/* EPHY0/1/2/3 link routed to EPHY0 LED */
		};
		power_green@20 {
			reg = <20>;
			active-low;
			label = "green:power";
			default-state = "on";
		};
	};

Scenario 5 : BCM6362 with EPHY LEDs swapped
	leds0: led-controller@10001900 {
		compatible = "brcm,bcm6328-leds";
		#address-cells = <1>;
		#size-cells = <0>;
		reg = <0x10001900 0x24>;

		usb@0 {
			reg = <0>;
			brcm,hardware-controlled;
			brcm,link-signal-sources = <0>;
			brcm,activity-signal-sources = <0 1>;
			/* USB link/act and INET act routed to USB LED */
		};
		ephy0@4 {
			reg = <4>;
			brcm,hardware-controlled;
			brcm,link-signal-sources = <7>;
			/* EPHY3 link routed to EPHY0 LED */
		};
		ephy1@5 {
			reg = <5>;
			brcm,hardware-controlled;
			brcm,link-signal-sources = <6>;
			/* EPHY2 link routed to EPHY1 LED */
		};
		ephy2@6 {
			reg = <6>;
			brcm,hardware-controlled;
			brcm,link-signal-sources = <5>;
			/* EPHY1 link routed to EPHY2 LED */
		};
		ephy3@7 {
			reg = <7>;
			brcm,hardware-controlled;
			brcm,link-signal-sources = <4>;
			/* EPHY0 link routed to EPHY3 LED */
		};
		power_green@20 {
			reg = <20>;
			active-low;
			label = "green:power";
			default-state = "on";
		};
	};
```
