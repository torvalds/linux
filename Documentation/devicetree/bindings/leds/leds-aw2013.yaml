## Documentation/devicetree/bindings/leds/leds-consumer.yaml
```yaml
# SPDX-License-Identifier: (GPL-2.0-only OR BSD-2-Clause)
%YAML 1.2
---
$id: http://devicetree.org/schemas/leds/leds-consumer.yaml#
$schema: http://devicetree.org/meta-schemas/core.yaml#

title: Common leds consumer

maintainers:
  - Aleksandrs Vinarskis <alex@vinarskis.com>

description:
  Some LED defined in DT are required by other DT consumers, for example
  v4l2 subnode may require privacy or flash LED. Unlike trigger-source
  approach which is typically used as 'soft' binding, referencing LED
  devices by phandle makes things simpler when 'hard' binding is desired.

  Document LED properties that its consumers may define.

select: true

properties:
  leds:
    oneOf:
      - type: object
      - $ref: /schemas/types.yaml#/definitions/phandle-array
        description:
          A list of LED device(s) required by a particular consumer.
        items:
          maxItems: 1

  led-names:
    description:
      A list of device name(s). Used to map LED devices to their respective
      functions, when consumer requires more than one LED.

additionalProperties: true

examples:
  - |
    #include <dt-bindings/gpio/gpio.h>
    #include <dt-bindings/leds/common.h>

    leds {
        compatible = "gpio-leds";

        privacy_led: privacy-led {
            color = <LED_COLOR_ID_RED>;
            default-state = "off";
            function = LED_FUNCTION_INDICATOR;
            gpios = <&tlmm 110 GPIO_ACTIVE_HIGH>;
        };
    };

    i2c {
      #address-cells = <1>;
      #size-cells = <0>;

      v4l2_node: camera@36 {
        reg = <0x36>;

        leds = <&privacy_led>;
        led-names = "privacy";
      };
    };

...
```

## Documentation/devicetree/bindings/leds/leds-cpcap.txt
```
Motorola CPCAP PMIC LEDs
------------------------

This module is part of the CPCAP. For more details about the whole
chip see Documentation/devicetree/bindings/mfd/motorola-cpcap.txt.

Requires node properties:
- compatible: should be one of
   * "motorola,cpcap-led-mdl"		(Main Display Lighting)
   * "motorola,cpcap-led-kl"		(Keyboard Lighting)
   * "motorola,cpcap-led-adl"		(Aux Display Lighting)
   * "motorola,cpcap-led-red"		(Red Triode)
   * "motorola,cpcap-led-green"		(Green Triode)
   * "motorola,cpcap-led-blue"		(Blue Triode)
   * "motorola,cpcap-led-cf"		(Camera Flash)
   * "motorola,cpcap-led-bt"		(Bluetooth)
   * "motorola,cpcap-led-cp"		(Camera Privacy LED)
- label: see Documentation/devicetree/bindings/leds/common.txt
- vdd-supply: A phandle to the regulator powering the LED

Example:

&cpcap {
	cpcap_led_red: red-led {
		compatible = "motorola,cpcap-led-red";
		label = "cpcap:red";
		vdd-supply = <&sw5>;
	};
};
```

## Documentation/devicetree/bindings/leds/leds-cr0014114.txt
```
Crane Merchandising System - cr0014114 LED driver
-------------------------------------------------

This LED Board is widely used in vending machines produced
by Crane Merchandising Systems.

Required properties:
- compatible: "crane,cr0014114"

Property rules described in Documentation/devicetree/bindings/spi/spi-bus.txt
apply. In particular, "reg" and "spi-max-frequency" properties must be given.

LED sub-node properties:
- function :
	see Documentation/devicetree/bindings/leds/common.txt
- color :
	see Documentation/devicetree/bindings/leds/common.txt
- label :
	see Documentation/devicetree/bindings/leds/common.txt (deprecated)
- linux,default-trigger : (optional)
	see Documentation/devicetree/bindings/leds/common.txt

Example
-------

#include <dt-bindings/leds/common.h>

led-controller@0 {
	compatible = "crane,cr0014114";
	reg = <0>;
	spi-max-frequency = <50000>;
	#address-cells = <1>;
	#size-cells = <0>;

	led@0 {
		reg = <0>;
		function = "coin";
		color = <LED_COLOR_ID_RED>;
	};
	led@1 {
		reg = <1>;
		function = "coin";
		color = <LED_COLOR_ID_GREEN>;
	};
	led@2 {
		reg = <2>;
		function = "coin";
		color = <LED_COLOR_ID_BLUE>;
	};
	led@3 {
		reg = <3>;
		function = "bill";
		color = <LED_COLOR_ID_RED>;
	};
	led@4 {
		reg = <4>;
		function = "bill";
		color = <LED_COLOR_ID_GREEN>;
	};
	led@5 {
		reg = <5>;
		function = "bill";
		color = <LED_COLOR_ID_BLUE>;
	};
	...
};
```

## Documentation/devicetree/bindings/leds/leds-el15203000.txt
```
Crane Merchandising System - EL15203000 LED driver
--------------------------------------------------

This LED Board (aka RED LEDs board) is widely used in
coffee vending machines produced by Crane Merchandising Systems.
The board manages 3 LEDs and supports predefined blinking patterns
for specific leds.

Vending area LED encoded with symbol 'V' (hex code 0x56).
Doesn't have any hardware blinking pattern.

Screen light tube LED which surrounds vending machine screen and
encoded with symbol 'S' (hex code 0x53). Supports blinking breathing pattern.

Water Pipe LED encoded with symbol 'P' (hex code 0x50) and
actually consists of 5 LEDs that exposed by protocol like one LED.
Supports next patterns:
- cascade pattern
- inversed cascade pattern
- bounce pattern
- inversed bounce pattern

Required properties:
- compatible : "crane,el15203000"
- #address-cells : must be 1
- #size-cells : must be 0

Property rules described in Documentation/devicetree/bindings/spi/spi-bus.txt
apply. In particular, "reg" and "spi-max-frequency" properties must be given.

Optional LED sub-node properties:
- function:
	see Documentation/devicetree/bindings/leds/common.txt
- color:
	see Documentation/devicetree/bindings/leds/common.txt

Example
-------

#include <dt-bindings/leds/common.h>

led-controller@0 {
	compatible = "crane,el15203000";
	reg = <0>;
	spi-max-frequency = <50000>;
	#address-cells = <1>;
	#size-cells = <0>;

	/* water pipe */
	led@50 {
		reg = <0x50>;
		function = "pipe";
		color = <LED_COLOR_ID_RED>;
	};

	/* screen frame */
	led@53 {
		reg = <0x53>;
		function = "screen";
		color = <LED_COLOR_ID_RED>;
	};

	/* vending area */
	led@56 {
		reg = <0x56>;
		function = "vend";
		color = <LED_COLOR_ID_RED>;
	};
};
```

## Documentation/devicetree/bindings/leds/leds-gpio.txt
```
LEDs connected to GPIO lines

Required properties:
- compatible : should be "gpio-leds".

Each LED is represented as a sub-node of the gpio-leds device.  Each
node's name represents the name of the corresponding LED.

LED sub-node properties:
- gpios :  Should specify the LED's GPIO, see "gpios property" in
  Documentation/devicetree/bindings/gpio/gpio.txt.  Active low LEDs should be
  indicated using flags in the GPIO specifier.
- function :  (optional)
  see Documentation/devicetree/bindings/leds/common.txt
- color :  (optional)
  see Documentation/devicetree/bindings/leds/common.txt
- label :  (optional)
  see Documentation/devicetree/bindings/leds/common.txt (deprecated)
- linux,default-trigger :  (optional)
  see Documentation/devicetree/bindings/leds/common.txt
- default-state:  (optional) The initial state of the LED.
  see Documentation/devicetree/bindings/leds/common.txt
- retain-state-suspended: (optional) The suspend state can be retained.Such
  as charge-led gpio.
- retain-state-shutdown: (optional) Retain the state of the LED on shutdown.
  Useful in BMC systems, for example when the BMC is rebooted while the host
  remains up.
- panic-indicator : (optional)
  see Documentation/devicetree/bindings/leds/common.txt

Examples:

#include <dt-bindings/gpio/gpio.h>
#include <dt-bindings/leds/common.h>

leds {
	compatible = "gpio-leds";
	led0 {
		gpios = <&mcu_pio 0 GPIO_ACTIVE_LOW>;
		linux,default-trigger = "disk-activity";
		function = LED_FUNCTION_DISK;
	};

	led1 {
		gpios = <&mcu_pio 1 GPIO_ACTIVE_HIGH>;
		/* Keep LED on if BIOS detected hardware fault */
		default-state = "keep";
		function = LED_FUNCTION_FAULT;
	};
};

run-control {
	compatible = "gpio-leds";
	led0 {
		gpios = <&mpc8572 6 GPIO_ACTIVE_HIGH>;
		color = <LED_COLOR_ID_RED>;
		default-state = "off";
	};
	led1 {
		gpios = <&mpc8572 7 GPIO_ACTIVE_HIGH>;
		color = <LED_COLOR_ID_GREEN>;
		default-state = "on";
	};
};

leds {
	compatible = "gpio-leds";

	led0 {
		gpios = <&gpio1 2 GPIO_ACTIVE_HIGH>;
		linux,default-trigger = "max8903-charger-charging";
		retain-state-suspended;
		function = LED_FUNCTION_CHARGE;
	};
};
```

## Documentation/devicetree/bindings/leds/leds-gpio.yaml
```yaml
# SPDX-License-Identifier: GPL-2.0-only
%YAML 1.2
---
$id: http://devicetree.org/schemas/leds/leds-gpio.yaml#
$schema: http://devicetree.org/meta-schemas/core.yaml#

title: LEDs connected to GPIO lines

maintainers:
  - Jacek Anaszewski <jacek.anaszewski@gmail.com>
  - Pavel Machek <pavel@ucw.cz>

description:
  Each LED is represented as a sub-node of the gpio-leds device.  Each
  node's name represents the name of the corresponding LED.

properties:
  compatible:
    const: gpio-leds

patternProperties:
  # The first form is preferred, but fall back to just 'led' anywhere in the
  # node name to at least catch some child nodes.
  "(^led-[0-9a-f]$|led)":
    type: object

    $ref: common.yaml#

    properties:
      gpios:
        maxItems: 1

      retain-state-suspended:
        description:
          The suspend state can be retained.Such as charge-led gpio.
        type: boolean

      retain-state-shutdown:
        description:
          Retain the state of the LED on shutdown. Useful in BMC systems, for
          example when the BMC is rebooted while the host remains up.
        type: boolean

    required:
      - gpios

additionalProperties: false

examples:
  - |

    #include <dt-bindings/gpio/gpio.h>
    #include <dt-bindings/leds/common.h>

    leds {
        compatible = "gpio-leds";
        led-0 {
            gpios = <&mcu_pio 0 GPIO_ACTIVE_LOW>;
            linux,default-trigger = "disk-activity";
            function = LED_FUNCTION_DISK;
        };

        led-1 {
            gpios = <&mcu_pio 1 GPIO_ACTIVE_HIGH>;
            /* Keep LED on if BIOS detected hardware fault */
            default-state = "keep";
            function = LED_FUNCTION_FAULT;
        };
    };

    run-control {
        compatible = "gpio-leds";
        led-0 {
            gpios = <&mpc8572 6 GPIO_ACTIVE_HIGH>;
            color = <LED_COLOR_ID_RED>;
            default-state = "off";
        };
        led-1 {
            gpios = <&mpc8572 7 GPIO_ACTIVE_HIGH>;
            color = <LED_COLOR_ID_GREEN>;
            default-state = "on";
        };
    };

...
```

## Documentation/devicetree/bindings/leds/leds-group-multicolor.yaml
```yaml
# SPDX-License-Identifier: (GPL-2.0-only OR BSD-2-Clause)
%YAML 1.2
---
$id: http://devicetree.org/schemas/leds/leds-group-multicolor.yaml#
$schema: http://devicetree.org/meta-schemas/core.yaml#

title: Multi-color LED built with monochromatic LEDs

maintainers:
  - Jean-Jacques Hiblot <jjhiblot@traphandler.com>

description: |
  This driver combines several monochromatic LEDs into one multi-color
  LED using the multicolor LED class.

properties:
  compatible:
    const: leds-group-multicolor

  leds: true

required:
  - leds

allOf:
  - $ref: leds-class-multicolor.yaml#

unevaluatedProperties: false

examples:
  - |
    #include <dt-bindings/gpio/gpio.h>
    #include <dt-bindings/leds/common.h>

    monochromatic-leds {
        compatible = "gpio-leds";

        led0: led-0 {
            gpios = <&mcu_pio 0 GPIO_ACTIVE_LOW>;
            color = <LED_COLOR_ID_RED>;
        };

        led1: led-1 {
            gpios = <&mcu_pio 1 GPIO_ACTIVE_HIGH>;
            color = <LED_COLOR_ID_GREEN>;
        };

        led2: led-2 {
            gpios = <&mcu_pio 2 GPIO_ACTIVE_HIGH>;
            color = <LED_COLOR_ID_BLUE>;
        };
    };

    multi-led {
        compatible = "leds-group-multicolor";
        color = <LED_COLOR_ID_RGB>;
        function = LED_FUNCTION_INDICATOR;
        leds = <&led0>, <&led1>, <&led2>;
    };

...
```

## Documentation/devicetree/bindings/leds/leds-is31fl319x.txt
```
LEDs connected to is31fl319x LED controller chip

Required properties:
- compatible : Should be any of
	"issi,is31fl3190"
	"issi,is31fl3191"
	"issi,is31fl3193"
	"issi,is31fl3196"
	"issi,is31fl3199"
	"si-en,sn3199".
- #address-cells: Must be 1.
- #size-cells: Must be 0.
- reg: 0x64, 0x65, 0x66, or 0x67.

Optional properties:
- audio-gain-db : audio gain selection for external analog modulation input.
	Valid values: 0 - 21, step by 3 (rounded down)
	Default: 0
- shutdown-gpios : Specifier of the GPIO connected to SDB pin of the chip.

Each led is represented as a sub-node of the issi,is31fl319x device.
There can be less leds subnodes than the chip can support but not more.

Required led sub-node properties:
- reg : number of LED line
	Valid values: 1 - number of leds supported by the chip variant.

Optional led sub-node properties:
- label : see Documentation/devicetree/bindings/leds/common.txt.
- linux,default-trigger :
	see Documentation/devicetree/bindings/leds/common.txt.
- led-max-microamp : (optional)
	Valid values: 5000 - 40000, step by 5000 (rounded down)
	Default: 20000 (20 mA)
	Note: a driver will take the lowest of all led limits since the
	chip has a single global setting. The lowest value will be chosen
	due to the PWM specificity, where lower brightness is achieved
	by reducing the dury-cycle of pulses and not the current, which
	will always have its peak value equal to led-max-microamp.

Examples:

fancy_leds: leds@65 {
	compatible = "issi,is31fl3196";
	#address-cells = <1>;
	#size-cells = <0>;
	reg = <0x65>;
	shutdown-gpios = <&gpio0 11 GPIO_ACTIVE_HIGH>;

	red_aux: led@1 {
		label = "red:aux";
		reg = <1>;
		led-max-microamp = <10000>;
	};

	green_power: led@5 {
		label = "green:power";
		reg = <5>;
		linux,default-trigger = "default-on";
	};
};
```

## Documentation/devicetree/bindings/leds/leds-is31fl32xx.txt
```
Binding for ISSI IS31FL32xx and Si-En SN32xx LED Drivers

The IS31FL32xx/SN32xx family of LED drivers are I2C devices with multiple
constant-current channels, each with independent 256-level PWM control.
Each LED is represented as a sub-node of the device.

Required properties:
- compatible: one of
	issi,is31fl3236
	issi,is31fl3235
	issi,is31fl3218
	issi,is31fl3216
	si-en,sn3218
	si-en,sn3216
- reg: I2C slave address
- address-cells : must be 1
- size-cells : must be 0

LED sub-node properties:
- reg : LED channel number (1..N)
- label :  (optional)
  see Documentation/devicetree/bindings/leds/common.txt
- linux,default-trigger :  (optional)
  see Documentation/devicetree/bindings/leds/common.txt


Example:

is31fl3236: led-controller@3c {
	compatible = "issi,is31fl3236";
	reg = <0x3c>;
	#address-cells = <1>;
	#size-cells = <0>;

	led@1 {
		reg = <1>;
		label = "EB:blue:usr0";
	};
	led@2 {
		reg = <2>;
		label = "EB:blue:usr1";
	};
	...
	led@36 {
		reg = <36>;
		label = "EB:blue:usr35";
	};
};

For more product information please see the links below:
http://www.issi.com/US/product-analog-fxled-driver.shtml
http://www.si-en.com/product.asp?parentid=890
```
