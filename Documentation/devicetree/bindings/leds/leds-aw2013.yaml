## Documentation/devicetree/bindings/leds/leds-ktd2692.txt
```
* Kinetic Technologies - KTD2692 Flash LED Driver

KTD2692 is the ideal power solution for high-power flash LEDs.
It uses ExpressWire single-wire programming for maximum flexibility.

The ExpressWire interface through CTRL pin can control LED on/off and
enable/disable the IC, Movie(max 1/3 of Flash current) / Flash mode current,
Flash timeout, LVP(low voltage protection).

Also, When the AUX pin is pulled high while CTRL pin is high,
LED current will be ramped up to the flash-mode current level.

Required properties:
- compatible : Should be "kinetic,ktd2692".
- ctrl-gpios : Specifier of the GPIO connected to CTRL pin.
- aux-gpios : Specifier of the GPIO connected to AUX pin.

Optional properties:
- vin-supply : "vin" LED supply (2.7V to 5.5V).
  See Documentation/devicetree/bindings/regulator/regulator.txt

A discrete LED element connected to the device must be represented by a child
node - See Documentation/devicetree/bindings/leds/common.txt

Required properties for flash LED child nodes:
  See Documentation/devicetree/bindings/leds/common.txt
- led-max-microamp : Minimum Threshold for Timer protection
  is defined internally (Maximum 300mA).
- flash-max-microamp : Flash LED maximum current
  Formula : I(mA) = 15000 / Rset.
- flash-max-timeout-us : Flash LED maximum timeout.

Optional properties for flash LED child nodes:
- label : See Documentation/devicetree/bindings/leds/common.txt

Example:

ktd2692 {
	compatible = "kinetic,ktd2692";
	ctrl-gpios = <&gpc0 1 0>;
	aux-gpios = <&gpc0 2 0>;
	vin-supply = <&vbat>;

	flash-led {
		label = "ktd2692-flash";
		led-max-microamp = <300000>;
		flash-max-microamp = <1500000>;
		flash-max-timeout-us = <1835000>;
	};
};
```

## Documentation/devicetree/bindings/leds/leds-lgm.yaml
```yaml
# SPDX-License-Identifier: (GPL-2.0-only OR BSD-2-Clause)
%YAML 1.2
---
$id: http://devicetree.org/schemas/leds/leds-lgm.yaml#
$schema: http://devicetree.org/meta-schemas/core.yaml#

title: Intel Lightning Mountain (LGM) SoC LED Serial Shift Output (SSO) Controller driver

maintainers:
  - Zhu, Yi Xin <Yixin.zhu@intel.com>
  - Amireddy Mallikarjuna reddy <mallikarjunax.reddy@intel.com>

properties:
  compatible:
    const: intel,lgm-ssoled

  gpio-controller: true

  '#gpio-cells':
    const: 2

  ngpios:
    minimum: 0
    maximum: 32
    description:
      Number of GPIOs this controller provides.

  intel,sso-update-rate-hz:
    description:
      Blink frequency for SOUTs in Hz.

  led-controller:
    type: object
    description:
      This sub-node must contain a sub-node for each leds.

    additionalProperties: false

    patternProperties:
      "^led@[0-23]$":
        type: object

        properties:
          reg:
            description: Index of the LED.
            minimum: 0
            maximum: 2

          intel,sso-hw-trigger:
            type: boolean
            description: This property indicates Hardware driven/control LED.

          intel,sso-hw-blink:
            type: boolean
            description: This property indicates Enable LED blink by Hardware.

          intel,sso-blink-rate-hz:
            description: LED HW blink frequency.

          retain-state-suspended:
            type: boolean
            description: The suspend state of LED can be retained.

          retain-state-shutdown:
            type: boolean
            description: Retain the state of the LED on shutdown.

required:
  - compatible
  - reg
  - clocks
  - clock-names
  - "#gpio-cells"
  - gpio-controller

additionalProperties: false

examples:
  - |
    #include <dt-bindings/clock/intel,lgm-clk.h>
    #include <dt-bindings/leds/common.h>

    ssogpio: ssogpio@e0d40000 {
      compatible = "intel,sso-led";
      reg = <0xE0D40000 0x2E4>;
      gpio-controller;
      #gpio-cells = <2>;
      ngpios = <32>;
      pinctrl-names = "default";
      pinctrl-0 = <&pinctrl_ledc>;
      clocks = <&cgu0 LGM_GCLK_LEDC0>, <&afeclk>;
      clock-names = "sso", "fpid";
      intel,sso-update-rate-hz = <250000>;

      led-controller {
        #address-cells = <1>;
        #size-cells = <0>;

        led@0 {
          reg = <0>;
          function = "gphy";
          color = <LED_COLOR_ID_GREEN>;
          led-gpio = <&ssogpio 0 0>;
        };

        led@23 {
          reg = <23>;
          function = LED_FUNCTION_POWER;
          color = <LED_COLOR_ID_GREEN>;
          led-gpio = <&ssogpio 23 0>;
        };
      };
    };
```

## Documentation/devicetree/bindings/leds/leds-lm3532.txt
```
* Texas Instruments - lm3532 White LED driver with ambient light sensing
capability.

The LM3532 provides the 3 high-voltage, low-side current sinks. The device is
programmable over an I2C-compatible interface and has independent
current control for all three channels. The adaptive current regulation
method allows for different LED currents in each current sink thus allowing
for a wide variety of backlight and keypad applications.

The main features of the LM3532 include dual ambient light sensor inputs
each with 32 internal voltage setting resistors, 8-bit logarithmic and linear
brightness control, dual external PWM brightness control inputs, and up to
1000:1 dimming ratio with programmable fade in and fade out settings.

Required properties:
	- compatible : "ti,lm3532"
	- reg : I2C slave address
	- #address-cells : 1
	- #size-cells : 0

Optional properties:
	- enable-gpios : gpio pin to enable (active high)/disable the device.
	- ramp-up-us - The Run time ramp rates/step are from one current
		       set-point to another after the device has reached its
		       initial target set point from turn-on
	- ramp-down-us - The Run time ramp rates/step are from one current
			 set-point to another after the device has reached its
			 initial target set point from turn-on
	Range for ramp settings: 8us - 65536us

Optional properties if ALS mode is used:
	- ti,als-vmin - Minimum ALS voltage defined in Volts
	- ti,als-vmax - Maximum ALS voltage defined in Volts
	Per the data sheet the max ALS voltage is 2V and the min is 0V

	- ti,als1-imp-sel - ALS1 impedance resistor selection in Ohms
	- ti,als2-imp-sel - ALS2 impedance resistor selection in Ohms
	Range for impedance select: 37000 Ohms - 1190 Ohms
	Values above 37kohms will be set to the "High Impedance" setting

	- ti,als-avrg-time-us - Determines the length of time the device needs to
			  average the two ALS inputs.  This is only used if
			  the input mode is LM3532_ALS_INPUT_AVRG.
			     Range: 17920us - 2293760us
	- ti,als-input-mode - Determines how the device uses the attached ALS
			   devices.
			   0x00 - ALS1 and ALS2 input average
			   0x01 - ALS1 Input
			   0x02 - ALS2 Input
			   0x03 - Max of ALS1 and ALS2

Required child properties:
	- reg : Indicates control bank the LED string is controlled by
	- led-sources : see Documentation/devicetree/bindings/leds/common.txt
	- ti,led-mode : Defines if the LED strings are manually controlled or
			if the LED strings are controlled by the ALS.
			0x00 - LED strings are I2C controlled via full scale
			       brightness control register
			0x01 - LED strings are ALS controlled

Optional LED child properties:
	- label : see Documentation/devicetree/bindings/leds/common.txt
	- linux,default-trigger :
	   see Documentation/devicetree/bindings/leds/common.txt
	- led-max-microamp : Defines the full scale current value for each control
			  bank.  The range is from 5000uA-29800uA in increments
			  of 800uA.

Example:
led-controller@38 {
	compatible = "ti,lm3532";
	#address-cells = <1>;
	#size-cells = <0>;
	reg = <0x38>;

	enable-gpios = <&gpio6 12 GPIO_ACTIVE_HIGH>;
	ramp-up-us = <1024>;
	ramp-down-us = <65536>;

	ti,als-vmin = <0>;
	ti,als-vmax = <2000>;
	ti,als1-imp-sel = <4110>;
	ti,als2-imp-sel = <2180>;
	ti,als-avrg-time-us = <17920>;
	ti,als-input-mode = <0x00>;

	led@0 {
		reg = <0>;
		led-sources = <2>;
		ti,led-mode = <1>;
		led-max-microamp = <21800>;
		label = ":backlight";
		linux,default-trigger = "backlight";
	};

	led@1 {
		reg = <1>;
		led-sources = <1>;
		ti,led-mode = <0>;
		label = ":kbd_backlight";
	};
};

For more product information please see the links below:
https://www.ti.com/product/LM3532
```

## Documentation/devicetree/bindings/leds/leds-lm3601x.txt
```
* Texas Instruments - lm3601x Single-LED Flash Driver

The LM3601X are ultra-small LED flash drivers that
provide a high level of adjustability.

Required properties:
	- compatible : Can be one of the following
		"ti,lm36010"
		"ti,lm36011"
	- reg : I2C slave address
	- #address-cells : 1
	- #size-cells : 0

Required child properties:
	- reg : 0 - Indicates a IR mode
		1 - Indicates a Torch (white LED) mode

Required properties for flash LED child nodes:
	See Documentation/devicetree/bindings/leds/common.txt
	- flash-max-microamp : Range from 11mA - 1.5A
	- flash-max-timeout-us : Range from 40ms - 1600ms
	- led-max-microamp : Range from 2.4mA - 376mA

Optional child properties:
	- function : see Documentation/devicetree/bindings/leds/common.txt
	- color : see Documentation/devicetree/bindings/leds/common.txt
	- label : see Documentation/devicetree/bindings/leds/common.txt (deprecated)

Example:

#include <dt-bindings/leds/common.h>

led-controller@64 {
	compatible = "ti,lm36010";
	#address-cells = <1>;
	#size-cells = <0>;
	reg = <0x64>;

	led@0 {
		reg = <1>;
		function = LED_FUNCTION_TORCH;
		color = <LED_COLOR_ID_WHITE>;
		led-max-microamp = <376000>;
		flash-max-microamp = <1500000>;
		flash-max-timeout-us = <1600000>;
	};
}

For more product information please see the links below:
http://www.ti.com/product/LM36010
http://www.ti.com/product/LM36011
```

## Documentation/devicetree/bindings/leds/leds-lm36274.txt
```
* Texas Instruments LM36274 4-Channel LCD Backlight Driver w/Integrated Bias

The LM36274 is an integrated four-channel WLED driver and LCD bias supply.
The backlight boost provides the power to bias four parallel LED strings with
up to 29V total output voltage. The 11-bit LED current is programmable via
the I2C bus and/or controlled via a logic level PWM input from 60 uA to 30 mA.

Parent device properties are documented in
Documentation/devicetree/bindings/mfd/ti-lmu.txt

Regulator properties are documented in
Documentation/devicetree/bindings/regulator/lm363x-regulator.txt

Required backlight properties:
	- compatible:
		"ti,lm36274-backlight"
	- reg : 0
	- #address-cells : 1
	- #size-cells : 0
	- led-sources : Indicates which LED strings will be enabled.
			Values from 0-3, sources is 0 based so strings will be
			source value + 1.

Optional backlight properties:
	- label : see Documentation/devicetree/bindings/leds/common.txt
	- linux,default-trigger :
	   see Documentation/devicetree/bindings/leds/common.txt

Example:

HVLED string 1 and 3 are controlled by control bank A and HVLED 2 string is
controlled by control bank B.

lm36274@11 {
	compatible = "ti,lm36274";
	#address-cells = <1>;
	#size-cells = <0>;
	reg = <0x11>;

	enable-gpios = <&gpio1 28 GPIO_ACTIVE_HIGH>;

	regulators {
		#address-cells = <1>;
		#size-cells = <0>;
		compatible = "ti,lm363x-regulator";

		enable-gpios = <&pioC 0 GPIO_ACTIVE_HIGH>,
			       <&pioC 1 GPIO_ACTIVE_HIGH>;

		vboost {
			regulator-name = "lcd_boost";
			regulator-min-microvolt = <4000000>;
			regulator-max-microvolt = <7150000>;
			regulator-always-on;
		};

		vpos {
			regulator-name = "lcd_vpos";
			regulator-min-microvolt = <4000000>;
			regulator-max-microvolt = <6500000>;
		};

		vneg {
			regulator-name = "lcd_vneg";
			regulator-min-microvolt = <4000000>;
			regulator-max-microvolt = <6500000>;
		};
	};

	backlight {
		#address-cells = <1>;
		#size-cells = <0>;
		compatible = "ti,lm36274-backlight";

		led@0 {
			reg = <0>;
			led-sources = <0 2>;
			label = "white:backlight_cluster";
			linux,default-trigger = "backlight";
		};
	};
};

For more product information please see the link below:
https://www.ti.com/lit/ds/symlink/lm36274.pdf
```

## Documentation/devicetree/bindings/leds/leds-lm3692x.txt
```
* Texas Instruments - LM3692x Highly Efficient White LED Driver

The LM3692x is an ultra-compact, highly efficient,
white-LED driver designed for LCD display backlighting.

The main difference between the LM36922 and LM36923 is the number of
LED strings it supports.  The LM36922 supports two strings while the LM36923
supports three strings.

Required properties:
	- compatible:
		"ti,lm36922"
		"ti,lm36923"
	- reg :  I2C slave address
	- #address-cells : 1
	- #size-cells : 0

Optional properties:
	- enable-gpios : gpio pin to enable/disable the device.
	- vled-supply : LED supply
	- ti,ovp-microvolt: Overvoltage protection in
	    micro-volt, can be 17000000, 21000000, 25000000 or
	    29000000. If ti,ovp-microvolt is not specified it
	    defaults to 29000000.

Required child properties:
	- reg : 0 - Will enable all LED sync paths
		1 - Will enable the LED1 sync
		2 - Will enable the LED2 sync
		3 - Will enable the LED3 sync (LM36923 only)

Optional child properties:
	- function : see Documentation/devicetree/bindings/leds/common.txt
	- color : see Documentation/devicetree/bindings/leds/common.txt
	- label : see Documentation/devicetree/bindings/leds/common.txt (deprecated)
	- linux,default-trigger :
	   see Documentation/devicetree/bindings/leds/common.txt
	- led-max-microamp :
	   see Documentation/devicetree/bindings/leds/common.txt

Example:

#include <dt-bindings/leds/common.h>

led-controller@36 {
	compatible = "ti,lm3692x";
	reg = <0x36>;
	#address-cells = <1>;
	#size-cells = <0>;

	enable-gpios = <&gpio1 28 GPIO_ACTIVE_HIGH>;
	vled-supply = <&vbatt>;
	ti,ovp-microvolt = <29000000>;

	led@0 {
		reg = <0>;
		function = LED_FUNCTION_BACKLIGHT;
		color = <LED_COLOR_ID_WHITE>;
		linux,default-trigger = "backlight";
		led-max-microamp = <20000>;
	};
}

For more product information please see the link below:
http://www.ti.com/lit/ds/snvsa29/snvsa29.pdf
```
