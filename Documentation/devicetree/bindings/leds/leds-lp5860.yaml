## Documentation/devicetree/bindings/leds/leds-lp5860.yaml
```yaml
# SPDX-License-Identifier: (GPL-2.0-only OR BSD-2-Clause)
%YAML 1.2
---
$id: http://devicetree.org/schemas/leds/leds-lp5860.yaml#
$schema: http://devicetree.org/meta-schemas/core.yaml#

title: LED driver for LP5860 RGB LED from Texas Instruments.

maintainers:
  - Steffen Trumtrar <kernel@pengutronix.de>

description: |
  The LP5860 is multi-channel, I2C and SPI RGB LED Driver that can group RGB LEDs
  into a LED group or control them individually.

  For more product information please see the link below:
  https://www.ti.com/lit/ds/symlink/lp5860.pdf

allOf:
  - $ref: /schemas/spi/spi-peripheral-props.yaml#

properties:
  compatible:
    enum:
      - ti,lp5860

  reg:
    maxItems: 1

  '#address-cells':
    const: 1

  '#size-cells':
    const: 0

patternProperties:
  '^multi-led@[0-9a-f]+$':
    type: object
    $ref: leds-class-multicolor.yaml#
    unevaluatedProperties: false

    properties:
      reg:
        minimum: 0
        maximum: 198
        description:
          This property denotes the LED module number that is used
          for the child node.

      '#address-cells':
        const: 1

      '#size-cells':
        const: 0

    patternProperties:
      "^led@[0-9a-f]+$":
        type: object
        $ref: common.yaml#
        unevaluatedProperties: false

        properties:
          reg:
            maxItems: 1

        required:
          - reg

required:
  - compatible
  - reg

unevaluatedProperties: false

examples:
  - |
    #include <dt-bindings/leds/common.h>

    spi {
        #address-cells = <1>;
        #size-cells = <0>;

        led-controller@0 {
            compatible = "ti,lp5860";
            reg = <0x0>;
            #address-cells = <1>;
            #size-cells = <0>;

            multi-led@0 {
                #address-cells = <1>;
                #size-cells = <0>;
                reg = <0x0>;
                color = <LED_COLOR_ID_RGB>;

                led@0 {
                     reg = <0x0>;
                     color = <LED_COLOR_ID_RED>;
                };

                led@1 {
                     reg = <0x1>;
                     color = <LED_COLOR_ID_GREEN>;
                };

                led@2 {
                     reg = <0x2>;
                     color = <LED_COLOR_ID_BLUE>;
                };
            };
        };
    };
```

## Documentation/devicetree/bindings/leds/leds-lp8860.txt
```
* Texas Instruments - lp8860 4-Channel LED Driver

The LP8860-Q1 is an high-efficiency LED
driver with boost controller. It has 4 high-precision
current sinks that can be controlled by a PWM input
signal, a SPI/I2C master, or both.

Required properties:
	- compatible :
		"ti,lp8860"
	- reg : I2C slave address
	- #address-cells : 1
	- #size-cells : 0

Optional properties:
	- enable-gpios : gpio pin to enable (active high)/disable the device.
	- vled-supply : LED supply

Required child properties:
	- reg : 0

Optional child properties:
	- function : see Documentation/devicetree/bindings/leds/common.txt
	- color : see Documentation/devicetree/bindings/leds/common.txt
	- label : see Documentation/devicetree/bindings/leds/common.txt (deprecated)
	- linux,default-trigger :
	   see Documentation/devicetree/bindings/leds/common.txt

Example:

#include <dt-bindings/leds/common.h>

led-controller@2d {
	compatible = "ti,lp8860";
	#address-cells = <1>;
	#size-cells = <0>;
	reg = <0x2d>;
	enable-gpios = <&gpio1 28 GPIO_ACTIVE_HIGH>;
	vled-supply = <&vbatt>;

	led@0 {
		reg = <0>;
		function = LED_FUNCTION_BACKLIGHT;
		color = <LED_COLOR_ID_WHITE>;
		linux,default-trigger = "backlight";
	};
}

For more product information please see the link below:
http://www.ti.com/product/lp8860-q1
```

## Documentation/devicetree/bindings/leds/leds-lt3593.txt
```
Bindings for Linear Technologies LT3593 LED controller

Required properties:
- compatible:		Should be "lltc,lt3593".
- lltc,ctrl-gpios:	A handle to the GPIO that is connected to the 'CTRL'
			pin of the chip.

The hardware supports only one LED. The properties of this LED are
configured in a sub-node in the device node.

Optional sub-node properties:
- function:		See Documentation/devicetree/bindings/leds/common.txt
- color:		See Documentation/devicetree/bindings/leds/common.txt
- label:		A label for the LED. If none is given, the LED will be
			named "lt3595::" (deprecated)
- linux,default-trigger: The default trigger for the LED.
			See Documentation/devicetree/bindings/leds/common.txt
- default-state:	The initial state of the LED.
			See Documentation/devicetree/bindings/leds/common.txt

If multiple chips of this type are found in a design, each one needs to
be handled by its own device node.

Example:

#include <dt-bindings/leds/common.h>

led-controller {
	compatible = "lltc,lt3593";
	lltc,ctrl-gpios = <&gpio 0 GPIO_ACTIVE_HIGH>;

	led {
		function = LED_FUNCTION_BACKLIGHT;
		color = <LED_COLOR_ID_WHITE>;
		default-state = "on";
	};
};
```

## Documentation/devicetree/bindings/leds/leds-max77650.txt
```
LED driver for MAX77650 PMIC from Maxim Integrated.

This module is part of the MAX77650 MFD device. For more details
see Documentation/devicetree/bindings/mfd/max77650.txt.

The LED controller is represented as a sub-node of the PMIC node on
the device tree.

This device has three current sinks.

Required properties:
--------------------
- compatible:		Must be "maxim,max77650-led"
- #address-cells:	Must be <1>.
- #size-cells:		Must be <0>.

Each LED is represented as a sub-node of the LED-controller node. Up to
three sub-nodes can be defined.

Required properties of the sub-node:
------------------------------------

- reg:			Must be <0>, <1> or <2>.

Optional properties of the sub-node:
------------------------------------

- label:		See Documentation/devicetree/bindings/leds/common.txt
- linux,default-trigger: See Documentation/devicetree/bindings/leds/common.txt

For more details, please refer to the generic GPIO DT binding document
<devicetree/bindings/gpio/gpio.txt>.

Example:
--------

	leds {
		compatible = "maxim,max77650-led";
		#address-cells = <1>;
		#size-cells = <0>;

		led@0 {
			reg = <0>;
			label = "blue:usr0";
		};

		led@1 {
			reg = <1>;
			label = "red:usr1";
			linux,default-trigger = "heartbeat";
		};

		led@2 {
			reg = <2>;
			label = "green:usr2";
		};
	};
```

## Documentation/devicetree/bindings/leds/leds-max77650.yaml
```yaml
# SPDX-License-Identifier: GPL-2.0
%YAML 1.2
---
$id: http://devicetree.org/schemas/leds/leds-max77650.yaml#
$schema: http://devicetree.org/meta-schemas/core.yaml#

title: LED driver for MAX77650 PMIC from Maxim Integrated.

maintainers:
  - Bartosz Golaszewski <bgolaszewski@baylibre.com>

description: |
  This module is part of the MAX77650 MFD device. For more details
  see Documentation/devicetree/bindings/mfd/max77650.yaml.

  The LED controller is represented as a sub-node of the PMIC node on
  the device tree.

  This device has three current sinks.

properties:
  compatible:
    const: maxim,max77650-led

  "#address-cells":
    const: 1

  "#size-cells":
    const: 0

patternProperties:
  "^led@[0-2]$":
    type: object
    description: |
      Properties for a single LED.

    properties:
      reg:
        description:
          Index of the LED.
        minimum: 0
        maximum: 2

      label: true

      linux,default-trigger: true

required:
  - compatible
  - "#address-cells"
  - "#size-cells"
additionalProperties: false

...
```

## Documentation/devicetree/bindings/leds/leds-mt6323.txt
```
Device Tree Bindings for LED support on MT6323 PMIC

MT6323 LED controller is subfunction provided by MT6323 PMIC, so the LED
controllers are defined as the subnode of the function node provided by MT6323
PMIC controller that is being defined as one kind of Muti-Function Device (MFD)
using shared bus called PMIC wrapper for each subfunction to access remote
MT6323 PMIC hardware.

For MT6323 MFD bindings see:
Documentation/devicetree/bindings/mfd/mt6397.txt
For MediaTek PMIC wrapper bindings see:
Documentation/devicetree/bindings/soc/mediatek/mediatek,pwrap.yaml

Required properties:
- compatible : Must be one of
  - "mediatek,mt6323-led"
  - "mediatek,mt6331-led"
  - "mediatek,mt6332-led"
- address-cells : Must be 1
- size-cells : Must be 0

Each led is represented as a child node of the mediatek,mt6323-led that
describes the initial behavior for each LED physically and currently only four
LED child nodes can be supported.

Required properties for the LED child node:
- reg : LED channel number (0..3)

Optional properties for the LED child node:
- label : See Documentation/devicetree/bindings/leds/common.txt
- linux,default-trigger : See Documentation/devicetree/bindings/leds/common.txt
- default-state: See Documentation/devicetree/bindings/leds/common.txt

Example:

	mt6323: pmic {
		compatible = "mediatek,mt6323";

		...

		mt6323led: leds {
			compatible = "mediatek,mt6323-led";
			#address-cells = <1>;
			#size-cells = <0>;

			led@0 {
				reg = <0>;
				label = "LED0";
				linux,default-trigger = "timer";
				default-state = "on";
			};
			led@1 {
				reg = <1>;
				label = "LED1";
				default-state = "off";
			};
			led@2 {
				reg = <2>;
				label = "LED2";
				default-state = "on";
			};
		};
	};
```

## Documentation/devicetree/bindings/leds/leds-mt6360.yaml
```yaml
# SPDX-License-Identifier: (GPL-2.0-only OR BSD-2-Clause)
%YAML 1.2
---
$id: http://devicetree.org/schemas/leds/leds-mt6360.yaml#
$schema: http://devicetree.org/meta-schemas/core.yaml#

title: LED driver for MT6360 PMIC from MediaTek Integrated.

maintainers:
  - Gene Chen <gene_chen@richtek.com>

description: |
  This module is part of the MT6360 MFD device.
  see Documentation/devicetree/bindings/mfd/mediatek,mt6360.yaml
  Add MT6360 LED driver include 2-channel Flash LED with torch/strobe mode,
  and 4-channel RGB LED support Register/Flash/Breath Mode

properties:
  compatible:
    const: mediatek,mt6360-led

  "#address-cells":
    const: 1

  "#size-cells":
    const: 0

patternProperties:
  "^multi-led@[0-5]$":
    type: object
    $ref: leds-class-multicolor.yaml#
    unevaluatedProperties: false

    properties:
      reg:
        description: Index of the LED.
        enum:
          - 0 # LED output ISINK1
          - 1 # LED output ISINK2
          - 2 # LED output ISINK3
          - 3 # LED output ISINKML
          - 4 # LED output FLASH1
          - 5 # LED output FLASH2

      "#address-cells":
        const: 1

      "#size-cells":
        const: 0

    patternProperties:
      "^led@[0-2]$":
        type: object
        $ref: common.yaml#
        unevaluatedProperties: false

        properties:
          reg:
            enum: [0, 1, 2]

        required:
          - reg
          - color

    required:
      - reg
      - "#address-cells"
      - "#size-cells"

  "^led@[0-5]$":
    type: object
    $ref: common.yaml#
    unevaluatedProperties: false
    description:
      Properties for a single LED.

    properties:
      reg:
        enum: [0, 1, 2, 3, 4, 5]

required:
  - compatible
  - "#address-cells"
  - "#size-cells"

additionalProperties: false

examples:
  - |
   #include <dt-bindings/leds/common.h>
   led-controller {
     compatible = "mediatek,mt6360-led";
     #address-cells = <1>;
     #size-cells = <0>;

     multi-led@0 {
       reg = <0>;
       function = LED_FUNCTION_INDICATOR;
       color = <LED_COLOR_ID_RGB>;
       led-max-microamp = <24000>;
       #address-cells = <1>;
       #size-cells = <0>;
       led@0 {
         reg = <0>;
         color = <LED_COLOR_ID_RED>;
       };
       led@1 {
         reg = <1>;
         color = <LED_COLOR_ID_GREEN>;
       };
       led@2 {
         reg = <2>;
         color = <LED_COLOR_ID_BLUE>;
       };
     };
     led@3 {
       reg = <3>;
       function = LED_FUNCTION_INDICATOR;
       color = <LED_COLOR_ID_WHITE>;
       led-max-microamp = <150000>;
     };
     led@4 {
       reg = <4>;
       function = LED_FUNCTION_FLASH;
       color = <LED_COLOR_ID_WHITE>;
       function-enumerator = <1>;
       led-max-microamp = <200000>;
       flash-max-microamp = <500000>;
       flash-max-timeout-us = <1024000>;
     };
     led@5 {
       reg = <5>;
       function = LED_FUNCTION_FLASH;
       color = <LED_COLOR_ID_WHITE>;
       function-enumerator = <2>;
       led-max-microamp = <200000>;
       flash-max-microamp = <500000>;
       flash-max-timeout-us = <1024000>;
     };
   };

  - |

   led-controller {
     compatible = "mediatek,mt6360-led";
     #address-cells = <1>;
     #size-cells = <0>;

     led@0 {
       reg = <0>;
       function = LED_FUNCTION_INDICATOR;
       color = <LED_COLOR_ID_RED>;
       led-max-microamp = <24000>;
     };
     led@1 {
       reg = <1>;
       function = LED_FUNCTION_INDICATOR;
       color = <LED_COLOR_ID_GREEN>;
       led-max-microamp = <24000>;
     };
     led@2 {
       reg = <2>;
       function = LED_FUNCTION_INDICATOR;
       color = <LED_COLOR_ID_BLUE>;
       led-max-microamp = <24000>;
     };
     led@3 {
       reg = <3>;
       function = LED_FUNCTION_INDICATOR;
       color = <LED_COLOR_ID_WHITE>;
       led-max-microamp = <150000>;
     };
     led@4 {
       reg = <4>;
       function = LED_FUNCTION_FLASH;
       color = <LED_COLOR_ID_WHITE>;
       function-enumerator = <1>;
       led-max-microamp = <200000>;
       flash-max-microamp = <500000>;
       flash-max-timeout-us = <1024000>;
     };
     led@5 {
       reg = <5>;
       function = LED_FUNCTION_FLASH;
       color = <LED_COLOR_ID_WHITE>;
       function-enumerator = <2>;
       led-max-microamp = <200000>;
       flash-max-microamp = <500000>;
       flash-max-timeout-us = <1024000>;
     };
   };
...
```
