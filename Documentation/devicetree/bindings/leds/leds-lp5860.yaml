## Documentation/devicetree/bindings/leds/leds-tlc591xx.txt
```
LEDs connected to tlc59116 or tlc59108

Required properties
- compatible: should be "ti,tlc59116" or "ti,tlc59108"
- #address-cells: must be 1
- #size-cells: must be 0
- reg: typically 0x68

Each led is represented as a sub-node of the ti,tlc59116.
See Documentation/devicetree/bindings/leds/common.txt

LED sub-node properties:
- reg: number of LED line, 0 to 15 or 0 to 7
- label: (optional) name of LED
- linux,default-trigger : (optional)

Examples:

tlc59116@68 {
	#address-cells = <1>;
	#size-cells = <0>;
	compatible = "ti,tlc59116";
	reg = <0x68>;

	wan@0 {
		label = "wrt1900ac:amber:wan";
		reg = <0x0>;
	};

	2g@2 {
		label = "wrt1900ac:white:2g";
		reg = <0x2>;
	};

	alive@9 {
		label = "wrt1900ac:green:alive";
		reg = <0x9>;
		linux,default_trigger = "heartbeat";
	};
};
```
