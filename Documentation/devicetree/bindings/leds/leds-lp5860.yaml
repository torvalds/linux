## Documentation/devicetree/bindings/leds/leds-netxbig.txt
```
Binding for the CPLD LEDs (GPIO extension bus) found on some LaCie/Seagate
boards (Example: 2Big/5Big Network v2, 2Big NAS).

Required properties:
- compatible: "lacie,netxbig-leds".
- gpio-ext: Phandle for the gpio-ext bus.

Optional properties:
- timers: Timer array. Each timer entry is represented by three integers:
  Mode (gpio-ext bus), delay_on and delay_off.

Each LED is represented as a sub-node of the netxbig-leds device.

Required sub-node properties:
- mode-addr: Mode register address on gpio-ext bus.
- mode-val: Mode to value mapping. Each entry is represented by two integers:
  A mode and the corresponding value on the gpio-ext bus.
- bright-addr: Brightness register address on gpio-ext bus.
- max-brightness: Maximum brightness value.

Optional sub-node properties:
- label: Name for this LED. If omitted, the label is taken from the node name.
- linux,default-trigger: Trigger assigned to the LED.

Example:

netxbig-leds {
	compatible = "lacie,netxbig-leds";

	gpio-ext = &gpio_ext;

	timers = <NETXBIG_LED_TIMER1 500 500
		  NETXBIG_LED_TIMER2 500 1000>;

	blue-power {
		label = "netxbig:blue:power";
		mode-addr = <0>;
		mode-val = <NETXBIG_LED_OFF 0
			    NETXBIG_LED_ON 1
			    NETXBIG_LED_TIMER1 3
			    NETXBIG_LED_TIMER2 7>;
		bright-addr = <1>;
		max-brightness = <7>;
	};
	red-power {
		label = "netxbig:red:power";
		mode-addr = <0>;
		mode-val = <NETXBIG_LED_OFF 0
			    NETXBIG_LED_ON 2
			    NETXBIG_LED_TIMER1 4>;
		bright-addr = <1>;
		max-brightness = <7>;
	};
	blue-sata0 {
		label = "netxbig:blue:sata0";
		mode-addr = <3>;
		mode-val = <NETXBIG_LED_OFF 0
			    NETXBIG_LED_ON 7
			    NETXBIG_LED_SATA 1
			    NETXBIG_LED_TIMER1 3>;
		bright-addr = <2>;
		max-brightness = <7>;
	};
	red-sata0 {
		label = "netxbig:red:sata0";
		mode-addr = <3>;
		mode-val = <NETXBIG_LED_OFF 0
			    NETXBIG_LED_ON 2
			    NETXBIG_LED_TIMER1 4>;
		bright-addr = <2>;
		max-brightness = <7>;
	};
	blue-sata1 {
		label = "netxbig:blue:sata1";
		mode-addr = <4>;
		mode-val = <NETXBIG_LED_OFF 0
			    NETXBIG_LED_ON 7
			    NETXBIG_LED_SATA 1
			    NETXBIG_LED_TIMER1 3>;
		bright-addr = <2>;
		max-brightness = <7>;
	};
	red-sata1 {
		label = "netxbig:red:sata1";
		mode-addr = <4>;
		mode-val = <NETXBIG_LED_OFF 0
			    NETXBIG_LED_ON 2
			    NETXBIG_LED_TIMER1 4>;
		bright-addr = <2>;
		max-brightness = <7>;
	};
};
```

## Documentation/devicetree/bindings/leds/leds-ns2.txt
```
Binding for dual-GPIO LED found on Network Space v2 (and parents).

Required properties:
- compatible: "lacie,ns2-leds".

Each LED is represented as a sub-node of the ns2-leds device.

Required sub-node properties:
- cmd-gpio: Command LED GPIO. See OF device-tree GPIO specification.
- slow-gpio: Slow LED GPIO. See OF device-tree GPIO specification.
- modes-map: A mapping between LED modes (off, on or SATA activity blinking) and
  the corresponding cmd-gpio/slow-gpio values. All the GPIO values combinations
  should be given in order to avoid having an unknown mode at driver probe time.

Optional sub-node properties:
- label: Name for this LED. If omitted, the label is taken from the node name.
- linux,default-trigger: Trigger assigned to the LED.

Example:

#include <dt-bindings/leds/leds-ns2.h>

ns2-leds {
	compatible = "lacie,ns2-leds";

	blue-sata {
		label = "ns2:blue:sata";
		slow-gpio = <&gpio0 29 0>;
		cmd-gpio = <&gpio0 30 0>;
		modes-map = <NS_V2_LED_OFF  0 1
			     NS_V2_LED_ON   1 0
			     NS_V2_LED_ON   0 0
			     NS_V2_LED_SATA 1 1>;
	};
};
```

## Documentation/devicetree/bindings/leds/leds-pca9532.txt
```
*NXP - pca9532 PWM LED Driver

The PCA9532 family is SMBus I/O expander optimized for dimming LEDs.
The PWM support 256 steps.

Required properties:
	- compatible:
		"nxp,pca9530"
		"nxp,pca9531"
		"nxp,pca9532"
		"nxp,pca9533"
	- reg -  I2C slave address

Each led is represented as a sub-node of the nxp,pca9530.

Optional sub-node properties:
	- label: see Documentation/devicetree/bindings/leds/common.txt
	- type: Output configuration, see dt-bindings/leds/leds-pca9532.h (default NONE)
	- linux,default-trigger: see Documentation/devicetree/bindings/leds/common.txt
	- default-state: see Documentation/devicetree/bindings/leds/common.txt
	  This property is only valid for sub-nodes of type <PCA9532_TYPE_LED>.

Example:
  #include <dt-bindings/leds/leds-pca9532.h>

  leds: pca9530@60 {
    compatible = "nxp,pca9530";
    reg = <0x60>;

    red-power {
      label = "pca:red:power";
      type = <PCA9532_TYPE_LED>;
    };
    green-power {
      label = "pca:green:power";
      type = <PCA9532_TYPE_LED>;
    };
    kernel-booting {
      type = <PCA9532_TYPE_LED>;
      default-state = "on";
    };
    sys-stat {
      type = <PCA9532_TYPE_LED>;
      default-state = "keep"; // don't touch, was set by U-Boot
    };
  };

For more product information please see the link below:
http://nxp.com/documents/data_sheet/PCA9532.pdf
```

## Documentation/devicetree/bindings/leds/leds-pca955x.txt
```
* NXP - pca955x LED driver

The PCA955x family of chips are I2C LED blinkers whose pins not used
to control LEDs can be used as general purpose I/Os. The GPIO pins can
be input or output, and output pins can also be pulse-width controlled.

Required properties:
- compatible : should be one of :
	"nxp,pca9550"
	"nxp,pca9551"
	"nxp,pca9552"
	"ibm,pca9552"
	"nxp,pca9553"
- #address-cells: must be 1
- #size-cells: must be 0
- reg: I2C slave address. depends on the model.

Optional properties:
- gpio-controller: allows pins to be used as GPIOs.
- #gpio-cells: must be 2.
- gpio-line-names: define the names of the GPIO lines

LED sub-node properties:
- reg : number of LED line.
		from 0 to  1 for the pca9550
		from 0 to  7 for the pca9551
		from 0 to 15 for the pca9552
		from 0 to  3 for the pca9553
- type: (optional) either
	PCA955X_TYPE_NONE
	PCA955X_TYPE_LED
	PCA955X_TYPE_GPIO
	see dt-bindings/leds/leds-pca955x.h (default to LED)
- label : (optional)
	see Documentation/devicetree/bindings/leds/common.txt
- linux,default-trigger : (optional)
	see Documentation/devicetree/bindings/leds/common.txt

Examples:

pca9552: pca9552@60 {
	compatible = "nxp,pca9552";
	#address-cells = <1>;
        #size-cells = <0>;
	reg = <0x60>;

	gpio-controller;
	#gpio-cells = <2>;
	gpio-line-names = "GPIO12", "GPIO13", "GPIO14", "GPIO15";

	gpio@12 {
		reg = <12>;
		type = <PCA955X_TYPE_GPIO>;
	};
	gpio@13 {
		reg = <13>;
		type = <PCA955X_TYPE_GPIO>;
	};
	gpio@14 {
		reg = <14>;
		type = <PCA955X_TYPE_GPIO>;
	};
	gpio@15 {
		reg = <15>;
		type = <PCA955X_TYPE_GPIO>;
	};

	led@0 {
		label = "red:power";
		linux,default-trigger = "default-on";
		reg = <0>;
		type = <PCA955X_TYPE_LED>;
	};
	led@1 {
		label = "green:power";
		reg = <1>;
		type = <PCA955X_TYPE_LED>;
	};
	led@2 {
		label = "pca9552:yellow";
		reg = <2>;
		type = <PCA955X_TYPE_LED>;
	};
	led@3 {
		label = "pca9552:white";
		reg = <3>;
		type = <PCA955X_TYPE_LED>;
	};
};
```

## Documentation/devicetree/bindings/leds/leds-pm8058.txt
```
Qualcomm PM8058 LED driver

The Qualcomm PM8058 is a multi-functional device which contains
an LED driver block for up to six LEDs: three normal LEDs, two
"flash" LEDs and one "keypad backlight" LED. The names are
quoted because sometimes these LED drivers are used for wildly
different things than flash or keypad backlight: their names
are more of a suggestion than a hard-wired usecase.

Hardware-wise the different LEDs support slightly different
output currents. The "flash" LEDs do not need to charge nor
do they support external triggers. They are just powerful LED
drivers.

The LEDs appear as children to the PM8058 device, with the
proper compatible string. For the PM8058 bindings see:
mfd/qcom-pm8xxx.txt.

Each LED is represented as a sub-node of the syscon device. Each
node's name represents the name of the corresponding LED.

LED sub-node properties:

Required properties:
- compatible: one of
  "qcom,pm8058-led" (for the normal LEDs at 0x131, 0x132 and 0x133)
  "qcom,pm8058-keypad-led" (for the "keypad" LED at 0x48)
  "qcom,pm8058-flash-led" (for the "flash" LEDs at 0x49 and 0xFB)

Optional properties:
- label: see Documentation/devicetree/bindings/leds/common.txt
- default-state: see Documentation/devicetree/bindings/leds/common.txt
- linux,default-trigger: see Documentation/devicetree/bindings/leds/common.txt

Example:

qcom,ssbi@500000 {
	pmicintc: pmic@0 {
		compatible = "qcom,pm8058";
		led@48 {
			compatible = "qcom,pm8058-keypad-led";
			reg = <0x48>;
			label = "pm8050:white:keypad";
			default-state = "off";
		};
		led@131 {
			compatible = "qcom,pm8058-led";
			reg = <0x131>;
			label = "pm8058:red";
			default-state = "off";
		};
		led@132 {
			compatible = "qcom,pm8058-led";
			reg = <0x132>;
			label = "pm8058:yellow";
			default-state = "off";
			linux,default-trigger = "mmc0";
		};
		led@133 {
			compatible = "qcom,pm8058-led";
			reg = <0x133>;
			label = "pm8058:green";
			default-state = "on";
			linux,default-trigger = "heartbeat";
		};
	};
};
```

## Documentation/devicetree/bindings/leds/leds-powernv.txt
```
Device Tree binding for LEDs on IBM Power Systems
-------------------------------------------------

Required properties:
- compatible : Should be "ibm,opal-v3-led".
- led-mode   : Should be "lightpath" or "guidinglight".

Each location code of FRU/Enclosure must be expressed in the
form of a sub-node.

Required properties for the sub nodes:
- led-types : Supported LED types (attention/identify/fault) provided
              in the form of string array.

Example:

leds {
	compatible = "ibm,opal-v3-led";
	led-mode = "lightpath";

	U78C9.001.RST0027-P1-C1 {
		led-types = "identify", "fault";
	};
	...
	...
};
```

## Documentation/devicetree/bindings/leds/leds-pwm-multicolor.yaml
```yaml
# SPDX-License-Identifier: (GPL-2.0-only OR BSD-2-Clause)
%YAML 1.2
---
$id: http://devicetree.org/schemas/leds/leds-pwm-multicolor.yaml#
$schema: http://devicetree.org/meta-schemas/core.yaml#

title: Multi-color LEDs connected to PWM

maintainers:
  - Sven Schwermer <sven.schwermer@disruptive-technologies.com>

description: |
  This driver combines several monochrome PWM LEDs into one multi-color
  LED using the multicolor LED class.

properties:
  compatible:
    const: pwm-leds-multicolor

  multi-led:
    type: object
    $ref: leds-class-multicolor.yaml#
    unevaluatedProperties: false

    properties:
      max-brightness:
        description:
          Maximum brightness possible for the LED
        $ref: /schemas/types.yaml#/definitions/uint32

    patternProperties:
      "^led-[0-9a-z]+$":
        type: object
        $ref: common.yaml#

        additionalProperties: false

        properties:
          pwms:
            maxItems: 1

          pwm-names: true

          active-low: true

          color: true

        required:
          - pwms
          - color

required:
  - compatible

additionalProperties: false

examples:
  - |
    #include <dt-bindings/leds/common.h>

    led-controller {
        compatible = "pwm-leds-multicolor";

        multi-led {
            color = <LED_COLOR_ID_RGB>;
            function = LED_FUNCTION_INDICATOR;
            max-brightness = <65535>;

            led-red {
                pwms = <&pwm1 0 1000000>;
                color = <LED_COLOR_ID_RED>;
            };

            led-green {
                pwms = <&pwm2 0 1000000>;
                color = <LED_COLOR_ID_GREEN>;
            };

            led-blue {
                pwms = <&pwm3 0 1000000>;
                color = <LED_COLOR_ID_BLUE>;
            };
        };
    };

...
```

## Documentation/devicetree/bindings/leds/leds-pwm.txt
```
LED connected to PWM

Required properties:
- compatible : should be "pwm-leds".

Each LED is represented as a sub-node of the pwm-leds device.  Each
node's name represents the name of the corresponding LED.

LED sub-node properties:
- pwms : PWM property to point to the PWM device (phandle)/port (id) and to
  specify the period time to be used: <&phandle id period_ns>;
- pwm-names : (optional) Name to be used by the PWM subsystem for the PWM device
  For the pwms and pwm-names property please refer to:
  Documentation/devicetree/bindings/pwm/pwm.txt
- max-brightness : Maximum brightness possible for the LED
- label :  (optional)
  see Documentation/devicetree/bindings/leds/common.txt
- linux,default-trigger :  (optional)
  see Documentation/devicetree/bindings/leds/common.txt

Example:

twl_pwm: pwm {
	/* provides two PWMs (id 0, 1 for PWM1 and PWM2) */
	compatible = "ti,twl6030-pwm";
	#pwm-cells = <2>;
};

twl_pwmled: pwmled {
	/* provides one PWM (id 0 for Charing indicator LED) */
	compatible = "ti,twl6030-pwmled";
	#pwm-cells = <2>;
};

pwmleds {
	compatible = "pwm-leds";
	kpad {
		label = "omap4::keypad";
		pwms = <&twl_pwm 0 7812500>;
		max-brightness = <127>;
	};

	charging {
		label = "omap4:green:chrg";
		pwms = <&twl_pwmled 0 7812500>;
		max-brightness = <255>;
	};
};
```

## Documentation/devicetree/bindings/leds/leds-pwm.yaml
```yaml
# SPDX-License-Identifier: (GPL-2.0-only OR BSD-2-Clause)
%YAML 1.2
---
$id: http://devicetree.org/schemas/leds/leds-pwm.yaml#
$schema: http://devicetree.org/meta-schemas/core.yaml#

title: LEDs connected to PWM

maintainers:
  - Pavel Machek <pavel@ucw.cz>

description:
  Each LED is represented as a sub-node of the pwm-leds device.  Each
  node's name represents the name of the corresponding LED.

properties:
  compatible:
    const: pwm-leds

patternProperties:
  "^led(-[0-9a-f]+)?$":
    type: object
    $ref: common.yaml#
    unevaluatedProperties: false

    properties:
      pwms:
        maxItems: 1

      pwm-names: true

      max-brightness:
        description:
          Maximum brightness possible for the LED
        $ref: /schemas/types.yaml#/definitions/uint32

    required:
      - pwms
      - max-brightness

additionalProperties: false

examples:
  - |

    #include <dt-bindings/leds/common.h>

    led-controller {
        compatible = "pwm-leds";

        led-1 {
            label = "omap4::keypad";
            pwms = <&twl_pwm 0 7812500>;
            max-brightness = <127>;
        };

        led-2 {
            color = <LED_COLOR_ID_GREEN>;
            function = LED_FUNCTION_CHARGING;
            pwms = <&twl_pwmled 0 7812500>;
            max-brightness = <255>;
        };
    };

...
```
