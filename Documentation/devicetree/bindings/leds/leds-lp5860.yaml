## Documentation/devicetree/bindings/leds/leds-qcom-lpg.txt
```
Binding for Qualcomm Light Pulse Generator

The Qualcomm Light Pulse Generator consists of three different hardware blocks;
a ramp generator with lookup table, the light pulse generator and a three
channel current sink. These blocks are found in a wide range of Qualcomm PMICs.

Required properties:
- compatible: one of:
	      "qcom,pm8916-pwm",
	      "qcom,pm8941-lpg",
	      "qcom,pm8994-lpg",
	      "qcom,pmi8994-lpg",
	      "qcom,pmi8998-lpg",

Optional properties:
- qcom,power-source: power-source used to drive the output, as defined in the
		     datasheet. Should be specified if the TRILED block is
		     present
- qcom,dtest: configures the output into an internal test line of the
	      pmic. Specified by a list of u32 pairs, one pair per channel,
	      where each pair denotes the test line to drive and the second
	      configures how the value should be outputed, as defined in the
	      datasheet
- #pwm-cells: should be 2, see ../pwm/pwm.txt

LED subnodes:
A set of subnodes can be used to specify LEDs connected to the LPG. Channels
not associated with a LED are available as pwm channels, see ../pwm/pwm.txt.

Required properties:
- led-sources: list of channels associated with this LED, starting at 1 for the
	       first LPG channel

Optional properties:
- label: see Documentation/devicetree/bindings/leds/common.txt
- default-state: see Documentation/devicetree/bindings/leds/common.txt
- linux,default-trigger: see Documentation/devicetree/bindings/leds/common.txt

Example:
The following example defines a RGB LED attached to the PM8941.

&spmi_bus {
	pm8941@1 {
		lpg {
			compatible = "qcom,pm8941-lpg";
			qcom,power-source = <1>;

			rgb {
				led-sources = <7 6 5>;
			};
		};
	};
};

The following example defines the single PWM channel of the PM8916, which can
be muxed by the MPP4 as a current sink.

&spmi_bus {
	pm8916@1 {
		pm8916_pwm: pwm {
			compatible = "qcom,pm8916-pwm";

			#pwm-cells = <2>;
		};
	};
};
```

## Documentation/devicetree/bindings/leds/leds-qcom-lpg.yaml
```yaml
# SPDX-License-Identifier: (GPL-2.0-only OR BSD-2-Clause)
%YAML 1.2
---
$id: http://devicetree.org/schemas/leds/leds-qcom-lpg.yaml#
$schema: http://devicetree.org/meta-schemas/core.yaml#

title: Qualcomm Light Pulse Generator

maintainers:
  - Bjorn Andersson <bjorn.andersson@linaro.org>

description: >
  The Qualcomm Light Pulse Generator consists of three different hardware blocks;
  a ramp generator with lookup table (LUT), the light pulse generator and a three
  channel current sink. These blocks are found in a wide range of Qualcomm PMICs.

properties:
  compatible:
    oneOf:
      - enum:
          - qcom,pm660l-lpg
          - qcom,pm8150b-lpg
          - qcom,pm8150l-lpg
          - qcom,pm8350c-pwm
          - qcom,pm8916-pwm
          - qcom,pm8941-lpg
          - qcom,pm8994-lpg
          - qcom,pmc8180c-lpg
          - qcom,pmi632-lpg
          - qcom,pmi8950-pwm
          - qcom,pmi8994-lpg
          - qcom,pmi8998-lpg
          - qcom,pmk8550-pwm
      - items:
          - enum:
              - qcom,pm6150l-lpg
          - const: qcom,pm8150l-lpg
      - items:
          - enum:
              - qcom,pm8550-pwm
          - const: qcom,pm8350c-pwm
      - items:
          - enum:
              - qcom,pm8937-pwm
          - const: qcom,pm8916-pwm

  "#pwm-cells":
    const: 2

  "#address-cells":
    const: 1

  "#size-cells":
    const: 0

  qcom,power-source:
    $ref: /schemas/types.yaml#/definitions/uint32
    description:
      power-source used to drive the output, as defined in the datasheet.
      Should be specified if the TRILED block is present
    enum: [0, 1, 3]

  qcom,dtest:
    $ref: /schemas/types.yaml#/definitions/uint32-matrix
    description: >
      A list of integer pairs, where each pair represent the dtest line the
      particular channel should be connected to and the flags denoting how the
      value should be outputted, as defined in the datasheet. The number of
      pairs should be the same as the number of channels.
    items:
      items:
        - description: dtest line to attach
        - description: flags for the attachment

  nvmem:
    description: >
      This property is required for PMICs that supports PPG, which is when a
      PMIC stores LPG per-channel data and pattern LUT in SDAM modules instead
      of in a LUT peripheral. For PMICs, such as PM8350C, per-channel data
      and pattern LUT is separated into 2 SDAM modules. In that case, phandles
      to both SDAM modules need to be specified.
    minItems: 1
    maxItems: 2

  nvmem-names:
    minItems: 1
    items:
      - const: lpg_chan_sdam
      - const: lut_sdam

  qcom,pbs:
    $ref: /schemas/types.yaml#/definitions/phandle
    description: >
      Phandle of the Qualcomm Programmable Boot Sequencer node (PBS).
      PBS node is used to trigger LPG pattern sequences for PMICs that support
      single SDAM PPG.

  multi-led:
    type: object
    $ref: leds-class-multicolor.yaml#
    unevaluatedProperties: false

    properties:
      "#address-cells":
        const: 1

      "#size-cells":
        const: 0

    patternProperties:
      "^led@[0-9a-f]$":
        type: object
        $ref: common.yaml#
        unevaluatedProperties: false

        properties:
          reg:
            maxItems: 1

        required:
          - reg

patternProperties:
  "^led@[0-9a-f]$":
    type: object
    $ref: common.yaml#
    unevaluatedProperties: false

    properties:
      reg:
        maxItems: 1

    required:
      - reg

required:
  - compatible

additionalProperties: false

allOf:
  - if:
      properties:
        compatible:
          contains:
            enum:
              - qcom,pm660l-lpg
              - qcom,pm8150b-lpg
              - qcom,pm8150l-lpg
              - qcom,pm8916-pwm
              - qcom,pm8941-lpg
              - qcom,pm8994-lpg
              - qcom,pmc8180c-lpg
              - qcom,pmi8950-pwm
              - qcom,pmi8994-lpg
              - qcom,pmi8998-lpg
              - qcom,pmk8550-pwm
    then:
      properties:
        nvmem: false
        nvmem-names: false

  - if:
      properties:
        compatible:
          contains:
            const: qcom,pmi632-lpg
    then:
      properties:
        nvmem:
          maxItems: 1
        nvmem-names:
          maxItems: 1

  - if:
      properties:
        compatible:
          contains:
            enum:
              - qcom,pm8350c-pwm
    then:
      properties:
        nvmem:
          minItems: 2
        nvmem-names:
          minItems: 2

examples:
  - |
    #include <dt-bindings/leds/common.h>

    led-controller {
      compatible = "qcom,pmi8994-lpg";

      #address-cells = <1>;
      #size-cells = <0>;

      qcom,power-source = <1>;

      qcom,dtest = <0 0>,
                   <0 0>,
                   <0 0>,
                   <4 1>;

      led@1 {
        reg = <1>;
        color = <LED_COLOR_ID_GREEN>;
        function = LED_FUNCTION_INDICATOR;
        function-enumerator = <1>;
      };

      led@2 {
        reg = <2>;
        color = <LED_COLOR_ID_GREEN>;
        function = LED_FUNCTION_INDICATOR;
        function-enumerator = <0>;
        default-state = "on";
      };

      led@3 {
        reg = <3>;
        color = <LED_COLOR_ID_GREEN>;
        function = LED_FUNCTION_INDICATOR;
        function-enumerator = <2>;
      };

      led@4 {
        reg = <4>;
        color = <LED_COLOR_ID_GREEN>;
        function = LED_FUNCTION_INDICATOR;
        function-enumerator = <3>;
      };
    };
  - |
    #include <dt-bindings/leds/common.h>

    led-controller {
      compatible = "qcom,pmi8994-lpg";

      #address-cells = <1>;
      #size-cells = <0>;

      qcom,power-source = <1>;

      multi-led {
        color = <LED_COLOR_ID_RGB>;
        function = LED_FUNCTION_STATUS;

        #address-cells = <1>;
        #size-cells = <0>;

        led@1 {
          reg = <1>;
          color = <LED_COLOR_ID_RED>;
        };

        led@2 {
          reg = <2>;
          color = <LED_COLOR_ID_GREEN>;
        };

        led@3 {
          reg = <3>;
          color = <LED_COLOR_ID_BLUE>;
        };
      };
    };
  - |
    pwm-controller {
      compatible = "qcom,pm8916-pwm";
      #pwm-cells = <2>;
    };
  - |
    #include <dt-bindings/leds/common.h>

    led-controller {
      compatible = "qcom,pmi632-lpg";
      #address-cells = <1>;
      #size-cells = <0>;
      #pwm-cells = <2>;
      nvmem-names = "lpg_chan_sdam";
      nvmem = <&pmi632_sdam_7>;
      qcom,pbs = <&pmi632_pbs_client3>;

      led@1 {
        reg = <1>;
        color = <LED_COLOR_ID_RED>;
        label = "red";
      };

      led@2 {
        reg = <2>;
        color = <LED_COLOR_ID_GREEN>;
        label = "green";
      };

      led@3 {
        reg = <3>;
        color = <LED_COLOR_ID_BLUE>;
        label = "blue";
      };
    };
```

## Documentation/devicetree/bindings/leds/leds-rgb13h.txt
```
The device is controlled through enable gpio pin.
gpio asserted high, enable flash strobe.

Required properties:

- compatible : Must be "led,rgb13h".
- enable-gpios : Must be device tree identifier of the flash device enable pin.

A discrete LED element connected to the device must be represented by a child
node - see Documentation/devicetree/bindings/leds/common.txt.

Required properties of the LED child node:
- led-max-microamp : see Documentation/devicetree/bindings/leds/common.txt
- flash-max-microamp : see Documentation/devicetree/bindings/leds/common.txt
- flash-max-timeout-us : see Documentation/devicetree/bindings/leds/common.txt

Optional properties of the LED child node:
- label : see Documentation/devicetree/bindings/leds/common.txt

Special properties:
- rockchip,camera-module-index : indicate which camera the flash belongs to.
- rockchip,camera-module-facing : indicate the camera facing.

flash_rgb13h: flash-rgb13h {
	compatible = "led,rgb13h";
	label = "gpio-flash";
	led-max-microamp = <20000>;
	flash-max-microamp = <20000>;
	flash-max-timeout-us = <1000000>;
	enable-gpio = <&gpio0 11 GPIO_ACTIVE_HIGH>;
	rockchip,camera-module-index = <1>;
	rockchip,camera-module-facing = "back";
};

&i2c2 {
	...
	ov2680@10 {
		...
		flash-leds = <&flash_rgb13h>;
		...
	};
};
```

## Documentation/devicetree/bindings/leds/leds-rt4505.yaml
```yaml
# SPDX-License-Identifier: (GPL-2.0-only OR BSD-2-Clause)
%YAML 1.2
---
$id: http://devicetree.org/schemas/leds/leds-rt4505.yaml#
$schema: http://devicetree.org/meta-schemas/core.yaml#

title: Richtek RT4505 Single Channel LED Driver

maintainers:
  - ChiYuan Huang <cy_huang@richtek.com>

description: |
  The RT4505 is a flash LED driver that can support up to 375mA and 1.5A for
  torch and flash mode, respectively.

  The data sheet can be found at:
    https://www.richtek.com/assets/product_file/RT4505/DS4505-02.pdf

properties:
  compatible:
    const: richtek,rt4505

  reg:
    description: I2C slave address of the controller.
    maxItems: 1

  led:
    type: object
    $ref: common.yaml#
    unevaluatedProperties: false

required:
  - compatible
  - reg

additionalProperties: false

examples:
  - |
    #include <dt-bindings/leds/common.h>

    i2c {
      #address-cells = <1>;
      #size-cells = <0>;

      led-controller@63 {
        compatible = "richtek,rt4505";
        reg = <0x63>;

        rt4505_flash: led {
          function = LED_FUNCTION_FLASH;
          color = <LED_COLOR_ID_WHITE>;
          led-max-microamp = <375000>;
          flash-max-microamp = <1500000>;
          flash-max-timeout-us = <800000>;
        };
      };
    };
```

## Documentation/devicetree/bindings/leds/leds-sc27xx-bltc.txt
```
LEDs connected to Spreadtrum SC27XX PMIC breathing light controller

The SC27xx breathing light controller supports to 3 outputs:
red LED, green LED and blue LED. Each LED can work at normal
PWM mode or breath light mode.

Required properties:
- compatible: Should be "sprd,sc2731-bltc".
- #address-cells: Must be 1.
- #size-cells: Must be 0.
- reg: Specify the controller address.

Required child properties:
- reg: Port this LED is connected to.

Optional child properties:
- function: See Documentation/devicetree/bindings/leds/common.txt.
- color: See Documentation/devicetree/bindings/leds/common.txt.
- label: See Documentation/devicetree/bindings/leds/common.txt (deprecated).

Examples:

led-controller@200 {
	compatible = "sprd,sc2731-bltc";
	#address-cells = <1>;
	#size-cells = <0>;
	reg = <0x200>;

	led@0 {
		color = <LED_COLOR_ID_RED>;
		reg = <0x0>;
	};

	led@1 {
		color = <LED_COLOR_ID_GREEN>;
		reg = <0x1>;
	};

	led@2 {
		color = <LED_COLOR_ID_BLUE>;
		reg = <0x2>;
	};
};
```

## Documentation/devicetree/bindings/leds/leds-sgm3140.yaml
```yaml
# SPDX-License-Identifier: (GPL-2.0-only OR BSD-2-Clause)
%YAML 1.2
---
$id: http://devicetree.org/schemas/leds/leds-sgm3140.yaml#
$schema: http://devicetree.org/meta-schemas/core.yaml#

title: SGMICRO SGM3140 500mA Buck/Boost Charge Pump LED Driver

maintainers:
  - Luca Weiss <luca@z3ntu.xyz>

description: |
  The SGM3140 is a current-regulated charge pump which can regulate two current
  levels for Flash and Torch modes.

  The data sheet can be found at:
    http://www.sg-micro.com/uploads/soft/20190626/1561535688.pdf

properties:
  compatible:
    const: sgmicro,sgm3140

  enable-gpios:
    maxItems: 1
    description: A connection to the 'EN' pin.

  flash-gpios:
    maxItems: 1
    description: A connection to the 'FLASH' pin.

  vin-supply:
    description: Regulator providing power to the 'VIN' pin.

  led:
    type: object
    $ref: common.yaml#

required:
  - compatible
  - flash-gpios
  - enable-gpios

additionalProperties: false

examples:
  - |
    #include <dt-bindings/gpio/gpio.h>
    #include <dt-bindings/leds/common.h>

    led-controller {
        compatible = "sgmicro,sgm3140";
        flash-gpios = <&pio 3 24 GPIO_ACTIVE_HIGH>; /* PD24 */
        enable-gpios = <&pio 2 3 GPIO_ACTIVE_HIGH>; /* PC3 */
        vin-supply = <&reg_dcdc1>;

        sgm3140_flash: led {
            function = LED_FUNCTION_FLASH;
            color = <LED_COLOR_ID_WHITE>;
            flash-max-timeout-us = <250000>;
        };
    };
```

## Documentation/devicetree/bindings/leds/leds-spi-byte.txt
```
* Single Byte SPI LED Device Driver.

The driver can be used for controllers with a very simple SPI protocol:
- one LED is controlled by a single byte on MOSI
- the value of the byte gives the brightness between two values (lowest to
  highest)
- no return value is necessary (no MISO signal)

The value for lowest and highest brightness is dependent on the device and
therefore on the compatible string.

Depending on the compatible string some special functions (like hardware
accelerated blinking) might can be supported too.

The driver currently only supports one LED. The properties of the LED are
configured in a sub-node in the device node.

Required properties:
- compatible: should be one of
   * "ubnt,acb-spi-led"		microcontroller (SONiX 8F26E611LA) based device
				used for example in Ubiquiti airCube ISP

Property rules described in Documentation/devicetree/bindings/spi/spi-bus.txt
apply.

LED sub-node properties:
- label:
	see Documentation/devicetree/bindings/leds/common.txt
- default-state:
	see Documentation/devicetree/bindings/leds/common.txt
	Only "on" and "off" are supported.

Example:

led-controller@0 {
	compatible = "ubnt,acb-spi-led";
	reg = <0>;
	spi-max-frequency = <100000>;

	led {
		label = "white:status";
		default-state = "on";
	};
};
```
