## Documentation/devicetree/bindings/leds/skyworks,aat1290.yaml
```yaml
# SPDX-License-Identifier: GPL-2.0-only OR BSD-2-Clause
%YAML 1.2
---
$id: http://devicetree.org/schemas/leds/skyworks,aat1290.yaml#
$schema: http://devicetree.org/meta-schemas/core.yaml#

title: Skyworks Solutions, Inc. AAT1290 Current Regulator for Flash LEDs

maintainers:
  - Jacek Anaszewski <jacek.anaszewski@gmail.com>
  - Krzysztof Kozlowski <krzk@kernel.org>

description: |
  The device is controlled through two pins:: FL_EN and EN_SET. The pins when,
  asserted high, enable flash strobe and movie mode (max 1/2 of flash current)
  respectively. In order to add a capability of selecting the strobe signal
  source (e.g. CPU or camera sensor) there is an additional switch required,
  independent of the flash chip. The switch is controlled with pin control.

properties:
  compatible:
    const: skyworks,aat1290

  enset-gpios:
    maxItems: 1
    description: EN_SET pin

  flen-gpios:
    maxItems: 1
    description: FL_EN pin

  led:
    $ref: common.yaml#
    unevaluatedProperties: false

    properties:
      led-max-microamp: true

      flash-max-microamp:
        description: |
          Maximum flash LED supply current can be calculated using following
          formula:: I = 1A * 162 kOhm / Rset.

      flash-max-timeout-us:
        description: |
          Maximum flash timeout can be calculated using following formula::
            T = 8.82 * 10^9 * Ct.

    required:
      - flash-max-microamp
      - flash-max-timeout-us
      - led-max-microamp

  pinctrl-names:
    items:
      - const: default
      - const: host
      - const: isp

  pinctrl-0: true
  pinctrl-1: true
  pinctrl-2: true

required:
  - compatible
  - enset-gpios
  - flen-gpios
  - led

additionalProperties: false

examples:
  - |
    #include <dt-bindings/gpio/gpio.h>
    #include <dt-bindings/leds/common.h>

    // Ct = 220 nF, Rset = 160 kOhm
    led-controller {
        compatible = "skyworks,aat1290";
        flen-gpios = <&gpj1 1 GPIO_ACTIVE_HIGH>;
        enset-gpios = <&gpj1 2 GPIO_ACTIVE_HIGH>;

        pinctrl-names = "default", "host", "isp";
        pinctrl-0 = <&camera_flash_host>;
        pinctrl-1 = <&camera_flash_host>;
        pinctrl-2 = <&camera_flash_isp>;

        led {
            function = LED_FUNCTION_FLASH;
            color = <LED_COLOR_ID_WHITE>;
            led-max-microamp = <520833>;
            flash-max-microamp = <1012500>;
            flash-max-timeout-us = <1940000>;
        };
    };
```

## Documentation/devicetree/bindings/leds/sprd,sc2731-bltc.yaml
```yaml
# SPDX-License-Identifier: GPL-2.0-only OR BSD-2-Clause
%YAML 1.2
---
$id: http://devicetree.org/schemas/leds/sprd,sc2731-bltc.yaml#
$schema: http://devicetree.org/meta-schemas/core.yaml#

title: Spreadtrum SC2731 PMIC breathing light controller

maintainers:
  - Orson Zhai <orsonzhai@gmail.com>
  - Baolin Wang <baolin.wang7@gmail.com>
  - Chunyan Zhang <zhang.lyra@gmail.com>

description: |
  The SC2731 breathing light controller supports up to 3 outputs:
  red LED, green LED and blue LED. Each LED can work at normal PWM mode
  or breath light mode.

properties:
  compatible:
    const: sprd,sc2731-bltc

  reg:
    maxItems: 1

  '#address-cells':
    const: 1

  '#size-cells':
    const: 0

patternProperties:
  "^led@[0-2]$":
    type: object
    $ref: common.yaml#
    unevaluatedProperties: false

    properties:
      reg:
        minimum: 0
        maximum: 2

    required:
      - reg

required:
  - compatible
  - reg
  - '#address-cells'
  - '#size-cells'

additionalProperties: false
...
```

## Documentation/devicetree/bindings/leds/st,led1202.yaml
```yaml
# SPDX-License-Identifier: GPL-2.0-only OR BSD-2-Clause
%YAML 1.2
---
$id: http://devicetree.org/schemas/leds/st,led1202.yaml#
$schema: http://devicetree.org/meta-schemas/core.yaml#

title: ST LED1202 LED controllers

maintainers:
  - Vicentiu Galanopulo <vicentiu.galanopulo@remote-tech.co.uk>

description: |
  The LED1202 is a 12-channel low quiescent current LED controller
  programmable via I2C; The output current can be adjusted separately
  for each channel by 8-bit analog and 12-bit digital dimming control.
  Datasheet available at
  https://www.st.com/en/power-management/led1202.html

properties:
  compatible:
    const: st,led1202

  reg:
    maxItems: 1

  "#address-cells":
    const: 1

  "#size-cells":
    const: 0

patternProperties:
  "^led@[0-9a-f]$":
    type: object
    $ref: common.yaml#
    unevaluatedProperties: false

    properties:
      reg:
        minimum: 0
        maximum: 11

    required:
      - reg

required:
  - compatible
  - reg
  - "#address-cells"
  - "#size-cells"

additionalProperties: false

examples:
  - |
    #include <dt-bindings/leds/common.h>

    i2c {
        #address-cells = <1>;
        #size-cells = <0>;

        led-controller@58 {
            compatible = "st,led1202";
            reg = <0x58>;
            #address-cells = <1>;
            #size-cells = <0>;

            led@0 {
                reg = <0x0>;
                function = LED_FUNCTION_STATUS;
                color = <LED_COLOR_ID_RED>;
                function-enumerator = <1>;
            };

            led@1 {
                reg = <0x1>;
                function = LED_FUNCTION_STATUS;
                color = <LED_COLOR_ID_GREEN>;
                function-enumerator = <2>;
            };

            led@2 {
                reg = <0x2>;
                function = LED_FUNCTION_STATUS;
                color = <LED_COLOR_ID_BLUE>;
                function-enumerator = <3>;
            };

            led@3 {
                reg = <0x3>;
                function = LED_FUNCTION_STATUS;
                color = <LED_COLOR_ID_RED>;
                function-enumerator = <4>;
            };

            led@4 {
                reg = <0x4>;
                function = LED_FUNCTION_STATUS;
                color = <LED_COLOR_ID_GREEN>;
                function-enumerator = <5>;
            };

            led@5 {
                reg = <0x5>;
                function = LED_FUNCTION_STATUS;
                color = <LED_COLOR_ID_BLUE>;
                function-enumerator = <6>;
            };

            led@6 {
                reg = <0x6>;
                function = LED_FUNCTION_STATUS;
                color = <LED_COLOR_ID_RED>;
                function-enumerator = <7>;
            };

            led@7 {
                reg = <0x7>;
                function = LED_FUNCTION_STATUS;
                color = <LED_COLOR_ID_GREEN>;
                function-enumerator = <8>;
            };

            led@8 {
                reg = <0x8>;
                function = LED_FUNCTION_STATUS;
                color = <LED_COLOR_ID_BLUE>;
                function-enumerator = <9>;
            };
        };
    };
...
```

## Documentation/devicetree/bindings/leds/tca6507.txt
```
LEDs connected to tca6507

Required properties:
- compatible : should be : "ti,tca6507".
- #address-cells: must be 1
- #size-cells: must be 0
- reg: typically 0x45.

Optional properties:
- gpio-controller: allows lines to be used as output-only GPIOs.
- #gpio-cells: if present, must be 0.

Each led is represented as a sub-node of the ti,tca6507 device.

LED sub-node properties:
- label : (optional) see Documentation/devicetree/bindings/leds/common.txt
- reg : number of LED line (could be from 0 to 6)
- linux,default-trigger : (optional)
   see Documentation/devicetree/bindings/leds/common.txt
- compatible: either "led" (the default) or "gpio".

Examples:

tca6507@45 {
	compatible = "ti,tca6507";
	#address-cells = <1>;
	#size-cells = <0>;
	reg = <0x45>;

	gpio-controller;
	#gpio-cells = <2>;

	led0: red-aux@0 {
		label = "red:aux";
		reg = <0x0>;
	};

	led1: green-aux@1 {
		label = "green:aux";
		reg = <0x5>;
		linux,default-trigger = "default-on";
	};

	wifi-reset@6 {
		reg = <0x6>;
		compatible = "gpio";
	};
};
```
