## Documentation/devicetree/bindings/leds/register-bit-led.yaml
```yaml
# SPDX-License-Identifier: (GPL-2.0-only OR BSD-2-Clause)
%YAML 1.2
---
$id: http://devicetree.org/schemas/leds/register-bit-led.yaml#
$schema: http://devicetree.org/meta-schemas/core.yaml#

title: Register Bit LEDs

maintainers:
  - Linus Walleij <linus.walleij@linaro.org>

description: |+
  Register bit leds are used with syscon multifunctional devices where single
  bits in a certain register can turn on/off a single LED. The register bit LEDs
  appear as children to the syscon device, with the proper compatible string.
  For the syscon bindings see:
  Documentation/devicetree/bindings/mfd/syscon.yaml

allOf:
  - $ref: /schemas/leds/common.yaml#

properties:
  $nodename:
    description:
      The unit-address is in the form of @<reg addr>,<bit offset>
    pattern: '^led@[0-9a-f]+,[0-9a-f]{1,2}$'

  compatible:
    const: register-bit-led

  reg:
    description:
      The register address and size
    maxItems: 1

  mask:
    description:
      bit mask for the bit controlling this LED in the register
    $ref: /schemas/types.yaml#/definitions/uint32
    enum:
      [ 0x1, 0x2, 0x4, 0x8, 0x10, 0x20, 0x40, 0x80, 0x100, 0x200, 0x400, 0x800,
        0x1000, 0x2000, 0x4000, 0x8000, 0x10000, 0x20000, 0x40000, 0x80000,
        0x100000, 0x200000, 0x400000, 0x800000, 0x1000000, 0x2000000, 0x4000000,
        0x8000000, 0x10000000, 0x20000000, 0x40000000, 0x80000000 ]

  offset:
    description:
      register offset to the register controlling this LED
    $ref: /schemas/types.yaml#/definitions/uint32
    deprecated: true

required:
  - compatible
  - mask
  - reg

unevaluatedProperties: false

examples:
  - |

    syscon@10000000 {
        compatible = "arm,realview-pb1176-syscon", "syscon", "simple-mfd";
        reg = <0x10000000 0x1000>;
        #address-cells = <1>;
        #size-cells = <1>;
        ranges = <0x0 0x10000000 0x1000>;

        led@8,0 {
            compatible = "register-bit-led";
            reg = <0x08 0x04>;
            offset = <0x08>;
            mask = <0x01>;
            label = "versatile:0";
            linux,default-trigger = "heartbeat";
            default-state = "on";
        };
        led@8,1 {
            compatible = "register-bit-led";
            reg = <0x08 0x04>;
            offset = <0x08>;
            mask = <0x02>;
            label = "versatile:1";
            default-state = "off";
        };
        led@8,2 {
            compatible = "register-bit-led";
            reg = <0x08 0x04>;
            offset = <0x08>;
            mask = <0x04>;
            label = "versatile:2";
            default-state = "off";
        };
    };
...
```

## Documentation/devicetree/bindings/leds/regulator-led.yaml
```yaml
# SPDX-License-Identifier: (GPL-2.0-only OR BSD-2-Clause)
%YAML 1.2
---
$id: http://devicetree.org/schemas/leds/regulator-led.yaml#
$schema: http://devicetree.org/meta-schemas/core.yaml#

title: Device Tree Bindings for Regulator LEDs

maintainers:
  - Linus Walleij <linus.walleij@linaro.org>

description: |
  Regulator LEDs are powered by a single regulator such that they can
  be turned on or off by enabling or disabling the regulator. The available
  brightness settings will be inferred from the available voltages on the
  regulator, and any constraints on the voltage or current will need to be
  specified on the regulator.

allOf:
  - $ref: common.yaml#

properties:
  $nodename:
    pattern: '^led.*$'

  compatible:
    const: regulator-led

  vled-supply:
    description:
      The regulator controlling the current to the LED.

  function: true
  color: true
  linux,default-trigger: true
  default-state: true

required:
  - compatible
  - vled-supply

additionalProperties: false

examples:
  - |
    #include <dt-bindings/leds/common.h>

    led-heartbeat {
        compatible = "regulator-led";
        vled-supply = <&regulator>;
        function = LED_FUNCTION_STATUS;
        color = <LED_COLOR_ID_BLUE>;
        linux,default-trigger = "heartbeat";
    };
...
```

## Documentation/devicetree/bindings/leds/richtek,rt8515.yaml
```yaml
# SPDX-License-Identifier: (GPL-2.0-only OR BSD-2-Clause)
%YAML 1.2
---
$id: http://devicetree.org/schemas/leds/richtek,rt8515.yaml#
$schema: http://devicetree.org/meta-schemas/core.yaml#

title: Richtek RT8515 1.5A dual channel LED driver

maintainers:
  - Linus Walleij <linus.walleij@linaro.org>

description: |
  The Richtek RT8515 is a dual channel (two mode) LED driver that
  supports driving a white LED in flash or torch mode. The maximum
  current for each mode is defined in hardware using two resistors
  RFS and RTS.

properties:
  compatible:
    const: richtek,rt8515

  enf-gpios:
    maxItems: 1
    description: A connection to the 'ENF' (enable flash) pin.

  ent-gpios:
    maxItems: 1
    description: A connection to the 'ENT' (enable torch) pin.

  richtek,rfs-ohms:
    minimum: 7680
    maximum: 367000
    description: The resistance value of the RFS resistor. This
      resistors limits the maximum flash current. This must be set
      for the property flash-max-microamp to work, the RFS resistor
      defines the range of the dimmer setting (brightness) of the
      flash LED.

  richtek,rts-ohms:
    minimum: 7680
    maximum: 367000
    description: The resistance value of the RTS resistor. This
      resistors limits the maximum torch current. This must be set
      for the property torch-max-microamp to work, the RTS resistor
      defines the range of the dimmer setting (brightness) of the
      torch LED.

  led:
    type: object
    $ref: common.yaml#
    properties:
      function: true
      color: true
      flash-max-timeout-us: true

      flash-max-microamp:
        maximum: 700000
        description: The maximum current for flash mode
          is hardwired to the component using the RFS resistor to
          ground. The maximum hardware current setting is calculated
          according to the formula Imax = 5500 / RFS. The lowest
          allowed resistance value is 7.86 kOhm giving an absolute
          maximum current of 700mA. By setting this attribute in
          the device tree, you can further restrict the maximum
          current below the hardware limit. This requires the RFS
          to be defined as it defines the maximum range.

      led-max-microamp:
        maximum: 700000
        description: The maximum current for torch mode
          is hardwired to the component using the RTS resistor to
          ground. The maximum hardware current setting is calculated
          according to the formula Imax = 5500 / RTS. The lowest
          allowed resistance value is 7.86 kOhm giving an absolute
          maximum current of 700mA. By setting this attribute in
          the device tree, you can further restrict the maximum
          current below the hardware limit. This requires the RTS
          to be defined as it defines the maximum range.

    additionalProperties: false

required:
  - compatible
  - ent-gpios
  - enf-gpios
  - led

additionalProperties: false

examples:
  - |
    #include <dt-bindings/gpio/gpio.h>
    #include <dt-bindings/leds/common.h>

    led-controller {
        compatible = "richtek,rt8515";
        enf-gpios = <&gpio4 12 GPIO_ACTIVE_HIGH>;
        ent-gpios = <&gpio4 13 GPIO_ACTIVE_HIGH>;
        richtek,rfs-ohms = <16000>;
        richtek,rts-ohms = <100000>;

        led {
            function = LED_FUNCTION_FLASH;
            color = <LED_COLOR_ID_WHITE>;
            flash-max-timeout-us = <250000>;
            flash-max-microamp = <150000>;
            led-max-microamp = <25000>;
        };
    };

...
```

## Documentation/devicetree/bindings/leds/rohm,bd2606mvv.yaml
```yaml
# SPDX-License-Identifier: GPL-2.0-only OR BSD-2-Clause
%YAML 1.2
---
$id: http://devicetree.org/schemas/leds/rohm,bd2606mvv.yaml#
$schema: http://devicetree.org/meta-schemas/core.yaml#

title: ROHM BD2606MVV LED controller

maintainers:
  - Andreas Kemnade <andreas@kemnade.info>

description:
  The BD2606 MVV is a programmable LED controller connected via I2C that can
  drive 6 separate lines. Each of them can be individually switched on and off,
  but the brightness setting is shared between pairs of them.

  Datasheet is available at
  https://fscdn.rohm.com/en/products/databook/datasheet/ic/power/led_driver/bd2606mvv_1-e.pdf

properties:
  compatible:
    const: rohm,bd2606mvv

  reg:
    maxItems: 1

  "#address-cells":
    const: 1

  "#size-cells":
    const: 0

  enable-gpios:
    maxItems: 1
    description: GPIO pin to enable/disable the device.

patternProperties:
  "^led@[0-6]$":
    type: object
    $ref: common.yaml#
    unevaluatedProperties: false

    properties:
      reg:
        minimum: 0
        maximum: 6

    required:
      - reg

additionalProperties: false

examples:
  - |
    #include <dt-bindings/leds/common.h>

    i2c {
        #address-cells = <1>;
        #size-cells = <0>;

        led-controller@66 {
            compatible = "rohm,bd2606mvv";
            reg = <0x66>;
            #address-cells = <1>;
            #size-cells = <0>;

            led@0 {
                reg = <0x0>;
                color = <LED_COLOR_ID_RED>;
                function = LED_FUNCTION_POWER;
            };

            led@2 {
                reg = <0x2>;
                color = <LED_COLOR_ID_WHITE>;
                function = LED_FUNCTION_STATUS;
            };
        };
    };

...
```

## Documentation/devicetree/bindings/leds/rohm,bd71828-leds.yaml
```yaml
# SPDX-License-Identifier: GPL-2.0-only OR BSD-2-Clause
%YAML 1.2
---
$id: http://devicetree.org/schemas/leds/rohm,bd71828-leds.yaml#
$schema: http://devicetree.org/meta-schemas/core.yaml#

title: ROHM BD71828 Power Management Integrated Circuit LED driver

maintainers:
  - Matti Vaittinen <mazziesaccount@gmail.com>

description: |
  This module is part of the ROHM BD71828 MFD device. For more details
  see Documentation/devicetree/bindings/mfd/rohm,bd71828-pmic.yaml.

  The LED controller is represented as a sub-node of the PMIC node on the device
  tree.

  The device has two LED outputs referred as GRNLED and AMBLED in data-sheet.

select: false

properties:
  compatible:
    const: rohm,bd71828-leds

patternProperties:
  "^led-[1-2]$":
    $ref: common.yaml#
    unevaluatedProperties: false

    properties:
      rohm,led-compatible:
        description: LED identification string
        $ref: /schemas/types.yaml#/definitions/string
        enum:
          - bd71828-ambled
          - bd71828-grnled

required:
  - compatible
additionalProperties: false

...
```

## Documentation/devicetree/bindings/leds/samsung,s2mu005-flash.yaml
```yaml
# SPDX-License-Identifier: (GPL-2.0-only OR BSD-2-Clause)
%YAML 1.2
---
$id: http://devicetree.org/schemas/leds/samsung,s2mu005-flash.yaml#
$schema: http://devicetree.org/meta-schemas/core.yaml#

title: Flash and Torch LED Controller for Samsung S2M series PMICs

maintainers:
  - Kaustabh Chakraborty <kauschluss@disroot.org>

description: |
  The Samsung S2M series PMIC flash LED has two led channels (typically
  as back and front camera flashes), with support for both torch and
  flash modes.

  This is a part of device tree bindings for S2M and S5M family of Power
  Management IC (PMIC).

  See also Documentation/devicetree/bindings/mfd/samsung,s2mps11.yaml for
  additional information and example.

properties:
  compatible:
    enum:
      - samsung,s2mu005-flash

  "#address-cells":
    const: 1

  "#size-cells":
    const: 0

patternProperties:
  "^led@[0-1]$":
    type: object
    $ref: common.yaml#
    unevaluatedProperties: false

    properties:
      reg:
        enum: [0, 1]

    required:
      - reg

required:
  - compatible
  - "#address-cells"
  - "#size-cells"

additionalProperties: false
```

## Documentation/devicetree/bindings/leds/silergy,sy7802.yaml
```yaml
# SPDX-License-Identifier: (GPL-2.0-only OR BSD-2-Clause)
%YAML 1.2
---
$id: http://devicetree.org/schemas/leds/silergy,sy7802.yaml#
$schema: http://devicetree.org/meta-schemas/core.yaml#

title: Silergy SY7802 1800mA Boost Charge Pump LED Driver

maintainers:
  - André Apitzsch <git@apitzsch.eu>

description: |
  The SY7802 is a current-regulated charge pump which can regulate two current
  levels for Flash and Torch modes.

  The SY7802 is a high-current synchronous boost converter with 2-channel
  high side current sources. Each channel is able to deliver 900mA current.

properties:
  compatible:
    enum:
      - silergy,sy7802

  reg:
    maxItems: 1

  enable-gpios:
    maxItems: 1
    description: A connection to the 'EN' pin.

  flash-gpios:
    maxItems: 1
    description: A connection to the 'FLEN' pin.

  vin-supply:
    description: Regulator providing power to the 'VIN' pin.

  "#address-cells":
    const: 1

  "#size-cells":
    const: 0

patternProperties:
  "^led@[0-1]$":
    type: object
    $ref: common.yaml#
    unevaluatedProperties: false

    properties:
      reg:
        description: Index of the LED.
        minimum: 0
        maximum: 1

      led-sources:
        minItems: 1
        maxItems: 2
        items:
          minimum: 0
          maximum: 1

    required:
      - reg
      - led-sources

required:
  - compatible
  - reg
  - "#address-cells"
  - "#size-cells"
  - enable-gpios

additionalProperties: false

examples:
  - |
    #include <dt-bindings/gpio/gpio.h>
    #include <dt-bindings/leds/common.h>

    i2c {
        #address-cells = <1>;
        #size-cells = <0>;

        flash-led-controller@53 {
            compatible = "silergy,sy7802";
            reg = <0x53>;
            #address-cells = <1>;
            #size-cells = <0>;

            enable-gpios = <&tlmm 16 GPIO_ACTIVE_HIGH>;

            led@0 {
                reg = <0>;
                function = LED_FUNCTION_FLASH;
                color = <LED_COLOR_ID_WHITE>;
                led-sources = <0>, <1>;
            };
        };
    };
```
