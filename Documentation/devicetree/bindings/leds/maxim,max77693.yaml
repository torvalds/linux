## Documentation/devicetree/bindings/leds/maxim,max77693.yaml
```yaml
# SPDX-License-Identifier: GPL-2.0-only OR BSD-2-Clause
%YAML 1.2
---
$id: http://devicetree.org/schemas/leds/maxim,max77693.yaml#
$schema: http://devicetree.org/meta-schemas/core.yaml#

title: Maxim MAX77693 MicroUSB and Companion Power Management IC LEDs

maintainers:
  - Krzysztof Kozlowski <krzysztof.kozlowski@canonical.com>

description: |
  This is a part of device tree bindings for Maxim MAX77693 MicroUSB Integrated
  Circuit (MUIC).

  There are two LED outputs available - FLED1 and FLED2. Each of them can
  control a separate LED or they can be connected together to double the
  maximum current for a single connected LED. One LED is represented by one
  child node.

  See also Documentation/devicetree/bindings/mfd/maxim,max77693.yaml for
  additional information and example.

properties:
  compatible:
    const: maxim,max77693-led

  maxim,boost-mode:
    description:
      In boost mode the device can produce up to 1.2A of total current on both
      outputs. The maximum current on each output is reduced to 625mA then. If
      not enabled explicitly, boost setting defaults to LEDS_BOOST_FIXED in
      case both current sources are used.
      See LEDS_BOOST_* in include/dt-bindings/leds/common.h.
    $ref: /schemas/types.yaml#/definitions/uint32
    enum: [0, 1, 2]

  maxim,boost-mvout:
    description: |
      Output voltage of the boost module in millivolts.
      Valid values: 3300 - 5500, step by 25 (rounded down)
    $ref: /schemas/types.yaml#/definitions/uint32
    minimum: 3300
    maximum: 5500
    default: 3300

  maxim,mvsys-min:
    description: |
      Low input voltage level in millivolts. Flash is not fired if chip
      estimates that system voltage could drop below this level due to flash
      power consumption.
      Valid values: 2400 - 3400, step by 33 (rounded down)
    $ref: /schemas/types.yaml#/definitions/uint32
    minimum: 2400
    maximum: 3400
    default: 2400

patternProperties:
  "^([a-z]+-)?led[01]?$":
    type: object
    $ref: common.yaml#
    unevaluatedProperties: false

    properties:
      led-sources:
        allOf:
          - minItems: 1
            maxItems: 2
            items:
              minimum: 0
              maximum: 1

      led-max-microamp:
        description: |
          Valid values for a LED connected to one FLED output:
            15625 - 250000, step by 15625 (rounded down)
          Valid values for a LED connected to both FLED outputs:
            15625 - 500000, step by 15625 (rounded down)

      flash-max-microamp:
        description: |
          Valid values for a single LED connected to one FLED output
          (boost mode must be turned off):
            15625 - 1000000, step by 15625 (rounded down)
          Valid values for a single LED connected to both FLED outputs:
            15625 - 1250000, step by 15625 (rounded down)
          Valid values for two LEDs case:
            15625 - 625000, step by 15625 (rounded down)

      flash-max-timeout-us:
        description: |
          Valid values: 62500 - 1000000, step by 62500 (rounded down)
        minimum: 62500
        maximum: 1000000

    required:
      - flash-max-microamp
      - flash-max-timeout-us
      - led-max-microamp
      - led-sources

required:
  - compatible

additionalProperties: false
```

## Documentation/devicetree/bindings/leds/mediatek,mt6370-flashlight.yaml
```yaml
# SPDX-License-Identifier: (GPL-2.0-only OR BSD-2-Clause)
%YAML 1.2
---
$id: http://devicetree.org/schemas/leds/mediatek,mt6370-flashlight.yaml#
$schema: http://devicetree.org/meta-schemas/core.yaml#

title: Flash LED driver for MT6370 PMIC from MediaTek Integrated.

maintainers:
  - Alice Chen <alice_chen@richtek.com>

description: |
  This module is part of the MT6370 MFD device.
  Add MT6370 flash LED driver include 2-channel flash LED support Torch/Strobe Mode.

properties:
  compatible:
    const: mediatek,mt6370-flashlight

  "#address-cells":
    const: 1

  "#size-cells":
    const: 0

patternProperties:
  "^led@[0-1]$":
    type: object
    $ref: common.yaml#
    unevaluatedProperties: false

    properties:
      reg:
        enum: [0, 1]

required:
  - compatible
  - "#address-cells"
  - "#size-cells"

additionalProperties: false
```

## Documentation/devicetree/bindings/leds/mediatek,mt6370-indicator.yaml
```yaml
# SPDX-License-Identifier: (GPL-2.0-only OR BSD-2-Clause)
%YAML 1.2
---
$id: http://devicetree.org/schemas/leds/mediatek,mt6370-indicator.yaml#
$schema: http://devicetree.org/meta-schemas/core.yaml#

title: LED driver for MT6370 PMIC from MediaTek Integrated.

maintainers:
  - Alice Chen <alice_chen@richtek.com>

description: |
  This module is part of the MT6370 MFD device.
  Add MT6370 LED driver include 4-channel RGB LED support Register/PWM/Breath Mode

properties:
  compatible:
    const: mediatek,mt6370-indicator

  "#address-cells":
    const: 1

  "#size-cells":
    const: 0

patternProperties:
  "^multi-led@[0-3]$":
    type: object
    $ref: leds-class-multicolor.yaml#
    unevaluatedProperties: false

    properties:
      reg:
        enum: [0, 1, 2, 3]

      "#address-cells":
        const: 1

      "#size-cells":
        const: 0

    patternProperties:
      "^led@[0-2]$":
        type: object
        $ref: common.yaml#
        unevaluatedProperties: false

        properties:
          reg:
            enum: [0, 1, 2]

        required:
          - reg
          - color

    required:
      - reg
      - color
      - "#address-cells"
      - "#size-cells"

  "^led@[0-3]$":
    type: object
    $ref: common.yaml#
    unevaluatedProperties: false

    properties:
      reg:
        enum: [0, 1, 2, 3]

    required:
      - reg
      - color

required:
  - compatible
  - "#address-cells"
  - "#size-cells"

additionalProperties: false
```

## Documentation/devicetree/bindings/leds/nxp,pca953x.yaml
```yaml
# SPDX-License-Identifier: (GPL-2.0-only OR BSD-2-Clause)
%YAML 1.2
---
$id: http://devicetree.org/schemas/leds/nxp,pca953x.yaml#
$schema: http://devicetree.org/meta-schemas/core.yaml#

title: NXP PCA9532 LED Dimmer

maintainers:
  - Riku Voipio <riku.voipio@iki.fi>

description: |
  The PCA9532 family is SMBus I/O expander optimized for dimming LEDs.
  The PWM support 256 steps.

  For more product information please see the link below:
    https://www.nxp.com/docs/en/data-sheet/PCA9532.pdf

properties:
  compatible:
    enum:
      - nxp,pca9530
      - nxp,pca9531
      - nxp,pca9532
      - nxp,pca9533

  reg:
    maxItems: 1

  gpio-controller: true

  gpio-line-names:
    minItems: 1
    maxItems: 16

  '#gpio-cells':
    const: 2

patternProperties:
  "^led-[0-9a-z]+$":
    type: object
    $ref: common.yaml#
    unevaluatedProperties: false

    properties:
      type:
        description: |
          Output configuration, see include/dt-bindings/leds/leds-pca9532.h
        $ref: /schemas/types.yaml#/definitions/uint32
        default: 0
        minimum: 0
        maximum: 4

required:
  - compatible
  - reg

additionalProperties: false

examples:
  - |
    #include <dt-bindings/leds/leds-pca9532.h>

    i2c {
        #address-cells = <1>;
        #size-cells = <0>;

        led-controller@62 {
            compatible = "nxp,pca9533";
            reg = <0x62>;

            led-1 {
                label = "pca:red:power";
                type = <PCA9532_TYPE_LED>;
            };

            led-2 {
                label = "pca:green:power";
                type = <PCA9532_TYPE_LED>;
            };

            led-3 {
                type = <PCA9532_TYPE_LED>;
                default-state = "on";
            };

            led-4 {
                type = <PCA9532_TYPE_LED>;
                default-state = "keep";
            };
        };
    };

...
```

## Documentation/devicetree/bindings/leds/nxp,pca955x.yaml
```yaml
# SPDX-License-Identifier: GPL-2.0-only OR BSD-2-Clause
%YAML 1.2
---
$id: http://devicetree.org/schemas/leds/nxp,pca955x.yaml#
$schema: http://devicetree.org/meta-schemas/core.yaml#

title: NXP PCA955X LED controllers

maintainers:
  - Nate Case <ncase@xes-inc.com>

description: |
  The PCA955x family of chips are I2C LED blinkers whose pins not used
  to control LEDs can be used as general purpose I/Os. The GPIO pins can
  be input or output, and output pins can also be pulse-width controlled.

  For more product information please see the link below:
  - https://www.nxp.com/docs/en/data-sheet/PCA9552.pdf

properties:
  compatible:
    enum:
      - nxp,pca9550
      - nxp,pca9551
      - nxp,pca9552
      - ibm,pca9552
      - nxp,pca9553

  reg:
    maxItems: 1

  "#address-cells":
    const: 1

  "#size-cells":
    const: 0

  gpio-controller: true

  gpio-line-names:
    minItems: 1
    maxItems: 16

  "#gpio-cells":
    const: 2

patternProperties:
  "^led@[0-9a-f]$":
    type: object
    $ref: common.yaml#
    unevaluatedProperties: false

    properties:
      reg:
        maxItems: 1
      type:
        description: |
          Output configuration, see include/dt-bindings/leds/leds-pca955x.h
        $ref: /schemas/types.yaml#/definitions/uint32
        default: 0
        minimum: 0
        maximum: 2

    required:
      - reg

allOf:
  - if:
      properties:
        compatible:
          contains:
            enum:
              - nxp,pca9550
    then:
      patternProperties:
        "^led@[0-9a-f]$":
          properties:
            reg:
              maximum: 1
  - if:
      properties:
        compatible:
          contains:
            enum:
              - nxp,pca9551
    then:
      patternProperties:
        "^led@[0-9a-f]$":
          properties:
            reg:
              maximum: 7
  - if:
      properties:
        compatible:
          contains:
            enum:
              - nxp,pca9552
              - ibm,pca9552
    then:
      patternProperties:
        "^led@[0-9a-f]$":
          properties:
            reg:
              maximum: 15
  - if:
      properties:
        compatible:
          contains:
            enum:
              - nxp,pca9553
    then:
      patternProperties:
        "^led@[0-9a-f]$":
          properties:
            reg:
              maximum: 3

additionalProperties: false

examples:
  - |
    #include <dt-bindings/leds/leds-pca955x.h>

    i2c {
        #address-cells = <1>;
        #size-cells = <0>;

        led-controller@60 {
            compatible = "nxp,pca9552";
            reg = <0x60>;
            #address-cells = <1>;
            #size-cells = <0>;

            led@0 {
                reg = <0>;
                label = "red:power";
                linux,default-trigger = "default-on";
                type = <PCA955X_TYPE_LED>;
            };
            led@1 {
                reg = <1>;
                label = "green:power";
                type = <PCA955X_TYPE_LED>;
            };
            led@2 {
                reg = <2>;
                label = "pca9552:yellow";
                type = <PCA955X_TYPE_LED>;
            };
            led@3 {
                reg = <3>;
                label = "pca9552:white";
                type = <PCA955X_TYPE_LED>;
            };
        };
    };

...
```

## Documentation/devicetree/bindings/leds/nxp,pca963x.yaml
```yaml
# SPDX-License-Identifier: GPL-2.0-only OR BSD-2-Clause
%YAML 1.2
---
$id: http://devicetree.org/schemas/leds/nxp,pca963x.yaml#
$schema: http://devicetree.org/meta-schemas/core.yaml#

title: NXP PCA963x LED controllers

maintainers:
  - Laurent Pinchart <laurent.pinchart@ideasonboard.com>

description: |
  The NXP PCA963x are I2C-controlled LED drivers optimized for
  Red/Green/Blue/Amber (RGBA) color mixing applications. Each LED is
  individually controllable and has its own PWM controller.

  Datasheets are available at

  - https://www.nxp.com/docs/en/data-sheet/PCA9632.pdf
  - https://www.nxp.com/docs/en/data-sheet/PCA9633.pdf
  - https://www.nxp.com/docs/en/data-sheet/PCA9634.pdf
  - https://www.nxp.com/docs/en/data-sheet/PCA9635.pdf

properties:
  compatible:
    enum:
      - nxp,pca9632
      - nxp,pca9633
      - nxp,pca9634
      - nxp,pca9635

  reg:
    maxItems: 1

  "#address-cells":
    const: 1

  "#size-cells":
    const: 0

  nxp,hw-blink:
    type: boolean
    description:
      Use hardware blinking instead of software blinking

  nxp,inverted-out:
    type: boolean
    description:
      Invert the polarity of the generated PWM.

  nxp,period-scale:
    $ref: /schemas/types.yaml#/definitions/uint32
    description:
      In some configurations, the chip blinks faster than expected. This
      parameter provides a scaling ratio (fixed point, decimal divided by 1000)
      to compensate, e.g. 1300=1.3x and 750=0.75x.

  nxp,totem-pole:
    type: boolean
    description:
      Use totem pole (push-pull) instead of open-drain (pca9632 defaults to
      open-drain, newer chips to totem pole).

patternProperties:
  "^led@[0-9a-f]+$":
    type: object
    $ref: common.yaml#
    unevaluatedProperties: false

    properties:
      reg:
        minimum: 0

    required:
      - reg

allOf:
  - if:
      properties:
        compatible:
          contains:
            enum:
              - nxp,pca9632
              - nxp,pca9633
    then:
      patternProperties:
        "^led@[0-9a-f]+$":
          properties:
            reg:
              maximum: 3
    else:
      patternProperties:
        "^led@[0-9a-f]+$":
          properties:
            reg:
              maximum: 7

additionalProperties: false

examples:
  - |
    #include <dt-bindings/leds/common.h>

    i2c {
        #address-cells = <1>;
        #size-cells = <0>;

        led-controller@62 {
            compatible = "nxp,pca9632";
            reg = <0x62>;
            #address-cells = <1>;
            #size-cells = <0>;

            led@0 {
                    reg = <0>;
                    color = <LED_COLOR_ID_RED>;
                    function = LED_FUNCTION_STATUS;
            };

            led@1 {
                    reg = <1>;
                    color = <LED_COLOR_ID_GREEN>;
                    function = LED_FUNCTION_STATUS;
            };

            led@2 {
                    reg = <2>;
                    color = <LED_COLOR_ID_BLUE>;
                    function = LED_FUNCTION_STATUS;
            };

            led@3 {
                    reg = <3>;
                    color = <LED_COLOR_ID_WHITE>;
                    function = LED_FUNCTION_STATUS;
            };
        };
    };

...
```
