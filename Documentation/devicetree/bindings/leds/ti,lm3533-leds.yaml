## Documentation/devicetree/bindings/media/hisilicon,hix5hd2-ir.yaml
```yaml
# SPDX-License-Identifier: (GPL-2.0-only OR BSD-2-Clause)
%YAML 1.2
---
$id: http://devicetree.org/schemas/media/hisilicon,hix5hd2-ir.yaml#
$schema: http://devicetree.org/meta-schemas/core.yaml#

title: HiSilicon HIX5HD2 IR controller

maintainers:
  - Wei Xu <xuwei5@hisilicon.com>

allOf:
  - $ref: rc.yaml#

properties:
  compatible:
    items:
      - enum:
          - hisilicon,hix5hd2-ir
          - hisilicon,hi3796cv300-ir

  reg:
    maxItems: 1

  interrupts:
    maxItems: 1

  clocks:
    maxItems: 1

  hisilicon,power-syscon:
    description: Provide correct clocks instead.
    $ref: /schemas/types.yaml#/definitions/phandle
    deprecated: true

required:
  - compatible
  - reg
  - interrupts
  - clocks

unevaluatedProperties: false

examples:
  - |
    ir@f8001000 {
        compatible = "hisilicon,hix5hd2-ir";
        reg = <0xf8001000 0x1000>;
        interrupts = <0 47 4>;
        clocks = <&clock 0>;
        linux,rc-map-name = "rc-tivo";
    };
```

## Documentation/devicetree/bindings/media/i2c/himax,hm1246.yaml
```yaml
# SPDX-License-Identifier: (GPL-2.0-only OR BSD-2-Clause)
# Copyright 2025 Matthias Fend <matthias.fend@emfend.at>
%YAML 1.2
---
$id: http://devicetree.org/schemas/media/i2c/himax,hm1246.yaml#
$schema: http://devicetree.org/meta-schemas/core.yaml#

title: Himax HM1246-AWD 1/3.7-Inch megapixel SoC image sensor

maintainers:
  - Matthias Fend <matthias.fend@emfend.at>

description:
  The Himax HM1246-AWD is a 1/3.7-Inch CMOS image sensor SoC with an active
  array size of 1296 x 976. It is programmable through an I2C interface and
  connected via parallel bus.

allOf:
  - $ref: /schemas/media/video-interface-devices.yaml#

properties:
  compatible:
    const: himax,hm1246

  reg:
    maxItems: 1

  clocks:
    description: Input reference clock (6 - 27 MHz)
    maxItems: 1

  reset-gpios:
    description: Active low XSHUTDOWN pin
    maxItems: 1

  avdd-supply:
    description: Power for analog circuit (3.0 - 3.6 V)

  iovdd-supply:
    description: Power for I/O circuit (1.7 - 3.6 V)

  dvdd-supply:
    description: Power for digital circuit (1.5 / 1.8 V)

  port:
    $ref: /schemas/graph.yaml#/$defs/port-base
    additionalProperties: false
    description: Parallel video output port

    properties:
      endpoint:
        $ref: /schemas/media/video-interfaces.yaml#
        unevaluatedProperties: false

        properties:
          bus-width:
            default: 10

          hsync-active:
            default: 1

          vsync-active:
            default: 1

          pclk-sample:
            default: 0

        required:
          - link-frequencies

    required:
      - endpoint

required:
  - compatible
  - reg
  - clocks
  - avdd-supply
  - iovdd-supply
  - dvdd-supply
  - port

unevaluatedProperties: false

examples:
  - |
    #include <dt-bindings/gpio/gpio.h>
    #include <dt-bindings/media/video-interfaces.h>
    #include <dt-bindings/media/video-interface-devices.h>

    i2c {
        #address-cells = <1>;
        #size-cells = <0>;

        sensor@24 {
            compatible =  "himax,hm1246";
            reg = <0x24>;

            clocks = <&hm1246_clk>;

            reset-gpios = <&gpio0 0 GPIO_ACTIVE_LOW>;

            avdd-supply = <&hm1246_avdd>;
            iovdd-supply = <&hm1246_iovdd>;
            dvdd-supply = <&hm1246_dvdd>;

            orientation = <MEDIA_ORIENTATION_EXTERNAL>;
            rotation = <0>;

            port {
                endpoint {
                    remote-endpoint = <&isp_par_in>;
                    bus-width = <10>;
                    hsync-active = <1>; /* active high */
                    vsync-active = <1>; /* active high */
                    pclk-sample = <1>; /* sample on rising edge */
                    link-frequencies = /bits/ 64 <42200000>;
                };
            };
        };
    };
```

## Documentation/devicetree/bindings/media/i2c/ite,it6625.yaml
```yaml
# SPDX-License-Identifier: (GPL-2.0-only OR BSD-2-Clause)
%YAML 1.2
---
$id: http://devicetree.org/schemas/media/i2c/ite,it6625.yaml#
$schema: http://devicetree.org/meta-schemas/core.yaml#

title: ITE IT6625/IT6626 HDMI to dual MIPI CSI-2 bridge

maintainers:
  - Hermes Wu <Hermes.wu@ite.com.tw>

description:
  The ITE IT6625 and IT6626 are HDMI to MIPI CSI-2 bridge devices.
  IT6625 supports an HDMI 2.0 input and converts it to one or two D-PHY CSI
  outputs, while IT6626 supports an HDMI 2.1 input and converts it to one or
  two C/D-PHY CSI outputs. The bridges are programmable through I2C and
  expose two selectable CSI-2 output ports and an HDMI input port. The
  bridge can operate in split mode or clone mode.

properties:
  compatible:
    enum:
      - ite,it6625
      - ite,it6626

  reg:
    maxItems: 1

  interrupts:
    maxItems: 1

  reset-gpios:
    description:
      GPIO connected to the active-low reset line.
    maxItems: 1

  vcc10-supply:
    description: 1.0V core supply

  vdd33-supply:
    description: 3.3V supply

  ovdd-supply:
    description: I/O supply voltage

  ports:
    $ref: /schemas/graph.yaml#/properties/ports
    properties:
      port@0:
        $ref: /schemas/graph.yaml#/$defs/port-base
        unevaluatedProperties: false
        description: CSI-2 output port MIPI0

        properties:
          endpoint:
            $ref: /schemas/media/video-interfaces.yaml#
            unevaluatedProperties: false

            properties:
              data-lanes:
                minItems: 1
                maxItems: 4

              bus-type:
                enum:
                  - 1 # MEDIA_BUS_TYPE_CSI2_CPHY
                  - 4 # MEDIA_BUS_TYPE_CSI2_DPHY
                default: 4 # MEDIA_BUS_TYPE_CSI2_DPHY

            required:
              - data-lanes

      port@1:
        $ref: /schemas/graph.yaml#/$defs/port-base
        unevaluatedProperties: false
        description: CSI-2 output port MIPI1

        properties:
          endpoint:
            $ref: /schemas/media/video-interfaces.yaml#
            unevaluatedProperties: false

            properties:
              data-lanes:
                minItems: 1
                maxItems: 4

              bus-type:
                enum:
                  - 1 # MEDIA_BUS_TYPE_CSI2_CPHY
                  - 4 # MEDIA_BUS_TYPE_CSI2_DPHY
                default: 4 # MEDIA_BUS_TYPE_CSI2_DPHY

            required:
              - data-lanes

      port@2:
        $ref: /schemas/graph.yaml#/$defs/port-base
        unevaluatedProperties: false
        description: HDMI input port

    required:
      - port@0

required:
  - compatible
  - reg
  - ports
  - vcc10-supply
  - vdd33-supply
  - ovdd-supply

allOf:
  - if:
      properties:
        compatible:
          contains:
            const: ite,it6626
    then:
      properties:
        ports:
          properties:
            port@0:
              properties:
                endpoint:
                  required:
                    - bus-type
            port@1:
              properties:
                endpoint:
                  required:
                    - bus-type

additionalProperties: false

examples:
  - |
    #include <dt-bindings/gpio/gpio.h>
    #include <dt-bindings/interrupt-controller/irq.h>

    i2c {
      #address-cells = <1>;
      #size-cells = <0>;

      hdmi-bridge@4c {
        compatible = "ite,it6625";
        reg = <0x4c>;
        interrupts = <3 IRQ_TYPE_LEVEL_LOW>;

        reset-gpios = <&gpio 2 GPIO_ACTIVE_LOW>;

        vcc10-supply = <&vcc10_reg>;
        vdd33-supply = <&vdd33_reg>;
        ovdd-supply = <&ovdd_reg>;

        ports {
          #address-cells = <1>;
          #size-cells = <0>;

          port@0 {
            reg = <0>;
            csi_out0: endpoint {
              remote-endpoint = <&csi2_rx0>;
              bus-type = <4>; /* MEDIA_BUS_TYPE_CSI2_DPHY */
              data-lanes = <1 2 3 4>;
            };
          };

          port@2 {
            reg = <2>;
            endpoint {
              remote-endpoint = <&hdmi_con>;
            };
          };
        };
      };
    };
```

## Documentation/devicetree/bindings/media/i2c/maxim,max9296a.yaml
```yaml
# SPDX-License-Identifier: (GPL-2.0-only OR BSD-2-Clause)
# Copyright (C) 2024 Collabora Ltd.
%YAML 1.2
---
$id: http://devicetree.org/schemas/media/i2c/maxim,max9296a.yaml#
$schema: http://devicetree.org/meta-schemas/core.yaml#

title: Maxim MAX9296A GMSL2 to CSI-2 Deserializer

maintainers:
  - Cosmin Tanislav <cosmin.tanislav@analog.com>

description: >
  The MAX9296A deserializer converts single or dual serial inputs to
  MIPI CSI-2 outputs. The GMSL2 links operate at a fixed rate of 3Gbps
  or 6Gbps in the forward direction and 187.5Mbps in the reverse
  direction. In GMSL1 mode, each serial link can be paired with 3.12Gbps
  or 1.5Gbps GMSL1 serializers or operate up to 4.5Gbps with GMSL2
  serializers with GMSL1 backward compatibility. The MAX9296A supports
  mixed GMSL2 and GMSL1 links. The serial inputs operate independently,
  allowing videos with different timings and resolutions to be received
  on each input.

  MAX96716A supports both tunnel and pixel mode.

  MAX96792A supports both tunnel and pixel mode, and has two GMSL3 links.

properties:
  compatible:
    enum:
      - maxim,max9296a
      - maxim,max96716a
      - maxim,max96792a

  reg:
    maxItems: 1

  powerdown-gpios:
    maxItems: 1
    description: Specifier for the GPIO connected to the PWDNB pin.

  port0-poc-supply:
    description: Regulator providing Power over Coax for GMSL port 0

  port1-poc-supply:
    description: Regulator providing Power over Coax for GMSL port 1

  i2c-alias-pool:
    maxItems: 2

  i2c-atr:
    type: object
    additionalProperties: false

    properties:
      '#address-cells':
        const: 1

      '#size-cells':
        const: 0

    patternProperties:
      '^i2c@[0-1]$':
        $ref: /schemas/i2c/i2c-controller.yaml#
        unevaluatedProperties: false
        properties:
          reg:
            items:
              minimum: 0
              maximum: 1

  ports:
    $ref: /schemas/graph.yaml#/properties/ports

    patternProperties:
      '^port@[0-1]$':
        $ref: /schemas/graph.yaml#/properties/port
        description: GMSL Input ports 0-1

      '^port@[2-3]$':
        $ref: /schemas/graph.yaml#/$defs/port-base
        unevaluatedProperties: false
        description: CSI-2 Output ports 0-1
        properties:
          endpoint:
            $ref: /schemas/media/video-interfaces.yaml#
            unevaluatedProperties: false

            properties:
              data-lanes:
                minItems: 1
                maxItems: 4

              lane-polarities:
                minItems: 2
                maxItems: 5

              link-frequencies:
                maxItems: 1

            required:
              - data-lanes

    anyOf:
      - required:
          - port@2
      - required:
          - port@3

required:
  - compatible
  - reg
  - ports

additionalProperties: false

allOf:
  - $ref: /schemas/i2c/i2c-atr.yaml#

dependentRequired:
  i2c-atr: [i2c-alias-pool]
  i2c-alias-pool: [i2c-atr]

examples:
  - |
    #include <dt-bindings/gpio/gpio.h>
    #include <dt-bindings/media/video-interfaces.h>

    i2c {
        #address-cells = <1>;
        #size-cells = <0>;

        deserializer@28 {
            compatible = "maxim,max9296a";
            reg = <0x28>;
            powerdown-gpios = <&main_gpio0 37 GPIO_ACTIVE_LOW>;

            i2c-alias-pool = <0x40 0x41>;

            ports {
                #address-cells = <1>;
                #size-cells = <0>;

                port@0 {
                    reg = <0>;
                    des_gmsl_in_0: endpoint {
                        remote-endpoint = <&ser_0_gmsl_out>;
                    };
                };

                port@1 {
                    reg = <1>;
                    des_gmsl_in_1: endpoint {
                        remote-endpoint = <&ser_1_gmsl_out>;
                    };
                };

                port@2 {
                    reg = <2>;
                    des_csi_out: endpoint {
                        data-lanes = <1 2 3 4>;
                        link-frequencies = /bits/ 64 <400000000>;
                        remote-endpoint = <&csi_in>;
                    };
                };
            };

            i2c-atr {
                #address-cells = <1>;
                #size-cells = <0>;

                i2c@0 {
                    #address-cells = <1>;
                    #size-cells = <0>;
                    reg = <0>;

                    serializer@40 {
                        compatible = "maxim,max96717", "maxim,max96717f";
                        reg = <0x40>;
                        gpio-controller;
                        #gpio-cells = <2>;
                        #clock-cells = <0>;

                        ports {
                            #address-cells = <1>;
                            #size-cells = <0>;

                            port@0 {
                                reg = <0>;
                                ser_0_csi_in: endpoint {
                                    data-lanes = <1 2>;
                                    remote-endpoint = <&sensor_0_out>;
                                };
                            };

                            port@1 {
                                reg = <1>;
                                ser_0_gmsl_out: endpoint {
                                    remote-endpoint = <&des_gmsl_in_0>;
                                };
                            };
                        };
                    };
                };

                i2c@1 {
                    #address-cells = <1>;
                    #size-cells = <0>;
                    reg = <1>;

                    serializer@40 {
                        compatible = "maxim,max96717", "maxim,max96717f";
                        reg = <0x40>;
                        gpio-controller;
                        #gpio-cells = <2>;
                        #clock-cells = <0>;

                        ports {
                            #address-cells = <1>;
                            #size-cells = <0>;

                            port@0 {
                                reg = <0>;
                                ser_1_csi_in: endpoint {
                                    data-lanes = <1 2>;
                                    remote-endpoint = <&sensor_1_out>;
                                };
                            };

                            port@1 {
                                reg = <1>;
                                ser_1_gmsl_out: endpoint {
                                    remote-endpoint = <&des_gmsl_in_1>;
                                };
                            };
                        };
                    };
                };
            };
        };
    };
...
```
