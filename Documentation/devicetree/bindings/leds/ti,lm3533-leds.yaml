## Documentation/devicetree/bindings/leds/ti,lm3533-leds.yaml
```yaml
# SPDX-License-Identifier: (GPL-2.0-only OR BSD-2-Clause)
%YAML 1.2
---
$id: http://devicetree.org/schemas/leds/ti,lm3533-leds.yaml#
$schema: http://devicetree.org/meta-schemas/core.yaml#

title: TI LM3533 low voltage control banks for individual LEDs

description:
  This is part of the TI LM3533 MFD device. It represents four low voltage
  control banks for individual LEDs provided by the TI LM3533.

maintainers:
  - Svyatoslav Ryhel <clamor95@gmail.com>

allOf:
  - $ref: /schemas/leds/common.yaml#

properties:
  compatible:
    const: ti,lm3533-leds

  reg:
    description:
      Control bank selection (2 = bank C, 3 = bank D, 4 = bank E, 5 = bank F).
    minimum: 2
    maximum: 5

  led-max-microamp:
    description: maximum current in uA with a 800 uA step.
    minimum: 5000
    maximum: 29800
    default: 5000

  led-sources:
    description: |
      LVLED associated with this control bank. May be more than 1 source per bank.
        0 - LVLED1
        1 - LVLED2
        2 - LVLED3
        3 - LVLED4
        4 - LVLED5
    minItems: 1
    maxItems: 5
    items:
      maximum: 4

  ti,pwm-config-mask:
    $ref: /schemas/types.yaml#/definitions/uint32
    description: |
      Control Bank PWM Configuration Register mask that allows to configure
      PWM input in Zones 0-4
      BIT(0) - PWM Input is enabled
      BIT(1) - PWM Input is enabled in Zone 0
      BIT(2) - PWM Input is enabled in Zone 1
      BIT(3) - PWM Input is enabled in Zone 2
      BIT(4) - PWM Input is enabled in Zone 3
      BIT(5) - PWM Input is enabled in Zone 4
    default: 0

required:
  - compatible
  - reg

unevaluatedProperties: false

# see ti,lm3533.yaml for an example
```

## Documentation/devicetree/bindings/leds/ti,lm3533.yaml
```yaml
# SPDX-License-Identifier: (GPL-2.0-only OR BSD-2-Clause)
%YAML 1.2
---
$id: http://devicetree.org/schemas/leds/ti,lm3533.yaml#
$schema: http://devicetree.org/meta-schemas/core.yaml#

title: TI LM3533 Complete Lighting Power Solution

description: >
  The LM3533 is a complete power source for backlight, keypad, and indicator LEDs
  in smartphone handsets. The high-voltage inductive boost converter provides the
  power for two high voltage series LED strings for display backlight and four low
  voltage control banks for individual LEDs. Additionally, LM3533 features an
  interface for an external light sensor.

  https://www.ti.com/product/LM3533

maintainers:
  - Svyatoslav Ryhel <clamor95@gmail.com>

properties:
  compatible:
    const: ti,lm3533

  reg:
    maxItems: 1

  enable-gpios:
    description: GPIO connected to the HWEN pin.
    maxItems: 1

  vin-supply:
    description: Supply connected to the IN line (2.7 V to 5.5 V).

  '#address-cells':
    const: 1

  '#size-cells':
    const: 0

  ti,boost-ovp-microvolt:
    description: boost OVP select (16V, 24V, 32V, 40V)
    enum: [ 16000000, 24000000, 32000000, 40000000 ]
    default: 16000000

  ti,boost-freq-hz:
    description: boost frequency select (500KHz or 1MHz)
    enum: [ 500000, 1000000 ]
    default: 500000

  light-sensor:
    type: object
    additionalProperties: false

    properties:
      compatible:
        const: ti,lm3533-als

      interrupts:
        maxItems: 1

      ti,resistor-ohms:
        description:
          Internal configuration resistor value when light sensor is in
          Analog Sensor mode and PWM mode is disabled. The expectation is
          the input is a current from the external analog light sensor and
          this is used to convert it to a voltage within the target range.
        minimum: 1575
        maximum: 200000

      ti,pwm-mode:
        type: boolean
        description:
          Switch for mode in which light sensor interface is running. If
          this property is set then the light sensor interface is running
          in PWM mode, internal resistor value is set to high-impedance (0)
          and ti,resistor-ohms property is ignored.

    required:
      - compatible

    oneOf:
      - required:
          - ti,resistor-ohms
      - required:
          - ti,pwm-mode

patternProperties:
  "^backlight@[01]$":
    $ref: /schemas/leds/backlight/ti,lm3533-backlight.yaml#

  "^led@[2-5]$":
    $ref: /schemas/leds/ti,lm3533-leds.yaml#

required:
  - compatible
  - reg
  - '#address-cells'
  - '#size-cells'

additionalProperties: false

examples:
  - |
    #include <dt-bindings/gpio/gpio.h>
    #include <dt-bindings/interrupt-controller/irq.h>

    i2c {
        #address-cells = <1>;
        #size-cells = <0>;

        led-controller@36 {
            compatible = "ti,lm3533";
            reg = <0x36>;

            enable-gpios = <&gpio 110 GPIO_ACTIVE_HIGH>;
            vin-supply = <&vdd_3v3_bat>;

            ti,boost-ovp-microvolt = <24000000>;
            ti,boost-freq-hz = <500000>;

            #address-cells = <1>;
            #size-cells = <0>;

            backlight@0 {
                compatible = "ti,lm3533-backlight";
                reg = <0>;

                default-brightness = <113>;

                led-max-microamp = <23400>;
                led-sources = <0 1>;
            };

            led@2 {
                compatible = "ti,lm3533-leds";
                reg = <2>;

                led-max-microamp = <23400>;
                led-sources = <0 1>;
            };

            led@4 {
                compatible = "ti,lm3533-leds";
                reg = <4>;

                led-max-microamp = <23400>;
                led-sources = <2>;
            };

            led@5 {
                compatible = "ti,lm3533-leds";
                reg = <5>;

                led-max-microamp = <23400>;
                led-sources = <3 4>;
            };

            light-sensor {
                compatible = "ti,lm3533-als";

                interrupt-parent = <&gpio>;
                interrupts = <80 IRQ_TYPE_LEVEL_LOW>;

                ti,pwm-mode;
            };
        };
    };
...
```

## Documentation/devicetree/bindings/mailbox/axiado,ax3005-mailbox.yaml
```yaml
# SPDX-License-Identifier: (GPL-2.0-only OR BSD-2-Clause)
%YAML 1.2
---
$id: http://devicetree.org/schemas/mailbox/axiado,ax3005-mailbox.yaml#
$schema: http://devicetree.org/meta-schemas/core.yaml#

title: Axiado AX3005 Mailbox Controller

maintainers:
  - Krishnakumar Kesavan <kkesavan@axiado.com>
  - Prasad Bolisetty <pbolisetty@axiado.com>
  - Swark Yang <syang@axiado.com>

description:
  The Axiado mailbox controller provides inter-processor communication
  channels between subsystems within the Axiado SoC. The hardware has
  separate TX and RX register regions. Only the RX channels (channels 8-15)
  generate interrupts; TX channels are purely poll/write-based.

properties:
  compatible:
    const: axiado,ax3005-mailbox

  reg:
    items:
      - description: TX mailbox register region
      - description: RX mailbox register region

  reg-names:
    items:
      - const: tx
      - const: rx

  interrupts:
    description:
      One interrupt per RX channel. The hardware exposes eight RX interrupt
      lines corresponding to channels 8 through 15.
    maxItems: 8

  interrupt-names:
    description:
      Named interrupt lines for each RX channel, from ch8 to ch15.
    items:
      - const: ch8
      - const: ch9
      - const: ch10
      - const: ch11
      - const: ch12
      - const: ch13
      - const: ch14
      - const: ch15

  "#mbox-cells":
    description:
      Number of cells in a mailbox specifier. A single cell encodes the
      channel index as seen by the client.
    const: 1

required:
  - compatible
  - reg
  - reg-names
  - interrupts
  - interrupt-names
  - "#mbox-cells"

additionalProperties: false

examples:
  - |
    #include <dt-bindings/interrupt-controller/arm-gic.h>

    soc {
        #address-cells = <2>;
        #size-cells = <2>;

        mailbox@330f2000 {
            compatible = "axiado,ax3005-mailbox";
            reg = <0x0 0x330f2000 0x0 0x2000>,
                  <0x0 0x331b0000 0x0 0x1000>;
            reg-names = "tx", "rx";
            /* Only RX channels (8-15) have IRQs */
            interrupts = <GIC_SPI 242 IRQ_TYPE_LEVEL_HIGH>,
                         <GIC_SPI 243 IRQ_TYPE_LEVEL_HIGH>,
                         <GIC_SPI 244 IRQ_TYPE_LEVEL_HIGH>,
                         <GIC_SPI 245 IRQ_TYPE_LEVEL_HIGH>,
                         <GIC_SPI 246 IRQ_TYPE_LEVEL_HIGH>,
                         <GIC_SPI 247 IRQ_TYPE_LEVEL_HIGH>,
                         <GIC_SPI 248 IRQ_TYPE_LEVEL_HIGH>,
                         <GIC_SPI 249 IRQ_TYPE_LEVEL_HIGH>;
            interrupt-names = "ch8", "ch9", "ch10", "ch11",
                              "ch12", "ch13", "ch14", "ch15";
            interrupt-parent = <&gic500>;
            #mbox-cells = <1>;
        };
    };
```

## Documentation/devicetree/bindings/mailbox/hisilicon,hi3660-mbox.yaml
```yaml
# SPDX-License-Identifier: (GPL-2.0-only OR BSD-2-Clause)
%YAML 1.2
---
$id: http://devicetree.org/schemas/hisilicon,hi3660-mbox.yaml#
$schema: http://devicetree.org/meta-schemas/core.yaml#

title: Hisilicon Hi3660 Mailbox Controller

maintainers:
  - Wei Xu <xuwei5@hisilicon.com>

description:
  Hisilicon Hi3660 mailbox controller supports up to 32 channels.  Messages
  are passed between processors, including application & communication
  processors, MCU, HIFI, etc.  Each channel is unidirectional and accessed
  by using MMIO registers; it supports maximum to 8 words message.

properties:
  compatible:
    items:
      - const: hisilicon,hi3660-mbox

  reg:
    maxItems: 1

  interrupts:
    description: Mailbox interrupt vectors for message processing
    maxItems: 2

  '#mbox-cells':
    description: >
      The cells content are as follows:
        - Channel number
        - Remote destination interrupt vector
        - Local ack interrupt vector
    const: 3

required:
  - compatible
  - reg
  - interrupts
  - '#mbox-cells'

additionalProperties: false

examples:
  - |
    #include <dt-bindings/interrupt-controller/arm-gic.h>
    #include <dt-bindings/interrupt-controller/irq.h>

    mailbox@e896b000 {
        compatible = "hisilicon,hi3660-mbox";
        reg = <0xe896b000 0x1000>;
        interrupts = <GIC_SPI 0xc0 IRQ_TYPE_LEVEL_HIGH>,
                     <GIC_SPI 0xc1 IRQ_TYPE_LEVEL_HIGH>;
        #mbox-cells = <3>;
    };
```

## Documentation/devicetree/bindings/mailbox/hisilicon,hi6220-mbox.yaml
```yaml
# SPDX-License-Identifier: (GPL-2.0-only OR BSD-2-Clause)
%YAML 1.2
---
$id: http://devicetree.org/schemas/mailbox/hisilicon,hi6220-mbox.yaml#
$schema: http://devicetree.org/meta-schemas/core.yaml#

title: Hisilicon Hi6220 Mailbox Controller

maintainers:
  - Wei Xu <xuwei5@hisilicon.com>

description:
  Hisilicon Hi6220 mailbox supports up to 32 channels. Each channel is
  unidirectional with a maximum message size of 8 words. I/O is performed using
  register access (there is no DMA) and the cell raises an interrupt when
  messages are received.

properties:
  compatible:
    const: hisilicon,hi6220-mbox

  reg:
    items:
      - description: IPC registers
      - description: Shared buffer for mailbox slots

  interrupts:
    maxItems: 1

  "#mbox-cells":
    const: 3
    description: >
      The cells content are as follows:
        - Slot number
        - Remote destination interrupt vector
        - Local ack interrupt vector

  hi6220,mbox-tx-noirq:
    description:
      Flag to request MCU to enable automatic idle flag mode instead of IRQ for
      TX completion.
    type: boolean

required:
  - compatible
  - reg
  - interrupts
  - "#mbox-cells"

additionalProperties: false

examples:
  - |
    #include <dt-bindings/interrupt-controller/arm-gic.h>
    #include <dt-bindings/interrupt-controller/irq.h>

    mailbox@f7510000 {
        compatible = "hisilicon,hi6220-mbox";
        reg = <0xf7510000 0x1000>,
              <0x06dff800 0x0800>;
        interrupts = <GIC_SPI 94 IRQ_TYPE_LEVEL_HIGH>;
        #mbox-cells = <3>;
    };
```

## Documentation/devicetree/bindings/mailbox/ti,k2g-message-manager.yaml
```yaml
# SPDX-License-Identifier: (GPL-2.0-only OR BSD-2-Clause)
%YAML 1.2
---
$id: http://devicetree.org/schemas/mailbox/ti,k2g-message-manager.yaml#
$schema: http://devicetree.org/meta-schemas/core.yaml#

title: Texas Instruments Message Manager

maintainers:
  - Eduard Bostina <egbostina@gmail.com>

description:
  The Texas Instruments Message Manager is a mailbox controller that has
  configurable queues selectable at SoC (System on Chip) integration. The
  Message manager is broken up into queues in different address regions
  that are called "proxies" - each instance is unidirectional and is
  instantiated at SoC integration level to indicate receive or transmit path.

properties:
  compatible:
    const: ti,k2g-message-manager

  reg:
    maxItems: 2

  reg-names:
    items:
      - const: queue_proxy_region
      - const: queue_state_debug_region

  "#mbox-cells":
    const: 2
    description:
      Contains the queue ID and proxy ID in that order referring to the
      transfer path.

  interrupts:
    maxItems: 2

  interrupt-names:
    items:
      - const: rx_005
      - const: rx_057

required:
  - compatible
  - reg
  - reg-names
  - "#mbox-cells"
  - interrupts
  - interrupt-names

additionalProperties: false

examples:
  - |
    #include <dt-bindings/interrupt-controller/arm-gic.h>

    msgmgr@2a00000 {
        compatible = "ti,k2g-message-manager";
        #mbox-cells = <2>;
        reg-names = "queue_proxy_region", "queue_state_debug_region";
        reg = <0x02a00000 0x400000>, <0x028c3400 0x400>;
        interrupt-names = "rx_005", "rx_057";
        interrupts = <GIC_SPI 324 IRQ_TYPE_LEVEL_HIGH>,
                     <GIC_SPI 327 IRQ_TYPE_LEVEL_HIGH>;
    };
```

## Documentation/devicetree/bindings/media/fsl,imx95-csi-formatter.yaml
```yaml
# SPDX-License-Identifier: (GPL-2.0-only OR BSD-2-Clause)
%YAML 1.2
---
$id: http://devicetree.org/schemas/media/fsl,imx95-csi-formatter.yaml#
$schema: http://devicetree.org/meta-schemas/core.yaml#

title: i.MX95 CSI Pixel Formatter

maintainers:
  - Guoniu Zhou <guoniu.zhou@nxp.com>

description:
  The CSI pixel formatting module found on i.MX95 uses packet info, pixel
  and non-pixel data from the CSI-2 host controller and reformat them to
  match Pixel Link(PL) definition.

properties:
  compatible:
    const: fsl,imx95-csi-formatter

  reg:
    maxItems: 1
    description: Register offset and size within the parent syscon

  clocks:
    maxItems: 1

  power-domains:
    maxItems: 1

  ports:
    $ref: /schemas/graph.yaml#/properties/ports

    properties:
      port@0:
        $ref: /schemas/graph.yaml#/properties/port
        description:
          Input port, connects to MIPI CSI-2 receiver output (IDI interface)

      port@1:
        $ref: /schemas/graph.yaml#/properties/port
        description:
          Output port, connects to ISI input via Pixel Link (PL)

    required:
      - port@0
      - port@1

required:
  - compatible
  - reg
  - clocks
  - power-domains
  - ports

additionalProperties: false

examples:
  - |
    #include <dt-bindings/clock/nxp,imx95-clock.h>

    formatter@20 {
        compatible = "fsl,imx95-csi-formatter";
        reg = <0x20 0x100>;
        clocks = <&cameramix_csr IMX95_CLK_CAMBLK_CSI2_FOR0>;
        power-domains = <&scmi_devpd 3>;

        ports {
            #address-cells = <1>;
            #size-cells = <0>;

            port@0 {
                reg = <0>;

                endpoint {
                    remote-endpoint = <&mipi_csi_0_out>;
                };
            };

            port@1 {
                reg = <1>;

                endpoint {
                    remote-endpoint = <&isi_in_2>;
                };
            };
        };
    };
```
