## Documentation/devicetree/bindings/media/ti,am437x-vpfe.yaml
```yaml
# SPDX-License-Identifier: (GPL-2.0-only OR BSD-2-Clause)
%YAML 1.2
---
$id: http://devicetree.org/schemas/media/ti,am437x-vpfe.yaml#
$schema: http://devicetree.org/meta-schemas/core.yaml#

title: Texas Instruments AM437x CAMERA Video Processing Front End (VPFE)

maintainers:
  - Benoit Parrot <bparrot@ti.com>
  - Bhargav Joshi <j.bhargav.u@gmail.com>

description:
  The Video Processing Front End (VPFE) is a key component for image capture
  applications. The capture module provides the system interface and the
  processing capability to connect RAW image-sensor modules and video decoders
  to the AM437x device.

properties:
  compatible:
    const: ti,am437x-vpfe

  reg:
    maxItems: 1

  interrupts:
    maxItems: 1

  port:
    $ref: /schemas/graph.yaml#/$defs/port-base
    unevaluatedProperties: false
    description:
      A single parallel input port connecting to an external image sensor or
      video decoder. The VPFE supports only one input port per instance.

    properties:
      endpoint:
        $ref: video-interfaces.yaml#
        unevaluatedProperties: false

        properties:
          ti,am437x-vpfe-interface:
            $ref: /schemas/types.yaml#/definitions/uint32
            enum: [0, 1, 2, 3, 4]
            description:
              Selects the VPFE input interface type can be one of following
                0 - Raw Bayer        (VPFE_RAW_BAYER)
                1 - BT.656 8-bit     (VPFE_BT656)
                2 - BT.656 10-bit    (VPFE_BT656_10BIT)
                3 - YCbCr 8-bit sync (VPFE_YCBCR_SYNC_8)
                4 - YCbCr 16-bit sync (VPFE_YCBCR_SYNC_16)

          bus-width:
            minimum: 8
            maximum: 16

        required:
          - remote-endpoint
          - ti,am437x-vpfe-interface
          - bus-width

required:
  - compatible
  - reg
  - interrupts
  - port

additionalProperties: false

examples:
  - |
    #include <dt-bindings/interrupt-controller/arm-gic.h>
    #include <dt-bindings/interrupt-controller/irq.h>

    vpfe@48328000{
        compatible = "ti,am437x-vpfe";
        reg = <0x48328000 0x2000>;
        interrupts = <GIC_SPI 50 IRQ_TYPE_LEVEL_HIGH>;

        pinctrl-names = "default", "sleep";
        pinctrl-0 = <&vpfe_pins_default>;
        pinctrl-1 = <&vpfe_pins_sleep>;

        port {
            vpfe0_ep: endpoint {
                remote-endpoint = <&ov2659_1>;
                ti,am437x-vpfe-interface = <0>;
                bus-width = <8>;
                hsync-active = <0>;
                vsync-active = <0>;
            };
        };
    };
```

## Documentation/devicetree/bindings/media/ti,da850-vpif.yaml
```yaml
# SPDX-License-Identifier: (GPL-2.0-only OR BSD-2-Clause)
%YAML 1.2
---
$id: http://devicetree.org/schemas/media/ti,da850-vpif.yaml#
$schema: http://devicetree.org/meta-schemas/core.yaml#

title: Texas Instruments DA850/AM18x Video Port Interface (VPIF)

maintainers:
  - Lad, Prabhakar <prabhakar.csengg@gmail.com>

description:
  The Video Port Interface (VPIF) is the primary component for video capture
  and display on the DA850/AM18x family of TI DaVinci/Sitara SoCs.

  TI Document reference:- SPRUH82C, Chapter 35
  https://www.ti.com/lit/pdf/spruh82

properties:
  compatible:
    const: ti,da850-vpif

  reg:
    maxItems: 1

  interrupts:
    maxItems: 1

  power-domains:
    maxItems: 1

  '#address-cells':
    const: 1

  '#size-cells':
    const: 0

  port:
    $ref: /schemas/graph.yaml#/$defs/port-base
    unevaluatedProperties: false
    description:
      VPIF port when the bus is configured as a single 16-bit input

    properties:
      endpoint:
        $ref: video-interfaces.yaml#
        unevaluatedProperties: false

        properties:
          bus-width:
            enum: [8, 16]

patternProperties:
  ^port@[0-1]$:
    $ref: /schemas/graph.yaml#/$defs/port-base
    unevaluatedProperties: false
    description:
      VPIF has a 16-bit parallel bus input, supporting 2 8-bit channels or a
      single 16-bit channel. It should contain one or two port child nodes
      with child 'endpoint' node. If there are two ports then port@0 must
      describe the input and port@1 output channels.

    properties:
      endpoint:
        $ref: video-interfaces.yaml#
        unevaluatedProperties: false

        properties:
          bus-width:
            enum: [8, 16]

      endpoint@0:
        $ref: video-interfaces.yaml#
        unevaluatedProperties: false
        description:
          First 8-bit channel using the lower data lines [7:0].

        properties:
          bus-width:
            const: 8

          data-shift:
            const: 0

      endpoint@1:
        $ref: video-interfaces.yaml#
        unevaluatedProperties: false
        description:
          Second 8-bit channel using the upper data lines [15:8].

        properties:
          bus-width:
            const: 8

          data-shift:
            const: 8

    anyOf:
      - properties:
          endpoint@0: false
          endpoint@1: false
      - properties:
          endpoint: false

required:
  - compatible
  - reg
  - interrupts

oneOf:
  - properties:
      port@0: false
      port@1: false
  - properties:
      port: false

additionalProperties: false

examples:
  - |
    vpif@217000 {
        compatible = "ti,da850-vpif";
        reg = <0x217000 0x1000>;
        interrupts = <92>;

        #address-cells = <1>;
        #size-cells = <0>;

        port@0 {
            reg = <0>;
            #address-cells = <1>;
            #size-cells = <0>;

            vpif_input_ch0: endpoint@0 {
                reg = <0>;
                bus-width = <8>;
                remote-endpoint = <&composite_in>;
            };

            vpif_input_ch1: endpoint@1 {
                reg = <1>;
                bus-width = <8>;
                data-shift = <8>;
            };
        };

        port@1 {
            reg = <1>;

            vpif_output_ch0: endpoint {
                bus-width = <8>;
                remote-endpoint = <&composite_out>;
            };
        };
    };

  - |
    vpif@217000 {
        compatible = "ti,da850-vpif";
        reg = <0x217000 0x1000>;
        interrupts = <92>;

        port {
            vpif_ch0: endpoint {
                bus-width = <16>;
            };
        };
    };
```
