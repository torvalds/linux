## Documentation/devicetree/bindings/media/i2c/samsung,s5kjn5.yaml
```yaml
# SPDX-License-Identifier: (GPL-2.0-only OR BSD-2-Clause)
%YAML 1.2
---
$id: http://devicetree.org/schemas/media/i2c/samsung,s5kjn5.yaml#
$schema: http://devicetree.org/meta-schemas/core.yaml#

title: Samsung S5KJN5 Image Sensor

description:
  Samsung S5KJN5 is a 50MP 10-bit RAW MIPI CSI-2 image sensor.
  The sensor is controlled over I2C. The full resolution pixel array is
  8192x6144, data output format is RAW10 transferred over 4-lane MIPI
  D-PHY interface.

maintainers:
  - Wenmeng Liu <wenmeng.liu@oss.qualcomm.com>

allOf:
  - $ref: /schemas/media/video-interface-devices.yaml#

properties:
  compatible:
    const: samsung,s5kjn5

  reg:
    maxItems: 1

  clocks:
    description: MCLK/XVCLK input clock.
    maxItems: 1

  reset-gpios:
    description: Active low GPIO connected to RESET pad of the sensor.
    maxItems: 1

  vddio-supply:
    description:
      1.8 volt I/O voltage supply (VDD18). Required for both 1.8 and 1.2 volt
      I/O operation.

  vddd-supply:
    description: Digital core voltage supply, 1.0 volts.

  vddm-supply:
    description: MIPI voltage supply, 1.0 volts.

  vdda-supply:
    description: Analogue voltage supply, 2.2 volts.

  vddio1p2-supply:
    description:
      1.2 volt I/O voltage supply (VDDIO12). Required only for 1.2 volt I/O
      operation.

  afvdd-supply:
    description: Autofocus actuator voltage supply, 2.8-3.0 volts.

  port:
    $ref: /schemas/graph.yaml#/$defs/port-base
    additionalProperties: false

    properties:
      endpoint:
        $ref: /schemas/media/video-interfaces.yaml#
        unevaluatedProperties: false

        properties:
          data-lanes:
            items:
              - const: 1
              - const: 2
              - const: 3
              - const: 4

        required:
          - link-frequencies

required:
  - compatible
  - reg
  - clocks
  - port

unevaluatedProperties: false

examples:
  - |
      #include <dt-bindings/gpio/gpio.h>

      i2c {
          #address-cells = <1>;
          #size-cells = <0>;

          camera@10 {
              compatible = "samsung,s5kjn5";
              reg = <0x10>;
              clocks = <&camera_mclk 0>;
              assigned-clocks = <&camera_mclk 0>;
              assigned-clock-rates = <19200000>;
              reset-gpios = <&gpio1 10 GPIO_ACTIVE_LOW>;
              vddio-supply = <&vreg_1p8>;
              vddd-supply = <&vreg_1p0>;
              vddm-supply = <&vreg_1p0>;
              vdda-supply = <&vreg_2p2>;
              vddio1p2-supply = <&vreg_1p2>;
              afvdd-supply = <&vreg_2p8>;

              port {
                  endpoint {
                      link-frequencies = /bits/ 64 <1248000000>;
                      data-lanes = <1 2 3 4>;
                      remote-endpoint = <&mipi_csi2_ep>;
                  };
              };
          };
      };
...
```

## Documentation/devicetree/bindings/media/i2c/sony,imx576.yaml
```yaml
# SPDX-License-Identifier: (GPL-2.0 OR BSD-2-Clause)
%YAML 1.2
---
$id: http://devicetree.org/schemas/media/i2c/sony,imx576.yaml#
$schema: http://devicetree.org/meta-schemas/core.yaml#

title: Sony IMX576 Image Sensor

maintainers:
  - Hardevsinh Palaniya <hardevsinh.palaniya@siliconsignals.io>

description:
  IMX576 sensor is a Sony CMOS active pixel digital image sensor with an active
  array size of 5760(H) × 4312(V). It is programmable through an I2C interface.
  Image data is transmitted through MIPI CSI-2. It supports RAW10/RAW8, COMP8
  output formats.

allOf:
  - $ref: /schemas/media/video-interface-devices.yaml#

properties:
  compatible:
    const: sony,imx576

  reg:
    maxItems: 1

  clocks:
    items:
      - description: INCLK clock

  vana-supply:
    description: Analog Supply Voltage (2.8v)

  vdig-supply:
    description: Digital Supply Voltage (1.05v)

  vif-supply:
    description: Interface Supply Voltage (1.8v)

  reset-gpios:
    maxItems: 1
    description: Reset Pin GPIO Control (active low)

  port:
    description: MIPI CSI-2 transmitter port
    $ref: /schemas/graph.yaml#/$defs/port-base
    additionalProperties: false

    properties:
      endpoint:
        $ref: /schemas/media/video-interfaces.yaml#
        unevaluatedProperties: false

        properties:
          data-lanes:
            oneOf:
              - items:
                  - const: 1
                  - const: 2
                  - const: 3
                  - const: 4
              - items:
                  - const: 1
                  - const: 2
        required:
          - data-lanes
          - link-frequencies

    required:
      - endpoint

required:
  - compatible
  - reg
  - clocks
  - vana-supply
  - vif-supply
  - vdig-supply
  - port

unevaluatedProperties: false

examples:
  - |
    #include <dt-bindings/gpio/gpio.h>
    #include <dt-bindings/media/video-interfaces.h>

    i2c {
        #address-cells = <1>;
        #size-cells = <0>;

        camera-sensor@10 {
            compatible = "sony,imx576";
            reg = <0x10>;
            clocks = <&imx576_clk>;
            reset-gpios = <&tlmm 35 GPIO_ACTIVE_LOW>;

            vana-supply = <&vreg_l3p>;
            vif-supply = <&vreg_l6p>;
            vdig-supply = <&vreg_32m_cam_dvdd_1p05>;

            orientation = <0>;
            rotation = <90>;

            port {
                cam_out: endpoint {
                   remote-endpoint = <&csiphy3_ep>;
                   data-lanes = <1 2 3 4>;
                   link-frequencies = /bits/ 64 <1017000000>;
                };
            };
        };
    };
```

## Documentation/devicetree/bindings/media/i2c/toshiba,tc358743.yaml
```yaml
# SPDX-License-Identifier: (GPL-2.0-only OR BSD-2-Clause)
%YAML 1.2
---
$id: http://devicetree.org/schemas/media/i2c/toshiba,tc358743.yaml#
$schema: http://devicetree.org/meta-schemas/core.yaml#

title: Toshiba TC358743 HDMI-RX to MIPI CSI2-TX Bridge

maintainers:
  - Hans Verkuil <hverkuil@kernel.org>

description:
  The Toshiba TC358743 HDMI-RX to MIPI CSI2-TX (H2C) is a bridge that converts
  a HDMI stream to MIPI CSI-2 TX. It is programmable through I2C.

properties:
  compatible:
    const: toshiba,tc358743

  reg:
    maxItems: 1

  clocks:
    maxItems: 1

  clock-names:
    const: refclk

  reset-gpios:
    maxItems: 1

  interrupts:
    maxItems: 1

  port:
    $ref: /schemas/graph.yaml#/$defs/port-base
    unevaluatedProperties: false

    properties:
      endpoint:
        $ref: /schemas/media/video-interfaces.yaml#
        unevaluatedProperties: false

        properties:
          data-lanes:
            oneOf:
              - items:
                  - const: 1
                  - const: 2
              - items:
                  - const: 1
                  - const: 2
                  - const: 3
                  - const: 4

required:
  - compatible
  - reg
  - clocks
  - clock-names
  - port

additionalProperties: false

examples:
  - |
    #include <dt-bindings/gpio/gpio.h>
    #include <dt-bindings/interrupt-controller/irq.h>

    i2c {
        #address-cells = <1>;
        #size-cells = <0>;

        bridge@f {
            compatible = "toshiba,tc358743";
            reg = <0x0f>;
            clocks = <&hdmi_osc>;
            clock-names = "refclk";
            reset-gpios = <&gpio6 9 GPIO_ACTIVE_LOW>;
            interrupt-parent = <&gpio2>;
            interrupts = <5 IRQ_TYPE_LEVEL_HIGH>;

            port {
                 endpoint {
                     remote-endpoint = <&mipi_csi2_in>;
                     data-lanes = <1 2 3 4>;
                     clock-lanes = <0>;
                     clock-noncontinuous;
                     link-frequencies = /bits/ 64 <297000000>;
                 };
            };
        };
    };
```

## Documentation/devicetree/bindings/media/mediatek-jpeg-decoder.yaml
```yaml
# SPDX-License-Identifier: (GPL-2.0 OR BSD-2-Clause)
%YAML 1.2
---
$id: http://devicetree.org/schemas/media/mediatek-jpeg-decoder.yaml#
$schema: http://devicetree.org/meta-schemas/core.yaml#

title: MediaTek JPEG Decoder

maintainers:
  - Xia Jiang <xia.jiang@mediatek.com>

description: |-
  Mediatek JPEG Decoder is the JPEG decode hardware present in Mediatek SoCs

properties:
  compatible:
    oneOf:
      - enum:
          - mediatek,mt2701-jpgdec
          - mediatek,mt8173-jpgdec
          - mediatek,mt8189-jpgdec
      - items:
          - enum:
              - mediatek,mt7623-jpgdec
              - mediatek,mt8188-jpgdec
          - const: mediatek,mt2701-jpgdec

  reg:
    maxItems: 1

  interrupts:
    maxItems: 1

  clocks:
    minItems: 1
    maxItems: 2

  clock-names:
    oneOf:
      - items:
          - const: jpgdec
      - items:
          - const: jpgdec-smi
          - const: jpgdec

  power-domains:
    maxItems: 1

  iommus:
    minItems: 2
    maxItems: 32
    description: |
      Points to the respective IOMMU block with master port as argument, see
      Documentation/devicetree/bindings/iommu/mediatek,iommu.yaml for details.
      Ports are according to the HW.

  mediatek,larb:
    $ref: /schemas/types.yaml#/definitions/phandle
    description: |
      A phandle to the local arbiter (SMI LARB) node. This explicitly
      describes the hardware topology where the JPEG block is connected
      to a dedicated SMI LARB for memory bandwidth arbitration. It is
      required to accurately represent the hardware connection independently
      of the IOMMU.

required:
  - compatible
  - reg
  - interrupts
  - clocks
  - clock-names
  - power-domains
  - iommus

allOf:
  - if:
      properties:
        compatible:
          contains:
            const: mediatek,mt8189-jpgdec
    then:
      properties:
        clocks:
          maxItems: 1
        clock-names:
          maxItems: 1
      required:
        - mediatek,larb
    else:
      properties:
        clocks:
          minItems: 2
        clock-names:
          minItems: 2
        mediatek,larb: false

additionalProperties: false

examples:
  - |
    #include <dt-bindings/clock/mt2701-clk.h>
    #include <dt-bindings/interrupt-controller/arm-gic.h>
    #include <dt-bindings/memory/mt2701-larb-port.h>
    #include <dt-bindings/power/mt2701-power.h>
    jpegdec: jpegdec@15004000 {
      compatible = "mediatek,mt2701-jpgdec";
      reg = <0x15004000 0x1000>;
      interrupts = <GIC_SPI 143 IRQ_TYPE_LEVEL_LOW>;
      clocks =  <&imgsys CLK_IMG_JPGDEC_SMI>,
                <&imgsys CLK_IMG_JPGDEC>;
      clock-names = "jpgdec-smi",
                    "jpgdec";
      power-domains = <&scpsys MT2701_POWER_DOMAIN_ISP>;
      iommus = <&iommu MT2701_M4U_PORT_JPGDEC_WDMA>,
               <&iommu MT2701_M4U_PORT_JPGDEC_BSDMA>;
    };
```

## Documentation/devicetree/bindings/media/mediatek-jpeg-encoder.yaml
```yaml
# SPDX-License-Identifier: (GPL-2.0 OR BSD-2-Clause)
%YAML 1.2
---
$id: http://devicetree.org/schemas/media/mediatek-jpeg-encoder.yaml#
$schema: http://devicetree.org/meta-schemas/core.yaml#

title: MediaTek JPEG Encoder

maintainers:
  - Xia Jiang <xia.jiang@mediatek.com>

description: |-
  MediaTek JPEG Encoder is the JPEG encode hardware present in MediaTek SoCs

properties:
  compatible:
    oneOf:
      - enum:
          - mediatek,mt8189-jpgenc
      - items:
          - enum:
              - mediatek,mt2701-jpgenc
              - mediatek,mt8183-jpgenc
              - mediatek,mt8186-jpgenc
              - mediatek,mt8188-jpgenc
          - const: mediatek,mtk-jpgenc

  reg:
    maxItems: 1

  interrupts:
    maxItems: 1

  clocks:
    maxItems: 1

  clock-names:
    items:
      - const: jpgenc

  power-domains:
    maxItems: 1

  iommus:
    minItems: 2
    maxItems: 32
    description: |
      Points to the respective IOMMU block with master port as argument, see
      Documentation/devicetree/bindings/iommu/mediatek,iommu.yaml for details.
      Ports are according to the HW.

  mediatek,larb:
    $ref: /schemas/types.yaml#/definitions/phandle
    description: |
      A phandle to the local arbiter (SMI LARB) node. This explicitly
      describes the hardware topology where the JPEG block is connected
      to a dedicated SMI LARB for memory bandwidth arbitration. It is
      required to accurately represent the hardware connection independently
      of the IOMMU.

required:
  - compatible
  - reg
  - interrupts
  - clocks
  - clock-names
  - power-domains
  - iommus

allOf:
  - if:
      properties:
        compatible:
          contains:
            const: mediatek,mt8189-jpgenc
    then:
      required:
        - mediatek,larb
    else:
      properties:
        mediatek,larb: false

additionalProperties: false

examples:
  - |
    #include <dt-bindings/clock/mt2701-clk.h>
    #include <dt-bindings/interrupt-controller/arm-gic.h>
    #include <dt-bindings/memory/mt2701-larb-port.h>
    #include <dt-bindings/power/mt2701-power.h>
    jpegenc: jpegenc@1500a000 {
      compatible = "mediatek,mt2701-jpgenc",
                   "mediatek,mtk-jpgenc";
      reg = <0x1500a000 0x1000>;
      interrupts = <GIC_SPI 141 IRQ_TYPE_LEVEL_LOW>;
      clocks =  <&imgsys CLK_IMG_VENC>;
      clock-names = "jpgenc";
      power-domains = <&scpsys MT2701_POWER_DOMAIN_ISP>;
      iommus = <&iommu MT2701_M4U_PORT_JPGENC_RDMA>,
               <&iommu MT2701_M4U_PORT_JPGENC_BSDMA>;
    };
```
