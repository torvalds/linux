## Documentation/devicetree/bindings/interrupt-controller/cdns,xtensa-pic.yaml
```yaml
# SPDX-License-Identifier: (GPL-2.0-only OR BSD-2-Clause)
# Copyright 2025 Max Filippov <jcmvbkbc@gmail.com>

%YAML 1.2
---
$id: http://devicetree.org/schemas/interrupt-controller/cdns,xtensa-pic.yaml#
$schema: http://devicetree.org/meta-schemas/core.yaml#

title: Xtensa Interrupt Controllers

maintainers:
  - Max Filippov <jcmvbkbc@gmail.com>

description:
  Xtensa Interrupt Distributor and Programmable Interrupt Controller (MX) and
  Xtensa built-in Programmable Interrupt Controller (PIC)

properties:
  compatible:
    enum:
      - cdns,xtensa-mx
      - cdns,xtensa-pic

  '#interrupt-cells':
    enum: [ 1, 2 ]
    description:
      Number of cells to define the interrupts. When 1, the first cell is the
      internal IRQ number; when 2, the second cell specifies internal (0) or
      external (1).

  interrupt-controller: true

required:
  - compatible
  - '#interrupt-cells'
  - interrupt-controller

additionalProperties: false

examples:
  - |
    interrupt-controller {
        compatible = "cdns,xtensa-pic";
        /* one cell: internal irq number,
         * two cells: second cell == 0: internal irq number
         *            second cell == 1: external irq number
         */
        #interrupt-cells = <2>;
        interrupt-controller;
    };
```

## Documentation/devicetree/bindings/interrupt-controller/chrp,open-pic.yaml
```yaml
# SPDX-License-Identifier: (GPL-2.0-only OR BSD-2-Clause)
%YAML 1.2
---
$id: http://devicetree.org/schemas/interrupt-controller/chrp,open-pic.yaml#
$schema: http://devicetree.org/meta-schemas/core.yaml#

title: Open PIC Interrupt Controller

maintainers:
  - Rob Herring <robh@kernel.org>

description:
  This binding specifies what properties must be available in the device tree
  representation of an Open PIC compliant interrupt controller.  This binding is
  based on the binding defined for Open PIC in [1] and is a superset of that
  binding.

properties:
  compatible:
    oneOf:
      - items:
          - const: fsl,mpic
          - const: chrp,open-pic
      - const: chrp,open-pic

  device_type:
    const: open-pci
    deprecated: true

  reg:
    maxItems: 1

  interrupt-controller: true

  '#address-cells':
    const: 0

  '#interrupt-cells':
    description:
      A value of 4 means that interrupt specifiers contain the interrupt-type or
      type-specific information cells.
    enum: [ 2, 4 ]

  pic-no-reset:
    description: Indicates the PIC shall not be reset during runtime initialization.
    type: boolean

  single-cpu-affinity:
    description:
      If present, non-IPI interrupts will be routed to a single CPU at a time.
    type: boolean

  last-interrupt-source:
    description:
      Some MPICs do not correctly report the number of hardware sources in the
      global feature registers. This value, if specified, overrides the value
      read from MPIC_GREG_FEATURE_LAST_SRC.
    $ref: /schemas/types.yaml#/definitions/uint32

required:
  - compatible
  - reg
  - interrupt-controller
  - '#address-cells'
  - '#interrupt-cells'

additionalProperties: false

examples:
  - |
    interrupt-controller@40000 {
        compatible = "chrp,open-pic";
        reg = <0x40000 0x40000>;
        interrupt-controller;
        #address-cells = <0>;
        #interrupt-cells = <2>;
        pic-no-reset;
    };
```

## Documentation/devicetree/bindings/interrupt-controller/cirrus,clps711x-intc.txt
```
Cirrus Logic CLPS711X Interrupt Controller

Required properties:

- compatible: Should be "cirrus,clps711x-intc".
- reg: Specifies base physical address of the registers set.
- interrupt-controller: Identifies the node as an interrupt controller.
- #interrupt-cells: Specifies the number of cells needed to encode an
  interrupt source. The value shall be 1.

The interrupt sources are as follows:
ID	Name	Description
---------------------------
1:	BLINT	Battery low (FIQ)
3:	MCINT	Media changed (FIQ)
4:	CSINT	CODEC sound
5:	EINT1	External 1
6:	EINT2	External 2
7:	EINT3	External 3
8:	TC1OI	TC1 under flow
9:	TC2OI	TC2 under flow
10:	RTCMI	RTC compare match
11:	TINT	64Hz tick
12:	UTXINT1	UART1 transmit FIFO half empty
13:	URXINT1	UART1 receive FIFO half full
14:	UMSINT	UART1 modem status changed
15:	SSEOTI	SSI1 end of transfer
16:	KBDINT	Keyboard
17:	SS2RX	SSI2 receive FIFO half or greater full
18:	SS2TX	SSI2 transmit FIFO less than half empty
28:	UTXINT2	UART2 transmit FIFO half empty
29:	URXINT2	UART2 receive FIFO half full
32:	DAIINT	DAI interface (FIQ)

Example:
	intc: interrupt-controller {
		compatible = "cirrus,clps711x-intc";
		reg = <0x80000000 0x4000>;
		interrupt-controller;
		#interrupt-cells = <1>;
	};
```

## Documentation/devicetree/bindings/interrupt-controller/cirrus,ep7209-intc.yaml
```yaml
# SPDX-License-Identifier: (GPL-2.0-only OR BSD-2-Clause)
%YAML 1.2
---
$id: http://devicetree.org/schemas/interrupt-controller/cirrus,ep7209-intc.yaml#
$schema: http://devicetree.org/meta-schemas/core.yaml#

title: Cirrus Logic CLPS711X Interrupt Controller

maintainers:
  - Alexander Shiyan <shc_work@mail.ru>

description: >
  Cirrus Logic CLPS711X Interrupt Controller

  The interrupt sources are as follows:
    ID	Name	Description
    ---------------------------
    1:	BLINT	Battery low (FIQ)
    3:	MCINT	Media changed (FIQ)
    4:	CSINT	CODEC sound
    5:	EINT1	External 1
    6:	EINT2	External 2
    7:	EINT3	External 3
    8:	TC1OI	TC1 under flow
    9:	TC2OI	TC2 under flow
    10:	RTCMI	RTC compare match
    11:	TINT	64Hz tick
    12:	UTXINT1	UART1 transmit FIFO half empty
    13:	URXINT1	UART1 receive FIFO half full
    14:	UMSINT	UART1 modem status changed
    15:	SSEOTI	SSI1 end of transfer
    16:	KBDINT	Keyboard
    17:	SS2RX	SSI2 receive FIFO half or greater full
    18:	SS2TX	SSI2 transmit FIFO less than half empty
    28:	UTXINT2	UART2 transmit FIFO half empty
    29:	URXINT2	UART2 receive FIFO half full
    32:	DAIINT	DAI interface (FIQ)

properties:
  compatible:
    oneOf:
      - items:
          - const: cirrus,ep7312-intc
          - const: cirrus,ep7209-intc
      - items:
          - const: cirrus,ep7209-intc

  reg:
    maxItems: 1

  interrupt-controller: true

  '#interrupt-cells':
    const: 1

required:
  - compatible
  - reg
  - interrupt-controller
  - '#interrupt-cells'

additionalProperties: false

examples:
  - |
    interrupt-controller@80000000 {
        compatible = "cirrus,ep7312-intc", "cirrus,ep7209-intc";
        reg = <0x80000000 0x4000>;
        interrupt-controller;
        #interrupt-cells = <1>;
    };
```

## Documentation/devicetree/bindings/interrupt-controller/cnxt,cx92755-ic.yaml
```yaml
# SPDX-License-Identifier: (GPL-2.0-only OR BSD-2-Clause)
%YAML 1.2
---
$id: http://devicetree.org/schemas/interrupt-controller/cnxt,cx92755-ic.yaml#
$schema: http://devicetree.org/meta-schemas/core.yaml#

title: Conexant Digicolor Interrupt Controller

maintainers:
  - Baruch Siach <baruch@tkos.co.il>

description: Conexant Digicolor Interrupt Controller

properties:
  compatible:
    const: cnxt,cx92755-ic

  reg:
    maxItems: 1

  interrupt-controller: true

  '#interrupt-cells':
    const: 1

  syscon:
    description: A phandle to the syscon node describing UC registers
    $ref: /schemas/types.yaml#/definitions/phandle

required:
  - compatible
  - reg
  - interrupt-controller
  - '#interrupt-cells'
  - syscon

additionalProperties: false

examples:
  - |
    interrupt-controller@f0000040 {
        compatible = "cnxt,cx92755-ic";
        interrupt-controller;
        #interrupt-cells = <1>;
        reg = <0xf0000040 0x40>;
        syscon = <&uc_regs>;
    };
```

## Documentation/devicetree/bindings/interrupt-controller/cortina,gemini-interrupt-controller.txt
```
* Cortina Systems Gemini interrupt controller

This interrupt controller is found on the Gemini SoCs.

Required properties:
- compatible: must be "cortina,gemini-interrupt-controller"
- reg: The register bank for the interrupt controller.
- interrupt-controller: Identifies the node as an interrupt controller
- #interrupt-cells: The number of cells to define the interrupts.
  Must be 2 as the controller can specify level or rising edge
  IRQs. The bindings follows the standard binding for controllers
  with two cells specified in
  interrupt-controller/interrupts.txt

Example:

interrupt-controller@48000000 {
	compatible = "cortina,gemini-interrupt-controller";
	reg = <0x48000000 0x1000>;
	interrupt-controller;
	#interrupt-cells = <2>;
};
```

## Documentation/devicetree/bindings/interrupt-controller/csky,apb-intc.txt
```
==============================
C-SKY APB Interrupt Controller
==============================

C-SKY APB Interrupt Controller is a simple soc interrupt controller
on the apb bus and we only use it as root irq controller.

 - csky,apb-intc is used in a lot of csky fpgas and socs, it support 64 irq nums.
 - csky,dual-apb-intc consists of 2 apb-intc and 128 irq nums supported.
 - csky,gx6605s-intc is gx6605s soc internal irq interrupt controller, 64 irq nums.

=============================
intc node bindings definition
=============================

	Description: Describes APB interrupt controller

	PROPERTIES

	- compatible
		Usage: required
		Value type: <string>
		Definition: must be "csky,apb-intc"
				    "csky,dual-apb-intc"
				    "csky,gx6605s-intc"
	- #interrupt-cells
		Usage: required
		Value type: <u32>
		Definition: must be <1>
	- reg
		Usage: required
		Value type: <u32 u32>
		Definition: <phyaddr size> in soc from cpu view
	- interrupt-controller:
		Usage: required
	- csky,support-pulse-signal:
		Usage: select
		Description: to support pulse signal flag

Examples:
---------

	intc: interrupt-controller@500000 {
		compatible = "csky,apb-intc";
		#interrupt-cells = <1>;
		reg = <0x00500000 0x400>;
		interrupt-controller;
	};

	intc: interrupt-controller@500000 {
		compatible = "csky,dual-apb-intc";
		#interrupt-cells = <1>;
		reg = <0x00500000 0x400>;
		interrupt-controller;
	};

	intc: interrupt-controller@500000 {
		compatible = "csky,gx6605s-intc";
		#interrupt-cells = <1>;
		reg = <0x00500000 0x400>;
		interrupt-controller;
	};
```

## Documentation/devicetree/bindings/interrupt-controller/csky,apb-intc.yaml
```yaml
# SPDX-License-Identifier: (GPL-2.0-only OR BSD-2-Clause)
%YAML 1.2
---
$id: http://devicetree.org/schemas/csky,apb-intc.yaml#
$schema: http://devicetree.org/meta-schemas/core.yaml#

title: C-SKY APB Interrupt Controller

maintainers:
  - Guo Ren <guoren@kernel.org>

description: >
  C-SKY APB Interrupt Controller is a simple soc interrupt controller on the apb
  bus and we only use it as root irq controller.

    - csky,apb-intc is used in a lot of csky fpgas and socs, it support 64 irq nums.
    - csky,dual-apb-intc consists of 2 apb-intc and 128 irq nums supported.
    - csky,gx6605s-intc is gx6605s soc internal irq interrupt controller, 64 irq nums.

properties:
  compatible:
    enum:
      - csky,apb-intc
      - csky,dual-apb-intc
      - csky,gx6605s-intc

  reg:
    maxItems: 1

  '#interrupt-cells':
    const: 1

  interrupt-controller: true

  csky,support-pulse-signal:
    type: boolean
    description: Support for pulse signal flag.

additionalProperties: false

required:
  - compatible
  - reg
  - '#interrupt-cells'
  - interrupt-controller

examples:
  - |
    intc: interrupt-controller@500000 {
        compatible = "csky,apb-intc";
        #interrupt-cells = <1>;
        reg = <0x00500000 0x400>;
        interrupt-controller;
    };
```

## Documentation/devicetree/bindings/interrupt-controller/csky,mpintc.txt
```
===========================================
C-SKY Multi-processors Interrupt Controller
===========================================

C-SKY Multi-processors Interrupt Controller is designed for ck807/ck810/ck860
SMP soc, and it also could be used in non-SMP system.

Interrupt number definition:
  0-15  : software irq, and we use 15 as our IPI_IRQ.
 16-31  : private  irq, and we use 16 as the co-processor timer.
 31-1024: common irq for soc ip.

Interrupt triger mode: (Defined in dt-bindings/interrupt-controller/irq.h)
 IRQ_TYPE_LEVEL_HIGH (default)
 IRQ_TYPE_LEVEL_LOW
 IRQ_TYPE_EDGE_RISING
 IRQ_TYPE_EDGE_FALLING

=============================
intc node bindings definition
=============================

	Description: Describes SMP interrupt controller

	PROPERTIES

	- compatible
		Usage: required
		Value type: <string>
		Definition: must be "csky,mpintc"
	- #interrupt-cells
		Usage: required
		Value type: <u32>
		Definition: <2>
	- interrupt-controller:
		Usage: required

Examples: ("interrupts = <irq_num IRQ_TYPE_XXX>")
---------
#include <dt-bindings/interrupt-controller/irq.h>

	intc: interrupt-controller {
		compatible = "csky,mpintc";
		#interrupt-cells = <2>;
		interrupt-controller;
	};

	device: device-example {
		...
		interrupts = <34 IRQ_TYPE_EDGE_RISING>;
		interrupt-parent = <&intc>;
	};
```

## Documentation/devicetree/bindings/interrupt-controller/csky,mpintc.yaml
```yaml
# SPDX-License-Identifier: (GPL-2.0-only OR BSD-2-Clause)
%YAML 1.2
---
$id: http://devicetree.org/schemas/interrupt-controller/csky,mpintc.yaml#
$schema: http://devicetree.org/meta-schemas/core.yaml#

title: C-SKY Multi-processors Interrupt Controller

maintainers:
  - Guo Ren <guoren@kernel.org>

description: >
  C-SKY Multi-processors Interrupt Controller is designed for ck807/ck810/ck860
  SMP soc, and it also could be used in non-SMP system.

  Interrupt number definition:
    0-15  : software irq, and we use 15 as our IPI_IRQ.
    16-31  : private  irq, and we use 16 as the co-processor timer.
    31-1024: common irq for soc ip.

properties:
  compatible:
    const: csky,mpintc

  '#interrupt-cells':
    const: 2

  interrupt-controller: true

required:
  - compatible
  - "#interrupt-cells"
  - interrupt-controller

additionalProperties: false

examples:
  - |
    interrupt-controller {
        compatible = "csky,mpintc";
        #interrupt-cells = <2>;
        interrupt-controller;
    };
```

## Documentation/devicetree/bindings/interrupt-controller/digicolor-ic.txt
```
Conexant Digicolor Interrupt Controller

Required properties:

- compatible : should be "cnxt,cx92755-ic"
- reg : Specifies base physical address and size of the interrupt controller
  registers (IC) area
- interrupt-controller : Identifies the node as an interrupt controller
- #interrupt-cells : Specifies the number of cells needed to encode an
  interrupt source. The value shall be 1.
- syscon: A phandle to the syscon node describing UC registers

Example:

	intc: interrupt-controller@f0000040 {
		compatible = "cnxt,cx92755-ic";
		interrupt-controller;
		#interrupt-cells = <1>;
		reg = <0xf0000040 0x40>;
		syscon = <&uc_regs>;
	};
```
