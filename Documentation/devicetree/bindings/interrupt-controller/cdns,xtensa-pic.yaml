## Documentation/devicetree/bindings/interrupt-controller/fsl,irqsteer.yaml
```yaml
# SPDX-License-Identifier: (GPL-2.0-only OR BSD-2-Clause)
%YAML 1.2
---
$id: http://devicetree.org/schemas/interrupt-controller/fsl,irqsteer.yaml#
$schema: http://devicetree.org/meta-schemas/core.yaml#

title: Freescale IRQSTEER Interrupt Multiplexer

maintainers:
  - Lucas Stach <l.stach@pengutronix.de>

properties:
  compatible:
    oneOf:
      - const: fsl,imx-irqsteer
      - items:
          - const: fsl,imx8m-irqsteer
          - const: fsl,imx-irqsteer

  reg:
    maxItems: 1

  interrupts:
    description: |
      should contain the up to 8 parent interrupt lines used to multiplex
      the input interrupts. They should be specified sequentially from
      output 0 to 7.
    items:
      - description: output interrupt 0
      - description: output interrupt 1
      - description: output interrupt 2
      - description: output interrupt 3
      - description: output interrupt 4
      - description: output interrupt 5
      - description: output interrupt 6
      - description: output interrupt 7
    minItems: 1

  clocks:
    maxItems: 1

  clock-names:
    const: ipg

  interrupt-controller: true

  "#interrupt-cells":
    const: 1

  fsl,channel:
    $ref: '/schemas/types.yaml#/definitions/uint32'
    description: |
      u32 value representing the output channel that all input IRQs should be
      steered into.

  fsl,num-irqs:
    $ref: '/schemas/types.yaml#/definitions/uint32'
    description: |
      u32 value representing the number of input interrupts of this channel,
      should be multiple of 32 input interrupts and up to 512 interrupts.

required:
  - compatible
  - reg
  - interrupts
  - clocks
  - clock-names
  - interrupt-controller
  - "#interrupt-cells"
  - fsl,channel
  - fsl,num-irqs

additionalProperties: false

examples:
  - |
    #include <dt-bindings/clock/imx8mq-clock.h>
    #include <dt-bindings/interrupt-controller/arm-gic.h>

    interrupt-controller@32e2d000 {
        compatible = "fsl,imx-irqsteer";
        reg = <0x32e2d000 0x1000>;
        interrupts = <GIC_SPI 18 IRQ_TYPE_LEVEL_HIGH>;
        clocks = <&clk IMX8MQ_CLK_DISP_APB_ROOT>;
        clock-names = "ipg";
        fsl,channel = <0>;
        fsl,num-irqs = <64>;
        interrupt-controller;
        #interrupt-cells = <1>;
    };
```

## Documentation/devicetree/bindings/interrupt-controller/fsl,ls-extirq.txt
```
* Freescale Layerscape external IRQs

Some Layerscape SOCs (LS1021A, LS1043A, LS1046A) support inverting
the polarity of certain external interrupt lines.

The device node must be a child of the node representing the
Supplemental Configuration Unit (SCFG).

Required properties:
- compatible: should be "fsl,<soc-name>-extirq", e.g. "fsl,ls1021a-extirq".
- #interrupt-cells: Must be 2. The first element is the index of the
  external interrupt line. The second element is the trigger type.
- #address-cells: Must be 0.
- interrupt-controller: Identifies the node as an interrupt controller
- reg: Specifies the Interrupt Polarity Control Register (INTPCR) in
  the SCFG.
- interrupt-map: Specifies the mapping from external interrupts to GIC
  interrupts.
- interrupt-map-mask: Must be <0xffffffff 0>.

Example:
	scfg: scfg@1570000 {
		compatible = "fsl,ls1021a-scfg", "syscon";
		reg = <0x0 0x1570000 0x0 0x10000>;
		big-endian;
		#address-cells = <1>;
		#size-cells = <1>;
		ranges = <0x0 0x0 0x1570000 0x10000>;

		extirq: interrupt-controller@1ac {
			compatible = "fsl,ls1021a-extirq";
			#interrupt-cells = <2>;
			#address-cells = <0>;
			interrupt-controller;
			reg = <0x1ac 4>;
			interrupt-map =
				<0 0 &gic GIC_SPI 163 IRQ_TYPE_LEVEL_HIGH>,
				<1 0 &gic GIC_SPI 164 IRQ_TYPE_LEVEL_HIGH>,
				<2 0 &gic GIC_SPI 165 IRQ_TYPE_LEVEL_HIGH>,
				<3 0 &gic GIC_SPI 167 IRQ_TYPE_LEVEL_HIGH>,
				<4 0 &gic GIC_SPI 168 IRQ_TYPE_LEVEL_HIGH>,
				<5 0 &gic GIC_SPI 169 IRQ_TYPE_LEVEL_HIGH>;
			interrupt-map-mask = <0xffffffff 0x0>;
		};
	};


	interrupts-extended = <&gic GIC_SPI 88 IRQ_TYPE_LEVEL_HIGH>,
			      <&extirq 1 IRQ_TYPE_LEVEL_LOW>;
```

## Documentation/devicetree/bindings/interrupt-controller/fsl,ls-extirq.yaml
```yaml
# SPDX-License-Identifier: (GPL-2.0-only OR BSD-2-Clause)
%YAML 1.2
---
$id: http://devicetree.org/schemas/interrupt-controller/fsl,ls-extirq.yaml#
$schema: http://devicetree.org/meta-schemas/core.yaml#

title: Freescale Layerscape External Interrupt Controller

maintainers:
  - Shawn Guo <shawnguo@kernel.org>
  - Li Yang <leoyang.li@nxp.com>

description: |
  Some Layerscape SOCs (LS1021A, LS1043A, LS1046A LS1088A, LS208xA,
  LX216xA) support inverting the polarity of certain external interrupt
  lines.

properties:
  compatible:
    oneOf:
      - enum:
          - fsl,ls1021a-extirq
          - fsl,ls1043a-extirq
          - fsl,ls1088a-extirq
      - items:
          - enum:
              - fsl,ls1046a-extirq
          - const: fsl,ls1043a-extirq
      - items:
          - enum:
              - fsl,ls2080a-extirq
              - fsl,lx2160a-extirq
          - const: fsl,ls1088a-extirq

  '#interrupt-cells':
    const: 2

  '#address-cells':
    const: 0

  interrupt-controller: true

  reg:
    maxItems: 1
    description:
      Specifies the Interrupt Polarity Control Register (INTPCR) in the
      SCFG or the External Interrupt Control Register (IRQCR) in the ISC.

  interrupt-map:
    description: Specifies the mapping from external interrupts to GIC interrupts.

  interrupt-map-mask: true

required:
  - compatible
  - '#interrupt-cells'
  - '#address-cells'
  - interrupt-controller
  - reg
  - interrupt-map
  - interrupt-map-mask

allOf:
  - if:
      properties:
        compatible:
          contains:
            enum:
              - fsl,ls1021a-extirq
    then:
      properties:
        interrupt-map:
          minItems: 6
          maxItems: 6
        interrupt-map-mask:
          items:
            - const: 0x7
            - const: 0
  - if:
      properties:
        compatible:
          contains:
            enum:
              - fsl,ls1043a-extirq
              - fsl,ls1046a-extirq
              - fsl,ls1088a-extirq
              - fsl,ls2080a-extirq
              - fsl,lx2160a-extirq
    then:
      properties:
        interrupt-map:
          minItems: 12
          maxItems: 12
        interrupt-map-mask:
          items:
            - const: 0xf
            - const: 0

additionalProperties: false

examples:
  - |
    #include <dt-bindings/interrupt-controller/arm-gic.h>
    interrupt-controller@1ac {
            compatible = "fsl,ls1021a-extirq";
            #interrupt-cells = <2>;
            #address-cells = <0>;
            interrupt-controller;
            reg = <0x1ac 4>;
            interrupt-map =
                    <0 0 &gic GIC_SPI 163 IRQ_TYPE_LEVEL_HIGH>,
                    <1 0 &gic GIC_SPI 164 IRQ_TYPE_LEVEL_HIGH>,
                    <2 0 &gic GIC_SPI 165 IRQ_TYPE_LEVEL_HIGH>,
                    <3 0 &gic GIC_SPI 167 IRQ_TYPE_LEVEL_HIGH>,
                    <4 0 &gic GIC_SPI 168 IRQ_TYPE_LEVEL_HIGH>,
                    <5 0 &gic GIC_SPI 169 IRQ_TYPE_LEVEL_HIGH>;
            interrupt-map-mask = <0x7 0x0>;
    };
```

## Documentation/devicetree/bindings/interrupt-controller/fsl,ls-msi.yaml
```yaml
# SPDX-License-Identifier: (GPL-2.0-only OR BSD-2-Clause)
%YAML 1.2
---
$id: http://devicetree.org/schemas/interrupt-controller/fsl,ls-msi.yaml#
$schema: http://devicetree.org/meta-schemas/core.yaml#

title: Freescale Layerscape SCFG PCIe MSI controller

description: |
  This interrupt controller hardware is a second level interrupt controller that
  is hooked to a parent interrupt controller: e.g: ARM GIC for ARM-based
  platforms. If interrupt-parent is not provided, the default parent interrupt
  controller will be used.

  Each PCIe node needs to have property msi-parent that points to
  MSI controller node

maintainers:
  - Frank Li <Frank.Li@nxp.com>

properties:
  compatible:
    enum:
      - fsl,ls1012a-msi
      - fsl,ls1021a-msi
      - fsl,ls1043a-msi
      - fsl,ls1043a-v1.1-msi
      - fsl,ls1046a-msi

  reg:
    maxItems: 1

  '#msi-cells':
    const: 1

  interrupts:
    items:
      - description: Shared MSI interrupt group 0
      - description: Shared MSI interrupt group 1
      - description: Shared MSI interrupt group 2
      - description: Shared MSI interrupt group 3
    minItems: 1

required:
  - compatible
  - reg
  - msi-controller
  - interrupts

allOf:
  - $ref: msi-controller.yaml
  - if:
      properties:
        compatible:
          contains:
            enum:
              - fsl,ls1046a-msi
    then:
      properties:
        interrupts:
          minItems: 4
    else:
      properties:
        interrupts:
          maxItems: 1

unevaluatedProperties: false

examples:
  - |
    #include <dt-bindings/interrupt-controller/arm-gic.h>

    interrupt-controller@1571000 {
        compatible = "fsl,ls1043a-msi";
        reg = <0x1571000 0x8>;
        msi-controller;
        #msi-cells = <1>;
        interrupts = <GIC_SPI 116 IRQ_TYPE_LEVEL_HIGH>;
    };
```

## Documentation/devicetree/bindings/interrupt-controller/fsl,ls-scfg-msi.txt
```
* Freescale Layerscape SCFG PCIe MSI controller

Required properties:

- compatible: should be "fsl,<soc-name>-msi" to identify
	      Layerscape PCIe MSI controller block such as:
              "fsl,ls1021a-msi"
              "fsl,ls1043a-msi"
              "fsl,ls1046a-msi"
              "fsl,ls1043a-v1.1-msi"
              "fsl,ls1012a-msi"
- msi-controller: indicates that this is a PCIe MSI controller node
- reg: physical base address of the controller and length of memory mapped.
- interrupts: an interrupt to the parent interrupt controller.

This interrupt controller hardware is a second level interrupt controller that
is hooked to a parent interrupt controller: e.g: ARM GIC for ARM-based
platforms. If interrupt-parent is not provided, the default parent interrupt
controller will be used.
Each PCIe node needs to have property msi-parent that points to
MSI controller node

Examples:

	msi1: msi-controller@1571000 {
		compatible = "fsl,ls1043a-msi";
		reg = <0x0 0x1571000 0x0 0x8>,
		msi-controller;
		interrupts = <0 116 0x4>;
	};
```
