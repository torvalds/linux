## Documentation/devicetree/bindings/interrupt-controller/econet,en751221-intc.yaml
```yaml
# SPDX-License-Identifier: (GPL-2.0-only OR BSD-2-Clause)
%YAML 1.2
---
$id: http://devicetree.org/schemas/interrupt-controller/econet,en751221-intc.yaml#
$schema: http://devicetree.org/meta-schemas/core.yaml#

title: EcoNet EN751221 Interrupt Controller

maintainers:
  - Caleb James DeLisle <cjd@cjdns.fr>

description:
  The EcoNet EN751221 Interrupt Controller is a simple interrupt controller
  designed for the MIPS 34Kc MT SMP processor with 2 VPEs. Each interrupt can
  be routed to either VPE but not both, so to support per-CPU interrupts, a
  secondary IRQ number is allocated to control masking/unmasking on VPE#1. For
  lack of a better term we call these "shadow interrupts". The assignment of
  shadow interrupts is defined by the SoC integrator when wiring the interrupt
  lines, so they are configurable in the device tree.

allOf:
  - $ref: /schemas/interrupt-controller.yaml#

properties:
  compatible:
    const: econet,en751221-intc

  reg:
    maxItems: 1

  "#interrupt-cells":
    const: 1

  interrupt-controller: true

  interrupts:
    maxItems: 1
    description: Interrupt line connecting this controller to its parent.

  econet,shadow-interrupts:
    $ref: /schemas/types.yaml#/definitions/uint32-matrix
    description:
      An array of interrupt number pairs where each pair represents a shadow
      interrupt relationship. The first number in each pair is the primary IRQ,
      and the second is its shadow IRQ used for VPE#1 control. For example,
      <8 3> means IRQ 8 is shadowed by IRQ 3, so IRQ 3 cannot be mapped, but
      when VPE#1 requests IRQ 8, it will manipulate the IRQ 3 mask bit.
    minItems: 1
    maxItems: 20
    items:
      items:
        - description: primary per-CPU IRQ
        - description: shadow IRQ number

  econet,cpu-interrupt-map:
    $ref: /schemas/types.yaml#/definitions/uint32-matrix
    description:
      When running in VEIC mode, the hardware re-routes interrupts from the
      CPU interrupt controller core to the "external" interrupt controller
      (this device). It then prioritizes them and sends them back to the CPU
      along with its own interrupts. The CPU hardware handles interrupts using
      a special dispatch table (the normal interrupt handler is not invoked).
      In this interrupt controller, the CPU interrupts are renumbered as they
      are merged with this controller's own hardware interrupts.

      This is the inverse of an interrupt-map, mapping which interrupts from
      this controller must be routed back to the CPU interrupt domain for
      correct handling there.
    items:
      items:
        - description: The interrupt number as received in this controller
        - description: The interrupt number to be dispatched on the CPU intc

required:
  - compatible
  - reg
  - interrupt-controller
  - "#interrupt-cells"
  - interrupts

additionalProperties: false

examples:
  - |
    interrupt-controller@1fb40000 {
        compatible = "econet,en751221-intc";
        reg = <0x1fb40000 0x100>;

        interrupt-controller;
        #interrupt-cells = <1>;

        interrupt-parent = <&cpuintc>;
        interrupts = <2>;

        econet,shadow-interrupts = <7 2>, <8 3>, <13 12>, <30 29>;
        econet,cpu-interrupt-map = <7 0>, <8 1>;
    };
...
```

## Documentation/devicetree/bindings/interrupt-controller/ezchip,nps400-ic.txt
```
EZchip NPS Interrupt Controller

Required properties:

- compatible : should be "ezchip,nps400-ic"
- interrupt-controller : Identifies the node as an interrupt controller
- #interrupt-cells : Specifies the number of cells needed to encode an
  interrupt source. The value shall be 1.


Example:

intc: interrupt-controller {
	compatible = "ezchip,nps400-ic";
	interrupt-controller;
	#interrupt-cells = <1>;
};
```

## Documentation/devicetree/bindings/interrupt-controller/ezchip,nps400-ic.yaml
```yaml
# SPDX-License-Identifier: (GPL-2.0-only OR BSD-2-Clause)
%YAML 1.2
---
$id: http://devicetree.org/schemas/ezchip,nps400-ic.yaml#
$schema: http://devicetree.org/meta-schemas/core.yaml#

title: EZchip NPS Interrupt Controller

maintainers:
  - Noam Camus <noamc@ezchip.com>

properties:
  compatible:
    const: ezchip,nps400-ic

  interrupt-controller: true

  '#interrupt-cells':
    const: 1

required:
  - compatible
  - interrupt-controller
  - '#interrupt-cells'

additionalProperties: false

examples:
  - |
    interrupt-controller {
        compatible = "ezchip,nps400-ic";
        interrupt-controller;
        #interrupt-cells = <1>;
    };
```

## Documentation/devicetree/bindings/interrupt-controller/faraday,ftintc010.txt
```
* Faraday Technologt FTINTC010 interrupt controller

This interrupt controller is a stock IP block from Faraday Technology found
in the Gemini SoCs and other designs.

Required properties:
- compatible: must be one of
  "faraday,ftintc010"
  "cortina,gemini-interrupt-controller" (deprecated)
- reg: The register bank for the interrupt controller.
- interrupt-controller: Identifies the node as an interrupt controller
- #interrupt-cells: The number of cells to define the interrupts.
  Must be 2 as the controller can specify level or rising edge
  IRQs. The bindings follows the standard binding for controllers
  with two cells specified in
  interrupt-controller/interrupts.txt

Example:

interrupt-controller@48000000 {
	compatible = "faraday,ftintc010"
	reg = <0x48000000 0x1000>;
	interrupt-controller;
	#interrupt-cells = <2>;
};
```

## Documentation/devicetree/bindings/interrupt-controller/faraday,ftintc010.yaml
```yaml
# SPDX-License-Identifier: (GPL-2.0-only OR BSD-2-Clause)
---
$id: http://devicetree.org/schemas/interrupt-controller/faraday,ftintc010.yaml#
$schema: http://devicetree.org/meta-schemas/core.yaml#

title: Faraday Technology FTINTC010 interrupt controller

maintainers:
  - Linus Walleij <linus.walleij@linaro.org>

description:
  This interrupt controller is a stock IP block from Faraday Technology found
  in the Gemini SoCs and other designs.

properties:
  compatible:
    oneOf:
      - items:
          - const: moxa,moxart-ic
          - const: faraday,ftintc010
      - enum:
          - faraday,ftintc010
          - cortina,gemini-interrupt-controller

  reg:
    maxItems: 1

  interrupt-controller: true

  '#interrupt-cells':
    const: 2

  resets:
    maxItems: 1

required:
  - compatible
  - reg
  - interrupt-controller
  - '#interrupt-cells'

additionalProperties: false

examples:
  - |
    interrupt-controller@48000000 {
        compatible = "faraday,ftintc010";
        reg = <0x48000000 0x1000>;
        interrupt-controller;
        #interrupt-cells = <2>;
    };
```

## Documentation/devicetree/bindings/interrupt-controller/fsl,icoll.yaml
```yaml
# SPDX-License-Identifier: (GPL-2.0-only OR BSD-2-Clause)
%YAML 1.2
---
$id: http://devicetree.org/schemas/interrupt-controller/fsl,icoll.yaml#
$schema: http://devicetree.org/meta-schemas/core.yaml#

title: Freescale MXS icoll Interrupt controller

maintainers:
  - Frank Li <Frank.Li@nxp.com>

properties:
  compatible:
    oneOf:
      - items:
          - enum:
              - fsl,imx23-icoll
              - fsl,imx28-icoll
          - const: fsl,icoll

  reg:
    maxItems: 1

  interrupt-controller: true

  '#interrupt-cells':
    const: 1

required:
  - compatible
  - reg
  - interrupt-controller
  - '#interrupt-cells'

additionalProperties: false

examples:
  - |
    interrupt-controller@80000000 {
        compatible = "fsl,imx28-icoll", "fsl,icoll";
        reg = <0x80000000 0x2000>;
        interrupt-controller;
        #interrupt-cells = <1>;
    };
```
