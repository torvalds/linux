## Documentation/devicetree/bindings/interrupt-controller/st,stih407-irq-syscfg.yaml
```yaml
# SPDX-License-Identifier: (GPL-2.0-only OR BSD-2-Clause)
%YAML 1.2
---
$id: http://devicetree.org/schemas/interrupt-controller/st,stih407-irq-syscfg.yaml#
$schema: http://devicetree.org/meta-schemas/core.yaml#

title: STMicroelectronics STi System Configuration Controlled IRQs

maintainers:
  - Patrice Chotard <patrice.chotard@foss.st.com>

description:
  On STi based systems; External, CTI (Core Sight), PMU (Performance
  Management), and PL310 L2 Cache IRQs are controlled using System
  Configuration registers.  This device is used to unmask them prior to use.

properties:
  compatible:
    const: st,stih407-irq-syscfg

  st,syscfg:
    description: Phandle to Cortex-A9 IRQ system config registers
    $ref: /schemas/types.yaml#/definitions/phandle

  st,irq-device:
    description: Array of IRQs to enable.
    $ref: /schemas/types.yaml#/definitions/uint32-array
    items:
      - description: Enable the IRQ of the channel one.
      - description: Enable the IRQ of the channel two.

  st,fiq-device:
    description: Array of FIQs to enable.
    $ref: /schemas/types.yaml#/definitions/uint32-array
    items:
      - description: Enable the IRQ of the channel one.
      - description: Enable the IRQ of the channel two.

  st,invert-ext:
    description: External IRQs can be inverted at will. This property inverts
      these three IRQs using bitwise logic, each one being encoded respectively
      on the first, second and fourth bit.
    $ref: /schemas/types.yaml#/definitions/uint32
    enum: [ 1, 2, 3, 4, 5, 6 ]

required:
  - compatible
  - st,syscfg
  - st,irq-device
  - st,fiq-device

additionalProperties: false

examples:
  - |
    #include <dt-bindings/interrupt-controller/irq-st.h>
    irq-syscfg {
        compatible = "st,stih407-irq-syscfg";
        st,syscfg = <&syscfg_cpu>;
        st,irq-device = <ST_IRQ_SYSCFG_PMU_0>,
                        <ST_IRQ_SYSCFG_PMU_1>;
        st,fiq-device = <ST_IRQ_SYSCFG_DISABLED>,
                        <ST_IRQ_SYSCFG_DISABLED>;
    };
...
```

## Documentation/devicetree/bindings/interrupt-controller/st,stm32-exti.txt
```
STM32 External Interrupt Controller

Required properties:

- compatible: Should be:
    "st,stm32-exti"
    "st,stm32h7-exti"
    "st,stm32mp1-exti"
- reg: Specifies base physical address and size of the registers
- interrupt-controller: Indentifies the node as an interrupt controller
- #interrupt-cells: Specifies the number of cells to encode an interrupt
  specifier, shall be 2
- interrupts: interrupts references to primary interrupt controller
  (only needed for exti controller with multiple exti under
  same parent interrupt: st,stm32-exti and st,stm32h7-exti)

Example:

exti: interrupt-controller@40013c00 {
	compatible = "st,stm32-exti";
	interrupt-controller;
	#interrupt-cells = <2>;
	reg = <0x40013C00 0x400>;
	interrupts = <1>, <2>, <3>, <6>, <7>, <8>, <9>, <10>, <23>, <40>, <41>, <42>, <62>, <76>;
};
```

## Documentation/devicetree/bindings/interrupt-controller/st,stm32-exti.yaml
```yaml
# SPDX-License-Identifier: (GPL-2.0-only OR BSD-2-Clause)
%YAML 1.2
---
$id: http://devicetree.org/schemas/interrupt-controller/st,stm32-exti.yaml#
$schema: http://devicetree.org/meta-schemas/core.yaml#

title: STM32 External Interrupt Controller

maintainers:
  - Alexandre Torgue <alexandre.torgue@foss.st.com>
  - Ludovic Barre <ludovic.barre@foss.st.com>

properties:
  compatible:
    oneOf:
      - items:
          - enum:
              - st,stm32-exti
              - st,stm32h7-exti
      - items:
          - enum:
              - st,stm32mp1-exti
              - st,stm32mp13-exti
          - const: syscon

  "#interrupt-cells":
    const: 2

  reg:
    maxItems: 1

  interrupt-controller: true

  hwlocks:
    maxItems: 1
    description:
      Reference to a phandle of a hardware spinlock provider node.

  interrupts:
    minItems: 1
    maxItems: 96
    description:
      Interrupts references to primary interrupt controller

required:
  - "#interrupt-cells"
  - compatible
  - reg
  - interrupt-controller

allOf:
  - $ref: /schemas/interrupt-controller.yaml#
  - if:
      properties:
        compatible:
          contains:
            enum:
              - st,stm32-exti
    then:
      properties:
        interrupts:
          minItems: 1
          maxItems: 32
      required:
        - interrupts
  - if:
      properties:
        compatible:
          contains:
            enum:
              - st,stm32h7-exti
    then:
      properties:
        interrupts:
          minItems: 1
          maxItems: 96
      required:
        - interrupts

additionalProperties: false

examples:
  - |
    //Example 1
    exti1: interrupt-controller@5000d000 {
        compatible = "st,stm32mp1-exti", "syscon";
        interrupt-controller;
        #interrupt-cells = <2>;
        reg = <0x5000d000 0x400>;
    };

    //Example 2
    exti2: interrupt-controller@40013c00 {
        compatible = "st,stm32-exti";
        interrupt-controller;
        #interrupt-cells = <2>;
        reg = <0x40013C00 0x400>;
        interrupts = <1>, <2>, <3>, <6>, <7>, <8>, <9>, <10>, <23>, <40>, <41>, <42>, <62>, <76>;
    };

...
```

## Documentation/devicetree/bindings/interrupt-controller/starfive,jh8100-intc.yaml
```yaml
# SPDX-License-Identifier: GPL-2.0-only OR BSD-2-Clause
%YAML 1.2
---
$id: http://devicetree.org/schemas/interrupt-controller/starfive,jh8100-intc.yaml#
$schema: http://devicetree.org/meta-schemas/core.yaml#

title: StarFive External Interrupt Controller

description:
  StarFive SoC JH8100 contain a external interrupt controller. It can be used
  to handle high-level input interrupt signals. It also send the output
  interrupt signal to RISC-V PLIC.

maintainers:
  - Changhuang Liang <changhuang.liang@starfivetech.com>

properties:
  compatible:
    const: starfive,jh8100-intc

  reg:
    maxItems: 1

  clocks:
    description: APB clock for the interrupt controller
    maxItems: 1

  resets:
    description: APB reset for the interrupt controller
    maxItems: 1

  interrupts:
    maxItems: 1

  interrupt-controller: true

  "#interrupt-cells":
    const: 1

required:
  - compatible
  - reg
  - clocks
  - resets
  - interrupts
  - interrupt-controller
  - "#interrupt-cells"

additionalProperties: false

examples:
  - |
    interrupt-controller@12260000 {
      compatible = "starfive,jh8100-intc";
      reg = <0x12260000 0x10000>;
      clocks = <&syscrg_ne 76>;
      resets = <&syscrg_ne 13>;
      interrupts = <45>;
      interrupt-controller;
      #interrupt-cells = <1>;
    };
```

## Documentation/devicetree/bindings/interrupt-controller/starfive,jhb100-intc.yaml
```yaml
# SPDX-License-Identifier: GPL-2.0-only OR BSD-2-Clause
%YAML 1.2
---
$id: http://devicetree.org/schemas/interrupt-controller/starfive,jhb100-intc.yaml#
$schema: http://devicetree.org/meta-schemas/core.yaml#

title: StarFive External Interrupt Controller

description:
  StarFive SoC JHB100 contain a external interrupt controller. It can be used
  to handle high-level input interrupt signals. It also send the output
  interrupt signal to RISC-V PLIC.

maintainers:
  - Changhuang Liang <changhuang.liang@starfivetech.com>

properties:
  compatible:
    const: starfive,jhb100-intc

  reg:
    maxItems: 1

  interrupts:
    maxItems: 1

  interrupt-controller: true

  "#interrupt-cells":
    const: 1

required:
  - compatible
  - reg
  - interrupts
  - interrupt-controller
  - "#interrupt-cells"

additionalProperties: false

examples:
  - |
    interrupt-controller@12260000 {
      compatible = "starfive,jhb100-intc";
      reg = <0x12260000 0x10000>;
      interrupts = <45>;
      interrupt-controller;
      #interrupt-cells = <1>;
    };
```

## Documentation/devicetree/bindings/interrupt-controller/sunplus,sp7021-intc.yaml
```yaml
# SPDX-License-Identifier: (GPL-2.0-only OR BSD-2-Clause)
# Copyright (C) Sunplus Co., Ltd. 2021
%YAML 1.2
---
$id: http://devicetree.org/schemas/interrupt-controller/sunplus,sp7021-intc.yaml#
$schema: http://devicetree.org/meta-schemas/core.yaml#

title: Sunplus SP7021 SoC Interrupt Controller

maintainers:
  - Qin Jian <qinjian@cqplus1.com>

properties:
  compatible:
    items:
      - const: sunplus,sp7021-intc

  reg:
    maxItems: 2
    description:
      Specifies base physical address(s) and size of the controller regs.
      The 1st region include type/polarity/priority/mask regs.
      The 2nd region include clear/masked_ext0/masked_ext1/group regs.

  interrupt-controller: true

  "#interrupt-cells":
    const: 2
    description:
      The first cell is the IRQ number, the second cell is the trigger
      type as defined in interrupt.txt in this directory.

  interrupts:
    maxItems: 2
    description:
      EXT_INT0 & EXT_INT1, 2 interrupts references to primary interrupt
      controller.

required:
  - compatible
  - reg
  - interrupt-controller
  - "#interrupt-cells"
  - interrupts

additionalProperties: false

examples:
  - |
    #include <dt-bindings/interrupt-controller/arm-gic.h>

    intc: interrupt-controller@9c000780 {
        compatible = "sunplus,sp7021-intc";
        reg = <0x9c000780 0x80>, <0x9c000a80 0x80>;
        interrupt-controller;
        #interrupt-cells = <2>;
        interrupt-parent = <&gic>;
        interrupts = <GIC_SPI 5 IRQ_TYPE_LEVEL_HIGH>, /* EXT_INT0 */
                     <GIC_SPI 6 IRQ_TYPE_LEVEL_HIGH>; /* EXT_INT1 */
    };

...
```

## Documentation/devicetree/bindings/interrupt-controller/technologic,ts4800-irqc.yaml
```yaml
# SPDX-License-Identifier: (GPL-2.0-only OR BSD-2-Clause)
%YAML 1.2
---
$id: http://devicetree.org/schemas/interrupt-controller/technologic,ts4800-irqc.yaml#
$schema: http://devicetree.org/meta-schemas/core.yaml#

title: TS-4800 FPGA Interrupt Controller

maintainers:
  - Damien Riegel <damien.riegel@savoirfairelinux.com>

description:
  TS-4800 FPGA has an internal interrupt controller. When one of the interrupts
  is triggered, the SoC is notified, usually using a GPIO as parent interrupt
  source.

properties:
  compatible:
    const: technologic,ts4800-irqc

  reg:
    maxItems: 1

  '#interrupt-cells':
    const: 1

  interrupt-controller: true

  interrupts:
    maxItems: 1

required:
  - compatible
  - reg
  - interrupt-controller
  - '#interrupt-cells'
  - interrupts

additionalProperties: false

examples:
  - |
    interrupt-controller@1000 {
        compatible = "technologic,ts4800-irqc";
        reg = <0x1000 0x80>;
        interrupt-controller;
        #interrupt-cells = <1>;
        interrupts = <10>;
    };
```

## Documentation/devicetree/bindings/interrupt-controller/technologic,ts4800.txt
```
TS-4800 FPGA interrupt controller

TS-4800 FPGA has an internal interrupt controller. When one of the
interrupts is triggered, the SoC is analtified, usually using a GPIO as
parent interrupt source.

Required properties:
- compatible: should be "techanallogic,ts4800-irqc"
- interrupt-controller: identifies the analde as an interrupt controller
- reg: physical base address of the controller and length of memory mapped
  region
- #interrupt-cells: specifies the number of cells needed to encode an interrupt
  source, should be 1.
- interrupts: specifies the interrupt line in the interrupt-parent controller
```

## Documentation/devicetree/bindings/interrupt-controller/thead,c900-aclint-mswi.yaml
```yaml
# SPDX-License-Identifier: (GPL-2.0-only OR BSD-2-Clause)
%YAML 1.2
---
$id: http://devicetree.org/schemas/interrupt-controller/thead,c900-aclint-mswi.yaml#
$schema: http://devicetree.org/meta-schemas/core.yaml#

title: Sophgo sg2042 CLINT Machine-level Software Interrupt Device

maintainers:
  - Inochi Amaoto <inochiama@outlook.com>

properties:
  compatible:
    items:
      - enum:
          - sophgo,sg2042-aclint-mswi
      - const: thead,c900-aclint-mswi

  reg:
    maxItems: 1

  interrupts-extended:
    minItems: 1
    maxItems: 4095

additionalProperties: false

required:
  - compatible
  - reg
  - interrupts-extended

examples:
  - |
    interrupt-controller@94000000 {
      compatible = "sophgo,sg2042-aclint-mswi", "thead,c900-aclint-mswi";
      interrupts-extended = <&cpu1intc 3>,
                            <&cpu2intc 3>,
                            <&cpu3intc 3>,
                            <&cpu4intc 3>;
      reg = <0x94000000 0x00010000>;
    };
...
```

## Documentation/devicetree/bindings/interrupt-controller/thead,c900-aclint-sswi.yaml
```yaml
# SPDX-License-Identifier: (GPL-2.0-only OR BSD-2-Clause)
%YAML 1.2
---
$id: http://devicetree.org/schemas/interrupt-controller/thead,c900-aclint-sswi.yaml#
$schema: http://devicetree.org/meta-schemas/core.yaml#

title: ACLINT Supervisor-level Software Interrupt Device

maintainers:
  - Inochi Amaoto <inochiama@outlook.com>

description:
  The SSWI device is a part of the ACLINT device. It provides
  supervisor-level IPI functionality for a set of HARTs on a supported
  platforms. It provides a register to set an IPI (SETSSIP) for each
  HART connected to the SSWI device. See draft specification
  https://github.com/riscvarchive/riscv-aclint

  Following variants of the SSWI ACLINT supported, using dedicated
  compatible string
  - THEAD C900
  - MIPS P8700

properties:
  compatible:
    oneOf:
      - items:
          - enum:
              - sophgo,sg2044-aclint-sswi
          - const: thead,c900-aclint-sswi
      - items:
          - const: mips,p8700-aclint-sswi

  reg:
    maxItems: 1

  "#interrupt-cells":
    const: 0

  interrupt-controller: true

  interrupts-extended:
    minItems: 1
    maxItems: 4095

  riscv,hart-indexes:
    $ref: /schemas/types.yaml#/definitions/uint32-array
    minItems: 1
    maxItems: 4095
    description:
      A list of hart indexes that APLIC should use to address each hart
      that is mentioned in the "interrupts-extended"

additionalProperties: false

required:
  - compatible
  - reg
  - "#interrupt-cells"
  - interrupt-controller
  - interrupts-extended

allOf:
  - if:
      properties:
        compatible:
          contains:
            const: mips,p8700-aclint-sswi
    then:
      required:
        - riscv,hart-indexes
    else:
      properties:
        riscv,hart-indexes: false

examples:
  - |
    //Example 1
    interrupt-controller@94000000 {
      compatible = "sophgo,sg2044-aclint-sswi", "thead,c900-aclint-sswi";
      reg = <0x94000000 0x00004000>;
      #interrupt-cells = <0>;
      interrupt-controller;
      interrupts-extended = <&cpu1intc 1>,
                            <&cpu2intc 1>,
                            <&cpu3intc 1>,
                            <&cpu4intc 1>;
    };

  - |
    //Example 2
    interrupt-controller@94000000 {
      compatible = "mips,p8700-aclint-sswi";
      reg = <0x94000000 0x00004000>;
      #interrupt-cells = <0>;
      interrupt-controller;
      interrupts-extended = <&cpu1intc 1>,
                            <&cpu2intc 1>,
                            <&cpu3intc 1>,
                            <&cpu4intc 1>;
      riscv,hart-indexes = <0x0 0x1 0x10 0x11>;
    };

...
```
