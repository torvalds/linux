## Documentation/devicetree/bindings/interrupt-controller/ti,cp-intc.txt
```
* TI Common Platform Interrupt Controller

Common Platform Interrupt Controller (cp_intc) is used on
OMAP-L1x SoCs and can support several configurable number
of interrupts.

Main node required properties:

- compatible : should be:
	"ti,cp-intc"
- interrupt-controller : Identifies the node as an interrupt controller
- #interrupt-cells : Specifies the number of cells needed to encode an
  interrupt source. The type shall be a <u32> and the value shall be 1.

  The cell contains the interrupt number in the range [0-128].
- ti,intc-size: Number of interrupts handled by the interrupt controller.
- reg: physical base address and size of the intc registers map.

Example:

	intc: interrupt-controller@1 {
		compatible = "ti,cp-intc";
		interrupt-controller;
		#interrupt-cells = <1>;
		ti,intc-size = <101>;
		reg = <0xfffee000 0x2000>;
	};
```

## Documentation/devicetree/bindings/interrupt-controller/ti,cp-intc.yaml
```yaml
# SPDX-License-Identifier: (GPL-2.0-only OR BSD-2-Clause)
%YAML 1.2
---
$id: http://devicetree.org/schemas/interrupt-controller/ti,cp-intc.yaml#
$schema: http://devicetree.org/meta-schemas/core.yaml#

title: TI Common Platform Interrupt Controller

maintainers:
  - Bartosz Golaszewski <brgl@bgdev.pl>
  
description:
  Common Platform Interrupt Controller (cp_intc) is used on OMAP-L1x SoCs and
  can support several configurable number of interrupts.

properties:
  compatible:
    const: ti,cp-intc

  reg:
    maxItems: 1

  interrupt-controller: true

  '#interrupt-cells':
    const: 1
    description: Encodes an interrupt number in the range 0–128.

  ti,intc-size:
    description: Number of interrupts handled by the interrupt controller.
    $ref: /schemas/types.yaml#/definitions/uint32

required:
  - compatible
  - reg
  - interrupt-controller
  - '#interrupt-cells'
  - ti,intc-size

additionalProperties: false

examples:
  - |
    interrupt-controller@fffee000 {
        compatible = "ti,cp-intc";
        reg = <0xfffee000 0x2000>;
        interrupt-controller;
        #interrupt-cells = <1>;
        ti,intc-size = <101>;
    };
```

## Documentation/devicetree/bindings/interrupt-controller/ti,irq-crossbar.yaml
```yaml
# SPDX-License-Identifier: (GPL-2.0-only OR BSD-2-Clause)
%YAML 1.2
---
$id: http://devicetree.org/schemas/interrupt-controller/ti,irq-crossbar.yaml#
$schema: http://devicetree.org/meta-schemas/core.yaml#

title: Texas Instruments IRQ Crossbar

maintainers:
  - Sricharan R <r.sricharan@ti.com>

description:
  Some socs have a large number of interrupts requests to service the needs of
  its many peripherals and subsystems. All of the interrupt lines from the
  subsystems are not needed at the same time, so they have to be muxed to the
  irq-controller appropriately. In such places a interrupt controllers are
  preceded by an CROSSBAR that provides flexibility in muxing the device
  requests to the controller inputs.

properties:
  compatible:
    const: ti,irq-crossbar

  reg:
    maxItems: 1

  interrupt-controller: true

  '#interrupt-cells':
    const: 3

  ti,max-irqs:
    $ref: /schemas/types.yaml#/definitions/uint32
    description:
      Total number of irqs available at the parent interrupt controller.
    minimum: 1

  ti,max-crossbar-sources:
    $ref: /schemas/types.yaml#/definitions/uint32
    description:
      Maximum number of crossbar sources that can be routed.
    minimum: 1

  ti,reg-size:
    $ref: /schemas/types.yaml#/definitions/uint32
    description:
      Size of a individual register in bytes. Every individual
      register is assumed to be of same size.
    enum: [1, 2, 4]

  ti,irqs-reserved:
    $ref: /schemas/types.yaml#/definitions/uint32-array
    description:
      List of the reserved irq lines that are not muxed using crossbar. These
      interrupt lines are reserved in the soc, so crossbar bar driver should not
      consider them as free lines.

  ti,irqs-skip:
    $ref: /schemas/types.yaml#/definitions/uint32-array
    description:
      Similar to "ti,irqs-reserved", but these are for SOC-specific hard-wiring
      of those irqs which unexpectedly bypasses the crossbar. These irqs have a
      crossbar register, but still cannot be used.

  ti,irqs-safe-map:
    $ref: /schemas/types.yaml#/definitions/uint32
    description:
      integer which maps to a safe configuration to use when the interrupt
      controller irq is unused.
    default: 0

required:
  - compatible
  - reg
  - interrupt-controller
  - '#interrupt-cells'
  - ti,max-irqs
  - ti,max-crossbar-sources
  - ti,reg-size
  - ti,irqs-reserved

additionalProperties: false

examples:
  - |
    crossbar@4a002a48 {
        compatible = "ti,irq-crossbar";
        reg = <0x4a002a48 0x130>;
        interrupt-controller;
        #interrupt-cells = <3>;
        ti,max-irqs = <160>;
        ti,max-crossbar-sources = <400>;
        ti,reg-size = <2>;
        ti,irqs-reserved = <0 1 2 3 5 6 131 132>;
        ti,irqs-skip = <10 133 139 140>;
    };
```

## Documentation/devicetree/bindings/interrupt-controller/ti,keystone-irq.txt
```
Keystone 2 IRQ controller IP

On Keystone SOCs, DSP cores can send interrupts to ARM
host using the IRQ controller IP. It provides 28 IRQ signals to ARM.
The IRQ handler running on HOST OS can identify DSP signal source by
analyzing SRCCx bits in IPCARx registers. This is one of the component
used by the IPC mechanism used on Keystone SOCs.

Required Properties:
- compatible: should be "ti,keystone-irq"
- ti,syscon-dev : phandle and offset pair. The phandle to syscon used to
			access device control registers and the offset inside
			device control registers range.
- interrupt-controller : Identifies the node as an interrupt controller
- #interrupt-cells : Specifies the number of cells needed to encode interrupt
					 source should be 1.
- interrupts: interrupt reference to primary interrupt controller

Please refer to interrupts.txt in this directory for details of the common
Interrupt Controllers bindings used by client devices.

Example:
	kirq0: keystone_irq0@26202a0 {
		compatible = "ti,keystone-irq";
		ti,syscon-dev = <&devctrl 0x2a0>;
		interrupts = <GIC_SPI 4 IRQ_TYPE_EDGE_RISING>;
		interrupt-controller;
		#interrupt-cells = <1>;
	};

	dsp0: dsp0 {
		compatible = "linux,rproc-user";
		...
		interrupt-parent = <&kirq0>;
		interrupts = <10 2>;
	};
```

## Documentation/devicetree/bindings/interrupt-controller/ti,keystone-irq.yaml
```yaml
# SPDX-License-Identifier: (GPL-2.0-only OR BSD-2-Clause)
%YAML 1.2
---
$id: http://devicetree.org/schemas/ti,keystone-irq.yaml#
$schema: http://devicetree.org/meta-schemas/core.yaml#

title: Keystone 2 IRQ controller IP

maintainers:
  - Grygorii Strashko <grygorii.strashko@ti.com>

description:
  On Keystone SOCs, DSP cores can send interrupts to ARM host using the IRQ
  controller IP. It provides 28 IRQ signals to ARM. The IRQ handler running on
  HOST OS can identify DSP signal source by analyzing SRCCx bits in IPCARx
  registers. This is one of the component used by the IPC mechanism used on
  Keystone SOCs.

properties:
  compatible:
    const: ti,keystone-irq

  reg:
    maxItems: 1

  interrupt-controller: true

  '#interrupt-cells':
    const: 1

  interrupts:
    maxItems: 1

  ti,syscon-dev:
    description: Phandle and offset to syscon device
    $ref: /schemas/types.yaml#/definitions/phandle-array
    items:
      - items:
          - description: Phandle to syscon device control registers
          - description: Offset to control register

required:
  - compatible
  - reg
  - interrupt-controller
  - '#interrupt-cells'
  - interrupts
  - ti,syscon-dev

additionalProperties: false

examples:
  - |
    #include <dt-bindings/interrupt-controller/arm-gic.h>

    interrupt-controller@2a0 {
      compatible = "ti,keystone-irq";
      reg = <0x2a0 0x4>;
      ti,syscon-dev = <&devctrl 0x2a0>;
      interrupts = <GIC_SPI 4 IRQ_TYPE_EDGE_RISING>;
      interrupt-controller;
      #interrupt-cells = <1>;
    };
```

## Documentation/devicetree/bindings/interrupt-controller/ti,omap-intc-irq.txt
```
Omap2/3 intc controller

On TI omap2 and 3 the intc interrupt controller can provide
96 or 128 IRQ signals to the ARM host depending on the SoC.

Required Properties:
- compatible: should be one of
			"ti,omap2-intc"
			"ti,omap3-intc"
			"ti,dm814-intc"
			"ti,dm816-intc"
			"ti,am33xx-intc"

- interrupt-controller : Identifies the node as an interrupt controller
- #interrupt-cells : Specifies the number of cells needed to encode interrupt
		     source, should be 1 for intc
- interrupts: interrupt reference to primary interrupt controller

Please refer to interrupts.txt in this directory for details of the common
Interrupt Controllers bindings used by client devices.

Example:
	intc: interrupt-controller@48200000 {
		compatible = "ti,omap3-intc";
		interrupt-controller;
		#interrupt-cells = <1>;
		reg = <0x48200000 0x1000>;
	};
```

## Documentation/devicetree/bindings/interrupt-controller/ti,omap-intc-irq.yaml
```yaml
# SPDX-License-Identifier: (GPL-2.0-only OR BSD-2-Clause)
%YAML 1.2
---
$id: http://devicetree.org/schemas/interrupt-controller/ti,omap-intc-irq.yaml#
$schema: http://devicetree.org/meta-schemas/core.yaml#

title: TI OMAP Interrupt Controller

maintainers:
  - Tony Lindgren <tony@atomide.com>

description:
  On TI omap2 and 3 the intc interrupt controller can provide 96 or 128 IRQ
  signals to the ARM host depending on the SoC.

properties:
  compatible:
    enum:
      - ti,omap2-intc
      - ti,omap3-intc
      - ti,dm814-intc
      - ti,dm816-intc
      - ti,am33xx-intc

  reg:
    maxItems: 1

  interrupts:
    maxItems: 1

  interrupt-controller: true

  '#interrupt-cells':
    const: 1

required:
  - compatible
  - reg
  - interrupt-controller
  - '#interrupt-cells'

additionalProperties: false

examples:
  - |
    interrupt-controller@48200000 {
        compatible = "ti,omap3-intc";
        reg = <0x48200000 0x1000>;
        interrupts = <32>;
        interrupt-controller;
        #interrupt-cells = <1>;
    };
```

## Documentation/devicetree/bindings/interrupt-controller/ti,omap2-intc.txt
```
* OMAP Interrupt Controller

OMAP2/3 are using a TI interrupt controller that can support several
configurable number of interrupts.

Main node required properties:

- compatible : should be:
	"ti,omap2-intc"
- interrupt-controller : Identifies the node as an interrupt controller
- #interrupt-cells : Specifies the number of cells needed to encode an
  interrupt source. The type shall be a <u32> and the value shall be 1.

  The cell contains the interrupt number in the range [0-128].
- ti,intc-size: Number of interrupts handled by the interrupt controller.
- reg: physical base address and size of the intc registers map.

Example:

	intc: interrupt-controller@1 {
		compatible = "ti,omap2-intc";
		interrupt-controller;
		#interrupt-cells = <1>;
		ti,intc-size = <96>;
		reg = <0x48200000 0x1000>;
	};
```

## Documentation/devicetree/bindings/interrupt-controller/ti,omap4-wugen-mpu.yaml
```yaml
# SPDX-License-Identifier: (GPL-2.0-only OR BSD-2-Clause)
%YAML 1.2
---
$id: http://devicetree.org/schemas/interrupt-controller/ti,omap4-wugen-mpu.yaml#
$schema: http://devicetree.org/meta-schemas/core.yaml#

title: TI OMAP4 Wake-up Generator

maintainers:
  - Krzysztof Kozlowski <krzysztof.kozlowski@linaro.org>

description: >
  All TI OMAP4/5 (and their derivatives) are interrupt controllers that route
  interrupts to the GIC, and also serve as wakeup sources. They are also
  referred to as "WUGEN-MPU", hence the name of the binding.

  Notes:

    - Because this HW ultimately routes interrupts to the GIC, the interrupt
      specifier must be that of the GIC.
    - Only SPIs can use the WUGEN as an interrupt parent. SGIs and PPIs are
      explicitly forbidden.

properties:
  compatible:
    oneOf:
      - items:
          - const: ti,omap5-wugen-mpu
          - const: ti,omap4-wugen-mpu
      - const: ti,omap4-wugen-mpu

  reg:
    maxItems: 1

  interrupt-controller: true

  '#interrupt-cells':
    const: 3

required:
  - compatible
  - reg
  - interrupt-controller
  - '#interrupt-cells'

additionalProperties: false

examples:
  - |
    interrupt-controller@48281000 {
        compatible = "ti,omap5-wugen-mpu", "ti,omap4-wugen-mpu";
        reg = <0x48281000 0x1000>;
        interrupt-controller;
        #interrupt-cells = <3>;
    };
```
