## Documentation/devicetree/bindings/interrupt-controller/mips-gic.txt
```
MIPS Global Interrupt Controller (GIC)

The MIPS GIC routes external interrupts to individual VPEs and IRQ pins.
It also supports local (per-processor) interrupts and software-generated
interrupts which can be used as IPIs.  The GIC also includes a free-running
global timer, per-CPU count/compare timers, and a watchdog.

Required properties:
- compatible : Should be "mti,gic".
- interrupt-controller : Identifies the node as an interrupt controller
- #interrupt-cells : Specifies the number of cells needed to encode an
  interrupt specifier.  Should be 3.
  - The first cell is the type of interrupt, local or shared.
    See <include/dt-bindings/interrupt-controller/mips-gic.h>.
  - The second cell is the GIC interrupt number.
  - The third cell encodes the interrupt flags.
    See <include/dt-bindings/interrupt-controller/irq.h> for a list of valid
    flags.

Optional properties:
- reg : Base address and length of the GIC registers.  If not present,
  the base address reported by the hardware GCR_GIC_BASE will be used.
- mti,reserved-cpu-vectors : Specifies the list of CPU interrupt vectors
  to which the GIC may not route interrupts.  Valid values are 2 - 7.
  This property is ignored if the CPU is started in EIC mode.

Required properties for timer sub-node:
- compatible : Should be "mti,gic-timer".
- interrupts : Interrupt for the GIC local timer.

Optional properties for timer sub-node:
- clocks : GIC timer operating clock.
- clock-frequency : Clock frequency at which the GIC timers operate.

Note that one of clocks or clock-frequency must be specified.

Example:

	gic: interrupt-controller@1bdc0000 {
		compatible = "mti,gic";
		reg = <0x1bdc0000 0x20000>;

		interrupt-controller;
		#interrupt-cells = <3>;

		mti,reserved-cpu-vectors = <7>;

		timer {
			compatible = "mti,gic-timer";
			interrupts = <GIC_LOCAL 1 IRQ_TYPE_NONE>;
			clock-frequency = <50000000>;
		};
	};

	uart@18101400 {
		...
		interrupt-parent = <&gic>;
		interrupts = <GIC_SHARED 24 IRQ_TYPE_LEVEL_HIGH>;
		...
	};
```

## Documentation/devicetree/bindings/interrupt-controller/mrvl,intc.yaml
```yaml
# SPDX-License-Identifier: GPL-2.0-only
%YAML 1.2
---
$id: http://devicetree.org/schemas/interrupt-controller/mrvl,intc.yaml#
$schema: http://devicetree.org/meta-schemas/core.yaml#

title: Marvell MMP/Orion Interrupt controller bindings

maintainers:
  - Thomas Gleixner <tglx@linutronix.de>
  - Jason Cooper <jason@lakedaemon.net>
  - Marc Zyngier <maz@kernel.org>
  - Rob Herring <robh+dt@kernel.org>

allOf:
  - if:
      properties:
        compatible:
          not:
            contains:
              const: marvell,orion-intc
    then:
      required:
        - mrvl,intc-nr-irqs
  - if:
      properties:
        compatible:
          contains:
            enum:
              - mrvl,mmp-intc
              - mrvl,mmp2-intc
    then:
      properties:
        reg:
          maxItems: 1
  - if:
      properties:
        compatible:
          contains:
            enum:
              - marvell,mmp3-intc
              - mrvl,mmp2-mux-intc
    then:
      properties:
        reg:
          minItems: 2
  - if:
      properties:
        compatible:
          contains:
            const: mrvl,mmp2-mux-intc
    then:
      properties:
        interrupts:
          maxItems: 1
        reg-names:
          items:
            - const: 'mux status'
            - const: 'mux mask'
      required:
        - interrupts
    else:
      properties:
        interrupts: false

properties:
  '#interrupt-cells':
    const: 1

  compatible:
    enum:
      - mrvl,mmp-intc
      - mrvl,mmp2-intc
      - marvell,mmp3-intc
      - marvell,orion-intc
      - mrvl,mmp2-mux-intc

  reg:
    minItems: 1
    maxItems: 2

  reg-names: true

  interrupts: true

  interrupt-controller: true

  mrvl,intc-nr-irqs:
    description: |
      Specifies the number of interrupts in the interrupt controller.
    $ref: /schemas/types.yaml#/definitions/uint32

  mrvl,clr-mfp-irq:
    description: |
      Specifies the interrupt that needs to clear MFP edge detection first.
    $ref: /schemas/types.yaml#/definitions/uint32

required:
  - '#interrupt-cells'
  - compatible
  - reg
  - interrupt-controller

additionalProperties: false

examples:
  - |
    interrupt-controller@d4282000 {
        compatible = "mrvl,mmp2-intc";
        interrupt-controller;
        #interrupt-cells = <1>;
        reg = <0xd4282000 0x1000>;
        mrvl,intc-nr-irqs = <64>;
    };

    interrupt-controller@d4282150 {
        compatible = "mrvl,mmp2-mux-intc";
        interrupts = <4>;
        interrupt-controller;
        #interrupt-cells = <1>;
        reg = <0x150 0x4>, <0x168 0x4>;
        reg-names = "mux status", "mux mask";
        mrvl,intc-nr-irqs = <2>;
    };
  - |
    interrupt-controller@fed20204 {
        compatible = "marvell,orion-intc";
        interrupt-controller;
        #interrupt-cells = <1>;
        reg = <0xfed20204 0x04>,
              <0xfed20214 0x04>;
    };

...
```

## Documentation/devicetree/bindings/interrupt-controller/mscc,ocelot-icpu-intr.txt
```
Microsemi Ocelot SoC ICPU Interrupt Controller

Required properties:

- compatible : should be "mscc,ocelot-icpu-intr"
- reg : Specifies base physical address and size of the registers.
- interrupt-controller : Identifies the node as an interrupt controller
- #interrupt-cells : Specifies the number of cells needed to encode an
  interrupt source. The value shall be 1.
- interrupt-parent : phandle of the CPU interrupt controller.
- interrupts : Specifies the CPU interrupt the controller is connected to.

Example:

		intc: interrupt-controller@70000070 {
			compatible = "mscc,ocelot-icpu-intr";
			reg = <0x70000070 0x70>;
			#interrupt-cells = <1>;
			interrupt-controller;
			interrupt-parent = <&cpuintc>;
			interrupts = <2>;
		};
```

## Documentation/devicetree/bindings/interrupt-controller/mscc,ocelot-icpu-intr.yaml
```yaml
# SPDX-License-Identifier: (GPL-2.0 OR BSD-2-Clause)
%YAML 1.2
---
$id: http://devicetree.org/schemas/interrupt-controller/mscc,ocelot-icpu-intr.yaml#
$schema: http://devicetree.org/meta-schemas/core.yaml#

title: Microsemi Ocelot SoC ICPU Interrupt Controller

maintainers:
  - Alexandre Belloni <alexandre.belloni@bootlin.com>

allOf:
  - $ref: /schemas/interrupt-controller.yaml#

description: |
  the Microsemi Ocelot interrupt controller that is part of the
  ICPU. It is connected directly to the MIPS core interrupt
  controller.

properties:
  compatible:
    items:
      - enum:
          - mscc,jaguar2-icpu-intr
          - mscc,luton-icpu-intr
          - mscc,ocelot-icpu-intr
          - mscc,serval-icpu-intr


  '#interrupt-cells':
    const: 1

  '#address-cells':
    const: 0

  interrupt-controller: true

  reg:
    maxItems: 1

  interrupts:
    maxItems: 1

required:
  - compatible
  - '#interrupt-cells'
  - '#address-cells'
  - interrupt-controller
  - reg

additionalProperties: false

examples:
  - |
    intc: interrupt-controller@70000070 {
        compatible = "mscc,ocelot-icpu-intr";
        reg = <0x70000070 0x70>;
        #interrupt-cells = <1>;
        #address-cells = <0>;
        interrupt-controller;
        interrupt-parent = <&cpuintc>;
        interrupts = <2>;
    };
...
```

## Documentation/devicetree/bindings/interrupt-controller/msi-controller.yaml
```yaml
# SPDX-License-Identifier: (GPL-2.0-only OR BSD-2-Clause)
%YAML 1.2
---
$id: http://devicetree.org/schemas/interrupt-controller/msi-controller.yaml#
$schema: http://devicetree.org/meta-schemas/core.yaml#

title: MSI controller

maintainers:
  - Marc Zyngier <maz@kernel.org>

description: |
  An MSI controller signals interrupts to a CPU when a write is made
  to an MMIO address by some master. An MSI controller may feature a
  number of doorbells.

properties:
  "#msi-cells":
    description: |
      The number of cells in an msi-specifier, required if not zero.

      Typically this will encode information related to sideband data,
      and will not encode doorbells or payloads as these can be
      configured dynamically.

      The meaning of the msi-specifier is defined by the device tree
      binding of the specific MSI controller.
    enum: [0, 1]

  msi-controller:
    description:
      Identifies the node as an MSI controller.
    $ref: /schemas/types.yaml#/definitions/flag

  msi-ranges:
    description:
      A list of <phandle intspec span> tuples, where "phandle" is the
      parent interrupt controller, "intspec" is the starting/base
      interrupt specifier and "span" is the size of the
      range. Multiple ranges can be provided.
    $ref: /schemas/types.yaml#/definitions/phandle-array

dependencies:
  "#msi-cells": [ msi-controller ]

additionalProperties: true
```

## Documentation/devicetree/bindings/interrupt-controller/msi.txt
```
This document describes the generic device tree binding for MSI controllers and
their master(s).

Message Signaled Interrupts (MSIs) are a class of interrupts generated by a
write to an MMIO address.

MSIs were originally specified by PCI (and are used with PCIe), but may also be
used with other busses, and hence a mechanism is required to relate devices on
those busses to the MSI controllers which they are capable of using,
potentially including additional information.

MSIs are distinguished by some combination of:

- The doorbell (the MMIO address written to).
  
  Devices may be configured by software to write to arbitrary doorbells which
  they can address. An MSI controller may feature a number of doorbells.

- The payload (the value written to the doorbell).
  
  Devices may be configured to write an arbitrary payload chosen by software.
  MSI controllers may have restrictions on permitted payloads.

- Sideband information accompanying the write.
  
  Typically this is neither configurable nor probeable, and depends on the path
  taken through the memory system (i.e. it is a property of the combination of
  MSI controller and device rather than a property of either in isolation).


MSI controllers:
================

An MSI controller signals interrupts to a CPU when a write is made to an MMIO
address by some master. An MSI controller may feature a number of doorbells.

Required properties:
--------------------

- msi-controller: Identifies the node as an MSI controller.

Optional properties:
--------------------

- #msi-cells: The number of cells in an msi-specifier, required if not zero.

  Typically this will encode information related to sideband data, and will
  not encode doorbells or payloads as these can be configured dynamically.

  The meaning of the msi-specifier is defined by the device tree binding of
  the specific MSI controller. 


MSI clients
===========

MSI clients are devices which generate MSIs. For each MSI they wish to
generate, the doorbell and payload may be configured, though sideband
information may not be configurable.

Required properties:
--------------------

- msi-parent: A list of phandle + msi-specifier pairs, one for each MSI
  controller which the device is capable of using.

  This property is unordered, and MSIs may be allocated from any combination of
  MSI controllers listed in the msi-parent property.

  If a device has restrictions on the allocation of MSIs, these restrictions
  must be described with additional properties.

  When #msi-cells is non-zero, busses with an msi-parent will require
  additional properties to describe the relationship between devices on the bus
  and the set of MSIs they can potentially generate.


Example
=======

/ {
	#address-cells = <1>;
	#size-cells = <1>;

	msi_a: msi-controller@a {
		reg = <0xa 0xf00>;
		compatible = "vendor-a,some-controller";
		msi-controller;
		/* No sideband data, so #msi-cells omitted */
	};

	msi_b: msi-controller@b {
		reg = <0xb 0xf00>;
		compatible = "vendor-b,another-controller";
		msi-controller;
		/* Each device has some unique ID */
		#msi-cells = <1>;
	};

	msi_c: msi-controller@c {
		reg = <0xc 0xf00>;
		compatible = "vendor-b,another-controller";
		msi-controller;
		/* Each device has some unique ID */
		#msi-cells = <1>;
	};

	dev@0 {
		reg = <0x0 0xf00>;
		compatible = "vendor-c,some-device";

		/* Can only generate MSIs to msi_a */
		msi-parent = <&msi_a>;
	};

	dev@1 {
		reg = <0x1 0xf00>;
		compatible = "vendor-c,some-device";

		/* 
		 * Can generate MSIs to either A or B.
		 */
		msi-parent = <&msi_a>, <&msi_b 0x17>;
	};

	dev@2 {
		reg = <0x2 0xf00>;
		compatible = "vendor-c,some-device";
		/*
		 * Has different IDs at each MSI controller.
		 * Can generate MSIs to all of the MSI controllers.
		 */
		msi-parent = <&msi_a>, <&msi_b 0x17>, <&msi_c 0x53>;
	};
};
```

## Documentation/devicetree/bindings/interrupt-controller/mstar,mst-intc.yaml
```yaml
# SPDX-License-Identifier: (GPL-2.0-only OR BSD-2-Clause)
%YAML 1.2
---
$id: http://devicetree.org/schemas/interrupt-controller/mstar,mst-intc.yaml#
$schema: http://devicetree.org/meta-schemas/core.yaml#

title: MStar Interrupt Controller

maintainers:
  - Mark-PK Tsai <mark-pk.tsai@mediatek.com>

description: |+
  MStar, SigmaStar and Mediatek TV SoCs contain multiple legacy
  interrupt controllers that routes interrupts to the GIC.

  The HW block exposes a number of interrupt controllers, each
  can support up to 64 interrupts.

properties:
  compatible:
    const: mstar,mst-intc

  interrupt-controller: true

  "#interrupt-cells":
    const: 3
    description: |
      Use the same format as specified by GIC in arm,gic.yaml.

  reg:
    maxItems: 1

  mstar,irqs-map-range:
    description: |
      The range <start, end> of parent interrupt controller's interrupt
      lines that are hardwired to mstar interrupt controller.
    $ref: /schemas/types.yaml#/definitions/uint32-matrix
    items:
      minItems: 2
      maxItems: 2

  mstar,intc-no-eoi:
    description:
      Mark this controller has no End Of Interrupt(EOI) implementation.
    type: boolean

required:
  - compatible
  - reg
  - mstar,irqs-map-range

additionalProperties: false

examples:
  - |
    mst_intc0: interrupt-controller@1f2032d0 {
      compatible = "mstar,mst-intc";
      interrupt-controller;
      #interrupt-cells = <3>;
      interrupt-parent = <&gic>;
      reg = <0x1f2032d0 0x30>;
      mstar,irqs-map-range = <0 63>;
    };
...
```

## Documentation/devicetree/bindings/interrupt-controller/mti,cpu-interrupt-controller.yaml
```yaml
# SPDX-License-Identifier: GPL-2.0-only OR BSD-2-Clause
%YAML 1.2
---
$id: http://devicetree.org/schemas/interrupt-controller/mti,cpu-interrupt-controller.yaml#
$schema: http://devicetree.org/meta-schemas/core.yaml#

title: MIPS CPU Interrupt Controller

description: >
   On MIPS the mips_cpu_irq_of_init() helper can be used to initialize the 8 CPU
   IRQs from a devicetree file and create a irq_domain for IRQ controller.

   With the irq_domain in place we can describe how the 8 IRQs are wired to the
   platforms internal interrupt controller cascade.

maintainers:
  - Thomas Bogendoerfer <tsbogend@alpha.franken.de>

properties:
  compatible:
    const: mti,cpu-interrupt-controller

  '#interrupt-cells':
    const: 1

  '#address-cells':
    const: 0

  interrupt-controller: true

additionalProperties: false

required:
  - compatible
  - '#interrupt-cells'
  - '#address-cells'
  - interrupt-controller

examples:
  - |
    interrupt-controller {
      compatible = "mti,cpu-interrupt-controller";
      #address-cells = <0>;
      #interrupt-cells = <1>;
      interrupt-controller;
    };
```
