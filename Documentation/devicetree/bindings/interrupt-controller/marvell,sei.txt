## Documentation/devicetree/bindings/interrupt-controller/opencores,or1k-pic.txt
```
OpenRISC 1000 Programmable Interrupt Controller

Required properties:

- compatible : should be "opencores,or1k-pic-level" for variants with
  level triggered interrupt lines, "opencores,or1k-pic-edge" for variants with
  edge triggered interrupt lines or "opencores,or1200-pic" for machines
  with the non-spec compliant or1200 type implementation.

  "opencores,or1k-pic" is also provided as an alias to "opencores,or1200-pic",
  but this is only for backwards compatibility.

- interrupt-controller : Identifies the node as an interrupt controller
- #interrupt-cells : Specifies the number of cells needed to encode an
  interrupt source. The value shall be 1.

Example:

intc: interrupt-controller {
	compatible = "opencores,or1k-pic-level";
	interrupt-controller;
	#interrupt-cells = <1>;
};
```

## Documentation/devicetree/bindings/interrupt-controller/opencores,or1k-pic.yaml
```yaml
# SPDX-License-Identifier: (GPL-2.0-only OR BSD-2-Clause)
%YAML 1.2
---
$id: http://devicetree.org/schemas/interrupt-controller/opencores,or1k-pic.yaml#
$schema: http://devicetree.org/meta-schemas/core.yaml#

title: OpenRISC 1000 Programmable Interrupt Controller

maintainers:
  - Stefan Kristiansson <stefan.kristiansson@saunalahti.fi>

properties:
  compatible:
    enum:
      - opencores,or1k-pic-level
      - opencores,or1k-pic-edge
      - opencores,or1200-pic
      - opencores,or1k-pic

  interrupt-controller: true

  '#interrupt-cells':
    const: 1

required:
  - compatible
  - interrupt-controller
  - '#interrupt-cells'

additionalProperties: false

examples:
  - |
    interrupt-controller {
        compatible = "opencores,or1k-pic-level";
        interrupt-controller;
        #interrupt-cells = <1>;
    };
```
