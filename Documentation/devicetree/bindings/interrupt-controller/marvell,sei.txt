## Documentation/devicetree/bindings/interrupt-controller/marvell,sei.txt
```
Marvell SEI (System Error Interrupt) Controller
-----------------------------------------------

Marvell SEI (System Error Interrupt) controller is an interrupt
aggregator. It receives interrupts from several sources and aggregates
them to a single interrupt line (an SPI) on the parent interrupt
controller.

This interrupt controller can handle up to 64 SEIs, a set comes from the
AP and is wired while a second set comes from the CPs by the mean of
MSIs.

Required properties:

- compatible: should be one of:
              * "marvell,ap806-sei"
- reg: SEI registers location and length.
- interrupts: identifies the parent IRQ that will be triggered.
- #interrupt-cells: number of cells to define an SEI wired interrupt
                    coming from the AP, should be 1. The cell is the IRQ
                    number.
- interrupt-controller: identifies the node as an interrupt controller
                        for AP interrupts.
- msi-controller: identifies the node as an MSI controller for the CPs
                  interrupts.

Example:

        sei: interrupt-controller@3f0200 {
                compatible = "marvell,ap806-sei";
                reg = <0x3f0200 0x40>;
                interrupts = <GIC_SPI 0 IRQ_TYPE_LEVEL_HIGH>;
                #interrupt-cells = <1>;
                interrupt-controller;
                msi-controller;
        };
```

## Documentation/devicetree/bindings/interrupt-controller/mediatek,cirq.txt
```
* Mediatek 27xx cirq

In Mediatek SOCs, the CIRQ is a low power interrupt controller designed to
work outside MCUSYS which comprises with Cortex-Ax cores,CCI and GIC.
The external interrupts (outside MCUSYS) will feed through CIRQ and connect
to GIC in MCUSYS. When CIRQ is enabled, it will record the edge-sensitive
interrupts and generate a pulse signal to parent interrupt controller when
flush command is executed. With CIRQ, MCUSYS can be completely turned off
to improve the system power consumption without losing interrupts.

Required properties:
- compatible: should be one of
  - "mediatek,mt2701-cirq" for mt2701 CIRQ
  - "mediatek,mt8135-cirq" for mt8135 CIRQ
  - "mediatek,mt8173-cirq" for mt8173 CIRQ
  and "mediatek,cirq" as a fallback.
- interrupt-controller : Identifies the node as an interrupt controller.
- #interrupt-cells : Use the same format as specified by GIC in arm,gic.txt.
- reg: Physical base address of the cirq registers and length of memory
  mapped region.
- mediatek,ext-irq-range: Identifies external irq number range in different
  SOCs.

Example:
	cirq: interrupt-controller@10204000 {
		compatible = "mediatek,mt2701-cirq",
			     "mediatek,mtk-cirq";
		interrupt-controller;
		#interrupt-cells = <3>;
		interrupt-parent = <&sysirq>;
		reg = <0 0x10204000 0 0x400>;
		mediatek,ext-irq-start = <32 200>;
	};
```

## Documentation/devicetree/bindings/interrupt-controller/mediatek,mt6577-sysirq.yaml
```yaml
# SPDX-License-Identifier: GPL-2.0-only OR BSD-2-Clause
%YAML 1.2
---
$id: http://devicetree.org/schemas/interrupt-controller/mediatek,mt6577-sysirq.yaml#
$schema: http://devicetree.org/meta-schemas/core.yaml#

title: MediaTek sysirq

description:
  MediaTek SOCs sysirq support controllable irq inverter for each GIC SPI
  interrupt.

maintainers:
  - Matthias Brugger <matthias.bgg@gmail.com>

properties:
  compatible:
    oneOf:
      - const: mediatek,mt6577-sysirq
      - items:
          - enum:
              - mediatek,mt2701-sysirq
              - mediatek,mt2712-sysirq
              - mediatek,mt6572-sysirq
              - mediatek,mt6580-sysirq
              - mediatek,mt6582-sysirq
              - mediatek,mt6589-sysirq
              - mediatek,mt6592-sysirq
              - mediatek,mt6755-sysirq
              - mediatek,mt6765-sysirq
              - mediatek,mt6779-sysirq
              - mediatek,mt6795-sysirq
              - mediatek,mt6797-sysirq
              - mediatek,mt7622-sysirq
              - mediatek,mt7623-sysirq
              - mediatek,mt7629-sysirq
              - mediatek,mt8127-sysirq
              - mediatek,mt8135-sysirq
              - mediatek,mt8173-sysirq
              - mediatek,mt8183-sysirq
              - mediatek,mt8365-sysirq
              - mediatek,mt8516-sysirq
          - const: mediatek,mt6577-sysirq

  reg:
    minItems: 1
    maxItems: 2

  interrupt-controller: true

  "#interrupt-cells":
    $ref: arm,gic.yaml#/properties/#interrupt-cells

required:
  - reg
  - interrupt-controller
  - "#interrupt-cells"

allOf:
  - $ref: /schemas/interrupt-controller.yaml#
  - if:
      properties:
        compatible:
          contains:
            const: mediatek,mt6797-sysirq
    then:
      properties:
        reg:
          minItems: 2
    else:
      properties:
        reg:
          maxItems: 1

unevaluatedProperties: false

examples:
  - |
    interrupt-controller@10200620 {
        compatible = "mediatek,mt6797-sysirq", "mediatek,mt6577-sysirq";
        reg = <0x10220620 0x20>,
              <0x10220690 0x10>;
        interrupt-parent = <&gic>;
        interrupt-controller;
        #interrupt-cells = <3>;
    };
```

## Documentation/devicetree/bindings/interrupt-controller/mediatek,mtk-cirq.yaml
```yaml
# SPDX-License-Identifier: GPL-2.0-only OR BSD-2-Clause
%YAML 1.2
---
$id: http://devicetree.org/schemas/interrupt-controller/mediatek,mtk-cirq.yaml#
$schema: http://devicetree.org/meta-schemas/core.yaml#

title: MediaTek System Interrupt Controller

maintainers:
  - Youlin Pei <youlin.pei@mediatek.com>

description:
  In MediaTek SoCs, the CIRQ is a low power interrupt controller designed to
  work outside of MCUSYS which comprises with Cortex-Ax cores, CCI and GIC.
  The external interrupts (outside MCUSYS) will feed through CIRQ and connect
  to GIC in MCUSYS. When CIRQ is enabled, it will record the edge-sensitive
  interrupts and generate a pulse signal to parent interrupt controller when
  flush command is executed. With CIRQ, MCUSYS can be completely turned off
  to improve the system power consumption without losing interrupts.


properties:
  compatible:
    items:
      - enum:
          - mediatek,mt2701-cirq
          - mediatek,mt8135-cirq
          - mediatek,mt8173-cirq
          - mediatek,mt8192-cirq
      - const: mediatek,mtk-cirq

  reg:
    maxItems: 1

  '#interrupt-cells':
    const: 3

  interrupt-controller: true

  mediatek,ext-irq-range:
    $ref: /schemas/types.yaml#/definitions/uint32-array
    items:
      - description: First CIRQ interrupt
      - description: Last CIRQ interrupt
    description:
      Identifies the range of external interrupts in different SoCs

required:
  - compatible
  - reg
  - '#interrupt-cells'
  - interrupt-controller
  - mediatek,ext-irq-range

additionalProperties: false

examples:
  - |
    #include <dt-bindings/interrupt-controller/irq.h>

    cirq: interrupt-controller@10204000 {
        compatible = "mediatek,mt2701-cirq", "mediatek,mtk-cirq";
        reg = <0x10204000 0x400>;
        #interrupt-cells = <3>;
        interrupt-controller;
        interrupt-parent = <&sysirq>;
        mediatek,ext-irq-range = <32 200>;
    };
```

## Documentation/devicetree/bindings/interrupt-controller/mediatek,sysirq.txt
```
MediaTek sysirq

MediaTek SOCs sysirq support controllable irq inverter for each GIC SPI
interrupt.

Required properties:
- compatible: should be
	"mediatek,mt8516-sysirq", "mediatek,mt6577-sysirq": for MT8516
	"mediatek,mt8183-sysirq", "mediatek,mt6577-sysirq": for MT8183
	"mediatek,mt8173-sysirq", "mediatek,mt6577-sysirq": for MT8173
	"mediatek,mt8135-sysirq", "mediatek,mt6577-sysirq": for MT8135
	"mediatek,mt8127-sysirq", "mediatek,mt6577-sysirq": for MT8127
	"mediatek,mt7622-sysirq", "mediatek,mt6577-sysirq": for MT7622
	"mediatek,mt7623-sysirq", "mediatek,mt6577-sysirq": for MT7623
	"mediatek,mt7629-sysirq", "mediatek,mt6577-sysirq": for MT7629
	"mediatek,mt6795-sysirq", "mediatek,mt6577-sysirq": for MT6795
	"mediatek,mt6797-sysirq", "mediatek,mt6577-sysirq": for MT6797
	"mediatek,mt6765-sysirq", "mediatek,mt6577-sysirq": for MT6765
	"mediatek,mt6755-sysirq", "mediatek,mt6577-sysirq": for MT6755
	"mediatek,mt6592-sysirq", "mediatek,mt6577-sysirq": for MT6592
	"mediatek,mt6589-sysirq", "mediatek,mt6577-sysirq": for MT6589
	"mediatek,mt6582-sysirq", "mediatek,mt6577-sysirq": for MT6582
	"mediatek,mt6580-sysirq", "mediatek,mt6577-sysirq": for MT6580
	"mediatek,mt6577-sysirq": for MT6577
	"mediatek,mt2712-sysirq", "mediatek,mt6577-sysirq": for MT2712
	"mediatek,mt2701-sysirq", "mediatek,mt6577-sysirq": for MT2701
- interrupt-controller : Identifies the node as an interrupt controller
- #interrupt-cells : Use the same format as specified by GIC in arm,gic.txt.
- reg: Physical base address of the intpol registers and length of memory
  mapped region. Could be multiple bases here. Ex: mt6797 needs 2 reg, others
  need 1.

Example:
	sysirq: intpol-controller@10200620 {
		compatible = "mediatek,mt6797-sysirq",
			     "mediatek,mt6577-sysirq";
		interrupt-controller;
		#interrupt-cells = <3>;
		interrupt-parent = <&gic>;
		reg = <0 0x10220620 0 0x20>,
		      <0 0x10220690 0 0x10>;
	};
```

## Documentation/devicetree/bindings/interrupt-controller/microchip,lan966x-oic.yaml
```yaml
# SPDX-License-Identifier: (GPL-2.0 OR BSD-2-Clause)
%YAML 1.2
---
$id: http://devicetree.org/schemas/interrupt-controller/microchip,lan966x-oic.yaml#
$schema: http://devicetree.org/meta-schemas/core.yaml#

title: Microchip LAN966x outband interrupt controller

maintainers:
  - Herve Codina <herve.codina@bootlin.com>

allOf:
  - $ref: /schemas/interrupt-controller.yaml#

description: |
  The Microchip LAN966x outband interrupt controller (OIC) maps the internal
  interrupt sources of the LAN966x device to an external interrupt.
  When the LAN966x device is used as a PCI device, the external interrupt is
  routed to the PCI interrupt.

properties:
  compatible:
    const: microchip,lan966x-oic

  '#interrupt-cells':
    const: 2

  interrupt-controller: true

  reg:
    maxItems: 1

  interrupts:
    maxItems: 1

required:
  - compatible
  - '#interrupt-cells'
  - interrupt-controller
  - interrupts
  - reg

additionalProperties: false

examples:
  - |
    interrupt-controller@e00c0120 {
        compatible = "microchip,lan966x-oic";
        reg = <0xe00c0120 0x190>;
        #interrupt-cells = <2>;
        interrupt-controller;
        interrupts = <0>;
        interrupt-parent = <&intc>;
    };
...
```

## Documentation/devicetree/bindings/interrupt-controller/microchip,pic32mzda-evic.yaml
```yaml
# SPDX-License-Identifier: (GPL-2.0-only OR BSD-2-Clause)
%YAML 1.2
---
$id: http://devicetree.org/schemas/interrupt-controller/microchip,pic32mzda-evic.yaml#
$schema: http://devicetree.org/meta-schemas/core.yaml#

title: Microchip PIC32 EVIC Interrupt Controller

maintainers:
  - Cristian Birsan <cristian.birsan@microchip.com>

description: >
  The Microchip PIC32 contains an Enhanced Vectored Interrupt Controller (EVIC).
  It handles all internal and external interrupts. This controller exists
  outside of the CPU and is the arbitrator of all interrupts (including
  interrupts from the CPU itself) before they are presented to the CPU.

  External interrupts have a software configurable edge polarity. Non external
  interrupts have a type and polarity that is determined by the source of the
  interrupt.

properties:
  compatible:
    items:
      - const: microchip,pic32mzda-evic

  reg:
    maxItems: 1

  interrupt-controller: true

  '#interrupt-cells':
    const: 2

  interrupts:
    maxItems: 1

  microchip,external-irqs:
    description:
      External interrupts with software polarity configuration corresponding to
      the INTCON SFR bits.
    $ref: /schemas/types.yaml#/definitions/uint32-array

required:
  - compatible
  - reg
  - interrupt-controller
  - '#interrupt-cells'

additionalProperties: false

examples:
  - |
      interrupt-controller@1f810000 {
          compatible = "microchip,pic32mzda-evic";
          reg = <0x1f810000 0x1000>;
          interrupt-controller;
          #interrupt-cells = <2>;
          microchip,external-irqs = <3 8 13 18 23>;
      };
```

## Documentation/devicetree/bindings/interrupt-controller/microchip,sama7g5-eic.yaml
```yaml
# SPDX-License-Identifier: (GPL-2.0-only OR BSD-2-Clause)
%YAML 1.2
---
$id: http://devicetree.org/schemas/interrupt-controller/microchip,sama7g5-eic.yaml#
$schema: http://devicetree.org/meta-schemas/core.yaml#

title: Microchip External Interrupt Controller

maintainers:
  - Claudiu Beznea <claudiu.beznea@microchip.com>

description:
  This interrupt controller is found in Microchip SoCs (SAMA7G5) and provides
  support for handling up to 2 external interrupt lines.

properties:
  compatible:
    enum:
      - microchip,sama7g5-eic

  reg:
    maxItems: 1

  interrupt-controller: true

  '#interrupt-cells':
    const: 2
    description:
      The first cell is the input IRQ number (between 0 and 1), the second cell
      is the trigger type as defined in interrupt.txt present in this directory.

  interrupts:
    description: |
      Contains the GIC SPI IRQs mapped to the external interrupt lines. They
      should be specified sequentially from output 0 to output 1.
    minItems: 2
    maxItems: 2

  clocks:
    maxItems: 1

  clock-names:
    const: pclk

required:
  - compatible
  - reg
  - interrupt-controller
  - '#interrupt-cells'
  - interrupts
  - clocks
  - clock-names

additionalProperties: false

examples:
  - |
    #include <dt-bindings/clock/at91.h>
    #include <dt-bindings/interrupt-controller/arm-gic.h>

    eic: interrupt-controller@e1628000 {
      compatible = "microchip,sama7g5-eic";
      reg = <0xe1628000 0x100>;
      interrupt-parent = <&gic>;
      interrupt-controller;
      #interrupt-cells = <2>;
      interrupts = <GIC_SPI 153 IRQ_TYPE_LEVEL_HIGH>,
                   <GIC_SPI 154 IRQ_TYPE_LEVEL_HIGH>;
      clocks = <&pmc PMC_TYPE_PERIPHERAL 37>;
      clock-names = "pclk";
    };

...
```
