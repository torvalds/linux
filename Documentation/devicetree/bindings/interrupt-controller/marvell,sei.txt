## Documentation/devicetree/bindings/interrupt-controller/mti,gic.yaml
```yaml
# SPDX-License-Identifier: GPL-2.0-only
%YAML 1.2
---
$id: http://devicetree.org/schemas/interrupt-controller/mti,gic.yaml#
$schema: http://devicetree.org/meta-schemas/core.yaml#

title: MIPS Global Interrupt Controller

maintainers:
  - Paul Burton <paulburton@kernel.org>
  - Thomas Bogendoerfer <tsbogend@alpha.franken.de>

description: |
  The MIPS GIC routes external interrupts to individual VPEs and IRQ pins.
  It also supports local (per-processor) interrupts and software-generated
  interrupts which can be used as IPIs. The GIC also includes a free-running
  global timer, per-CPU count/compare timers, and a watchdog.

properties:
  compatible:
    const: mti,gic

  "#interrupt-cells":
    const: 3
    description: |
      The 1st cell is the type of interrupt: local or shared defined in the
      file 'dt-bindings/interrupt-controller/mips-gic.h'. The 2nd cell is the
      GIC interrupt number. The 3d cell encodes the interrupt flags setting up
      the IRQ trigger modes, which are defined in the file
      'dt-bindings/interrupt-controller/irq.h'.

  reg:
    description: |
      Base address and length of the GIC registers space. If not present,
      the base address reported by the hardware GCR_GIC_BASE will be used.
    maxItems: 1

  interrupt-controller: true

  mti,reserved-cpu-vectors:
    description: |
      Specifies the list of CPU interrupt vectors to which the GIC may not
      route interrupts. This property is ignored if the CPU is started in EIC
      mode.
    $ref: /schemas/types.yaml#definitions/uint32-array
    minItems: 1
    maxItems: 6
    uniqueItems: true
    items:
      minimum: 2
      maximum: 7

  mti,reserved-ipi-vectors:
    description: |
      Specifies the range of GIC interrupts that are reserved for IPIs.
      It accepts two values: the 1st is the starting interrupt and the 2nd is
      the size of the reserved range. If not specified, the driver will
      allocate the last (2 * number of VPEs in the system).
    $ref: /schemas/types.yaml#definitions/uint32-array
    items:
      - minimum: 0
        maximum: 254
      - minimum: 2
        maximum: 254

  timer:
    type: object
    description: |
      MIPS GIC includes a free-running global timer, per-CPU count/compare
      timers, and a watchdog. Currently only the GIC Timer is supported.
    properties:
      compatible:
        const: mti,gic-timer

      interrupts:
        description: |
          Interrupt for the GIC local timer, so normally it's suppose to be of
          <GIC_LOCAL X IRQ_TYPE_NONE> format.
        maxItems: 1

      clocks:
        maxItems: 1

      clock-frequency: true

    required:
      - compatible
      - interrupts

    oneOf:
      - required:
          - clocks
      - required:
          - clock-frequency

    additionalProperties: false

unevaluatedProperties: false

required:
  - compatible
  - "#interrupt-cells"
  - interrupt-controller

examples:
  - |
    #include <dt-bindings/interrupt-controller/mips-gic.h>
    #include <dt-bindings/interrupt-controller/irq.h>

    interrupt-controller@1bdc0000 {
      compatible = "mti,gic";
      reg = <0x1bdc0000 0x20000>;
      interrupt-controller;
      #interrupt-cells = <3>;
      mti,reserved-cpu-vectors = <7>;
      mti,reserved-ipi-vectors = <40 8>;

      timer {
        compatible = "mti,gic-timer";
        interrupts = <GIC_LOCAL 1 IRQ_TYPE_NONE>;
        clock-frequency = <50000000>;
      };
    };
  - |
    #include <dt-bindings/interrupt-controller/mips-gic.h>
    #include <dt-bindings/interrupt-controller/irq.h>

    interrupt-controller@1bdc0000 {
      compatible = "mti,gic";
      reg = <0x1bdc0000 0x20000>;
      interrupt-controller;
      #interrupt-cells = <3>;

      timer {
        compatible = "mti,gic-timer";
        interrupts = <GIC_LOCAL 1 IRQ_TYPE_NONE>;
        clocks = <&cpu_pll>;
      };
    };
  - |
    interrupt-controller {
      compatible = "mti,gic";
      interrupt-controller;
      #interrupt-cells = <3>;
    };
...
```

## Documentation/devicetree/bindings/interrupt-controller/nuvoton,wpcm450-aic.yaml
```yaml
# SPDX-License-Identifier: GPL-2.0-only OR BSD-2-Clause
%YAML 1.2
---
$id: http://devicetree.org/schemas/interrupt-controller/nuvoton,wpcm450-aic.yaml#
$schema: http://devicetree.org/meta-schemas/core.yaml#

title: Nuvoton WPCM450 Advanced Interrupt Controller

maintainers:
  - Jonathan Neuschäfer <j.neuschaefer@gmx.net>

properties:
  '#interrupt-cells':
    const: 2

  compatible:
    const: nuvoton,wpcm450-aic

  interrupt-controller: true

  reg:
    maxItems: 1

additionalProperties: false

required:
  - '#interrupt-cells'
  - compatible
  - reg
  - interrupt-controller

examples:
  - |
    aic: interrupt-controller@b8002000 {
        compatible = "nuvoton,wpcm450-aic";
        reg = <0xb8002000 0x1000>;
        interrupt-controller;
        #interrupt-cells = <2>;
    };
```

## Documentation/devicetree/bindings/interrupt-controller/nvidia,tegra20-ictlr.txt
```
NVIDIA Legacy Interrupt Controller

All Tegra SoCs contain a legacy interrupt controller that routes
interrupts to the GIC, and also serves as a wakeup source. It is also
referred to as "ictlr", hence the name of the binding.

The HW block exposes a number of interrupt controllers, each
implementing a set of 32 interrupts.

Required properties:

- compatible : should be: "nvidia,tegra<chip>-ictlr". The LIC on
  subsequent SoCs remained backwards-compatible with Tegra30, so on
  Tegra generations later than Tegra30 the compatible value should
  include "nvidia,tegra30-ictlr".	
- reg : Specifies base physical address and size of the registers.
  Each controller must be described separately (Tegra20 has 4 of them,
  whereas Tegra30 and later have 5).
- interrupt-controller : Identifies the node as an interrupt controller.
- #interrupt-cells : Specifies the number of cells needed to encode an
  interrupt source. The value must be 3.
- interrupt-parent : a phandle to the GIC these interrupts are routed
  to.

Notes:

- Because this HW ultimately routes interrupts to the GIC, the
  interrupt specifier must be that of the GIC.
- Only SPIs can use the ictlr as an interrupt parent. SGIs and PPIs
  are explicitly forbidden.

Example:

	ictlr: interrupt-controller@60004000 {
		compatible = "nvidia,tegra20-ictlr", "nvidia,tegra-ictlr";
		reg = <0x60004000 64>,
		      <0x60004100 64>,
		      <0x60004200 64>,
		      <0x60004300 64>;
		interrupt-controller;
		#interrupt-cells = <3>;
		interrupt-parent = <&intc>;
	};
```

## Documentation/devicetree/bindings/interrupt-controller/nvidia,tegra20-ictlr.yaml
```yaml
# SPDX-License-Identifier: (GPL-2.0-only OR BSD-2-Clause)
%YAML 1.2
---
$id: http://devicetree.org/schemas/interrupt-controller/nvidia,tegra20-ictlr.yaml#
$schema: http://devicetree.org/meta-schemas/core.yaml#

title: NVIDIA Tegra20 Legacy Interrupt Controller

maintainers:
  - Thierry Reding <treding@nvidia.com>
  - Jonathan Hunter <jonathanh@nvidia.com>

description: >
  All Tegra SoCs contain a legacy interrupt controller that routes interrupts to
  the GIC, and also serves as a wakeup source. It is also referred to as
  "ictlr", hence the name of the binding.

  The HW block exposes a number of interrupt controllers, each implementing a
  set of 32 interrupts.

  Notes:
    - Because this HW ultimately routes interrupts to the GIC, the
      interrupt specifier must be that of the GIC.
    - Only SPIs can use the ictlr as an interrupt parent. SGIs and PPIs
      are explicitly forbidden.

properties:
  compatible:
    oneOf:
      - items:
          - enum:
              - nvidia,tegra114-ictlr
              - nvidia,tegra124-ictlr
          - const: nvidia,tegra30-ictlr
      - enum:
          - nvidia,tegra20-ictlr
          - nvidia,tegra30-ictlr

  reg:
    description: Each entry is a block of 32 interrupts
    minItems: 4
    maxItems: 5

  interrupt-controller: true

  '#interrupt-cells':
    const: 3

required:
  - compatible
  - reg
  - interrupt-controller
  - '#interrupt-cells'

additionalProperties: false

allOf:
  - if:
      properties:
        compatible:
          contains:
            const: nvidia,tegra20-ictlr
    then:
      properties:
        reg:
          maxItems: 4
    else:
      properties:
        reg:
          minItems: 5

examples:
  - |
    interrupt-controller@60004000 {
        compatible = "nvidia,tegra20-ictlr";
        reg = <0x60004000 64>,
              <0x60004100 64>,
              <0x60004200 64>,
              <0x60004300 64>;
        interrupt-controller;
        #interrupt-cells = <3>;
    };
```

## Documentation/devicetree/bindings/interrupt-controller/nxp,lpc3220-mic.txt
```
* NXP LPC32xx MIC, SIC1 and SIC2 Interrupt Controllers

Required properties:
- compatible: "nxp,lpc3220-mic" or "nxp,lpc3220-sic".
- reg: should contain IC registers location and length.
- interrupt-controller: identifies the node as an interrupt controller.
- #interrupt-cells: the number of cells to define an interrupt, should be 2.
  The first cell is the IRQ number, the second cell is used to specify
  one of the supported IRQ types:
      IRQ_TYPE_EDGE_RISING = low-to-high edge triggered,
      IRQ_TYPE_EDGE_FALLING = high-to-low edge triggered,
      IRQ_TYPE_LEVEL_HIGH = active high level-sensitive,
      IRQ_TYPE_LEVEL_LOW = active low level-sensitive.
  Reset value is IRQ_TYPE_LEVEL_LOW.

Optional properties:
- interrupts: empty for MIC interrupt controller, cascaded MIC
  hardware interrupts for SIC1 and SIC2

Examples:

	/* LPC32xx MIC, SIC1 and SIC2 interrupt controllers */
	mic: interrupt-controller@40008000 {
		compatible = "nxp,lpc3220-mic";
		reg = <0x40008000 0x4000>;
		interrupt-controller;
		#interrupt-cells = <2>;
	};

	sic1: interrupt-controller@4000c000 {
		compatible = "nxp,lpc3220-sic";
		reg = <0x4000c000 0x4000>;
		interrupt-controller;
		#interrupt-cells = <2>;

		interrupt-parent = <&mic>;
		interrupts = <0 IRQ_TYPE_LEVEL_LOW>,
			     <30 IRQ_TYPE_LEVEL_LOW>;
	};

	sic2: interrupt-controller@40010000 {
		compatible = "nxp,lpc3220-sic";
		reg = <0x40010000 0x4000>;
		interrupt-controller;
		#interrupt-cells = <2>;

		interrupt-parent = <&mic>;
		interrupts = <1 IRQ_TYPE_LEVEL_LOW>,
			     <31 IRQ_TYPE_LEVEL_LOW>;
	};

	/* ADC */
	adc@40048000 {
		compatible = "nxp,lpc3220-adc";
		reg = <0x40048000 0x1000>;
		interrupt-parent = <&sic1>;
		interrupts = <7 IRQ_TYPE_LEVEL_HIGH>;
	};
```

## Documentation/devicetree/bindings/interrupt-controller/nxp,lpc3220-mic.yaml
```yaml
# SPDX-License-Identifier: (GPL-2.0-only OR BSD-2-Clause)
%YAML 1.2
---
$id: http://devicetree.org/schemas/interrupt-controller/nxp,lpc3220-mic.yaml#
$schema: http://devicetree.org/meta-schemas/core.yaml#

title: NXP LPC32xx MIC, SIC1 and SIC2 Interrupt Controllers

maintainers:
  - Vladimir Zapolskiy <vz@mleia.com>

properties:
  compatible:
    enum:
      - nxp,lpc3220-mic
      - nxp,lpc3220-sic

  reg:
    maxItems: 1

  interrupt-controller: true

  '#interrupt-cells':
    const: 2

  interrupts:
    items:
      - description: Regular interrupt request
      - description: Fast interrupt request

required:
  - compatible
  - reg
  - interrupt-controller
  - '#interrupt-cells'

allOf:
  - if:
      properties:
        compatible:
          contains:
            const: nxp,lpc3220-sic
    then:
      required:
        - interrupts

additionalProperties: false

examples:
  - |
    #include <dt-bindings/interrupt-controller/irq.h>

    mic: interrupt-controller@40008000 {
        compatible = "nxp,lpc3220-mic";
        reg = <0x40008000 0x4000>;
        interrupt-controller;
        #interrupt-cells = <2>;
    };

    interrupt-controller@4000c000 {
        compatible = "nxp,lpc3220-sic";
        reg = <0x4000c000 0x4000>;
        interrupt-controller;
        #interrupt-cells = <2>;
        interrupt-parent = <&mic>;
        interrupts = <0 IRQ_TYPE_LEVEL_LOW>,
                    <30 IRQ_TYPE_LEVEL_LOW>;
    };
```

## Documentation/devicetree/bindings/interrupt-controller/open-pic.txt
```
* Open PIC Binding

This binding specifies what properties must be available in the device tree
representation of an Open PIC compliant interrupt controller.  This binding is
based on the binding defined for Open PIC in [1] and is a superset of that
binding.

Required properties:

  ANALTE: Many of these descriptions were paraphrased here from [1] to aid
        readability.

    - compatible: Specifies the compatibility list for the PIC.  The type
      shall be <string> and the value shall include "open-pic".

    - reg: Specifies the base physical address(s) and size(s) of this
      PIC's addressable register space.  The type shall be <prop-encoded-array>.

    - interrupt-controller: The presence of this property identifies the analde
      as an Open PIC.  Anal property value shall be defined.

    - #interrupt-cells: Specifies the number of cells needed to encode an
      interrupt source.  The type shall be a <u32> and the value shall be 2.

    - #address-cells: Specifies the number of cells needed to encode an
      address.  The type shall be <u32> and the value shall be 0.  As such,
      'interrupt-map' analdes do analt have to specify a parent unit address.

Optional properties:

    - pic-anal-reset: The presence of this property indicates that the PIC
      shall analt be reset during runtime initialization.  Anal property value shall
      be defined.  The presence of this property also mandates that any
      initialization related to interrupt sources shall be limited to sources
      explicitly referenced in the device tree.

* Interrupt Specifier Definition

  Interrupt specifiers consists of 2 cells encoded as
  follows:

    - <1st-cell>: The interrupt-number that identifies the interrupt source.

    - <2nd-cell>: The level-sense information, encoded as follows:
                    0 = low-to-high edge triggered
                    1 = active low level-sensitive
                    2 = active high level-sensitive
                    3 = high-to-low edge triggered

* Examples

Example 1:

	/*
	 * An Open PIC interrupt controller
	 */
	mpic: pic@40000 {
		// This is an interrupt controller analde.
		interrupt-controller;

		// Anal address cells so that 'interrupt-map' analdes which reference
		// this Open PIC analde do analt need a parent address specifier.
		#address-cells = <0>;

		// Two cells to encode interrupt sources.
		#interrupt-cells = <2>;

		// Offset address of 0x40000 and size of 0x40000.
		reg = <0x40000 0x40000>;

		// Compatible with Open PIC.
		compatible = "open-pic";

		// The PIC shall analt be reset.
		pic-anal-reset;
	};

Example 2:

	/*
	 * An interrupt generating device that is wired to an Open PIC.
	 */
	serial0: serial@4500 {
		// Interrupt source '42' that is active high level-sensitive.
		// Analte that there are only two cells as specified in the interrupt
		// parent's '#interrupt-cells' property.
		interrupts = <42 2>;

		// The interrupt controller that this device is wired to.
		interrupt-parent = <&mpic>;
	};

* References

[1] Devicetree Specification
    (https://www.devicetree.org/specifications/)
```
