## Documentation/devicetree/bindings/iommu/mediatek,iommu.yaml
```yaml
# SPDX-License-Identifier: (GPL-2.0-only OR BSD-2-Clause)
%YAML 1.2
---
$id: http://devicetree.org/schemas/iommu/mediatek,iommu.yaml#
$schema: http://devicetree.org/meta-schemas/core.yaml#

title: MediaTek IOMMU Architecture Implementation

maintainers:
  - Yong Wu <yong.wu@mediatek.com>

description: |+
  Some MediaTek SOCs contain a Multimedia Memory Management Unit (M4U), and
  this M4U have two generations of HW architecture. Generation one uses flat
  pagetable, and only supports 4K size page mapping. Generation two uses the
  ARM Short-Descriptor translation table format for address translation.

  About the M4U Hardware Block Diagram, please check below:

                EMI (External Memory Interface)
                 |
                m4u (Multimedia Memory Management Unit)
                 |
            +--------+
            |        |
        gals0-rx   gals1-rx    (Global Async Local Sync rx)
            |        |
            |        |
        gals0-tx   gals1-tx    (Global Async Local Sync tx)
            |        |          Some SoCs may have GALS.
            +--------+
                 |
             SMI Common(Smart Multimedia Interface Common)
                 |
         +----------------+-------
         |                |
         |             gals-rx        There may be GALS in some larbs.
         |                |
         |                |
         |             gals-tx
         |                |
     SMI larb0        SMI larb1   ... SoCs have several SMI local arbiter(larb).
     (display)         (vdec)
         |                |
         |                |
   +-----+-----+     +----+----+
   |     |     |     |    |    |
   |     |     |...  |    |    |  ... There are different ports in each larb.
   |     |     |     |    |    |
  OVL0 RDMA0 WDMA0  MC   PP   VLD

  As above, The Multimedia HW will go through SMI and M4U while it
  access EMI. SMI is a bridge between m4u and the Multimedia HW. It contain
  smi local arbiter and smi common. It will control whether the Multimedia
  HW should go through the m4u for translation or bypass it and talk
  directly with EMI. And also SMI help control the power domain and clocks for
  each local arbiter.

  Normally we specify a local arbiter(larb) for each multimedia HW
  like display, video decode, and camera. And there are different ports
  in each larb. Take a example, There are many ports like MC, PP, VLD in the
  video decode local arbiter, all these ports are according to the video HW.

  In some SoCs, there may be a GALS(Global Async Local Sync) module between
  smi-common and m4u, and additional GALS module between smi-larb and
  smi-common. GALS can been seen as a "asynchronous fifo" which could help
  synchronize for the modules in different clock frequency.

properties:
  compatible:
    oneOf:
      - enum:
          - mediatek,mt2701-m4u  # generation one
          - mediatek,mt2712-m4u  # generation two
          - mediatek,mt6779-m4u  # generation two
          - mediatek,mt6795-m4u  # generation two
          - mediatek,mt6893-iommu-mm         # generation two
          - mediatek,mt8167-m4u  # generation two
          - mediatek,mt8173-m4u  # generation two
          - mediatek,mt8183-m4u  # generation two
          - mediatek,mt8186-iommu-mm         # generation two
          - mediatek,mt8188-iommu-vdo        # generation two
          - mediatek,mt8188-iommu-vpp        # generation two
          - mediatek,mt8188-iommu-infra      # generation two
          - mediatek,mt8192-m4u  # generation two
          - mediatek,mt8195-iommu-vdo        # generation two
          - mediatek,mt8195-iommu-vpp        # generation two
          - mediatek,mt8195-iommu-infra      # generation two
          - mediatek,mt8365-m4u  # generation two

      - description: mt7623 generation one
        items:
          - const: mediatek,mt7623-m4u
          - const: mediatek,mt2701-m4u

  reg:
    maxItems: 1

  interrupts:
    maxItems: 1

  clocks:
    items:
      - description: bclk is the block clock.

  clock-names:
    items:
      - const: bclk

  mediatek,infracfg:
    $ref: /schemas/types.yaml#/definitions/phandle
    description: The phandle to the mediatek infracfg syscon

  mediatek,larbs:
    $ref: /schemas/types.yaml#/definitions/phandle-array
    minItems: 1
    maxItems: 32
    items:
      maxItems: 1
    description: |
      List of phandle to the local arbiters in the current Socs.
      Refer to bindings/memory-controllers/mediatek,smi-larb.yaml. It must sort
      according to the local arbiter index, like larb0, larb1, larb2...

  '#iommu-cells':
    const: 1
    description: |
      This is the mtk_m4u_id according to the HW. Specifies the mtk_m4u_id as
      defined in
      dt-binding/memory/mediatek,mt8188-memory-port.h for mt8188,
      dt-binding/memory/mt2701-larb-port.h for mt2701 and mt7623,
      dt-binding/memory/mt2712-larb-port.h for mt2712,
      dt-binding/memory/mt6779-larb-port.h for mt6779,
      dt-binding/memory/mt6795-larb-port.h for mt6795,
      dt-binding/memory/mediatek,mt6893-memory-port.h for mt6893,
      dt-binding/memory/mt8167-larb-port.h for mt8167,
      dt-binding/memory/mt8173-larb-port.h for mt8173,
      dt-binding/memory/mt8183-larb-port.h for mt8183,
      dt-binding/memory/mt8186-memory-port.h for mt8186,
      dt-binding/memory/mt8192-larb-port.h for mt8192.
      dt-binding/memory/mt8195-memory-port.h for mt8195.
      dt-binding/memory/mediatek,mt8365-larb-port.h for mt8365.

  power-domains:
    maxItems: 1

required:
  - compatible
  - reg
  - interrupts
  - '#iommu-cells'

allOf:
  - if:
      properties:
        compatible:
          contains:
            enum:
              - mediatek,mt2701-m4u
              - mediatek,mt2712-m4u
              - mediatek,mt6795-m4u
              - mediatek,mt6893-iommu-mm
              - mediatek,mt8173-m4u
              - mediatek,mt8186-iommu-mm
              - mediatek,mt8188-iommu-vdo
              - mediatek,mt8188-iommu-vpp
              - mediatek,mt8192-m4u
              - mediatek,mt8195-iommu-vdo
              - mediatek,mt8195-iommu-vpp

    then:
      required:
        - clocks

  - if:
      properties:
        compatible:
          enum:
            - mediatek,mt6893-iommu-mm
            - mediatek,mt8186-iommu-mm
            - mediatek,mt8188-iommu-vdo
            - mediatek,mt8188-iommu-vpp
            - mediatek,mt8192-m4u
            - mediatek,mt8195-iommu-vdo
            - mediatek,mt8195-iommu-vpp

    then:
      required:
        - power-domains

  - if:
      properties:
        compatible:
          contains:
            enum:
              - mediatek,mt2712-m4u
              - mediatek,mt6795-m4u
              - mediatek,mt8173-m4u

    then:
      required:
        - mediatek,infracfg

  - if: # The IOMMUs don't have larbs.
      not:
        properties:
          compatible:
            contains:
              enum:
                - mediatek,mt8188-iommu-infra
                - mediatek,mt8195-iommu-infra

    then:
      required:
        - mediatek,larbs

additionalProperties: false

examples:
  - |
    #include <dt-bindings/clock/mt8173-clk.h>
    #include <dt-bindings/interrupt-controller/arm-gic.h>

    iommu: iommu@10205000 {
            compatible = "mediatek,mt8173-m4u";
            reg = <0x10205000 0x1000>;
            interrupts = <GIC_SPI 139 IRQ_TYPE_LEVEL_LOW>;
            clocks = <&infracfg CLK_INFRA_M4U>;
            clock-names = "bclk";
            mediatek,infracfg = <&infracfg>;
            mediatek,larbs = <&larb0>, <&larb1>, <&larb2>,
                             <&larb3>, <&larb4>, <&larb5>;
            #iommu-cells = <1>;
    };
```

## Documentation/devicetree/bindings/iommu/msm,iommu-v0.txt
```
* QCOM IOMMU

The MSM IOMMU is an implementation compatible with the ARM VMSA short
descriptor page tables. It provides address translation for bus masters outside
of the CPU, each connected to the IOMMU through a port called micro-TLB.

Required Properties:

  - compatible: Must contain "qcom,apq8064-iommu".
  - reg: Base address and size of the IOMMU registers.
  - interrupts: Specifiers for the MMU fault interrupts. For instances that
    support secure mode two interrupts must be specified, for non-secure and
    secure mode, in that order. For instances that don't support secure mode a
    single interrupt must be specified.
  - #iommu-cells: The number of cells needed to specify the stream id. This
		  is always 1.
  - qcom,ncb:	  The total number of context banks in the IOMMU.
  - clocks	: List of clocks to be used during SMMU register access. See
		  Documentation/devicetree/bindings/clock/clock-bindings.txt
		  for information about the format. For each clock specified
		  here, there must be a corresponding entry in clock-names
		  (see below).

  - clock-names	: List of clock names corresponding to the clocks specified in
		  the "clocks" property (above).
		  Should be "smmu_pclk" for specifying the interface clock
		  required for iommu's register accesses.
		  Should be "smmu_clk" for specifying the functional clock
		  required by iommu for bus accesses.

Each bus master connected to an IOMMU must reference the IOMMU in its device
node with the following property:

  - iommus: A reference to the IOMMU in multiple cells. The first cell is a
	    phandle to the IOMMU and the second cell is the stream id.
	    A single master device can be connected to more than one iommu
	    and multiple contexts in each of the iommu. So multiple entries
	    are required to list all the iommus and the stream ids that the
	    master is connected to.

Example: mdp iommu and its bus master

                mdp_port0: iommu@7500000 {
			compatible = "qcom,apq8064-iommu";
			#iommu-cells = <1>;
			clock-names =
			    "smmu_pclk",
			    "smmu_clk";
			clocks =
			    <&mmcc SMMU_AHB_CLK>,
			    <&mmcc MDP_AXI_CLK>;
			reg = <0x07500000 0x100000>;
			interrupts =
			    <GIC_SPI 63 0>,
			    <GIC_SPI 64 0>;
			qcom,ncb = <2>;
		};

		mdp: qcom,mdp@5100000 {
			compatible = "qcom,mdp";
			...
			iommus = <&mdp_port0 0
				  &mdp_port0 2>;
		};
```

## Documentation/devicetree/bindings/iommu/nvidia,tegra20-gart.txt
```
NVIDIA Tegra 20 GART

Required properties:
- compatible: "nvidia,tegra20-gart"
- reg: Two pairs of cells specifying the physical address and size of
  the memory controller registers and the GART aperture respectively.

Example:

	gart {
		compatible = "nvidia,tegra20-gart";
		reg = <0x7000f024 0x00000018	/* controller registers */
		       0x58000000 0x02000000>;	/* GART aperture */
	};
```

## Documentation/devicetree/bindings/iommu/nvidia,tegra264-cmdqv.yaml
```yaml
# SPDX-License-Identifier: (GPL-2.0-only OR BSD-2-Clause)
%YAML 1.2
---
$id: http://devicetree.org/schemas/iommu/nvidia,tegra264-cmdqv.yaml#
$schema: http://devicetree.org/meta-schemas/core.yaml#

title: NVIDIA Tegra264 CMDQV

description:
  The CMDQ-Virtualization hardware block is part of the SMMUv3 implementation
  on Tegra264 SoCs. It assists in virtualizing the command queue for the SMMU.

maintainers:
  - Nicolin Chen <nicolinc@nvidia.com>

properties:
  compatible:
    const: nvidia,tegra264-cmdqv

  reg:
    maxItems: 1

  interrupts:
    maxItems: 1

required:
  - compatible
  - reg
  - interrupts

additionalProperties: false

examples:
  - |
    #include <dt-bindings/interrupt-controller/arm-gic.h>
    #include <dt-bindings/interrupt-controller/irq.h>

    cmdqv@5200000 {
            compatible = "nvidia,tegra264-cmdqv";
            reg = <0x5200000 0x830000>;
            interrupts = <GIC_SPI 19 IRQ_TYPE_LEVEL_HIGH>;
    };
```

## Documentation/devicetree/bindings/iommu/nvidia,tegra30-smmu.txt
```
NVIDIA Tegra 30 IOMMU H/W, SMMU (System Memory Management Unit)

Required properties:
- compatible : "nvidia,tegra30-smmu"
- reg : Should contain 3 register banks(address and length) for each
  of the SMMU register blocks.
- interrupts : Should contain MC General interrupt.
- nvidia,#asids : # of ASIDs
- dma-window : IOVA start address and length.
- nvidia,ahb : phandle to the ahb bus connected to SMMU.

Example:
	smmu {
		compatible = "nvidia,tegra30-smmu";
		reg = <0x7000f010 0x02c
		       0x7000f1f0 0x010
		       0x7000f228 0x05c>;
		nvidia,#asids = <4>;		/* # of ASIDs */
		dma-window = <0 0x40000000>;	/* IOVA start & length */
		nvidia,ahb = <&ahb>;
	};
```

## Documentation/devicetree/bindings/iommu/qcom,apq8064-iommu.yaml
```yaml
# SPDX-License-Identifier: (GPL-2.0-only OR BSD-2-Clause)
%YAML 1.2
---

$id: http://devicetree.org/schemas/iommu/qcom,apq8064-iommu.yaml#
$schema: http://devicetree.org/meta-schemas/core.yaml#

title: Qualcomm APQ8064 IOMMU

maintainers:
  - David Heidelberg <david@ixit.cz>

description:
  The MSM IOMMU is an implementation compatible with the ARM VMSA short
  descriptor page tables. It provides address translation for bus masters
  outside of the CPU, each connected to the IOMMU through a port called micro-TLB.

properties:
  compatible:
    const: qcom,apq8064-iommu

  clocks:
    items:
      - description: interface clock for register accesses
      - description: functional clock for bus accesses

  clock-names:
    items:
      - const: smmu_pclk
      - const: iommu_clk

  reg:
    maxItems: 1

  interrupts:
    description: Specifiers for the MMU fault interrupts.
    minItems: 1
    items:
      - description: non-secure mode interrupt
      - description: secure mode interrupt (for instances which supports it)

  "#iommu-cells":
    const: 1
    description: Each IOMMU specifier describes a single Stream ID.

  qcom,ncb:
    $ref: /schemas/types.yaml#/definitions/uint32
    description: The total number of context banks in the IOMMU.
    minimum: 1
    maximum: 4

required:
  - reg
  - interrupts
  - clocks
  - clock-names
  - qcom,ncb

additionalProperties: false

examples:
  - |
    #include <dt-bindings/clock/qcom,mmcc-msm8960.h>
    #include <dt-bindings/interrupt-controller/irq.h>
    #include <dt-bindings/interrupt-controller/arm-gic.h>

    iommu@7500000 {
            compatible = "qcom,apq8064-iommu";
            reg = <0x07500000 0x100000>;
            interrupts = <GIC_SPI 63 IRQ_TYPE_LEVEL_HIGH>,
                         <GIC_SPI 64 IRQ_TYPE_LEVEL_HIGH>;
            clocks = <&clk SMMU_AHB_CLK>,
                     <&clk MDP_AXI_CLK>;
            clock-names = "smmu_pclk",
                          "iommu_clk";
            #iommu-cells = <1>;
            qcom,ncb = <2>;
    };
```
