## Documentation/devicetree/bindings/interrupt-controller/ti,sci-intr.yaml
```yaml
# SPDX-License-Identifier: (GPL-2.0 OR BSD-2-Clause)
%YAML 1.2
---
$id: http://devicetree.org/schemas/interrupt-controller/ti,sci-intr.yaml#
$schema: http://devicetree.org/meta-schemas/core.yaml#

title: Texas Instruments K3 Interrupt Router

maintainers:
  - Lokesh Vutla <lokeshvutla@ti.com>

allOf:
  - $ref: /schemas/arm/keystone/ti,k3-sci-common.yaml#

description: |
  The Interrupt Router (INTR) module provides a mechanism to mux M
  interrupt inputs to N interrupt outputs, where all M inputs are selectable
  to be driven per N output.

                                   Interrupt Router
                               +----------------------+
                               |  Inputs     Outputs  |
          +-------+            | +------+    +-----+  |
          | GPIO  |----------->| | irq0 |    |  0  |  |       Host IRQ
          +-------+            | +------+    +-----+  |      controller
                               |    .           .     |      +-------+
          +-------+            |    .           .     |----->|  IRQ  |
          | INTA  |----------->|    .           .     |      +-------+
          +-------+            |    .        +-----+  |
                               | +------+    |  N  |  |
                               | | irqM |    +-----+  |
                               | +------+             |
                               |                      |
                               +----------------------+

  There is one register per output (MUXCNTL_N) that controls the selection.
  Configuration of these MUXCNTL_N registers is done by a system controller
  (like the Device Memory and Security Controller on K3 AM654 SoC). System
  controller will keep track of the used and unused registers within the Router.
  Driver should request the system controller to get the range of GIC IRQs
  assigned to the requesting hosts. It is the drivers responsibility to keep
  track of Host IRQs.

  Communication between the host processor running an OS and the system
  controller happens through a protocol called TI System Control Interface
  (TISCI protocol).

properties:
  compatible:
    const: ti,sci-intr

  ti,intr-trigger-type:
    $ref: /schemas/types.yaml#/definitions/uint32
    enum: [1, 4]
    description: |
      Should be one of the following.
        1 = If intr supports edge triggered interrupts.
        4 = If intr supports level triggered interrupts.

  reg:
    maxItems: 1

  interrupt-controller: true

  '#interrupt-cells':
    enum: [1, 2]
    description: |
      Number of cells in interrupt specifier. Depends on ti,intr-trigger-type:
      - If ti,intr-trigger-type is present: must be 1
        The 1st cell should contain interrupt router input hw number.
      - If ti,intr-trigger-type is absent: must be 2
        The 1st cell should contain interrupt router input hw number.
        The 2nd cell should contain interrupt trigger type (preserved by router).

  ti,interrupt-ranges:
    $ref: /schemas/types.yaml#/definitions/uint32-matrix
    description: |
      Interrupt ranges that converts the INTR output hw irq numbers
      to parents's input interrupt numbers.
    items:
      items:
        - description: |
            "output_irq" specifies the base for intr output irq
        - description: |
            "parent's input irq" specifies the base for parent irq
        - description: |
            "limit" specifies the limit for translation

if:
  required:
    - ti,intr-trigger-type
then:
  properties:
    '#interrupt-cells':
      const: 1
      description: Interrupt ID only. Interrupt type is specified globally
else:
  properties:
    '#interrupt-cells':
      const: 2
      description: Interrupt ID and corresponding interrupt type

required:
  - compatible
  - interrupt-controller
  - '#interrupt-cells'
  - ti,sci
  - ti,sci-dev-id
  - ti,interrupt-ranges

unevaluatedProperties: false

examples:
  - |
    main_gpio_intr: interrupt-controller0 {
        compatible = "ti,sci-intr";
        ti,intr-trigger-type = <1>;
        interrupt-controller;
        interrupt-parent = <&gic500>;
        #interrupt-cells = <1>;
        ti,sci = <&dmsc>;
        ti,sci-dev-id = <131>;
        ti,interrupt-ranges = <0 360 32>;
    };

  - |
    interrupt-controller {
        compatible = "ti,sci-intr";
        interrupt-controller;
        interrupt-parent = <&gic500>;
        #interrupt-cells = <2>;
        ti,sci = <&dmsc>;
        ti,sci-dev-id = <131>;
        ti,interrupt-ranges = <0 360 32>;
    };
```

## Documentation/devicetree/bindings/interrupt-controller/via,vt8500-intc.txt
```
VIA/Wondermedia VT8500 Interrupt Controller
-----------------------------------------------------

Required properties:
- compatible : "via,vt8500-intc"
- reg : Should contain 1 register ranges(address and length)
- #interrupt-cells : should be <1>

Example:

	intc: interrupt-controller@d8140000 {
		compatible = "via,vt8500-intc";
		interrupt-controller;
		reg = <0xd8140000 0x10000>;
		#interrupt-cells = <1>;
	};
```

## Documentation/devicetree/bindings/interrupt-controller/via,vt8500-intc.yaml
```yaml
# SPDX-License-Identifier: (GPL-2.0-only OR BSD-2-Clause)
%YAML 1.2
---
$id: http://devicetree.org/schemas/interrupt-controller/via,vt8500-intc.yaml#
$schema: http://devicetree.org/meta-schemas/core.yaml#

title: VIA and WonderMedia SoCs Interrupt Controller

description:
  This is the interrupt controller used in single-core ARM SoCs made by
  VIA and WonderMedia (up to and including WM8950). Each block handles
  up to 64 interrupt sources (level or edge triggered) and can generate
  up to 8 interrupts to its parent when used in a chained configuration.

maintainers:
  - Alexey Charkov <alchark@gmail.com>

allOf:
  - $ref: /schemas/interrupt-controller.yaml#

properties:
  compatible:
    const: via,vt8500-intc

  reg:
    maxItems: 1

  interrupts:
    items:
      - description:
          Interrupt number raised by the IRQ0 output of this controller
          Only used if this controller is chained
      - description:
          Interrupt number raised by the IRQ1 output of this controller
          Only used if this controller is chained
      - description:
          Interrupt number raised by the IRQ2 output of this controller
          Only used if this controller is chained
      - description:
          Interrupt number raised by the IRQ3 output of this controller
          Only used if this controller is chained
      - description:
          Interrupt number raised by the IRQ4 output of this controller
          Only used if this controller is chained
      - description:
          Interrupt number raised by the IRQ5 output of this controller
          Only used if this controller is chained
      - description:
          Interrupt number raised by the IRQ6 output of this controller
          Only used if this controller is chained
      - description:
          Interrupt number raised by the IRQ7 output of this controller
          Only used if this controller is chained

  interrupt-controller: true

  '#interrupt-cells':
    const: 1

required:
  - compatible
  - reg
  - interrupt-controller
  - '#interrupt-cells'

additionalProperties: false

examples:
  - |
    interrupt-controller@d8140000 {
        compatible = "via,vt8500-intc";
        interrupt-controller;
        reg = <0xd8140000 0x10000>;
        #interrupt-cells = <1>;
    };
...
```

## Documentation/devicetree/bindings/interrupt-controller/xlnx,intc.yaml
```yaml
# SPDX-License-Identifier: (GPL-2.0-only OR BSD-2-Clause)
%YAML 1.2
---
$id: http://devicetree.org/schemas/interrupt-controller/xlnx,intc.yaml#
$schema: http://devicetree.org/meta-schemas/core.yaml#

title: Xilinx Interrupt Controller

maintainers:
  - Michal Simek <michal.simek@amd.com>

description:
  The controller is a soft IP core that is configured at build time for the
  number of interrupts and the type of each interrupt. These details cannot
  be changed at run time.

properties:
  compatible:
    const: xlnx,xps-intc-1.00.a

  reg:
    maxItems: 1

  clocks:
    maxItems: 1

  power-domains:
    maxItems: 1

  resets:
    maxItems: 1

  "#interrupt-cells":
    const: 2
    description:
      Specifies the number of cells needed to encode an interrupt source.
      The value shall be a minimum of 1. The Xilinx device trees typically
      use 2 but the 2nd value is not used.

  interrupt-controller: true

  interrupts:
    maxItems: 1
    description:
      Specifies the interrupt of the parent controller from which it is chained.

  xlnx,kind-of-intr:
    $ref: /schemas/types.yaml#/definitions/uint32
    description:
      A 32 bit value specifying the interrupt type for each possible interrupt
      (1 = edge, 0 = level). The interrupt type typically comes in thru
      the device tree node of the interrupt generating device, but in this case
      the interrupt type is determined by the interrupt controller based on how
      it was implemented.

  xlnx,num-intr-inputs:
    $ref: /schemas/types.yaml#/definitions/uint32
    minimum: 1
    maximum: 32
    description:
      Specifies the number of interrupts supported by the specific
      implementation of the controller.

required:
  - reg
  - "#interrupt-cells"
  - interrupt-controller
  - xlnx,kind-of-intr
  - xlnx,num-intr-inputs

additionalProperties: false

examples:
  - |
    interrupt-controller@41800000 {
      compatible = "xlnx,xps-intc-1.00.a";
      reg = <0x41800000 0x10000>;
      #interrupt-cells = <2>;
      interrupt-controller;
      xlnx,kind-of-intr = <0x1>;
      xlnx,num-intr-inputs = <1>;
    };
```

## Documentation/devicetree/bindings/iommu/allwinner,sun50i-h6-iommu.yaml
```yaml
# SPDX-License-Identifier: (GPL-2.0 OR BSD-2-Clause)
%YAML 1.2
---
$id: http://devicetree.org/schemas/iommu/allwinner,sun50i-h6-iommu.yaml#
$schema: http://devicetree.org/meta-schemas/core.yaml#

title: Allwinner H6 IOMMU Device Tree Bindings

maintainers:
  - Chen-Yu Tsai <wens@csie.org>
  - Maxime Ripard <mripard@kernel.org>

properties:
  "#iommu-cells":
    const: 1
    description:
      The content of the cell is the master ID.

  compatible:
    const: allwinner,sun50i-h6-iommu

  reg:
    maxItems: 1

  interrupts:
    maxItems: 1

  clocks:
    maxItems: 1

  resets:
    maxItems: 1

required:
  - "#iommu-cells"
  - compatible
  - reg
  - interrupts
  - clocks
  - resets

additionalProperties: false

examples:
  - |
      #include <dt-bindings/interrupt-controller/arm-gic.h>
      #include <dt-bindings/interrupt-controller/irq.h>

      #include <dt-bindings/clock/sun50i-h6-ccu.h>
      #include <dt-bindings/reset/sun50i-h6-ccu.h>

      iommu: iommu@30f0000 {
          compatible = "allwinner,sun50i-h6-iommu";
          reg = <0x030f0000 0x10000>;
          interrupts = <GIC_SPI 57 IRQ_TYPE_LEVEL_HIGH>;
          clocks = <&ccu CLK_BUS_IOMMU>;
          resets = <&ccu RST_BUS_IOMMU>;
          #iommu-cells = <1>;
      };

...
```

## Documentation/devicetree/bindings/iommu/apple,dart.yaml
```yaml
# SPDX-License-Identifier: (GPL-2.0 OR BSD-2-Clause)
%YAML 1.2
---
$id: http://devicetree.org/schemas/iommu/apple,dart.yaml#
$schema: http://devicetree.org/meta-schemas/core.yaml#

title: Apple DART IOMMU

maintainers:
  - Sven Peter <sven@svenpeter.dev>

description: |+
  Apple SoCs may contain an implementation of their Device Address
  Resolution Table which provides a mandatory layer of address
  translations for various masters.

  Each DART instance is capable of handling up to 16 different streams
  with individual pagetables and page-level read/write protection flags.

  This DART IOMMU also raises interrupts in response to various
  fault conditions.

properties:
  compatible:
    const: apple,t8103-dart

  reg:
    maxItems: 1

  interrupts:
    maxItems: 1

  clocks:
    description:
      Reference to the gate clock phandle if required for this IOMMU.
      Optional since not all IOMMUs are attached to a clock gate.

  '#iommu-cells':
    const: 1
    description:
      Has to be one. The single cell describes the stream id emitted by
      a master to the IOMMU.

required:
  - compatible
  - reg
  - '#iommu-cells'
  - interrupts

additionalProperties: false

examples:
  - |+
    dart1: iommu@82f80000 {
      compatible = "apple,t8103-dart";
      reg = <0x82f80000 0x4000>;
      interrupts = <1 781 4>;
      #iommu-cells = <1>;
    };

    master1 {
      iommus = <&dart1 0>;
    };

  - |+
    dart2a: iommu@82f00000 {
      compatible = "apple,t8103-dart";
      reg = <0x82f00000 0x4000>;
      interrupts = <1 781 4>;
      #iommu-cells = <1>;
    };
    dart2b: iommu@82f80000 {
      compatible = "apple,t8103-dart";
      reg = <0x82f80000 0x4000>;
      interrupts = <1 781 4>;
      #iommu-cells = <1>;
    };

    master2 {
      iommus = <&dart2a 0>, <&dart2b 1>;
    };
```

## Documentation/devicetree/bindings/iommu/apple,sart.yaml
```yaml
# SPDX-License-Identifier: GPL-2.0 OR BSD-2-Clause
%YAML 1.2
---
$id: http://devicetree.org/schemas/iommu/apple,sart.yaml#
$schema: http://devicetree.org/meta-schemas/core.yaml#

title: Apple SART DMA address filter

maintainers:
  - Sven Peter <sven@svenpeter.dev>

description:
  Apple SART is a simple address filter for DMA transactions. Regions of
  physical memory must be added to the SART's allow list before any
  DMA can target these. Unlike a proper IOMMU no remapping can be done and
  special support in the consumer driver is required since not all DMA
  transactions of a single device are subject to SART filtering.

  SART1 has first been used since at least the A11 (iPhone 8 and iPhone X)
  and allows 36 bit of physical address space and filter entries with sizes
  up to 24 bit.

  SART2, first seen in A14 and M1, allows 36 bit of physical address space
  and filter entry size up to 36 bit.

  SART3, first seen in M1 Pro/Max, extends both the address space and filter
  entry size to 42 bit.

properties:
  compatible:
    enum:
      - apple,t6000-sart
      - apple,t8103-sart

  reg:
    maxItems: 1

  power-domains:
    maxItems: 1

required:
  - compatible
  - reg

additionalProperties: false

examples:
  - |
    iommu@7bc50000 {
      compatible = "apple,t8103-sart";
      reg = <0x7bc50000 0x4000>;
    };
```
