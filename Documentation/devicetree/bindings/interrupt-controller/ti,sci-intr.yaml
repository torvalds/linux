## Documentation/devicetree/bindings/iommu/qcom,iommu.txt
```
* QCOM IOMMU v1 Implementation

Qualcomm "B" family devices which are not compatible with arm-smmu have
a similar looking IOMMU but without access to the global register space,
and optionally requiring additional configuration to route context irqs
to non-secure vs secure interrupt line.

** Required properties:

- compatible       : Should be one of:

                        "qcom,msm8916-iommu"

                     Followed by "qcom,msm-iommu-v1".

- clock-names      : Should be a pair of "iface" (required for IOMMUs
                     register group access) and "bus" (required for
                     the IOMMUs underlying bus access).

- clocks           : Phandles for respective clocks described by
                     clock-names.

- #address-cells   : must be 1.

- #size-cells      : must be 1.

- #iommu-cells     : Must be 1.  Index identifies the context-bank #.

- ranges           : Base address and size of the iommu context banks.

- qcom,iommu-secure-id  : secure-id.

- List of sub-nodes, one per translation context bank.  Each sub-node
  has the following required properties:

  - compatible     : Should be one of:
        - "qcom,msm-iommu-v1-ns"  : non-secure context bank
        - "qcom,msm-iommu-v1-sec" : secure context bank
  - reg            : Base address and size of context bank within the iommu
  - interrupts     : The context fault irq.

** Optional properties:

- reg              : Base address and size of the SMMU local base, should
                     be only specified if the iommu requires configuration
                     for routing of context bank irq's to secure vs non-
                     secure lines.  (Ie. if the iommu contains secure
                     context banks)


** Examples:

	apps_iommu: iommu@1e20000 {
		#address-cells = <1>;
		#size-cells = <1>;
		#iommu-cells = <1>;
		compatible = "qcom,msm8916-iommu", "qcom,msm-iommu-v1";
		ranges = <0 0x1e20000 0x40000>;
		reg = <0x1ef0000 0x3000>;
		clocks = <&gcc GCC_SMMU_CFG_CLK>,
			 <&gcc GCC_APSS_TCU_CLK>;
		clock-names = "iface", "bus";
		qcom,iommu-secure-id = <17>;

		// mdp_0:
		iommu-ctx@4000 {
			compatible = "qcom,msm-iommu-v1-ns";
			reg = <0x4000 0x1000>;
			interrupts = <GIC_SPI 70 IRQ_TYPE_LEVEL_HIGH>;
		};

		// venus_ns:
		iommu-ctx@5000 {
			compatible = "qcom,msm-iommu-v1-sec";
			reg = <0x5000 0x1000>;
			interrupts = <GIC_SPI 70 IRQ_TYPE_LEVEL_HIGH>;
		};
	};

	gpu_iommu: iommu@1f08000 {
		#address-cells = <1>;
		#size-cells = <1>;
		#iommu-cells = <1>;
		compatible = "qcom,msm8916-iommu", "qcom,msm-iommu-v1";
		ranges = <0 0x1f08000 0x10000>;
		clocks = <&gcc GCC_SMMU_CFG_CLK>,
			 <&gcc GCC_GFX_TCU_CLK>;
		clock-names = "iface", "bus";
		qcom,iommu-secure-id = <18>;

		// gfx3d_user:
		iommu-ctx@1000 {
			compatible = "qcom,msm-iommu-v1-ns";
			reg = <0x1000 0x1000>;
			interrupts = <GIC_SPI 241 IRQ_TYPE_LEVEL_HIGH>;
		};

		// gfx3d_priv:
		iommu-ctx@2000 {
			compatible = "qcom,msm-iommu-v1-ns";
			reg = <0x2000 0x1000>;
			interrupts = <GIC_SPI 242 IRQ_TYPE_LEVEL_HIGH>;
		};
	};

	...

	venus: video-codec@1d00000 {
		...
		iommus = <&apps_iommu 5>;
	};

	mdp: mdp@1a01000 {
		...
		iommus = <&apps_iommu 4>;
	};

	gpu@1c00000 {
		...
		iommus = <&gpu_iommu 1>, <&gpu_iommu 2>;
	};
```

## Documentation/devicetree/bindings/iommu/qcom,iommu.yaml
```yaml
# SPDX-License-Identifier: (GPL-2.0-only OR BSD-2-Clause)
%YAML 1.2
---
$id: http://devicetree.org/schemas/iommu/qcom,iommu.yaml#
$schema: http://devicetree.org/meta-schemas/core.yaml#

title: Qualcomm Technologies legacy IOMMU implementations

maintainers:
  - Konrad Dybcio <konrad.dybcio@linaro.org>

description: |
  Qualcomm "B" family devices which are not compatible with arm-smmu have
  a similar looking IOMMU, but without access to the global register space
  and optionally requiring additional configuration to route context IRQs
  to non-secure vs secure interrupt line.

properties:
  compatible:
    items:
      - enum:
          - qcom,msm8916-iommu
          - qcom,msm8953-iommu
      - const: qcom,msm-iommu-v1

  clocks:
    items:
      - description: Clock required for IOMMU register group access
      - description: Clock required for underlying bus access

  clock-names:
    items:
      - const: iface
      - const: bus

  power-domains:
    maxItems: 1

  reg:
    maxItems: 1

  ranges: true

  qcom,iommu-secure-id:
    $ref: /schemas/types.yaml#/definitions/uint32
    description:
      The SCM secure ID of the IOMMU instance.

  '#address-cells':
    const: 1

  '#size-cells':
    const: 1

  '#iommu-cells':
    const: 1

patternProperties:
  "^iommu-ctx@[0-9a-f]+$":
    type: object
    additionalProperties: false
    properties:
      compatible:
        enum:
          - qcom,msm-iommu-v1-ns
          - qcom,msm-iommu-v1-sec

      interrupts:
        maxItems: 1

      reg:
        maxItems: 1

    required:
      - compatible
      - interrupts
      - reg

required:
  - compatible
  - clocks
  - clock-names
  - ranges
  - '#address-cells'
  - '#size-cells'
  - '#iommu-cells'

additionalProperties: false

examples:
  - |
    #include <dt-bindings/clock/qcom,gcc-msm8916.h>
    #include <dt-bindings/interrupt-controller/arm-gic.h>

    apps_iommu: iommu@1e20000 {
      compatible = "qcom,msm8916-iommu", "qcom,msm-iommu-v1";
      reg = <0x01ef0000 0x3000>;
      clocks = <&gcc GCC_SMMU_CFG_CLK>,
               <&gcc GCC_APSS_TCU_CLK>;
      clock-names = "iface", "bus";
      qcom,iommu-secure-id = <17>;
      #address-cells = <1>;
      #size-cells = <1>;
      #iommu-cells = <1>;
      ranges = <0 0x01e20000 0x40000>;

      /* mdp_0: */
      iommu-ctx@4000 {
        compatible = "qcom,msm-iommu-v1-ns";
        reg = <0x4000 0x1000>;
        interrupts = <GIC_SPI 70 IRQ_TYPE_LEVEL_HIGH>;
      };
    };
```

## Documentation/devicetree/bindings/iommu/qcom,tbu.yaml
```yaml
# SPDX-License-Identifier: (GPL-2.0-only OR BSD-2-Clause)
%YAML 1.2
---
$id: http://devicetree.org/schemas/iommu/qcom,tbu.yaml#
$schema: http://devicetree.org/meta-schemas/core.yaml#

title: Qualcomm TBU (Translation Buffer Unit)

maintainers:
  - Georgi Djakov <quic_c_gdjako@quicinc.com>

description:
  The Qualcomm SMMU500 implementation consists of TCU and TBU. The TBU contains
  a Translation Lookaside Buffer (TLB) that caches page tables. TBUs provides
  debug features to trace and trigger debug transactions. There are multiple TBU
  instances with each client core.

properties:
  compatible:
    enum:
      - qcom,sc7280-tbu
      - qcom,sdm845-tbu

  reg:
    maxItems: 1

  clocks:
    maxItems: 1

  interconnects:
    maxItems: 1

  power-domains:
    maxItems: 1

  qcom,stream-id-range:
    description: |
      Phandle of a SMMU device and Stream ID range (address and size) that
      is assigned by the TBU
    $ref: /schemas/types.yaml#/definitions/phandle-array
    items:
      - items:
          - description: phandle of a smmu node
          - description: stream id base address
          - description: stream id size

required:
  - compatible
  - reg
  - qcom,stream-id-range

additionalProperties: false

examples:
  - |
    #include <dt-bindings/clock/qcom,gcc-sdm845.h>
    #include <dt-bindings/interconnect/qcom,icc.h>
    #include <dt-bindings/interconnect/qcom,sdm845.h>

    tbu@150e1000 {
        compatible = "qcom,sdm845-tbu";
        reg = <0x150e1000 0x1000>;
        clocks = <&gcc GCC_AGGRE_NOC_PCIE_TBU_CLK>;
        interconnects = <&system_noc MASTER_GNOC_SNOC QCOM_ICC_TAG_ACTIVE_ONLY
                         &config_noc SLAVE_IMEM_CFG QCOM_ICC_TAG_ACTIVE_ONLY>;
        power-domains = <&gcc HLOS1_VOTE_AGGRE_NOC_MMU_PCIE_TBU_GDSC>;
        qcom,stream-id-range = <&apps_smmu 0x1c00 0x400>;
    };
...
```

## Documentation/devicetree/bindings/iommu/renesas,ipmmu-vmsa.txt
```
* Renesas VMSA-Compatible IOMMU

The IPMMU is an IOMMU implementation compatible with the ARM VMSA page tables.
It provides address translation for bus masters outside of the CPU, each
connected to the IPMMU through a port called micro-TLB.


Required Properties:

  - compatible: Must contain SoC-specific and generic entry below in case
    the device is compatible with the R-Car Gen2 VMSA-compatible IPMMU.

    - "renesas,ipmmu-r8a73a4" for the R8A73A4 (R-Mobile APE6) IPMMU.
    - "renesas,ipmmu-r8a7743" for the R8A7743 (RZ/G1M) IPMMU.
    - "renesas,ipmmu-r8a7744" for the R8A7744 (RZ/G1N) IPMMU.
    - "renesas,ipmmu-r8a7745" for the R8A7745 (RZ/G1E) IPMMU.
    - "renesas,ipmmu-r8a774a1" for the R8A774A1 (RZ/G2M) IPMMU.
    - "renesas,ipmmu-r8a774b1" for the R8A774B1 (RZ/G2N) IPMMU.
    - "renesas,ipmmu-r8a774c0" for the R8A774C0 (RZ/G2E) IPMMU.
    - "renesas,ipmmu-r8a7790" for the R8A7790 (R-Car H2) IPMMU.
    - "renesas,ipmmu-r8a7791" for the R8A7791 (R-Car M2-W) IPMMU.
    - "renesas,ipmmu-r8a7793" for the R8A7793 (R-Car M2-N) IPMMU.
    - "renesas,ipmmu-r8a7794" for the R8A7794 (R-Car E2) IPMMU.
    - "renesas,ipmmu-r8a7795" for the R8A7795 (R-Car H3) IPMMU.
    - "renesas,ipmmu-r8a7796" for the R8A7796 (R-Car M3-W) IPMMU.
    - "renesas,ipmmu-r8a77965" for the R8A77965 (R-Car M3-N) IPMMU.
    - "renesas,ipmmu-r8a77970" for the R8A77970 (R-Car V3M) IPMMU.
    - "renesas,ipmmu-r8a77980" for the R8A77980 (R-Car V3H) IPMMU.
    - "renesas,ipmmu-r8a77990" for the R8A77990 (R-Car E3) IPMMU.
    - "renesas,ipmmu-r8a77995" for the R8A77995 (R-Car D3) IPMMU.
    - "renesas,ipmmu-vmsa" for generic R-Car Gen2 or RZ/G1 VMSA-compatible
			   IPMMU.

  - reg: Base address and size of the IPMMU registers.
  - interrupts: Specifiers for the MMU fault interrupts. For instances that
    support secure mode two interrupts must be specified, for non-secure and
    secure mode, in that order. For instances that don't support secure mode a
    single interrupt must be specified. Not required for cache IPMMUs.

  - #iommu-cells: Must be 1.

Optional properties:

  - renesas,ipmmu-main: reference to the main IPMMU instance in two cells.
    The first cell is a phandle to the main IPMMU and the second cell is
    the interrupt bit number associated with the particular cache IPMMU device.
    The interrupt bit number needs to match the main IPMMU IMSSTR register.
    Only used by cache IPMMU instances.


Each bus master connected to an IPMMU must reference the IPMMU in its device
node with the following property:

  - iommus: A reference to the IPMMU in two cells. The first cell is a phandle
    to the IPMMU and the second cell the number of the micro-TLB that the
    device is connected to.


Example: R8A7791 IPMMU-MX and VSP1-D0 bus master

	ipmmu_mx: mmu@fe951000 {
		compatible = "renasas,ipmmu-r8a7791", "renasas,ipmmu-vmsa";
		reg = <0 0xfe951000 0 0x1000>;
		interrupts = <0 222 IRQ_TYPE_LEVEL_HIGH>,
			     <0 221 IRQ_TYPE_LEVEL_HIGH>;
		#iommu-cells = <1>;
	};

	vsp@fe928000 {
		...
		iommus = <&ipmmu_mx 13>;
		...
	};
```

## Documentation/devicetree/bindings/iommu/renesas,ipmmu-vmsa.yaml
```yaml
# SPDX-License-Identifier: (GPL-2.0-only OR BSD-2-Clause)
%YAML 1.2
---
$id: http://devicetree.org/schemas/iommu/renesas,ipmmu-vmsa.yaml#
$schema: http://devicetree.org/meta-schemas/core.yaml#

title: Renesas VMSA-Compatible IOMMU

maintainers:
  - Yoshihiro Shimoda <yoshihiro.shimoda.uh@renesas.com>

description:
  The IPMMU is an IOMMU implementation compatible with the ARM VMSA page tables.
  It provides address translation for bus masters outside of the CPU, each
  connected to the IPMMU through a port called micro-TLB.

properties:
  compatible:
    oneOf:
      - items:
          - enum:
              - renesas,ipmmu-r8a73a4  # R-Mobile APE6
              - renesas,ipmmu-r8a7742  # RZ/G1H
              - renesas,ipmmu-r8a7743  # RZ/G1M
              - renesas,ipmmu-r8a7744  # RZ/G1N
              - renesas,ipmmu-r8a7745  # RZ/G1E
              - renesas,ipmmu-r8a7790  # R-Car H2
              - renesas,ipmmu-r8a7791  # R-Car M2-W
              - renesas,ipmmu-r8a7793  # R-Car M2-N
              - renesas,ipmmu-r8a7794  # R-Car E2
          - const: renesas,ipmmu-vmsa  # R-Mobile APE6 or R-Car Gen2 or RZ/G1
      - items:
          - enum:
              - renesas,ipmmu-r8a774a1 # RZ/G2M
              - renesas,ipmmu-r8a774b1 # RZ/G2N
              - renesas,ipmmu-r8a774c0 # RZ/G2E
              - renesas,ipmmu-r8a774e1 # RZ/G2H
              - renesas,ipmmu-r8a7795  # R-Car H3
              - renesas,ipmmu-r8a7796  # R-Car M3-W
              - renesas,ipmmu-r8a77961 # R-Car M3-W+
              - renesas,ipmmu-r8a77965 # R-Car M3-N
              - renesas,ipmmu-r8a77970 # R-Car V3M
              - renesas,ipmmu-r8a77980 # R-Car V3H
              - renesas,ipmmu-r8a77990 # R-Car E3
              - renesas,ipmmu-r8a77995 # R-Car D3
              - renesas,ipmmu-r8a779a0 # R-Car V3U
      - items:
          - enum:
              - renesas,ipmmu-r8a779f0 # R-Car S4-8
          - const: renesas,rcar-gen4-ipmmu-vmsa  # R-Car Gen4

  reg:
    maxItems: 1

  interrupts:
    minItems: 1
    description:
      Specifiers for the MMU fault interrupts. Not required for cache IPMMUs.
    items:
      - description: non-secure mode
      - description: secure mode if supported

  '#iommu-cells':
    const: 1
    description:
      The number of the micro-TLB that the device is connected to.

  power-domains:
    maxItems: 1

  renesas,ipmmu-main:
    $ref: /schemas/types.yaml#/definitions/phandle-array
    items:
      - items:
          - description: phandle to main IPMMU
          - description: the interrupt bit number associated with the particular
              cache IPMMU device. The interrupt bit number needs to match the main
              IPMMU IMSSTR register. Only used by cache IPMMU instances.
    description:
      Reference to the main IPMMU phandle plus 1 cell. The cell is
      the interrupt bit number associated with the particular cache IPMMU
      device. The interrupt bit number needs to match the main IPMMU IMSSTR
      register. Only used by cache IPMMU instances.

required:
  - compatible
  - reg
  - '#iommu-cells'

oneOf:
  - required:
      - interrupts
  - required:
      - renesas,ipmmu-main

additionalProperties: false

allOf:
  - if:
      properties:
        compatible:
          not:
            contains:
              const: renesas,ipmmu-vmsa
    then:
      required:
        - power-domains

examples:
  - |
    #include <dt-bindings/clock/r8a7791-cpg-mssr.h>
    #include <dt-bindings/interrupt-controller/arm-gic.h>
    #include <dt-bindings/power/r8a7791-sysc.h>

    ipmmu_mx: iommu@fe951000 {
        compatible = "renesas,ipmmu-r8a7791", "renesas,ipmmu-vmsa";
        reg = <0xfe951000 0x1000>;
        interrupts = <GIC_SPI 222 IRQ_TYPE_LEVEL_HIGH>,
                     <GIC_SPI 221 IRQ_TYPE_LEVEL_HIGH>;
        #iommu-cells = <1>;
    };
```
