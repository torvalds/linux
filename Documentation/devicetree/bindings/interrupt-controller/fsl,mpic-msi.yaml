## Documentation/devicetree/bindings/interrupt-controller/fsl,mpic-msi.yaml
```yaml
# SPDX-License-Identifier: (GPL-2.0-only OR BSD-2-Clause)
%YAML 1.2
---
$id: http://devicetree.org/schemas/interrupt-controller/fsl,mpic-msi.yaml#
$schema: http://devicetree.org/meta-schemas/core.yaml#

title: Freescale MSI interrupt controller

description: |
  The Freescale hypervisor and msi-address-64
  -------------------------------------------

  Normally, PCI devices have access to all of CCSR via an ATMU mapping.  The
  Freescale MSI driver calculates the address of MSIIR (in the MSI register
  block) and sets that address as the MSI message address.

  In a virtualized environment, the hypervisor may need to create an IOMMU
  mapping for MSIIR.  The Freescale ePAPR hypervisor has this requirement
  because of hardware limitations of the Peripheral Access Management Unit
  (PAMU), which is currently the only IOMMU that the hypervisor supports.
  The ATMU is programmed with the guest physical address, and the PAMU
  intercepts transactions and reroutes them to the true physical address.

  In the PAMU, each PCI controller is given only one primary window.  The
  PAMU restricts DMA operations so that they can only occur within a window.
  Because PCI devices must be able to DMA to memory, the primary window must
  be used to cover all of the guest's memory space.

  PAMU primary windows can be divided into 256 subwindows, and each
  subwindow can have its own address mapping ("guest physical" to "true
  physical").  However, each subwindow has to have the same alignment, which
  means they cannot be located at just any address.  Because of these
  restrictions, it is usually impossible to create a 4KB subwindow that
  covers MSIIR where it's normally located.

  Therefore, the hypervisor has to create a subwindow inside the same
  primary window used for memory, but mapped to the MSIR block (where MSIIR
  lives).  The first subwindow after the end of guest memory is used for
  this.  The address specified in the msi-address-64 property is the PCI
  address of MSIIR.  The hypervisor configures the PAMU to map that address to
  the true physical address of MSIIR.

maintainers:
  - J. Neuschäfer <j.ne@posteo.net>

properties:
  compatible:
    oneOf:
      - enum:
          - fsl,mpic-msi
          - fsl,mpic-msi-v4.3
          - fsl,ipic-msi
          - fsl,vmpic-msi
          - fsl,vmpic-msi-v4.3
      - items:
          - enum:
              - fsl,mpc8572-msi
              - fsl,mpc8610-msi
              - fsl,mpc8641-msi
          - const: fsl,mpic-msi

  reg:
    minItems: 1
    items:
      - description: Address and length of the shared message interrupt
          register set
      - description: Address of aliased MSIIR or MSIIR1 register for platforms
          that have such an alias. If using MSIIR1, the second region must be
          added because different MSI group has different MSIIR1 offset.

  interrupts:
    minItems: 1
    maxItems: 16
    description:
      Each one of the interrupts here is one entry per 32 MSIs, and routed to
      the host interrupt controller. The interrupts should be set as edge
      sensitive. If msi-available-ranges is present, only the interrupts that
      correspond to available ranges shall be present.

  msi-available-ranges:
    $ref: /schemas/types.yaml#/definitions/uint32-matrix
    items:
      items:
        - description: First MSI interrupt in this range
        - description: Number of MSI interrupts in this range
    description:
      Define which MSI interrupt can be used in the 256 MSI interrupts.
      If not specified, all the MSI interrupts can be used.
      Each available range must begin and end on a multiple of 32 (i.e. no
      splitting an individual MSI register or the associated PIC interrupt).

  msi-address-64:
    $ref: /schemas/types.yaml#/definitions/uint64
    description:
      64-bit PCI address of the MSIIR register. The MSIIR register is used for
      MSI messaging.  The address of MSIIR in PCI address space is the MSI
      message address.

      This property may be used in virtualized environments where the hypervisor
      has created an alternate mapping for the MSIR block.  See the top-level
      description for an explanation.

required:
  - compatible
  - reg
  - interrupts

allOf:
  - if:
      properties:
        compatible:
          contains:
            enum:
              - fsl,mpic-msi-v4.3
              - fsl,vmpic-msi-v4.3
    then:
      properties:
        interrupts:
          minItems: 16
          description:
            Version 4.3 implies that there are 16 shared interrupts, and they
            are configured through MSIIR1.

        # MPIC v4.3 does not support this property because the 32 interrupts of
        # an individual register are not continuous when using MSIIR1.
        msi-available-ranges: false

        reg:
          minItems: 2

    else:
      properties:
        interrupts:
          maxItems: 8
          description:
            In versions before 4.3, only 8 shared interrupts are available, and
            they are configured through MSIIR.

unevaluatedProperties: false

examples:
  - |
    msi@41600 {
            compatible = "fsl,mpc8610-msi", "fsl,mpic-msi";
            reg = <0x41600 0x80>;
            msi-available-ranges = <0 0x100>;
            interrupts = <0xe0 0>, <0xe1 0>, <0xe2 0>, <0xe3 0>,
                         <0xe4 0>, <0xe5 0>, <0xe6 0>, <0xe7 0>;
    };

  - |
    msi@41600 {
            compatible = "fsl,mpic-msi-v4.3";
            reg = <0x41600 0x200>, <0x44148 4>;
            interrupts = <0xe0 0 0 0>, <0xe1 0 0 0>, <0xe2 0 0 0>, <0xe3 0 0 0>,
                         <0xe4 0 0 0>, <0xe5 0 0 0>, <0xe6 0 0 0>, <0xe7 0 0 0>,
                         <0x100 0 0 0>, <0x101 0 0 0>, <0x102 0 0 0>, <0x103 0 0 0>,
                         <0x104 0 0 0>, <0x105 0 0 0>, <0x106 0 0 0>, <0x107 0 0 0>;
    };

...
```

## Documentation/devicetree/bindings/interrupt-controller/fsl,mu-msi.yaml
```yaml
# SPDX-License-Identifier: (GPL-2.0-only OR BSD-2-Clause)
%YAML 1.2
---
$id: http://devicetree.org/schemas/interrupt-controller/fsl,mu-msi.yaml#
$schema: http://devicetree.org/meta-schemas/core.yaml#

title: Freescale/NXP i.MX Messaging Unit (MU) work as msi controller

maintainers:
  - Frank Li <Frank.Li@nxp.com>

description: |
  The Messaging Unit module enables two processors within the SoC to
  communicate and coordinate by passing messages (e.g. data, status
  and control) through the MU interface. The MU also provides the ability
  for one processor (A side) to signal the other processor (B side) using
  interrupts.

  Because the MU manages the messaging between processors, the MU uses
  different clocks (from each side of the different peripheral buses).
  Therefore, the MU must synchronize the accesses from one side to the
  other. The MU accomplishes synchronization using two sets of matching
  registers (Processor A-side, Processor B-side).

  MU can work as msi interrupt controller to do doorbell

allOf:
  - $ref: /schemas/interrupt-controller/msi-controller.yaml#

properties:
  compatible:
    enum:
      - fsl,imx6sx-mu-msi
      - fsl,imx7ulp-mu-msi
      - fsl,imx8ulp-mu-msi
      - fsl,imx8ulp-mu-msi-s4

  reg:
    items:
      - description: a side register base address
      - description: b side register base address

  reg-names:
    items:
      - const: processor-a-side
      - const: processor-b-side

  interrupts:
    description: a side interrupt number.
    maxItems: 1

  clocks:
    maxItems: 1

  power-domains:
    items:
      - description: a side power domain
      - description: b side power domain

  power-domain-names:
    items:
      - const: processor-a-side
      - const: processor-b-side

  msi-controller: true

  "#msi-cells":
    const: 0

required:
  - compatible
  - reg
  - interrupts
  - msi-controller
  - "#msi-cells"

additionalProperties: false

examples:
  - |
    #include <dt-bindings/interrupt-controller/arm-gic.h>
    #include <dt-bindings/firmware/imx/rsrc.h>

    msi-controller@5d270000 {
        compatible = "fsl,imx6sx-mu-msi";
        msi-controller;
        #msi-cells = <0>;
        reg = <0x5d270000 0x10000>,     /* A side */
              <0x5d300000 0x10000>;     /* B side */
        reg-names = "processor-a-side", "processor-b-side";
        interrupts = <GIC_SPI 191 IRQ_TYPE_LEVEL_HIGH>;
        power-domains = <&pd IMX_SC_R_MU_12A>,
                        <&pd IMX_SC_R_MU_12B>;
        power-domain-names = "processor-a-side", "processor-b-side";
    };
```

## Documentation/devicetree/bindings/interrupt-controller/fsl,qe-ports-ic.yaml
```yaml
# SPDX-License-Identifier: (GPL-2.0-only OR BSD-2-Clause)
%YAML 1.2
---
$id: http://devicetree.org/schemas/interrupt-controller/fsl,qe-ports-ic.yaml#
$schema: http://devicetree.org/meta-schemas/core.yaml#

title: Freescale QUICC Engine I/O Ports Interrupt Controller

maintainers:
  - Christophe Leroy (CS GROUP) <chleroy@kernel.org>

properties:
  compatible:
    enum:
      - fsl,mpc8323-qe-ports-ic

  reg:
    maxItems: 1

  interrupt-controller: true

  '#address-cells':
    const: 0

  '#interrupt-cells':
    const: 1

  interrupts:
    maxItems: 1

required:
  - compatible
  - reg
  - interrupt-controller
  - '#address-cells'
  - '#interrupt-cells'
  - interrupts

additionalProperties: false

examples:
  - |
    interrupt-controller@c00 {
      compatible = "fsl,mpc8323-qe-ports-ic";
      reg = <0xc00 0x18>;
      interrupt-controller;
      #address-cells = <0>;
      #interrupt-cells = <1>;
      interrupts = <74 0x8>;
      interrupt-parent = <&ipic>;
    };
```

## Documentation/devicetree/bindings/interrupt-controller/fsl,tzic.yaml
```yaml
# SPDX-License-Identifier: (GPL-2.0-only OR BSD-2-Clause)
%YAML 1.2
---
$id: http://devicetree.org/schemas/interrupt-controller/fsl,tzic.yaml#
$schema: http://devicetree.org/meta-schemas/core.yaml#

title: Freescale tzic Interrupt controller

maintainers:
  - Frank Li <Frank.Li@nxp.com>

properties:
  compatible:
    oneOf:
      - items:
          - enum:
              - fsl,imx51-tzic
              - fsl,imx53-tzic
          - const: fsl,tzic
      - items:
          - const: fsl,imx50-tzic
          - const: fsl,imx53-tzic
          - const: fsl,tzic

  reg:
    maxItems: 1

  interrupt-controller: true

  '#interrupt-cells':
    const: 1

required:
  - compatible
  - reg
  - interrupt-controller
  - '#interrupt-cells'

additionalProperties: false

examples:
  - |
    tz-interrupt-controller@fffc000 {
        compatible = "fsl,imx53-tzic", "fsl,tzic";
        reg = <0x0fffc000 0x4000>;
        interrupt-controller;
        #interrupt-cells = <1>;
    };
```

## Documentation/devicetree/bindings/interrupt-controller/fsl,vf610-mscm-ir.yaml
```yaml
# SPDX-License-Identifier: (GPL-2.0-only OR BSD-2-Clause)
%YAML 1.2
---
$id: http://devicetree.org/schemas/interrupt-controller/fsl,vf610-mscm-ir.yaml#
$schema: http://devicetree.org/meta-schemas/core.yaml#

title: Freescale Vybrid Miscellaneous System Control - Interrupt Router

description:
  The MSCM IP contains multiple sub modules, this binding describes the second
  block of registers which control the interrupt router. The interrupt router
  allows to configure the recipient of each peripheral interrupt. Furthermore
  it controls the directed processor interrupts. The module is available in all
  Vybrid SoC's but is only really useful in dual core configurations (VF6xx
  which comes with a Cortex-A5/Cortex-M4 combination).


maintainers:
  - Frank Li <Frank.Li@nxp.com>

properties:
  compatible:
    const: fsl,vf610-mscm-ir

  reg:
    maxItems: 1

  fsl,cpucfg:
    $ref: /schemas/types.yaml#/definitions/phandle
    description:
      The handle to the MSCM CPU configuration node, required
      to get the current CPU ID

  interrupt-controller: true

  '#interrupt-cells':
    const: 2
    description:
      Two cells, interrupt number and cells.
      The hardware interrupt number according to interrupt
      assignment of the interrupt router is required.
      Flags get passed only when using GIC as parent. Flags
      encoding as documented by the GIC bindings.

required:
  - compatible
  - reg
  - fsl,cpucfg
  - interrupt-controller
  - '#interrupt-cells'

additionalProperties: false

examples:
  - |
    interrupt-controller@40001800 {
        compatible = "fsl,vf610-mscm-ir";
        reg = <0x40001800 0x400>;
        fsl,cpucfg = <&mscm_cpucfg>;
        interrupt-controller;
        #interrupt-cells = <2>;
        interrupt-parent = <&intc>;
    };
```

## Documentation/devicetree/bindings/interrupt-controller/google,goldfish-pic.txt
```
Android Goldfish PIC

Android Goldfish programmable interrupt device used by Android
emulator.

Required properties:

- compatible : should contain "google,goldfish-pic"
- reg        : <registers mapping>
- interrupts : <interrupt mapping>

Example for mips when used in cascade mode:

        cpuintc {
                #interrupt-cells = <0x1>;
                #address-cells = <0>;
                interrupt-controller;
                compatible = "mti,cpu-interrupt-controller";
        };

        interrupt-controller@1f000000 {
                compatible = "google,goldfish-pic";
                reg = <0x1f000000 0x1000>;

                interrupt-controller;
                #interrupt-cells = <0x1>;

                interrupt-parent = <&cpuintc>;
                interrupts = <0x2>;
        };
```

## Documentation/devicetree/bindings/interrupt-controller/google,goldfish-pic.yaml
```yaml
# SPDX-License-Identifier: (GPL-2.0-only OR BSD-2-Clause)
%YAML 1.2
---
$id: http://devicetree.org/schemas/interrupt-controller/google,goldfish-pic.yaml#
$schema: http://devicetree.org/meta-schemas/core.yaml#

title: Android Goldfish PIC

maintainers:
  - Miodrag Dinic <miodrag.dinic@mips.com>

description:
  Android Goldfish programmable interrupt device used by Android emulator.

properties:
  compatible:
    const: google,goldfish-pic

  reg:
    maxItems: 1

  interrupts:
    maxItems: 1

  interrupt-controller: true

  '#interrupt-cells':
    const: 1

required:
  - compatible
  - reg
  - interrupts
  - interrupt-controller
  - '#interrupt-cells'

examples:
  - |
    interrupt-controller@1f000000 {
        compatible = "google,goldfish-pic";
        reg = <0x1f000000 0x1000>;
        interrupt-controller;
        #interrupt-cells = <1>;
        interrupts = <2>;
    };

additionalProperties: false
```
