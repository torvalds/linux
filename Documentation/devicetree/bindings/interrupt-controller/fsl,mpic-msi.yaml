## Documentation/devicetree/bindings/interrupt-controller/hisilicon,mbigen-v2.txt
```
Hisilicon mbigen device tree bindings.
=======================================

Mbigen means: message based interrupt generator.

MBI is kind of msi interrupt only used on Non-PCI devices.

To reduce the wired interrupt number connected to GIC,
Hisilicon designed mbigen to collect and generate interrupt.


Non-pci devices can connect to mbigen and generate the
interrupt by writing ITS register.

The mbigen chip and devices connect to mbigen have the following properties:

Mbigen main node required properties:
-------------------------------------------
- compatible: Should be "hisilicon,mbigen-v2"

- reg: Specifies the base physical address and size of the Mbigen
  registers.

- interrupt controller: Identifies the node as an interrupt controller

- msi-parent: Specifies the MSI controller this mbigen use.
  For more detail information,please refer to the generic msi-parent binding in
  Documentation/devicetree/bindings/interrupt-controller/msi.txt.

- num-pins: the total number of pins implemented in this Mbigen
  instance.

- #interrupt-cells : Specifies the number of cells needed to encode an
  interrupt source. The value must be 2.

  The 1st cell is hardware pin number of the interrupt.This number is local to
  each mbigen chip and in the range from 0 to the maximum interrupts number
  of the mbigen.

  The 2nd cell is the interrupt trigger type.
	The value of this cell should be:
	1: rising edge triggered
	or
	4: high level triggered

Examples:

	mbigen_device_gmac:intc {
			compatible = "hisilicon,mbigen-v2";
			reg = <0x0 0xc0080000 0x0 0x10000>;
			interrupt-controller;
			msi-parent = <&its_dsa 0x40b1c>;
			num-pins = <9>;
			#interrupt-cells = <2>;
	};

Devices connect to mbigen required properties:
----------------------------------------------------
-interrupt-parent: Specifies the mbigen device node which device connected.

-interrupts:Specifies the interrupt source.
 For the specific information of each cell in this property,please refer to
 the "interrupt-cells" description mentioned above.

Examples:
	gmac0: ethernet@c2080000 {
		#address-cells = <1>;
		#size-cells = <0>;
		reg = <0 0xc2080000 0 0x20000>,
		      <0 0xc0000000 0 0x1000>;
		interrupt-parent  = <&mbigen_device_gmac>;
		interrupts =	<656 1>,
				<657 1>;
	};
```

## Documentation/devicetree/bindings/interrupt-controller/hisilicon,mbigen-v2.yaml
```yaml
# SPDX-License-Identifier: (GPL-2.0-only OR BSD-2-Clause)
%YAML 1.2
---
$id: http://devicetree.org/schemas/interrupt-controller/hisilicon,mbigen-v2.yaml#
$schema: http://devicetree.org/meta-schemas/core.yaml#

title: Hisilicon mbigen v2

maintainers:
  - Wei Xu <xuwei5@hisilicon.com>

description: >
  Mbigen means: message based interrupt generator.

  MBI is kind of msi interrupt only used on Non-PCI devices.

  To reduce the wired interrupt number connected to GIC, Hisilicon designed
  mbigen to collect and generate interrupt.

  Non-pci devices can connect to mbigen and generate the interrupt by writing
  ITS register.

properties:
  compatible:
    const: hisilicon,mbigen-v2

  reg:
    maxItems: 1

required:
  - compatible
  - reg

additionalProperties:
  type: object
  additionalProperties: false

  properties:
    interrupt-controller: true

    '#interrupt-cells':
      const: 2

    msi-parent:
      maxItems: 1

    num-pins:
      description: The total number of pins implemented in this Mbigen instance.
      $ref: /schemas/types.yaml#/definitions/uint32

  required:
    - interrupt-controller
    - "#interrupt-cells"
    - msi-parent
    - num-pins

examples:
  - |
    mbigen@c0080000 {
        compatible = "hisilicon,mbigen-v2";
        reg = <0xc0080000 0x10000>;

        mbigen_gmac: intc_gmac {
            interrupt-controller;
            #interrupt-cells = <2>;
            msi-parent = <&its_dsa 0x40b1c>;
            num-pins = <9>;
        };

        mbigen_i2c: intc_i2c {
            interrupt-controller;
            #interrupt-cells = <2>;
            msi-parent = <&its_dsa 0x40b0e>;
            num-pins = <2>;
        };
    };
```

## Documentation/devicetree/bindings/interrupt-controller/idt,32434-pic.yaml
```yaml
# SPDX-License-Identifier: (GPL-2.0 OR BSD-2-Clause)
%YAML 1.2
---
$id: http://devicetree.org/schemas/interrupt-controller/idt,32434-pic.yaml#
$schema: http://devicetree.org/meta-schemas/core.yaml#

title: IDT 79RC32434 Interrupt Controller Device Tree Bindings

maintainers:
  - Thomas Bogendoerfer <tsbogend@alpha.franken.de>

allOf:
  - $ref: /schemas/interrupt-controller.yaml#

properties:
  "#interrupt-cells":
    const: 1

  compatible:
    const: idt,32434-pic

  reg:
    maxItems: 1

  interrupt-controller: true

required:
  - "#interrupt-cells"
  - compatible
  - reg
  - interrupt-controller

additionalProperties: false

examples:
  - |
    idtpic3: interrupt-controller@3800c {
        compatible = "idt,32434-pic";
        reg = <0x3800c 0x0c>;

        interrupt-controller;
        #interrupt-cells = <1>;

        interrupt-parent = <&cpuintc>;
        interrupts = <3>;
    };

...
```

## Documentation/devicetree/bindings/interrupt-controller/img,meta-intc.txt
```
* Meta External Trigger Controller Binding

This binding specifies what properties must be available in the device tree
representation of a Meta external trigger controller.

Required properties:

    - compatible: Specifies the compatibility list for the interrupt controller.
      The type shall be <string> and the value shall include "img,meta-intc".

    - num-banks: Specifies the number of interrupt banks (each of which can
      handle 32 interrupt sources).

    - interrupt-controller: The presence of this property identifies the node
      as an interrupt controller. No property value shall be defined.

    - #interrupt-cells: Specifies the number of cells needed to encode an
      interrupt source. The type shall be a <u32> and the value shall be 2.

    - #address-cells: Specifies the number of cells needed to encode an
      address. The type shall be <u32> and the value shall be 0. As such,
      'interrupt-map' nodes do not have to specify a parent unit address.

Optional properties:

    - no-mask: The controller doesn't have any mask registers.

* Interrupt Specifier Definition

  Interrupt specifiers consists of 2 cells encoded as follows:

    - <1st-cell>: The interrupt-number that identifies the interrupt source.

    - <2nd-cell>: The Linux interrupt flags containing level-sense information,
                  encoded as follows:
                    1 = edge triggered
                    4 = level-sensitive

* Examples

Example 1:

	/*
	 * Meta external trigger block
	 */
	intc: intc {
		// This is an interrupt controller node.
		interrupt-controller;

		// No address cells so that 'interrupt-map' nodes which
		// reference this interrupt controller node do not need a parent
		// address specifier.
		#address-cells = <0>;

		// Two cells to encode interrupt sources.
		#interrupt-cells = <2>;

		// Number of interrupt banks
		num-banks = <2>;

		// No HWMASKEXT is available (specify on Chorus2 and Comet ES1)
		no-mask;

		// Compatible with Meta hardware trigger block.
		compatible = "img,meta-intc";
	};

Example 2:

	/*
	 * An interrupt generating device that is wired to a Meta external
	 * trigger block.
	 */
	uart1: uart@02004c00 {
		// Interrupt source '5' that is level-sensitive.
		// Note that there are only two cells as specified in the
		// interrupt parent's '#interrupt-cells' property.
		interrupts = <5 4 /* level */>;

		// The interrupt controller that this device is wired to.
		interrupt-parent = <&intc>;
	};
```

## Documentation/devicetree/bindings/interrupt-controller/img,pdc-intc.txt
```
* ImgTec Powerdown Controller (PDC) Interrupt Controller Binding

This binding specifies what properties must be available in the device tree
representation of a PDC IRQ controller. This has a number of input interrupt
lines which can wake the system, and are passed on through output interrupt
lines.

Required properties:

    - compatible: Specifies the compatibility list for the interrupt controller.
      The type shall be <string> and the value shall include "img,pdc-intc".

    - reg: Specifies the base PDC physical address(s) and size(s) of the
      addressable register space. The type shall be <prop-encoded-array>.

    - interrupt-controller: The presence of this property identifies the node
      as an interrupt controller. No property value shall be defined.

    - #interrupt-cells: Specifies the number of cells needed to encode an
      interrupt source. The type shall be a <u32> and the value shall be 2.

    - num-perips: Number of waking peripherals.

    - num-syswakes: Number of SysWake inputs.

    - interrupts: List of interrupt specifiers. The first specifier shall be the
      shared SysWake interrupt, and remaining specifies shall be PDC peripheral
      interrupts in order.

* Interrupt Specifier Definition

  Interrupt specifiers consists of 2 cells encoded as follows:

    - <1st-cell>: The interrupt-number that identifies the interrupt source.
                    0-7:  Peripheral interrupts
                    8-15: SysWake interrupts

    - <2nd-cell>: The level-sense information, encoded using the Linux interrupt
                  flags as follows (only 4 valid for peripheral interrupts):
                    0 = none (decided by software)
                    1 = low-to-high edge triggered
                    2 = high-to-low edge triggered
                    3 = both edge triggered
                    4 = active-high level-sensitive (required for perip irqs)
                    8 = active-low level-sensitive

* Examples

Example 1:

	/*
	 * TZ1090 PDC block
	 */
	pdc: pdc@0x02006000 {
		// This is an interrupt controller node.
		interrupt-controller;

		// Three cells to encode interrupt sources.
		#interrupt-cells = <2>;

		// Offset address of 0x02006000 and size of 0x1000.
		reg = <0x02006000 0x1000>;

		// Compatible with Meta hardware trigger block.
		compatible = "img,pdc-intc";

		// Three peripherals are connected.
		num-perips = <3>;

		// Four SysWakes are connected.
		num-syswakes = <4>;

		interrupts = <18 4 /* level */>, /* Syswakes */
			     <30 4 /* level */>, /* Peripheral 0 (RTC) */
			     <29 4 /* level */>, /* Peripheral 1 (IR) */
			     <31 4 /* level */>; /* Peripheral 2 (WDT) */
	};

Example 2:

	/*
	 * An SoC peripheral that is wired through the PDC.
	 */
	rtc0 {
		// The interrupt controller that this device is wired to.
		interrupt-parent = <&pdc>;

		// Interrupt source Peripheral 0
		interrupts = <0   /* Peripheral 0 (RTC) */
		              4>  /* IRQ_TYPE_LEVEL_HIGH */
	};

Example 3:

	/*
	 * An interrupt generating device that is wired to a SysWake pin.
	 */
	touchscreen0 {
		// The interrupt controller that this device is wired to.
		interrupt-parent = <&pdc>;

		// Interrupt source SysWake 0 that is active-low level-sensitive
		interrupts = <8 /* SysWake0 */
			      8 /* IRQ_TYPE_LEVEL_LOW */>;
	};
```

## Documentation/devicetree/bindings/interrupt-controller/img,pdc-intc.yaml
```yaml
# SPDX-License-Identifier: (GPL-2.0-only OR BSD-2-Clause)
%YAML 1.2
---
$id: http://devicetree.org/schemas/interrupt-controller/img,pdc-intc.yaml#
$schema: http://devicetree.org/meta-schemas/core.yaml#

title: ImgTec Powerdown Controller (PDC) Interrupt Controller

maintainers:
  - James Hogan <jhogan@kernel.org>

description:
  ImgTec Powerdown Controller (PDC) Interrupt Controller has a number of input
  interrupt lines which can wake the system, and are passed on through output
  interrupt lines.

properties:
  compatible:
    const: img,pdc-intc

  reg:
    maxItems: 1

  interrupt-controller: true

  '#interrupt-cells':
    description: >
      <1st-cell>: The interrupt-number that identifies the interrupt source.
        0-7:  Peripheral interrupts
        8-15: SysWake interrupts

      <2nd-cell>: The level-sense information, encoded using the Linux interrupt
        flags as follows (only 4 valid for peripheral interrupts):
        0 = none (decided by software)
        1 = low-to-high edge triggered
        2 = high-to-low edge triggered
        3 = both edge triggered
        4 = active-high level-sensitive (required for perip irqs)
        8 = active-low level-sensitive
    const: 2

  num-perips:
    description: Number of waking peripherals
    $ref: /schemas/types.yaml#/definitions/uint32
    maximum: 8

  num-syswakes:
    description: Number of SysWake inputs
    $ref: /schemas/types.yaml#/definitions/uint32
    maximum: 8

  interrupts:
    description:
      First entry is syswake IRQ. Subsequent entries are 1 per peripheral.
    minItems: 2
    maxItems: 9

required:
  - compatible
  - reg
  - interrupt-controller
  - '#interrupt-cells'
  - num-perips
  - num-syswakes
  - interrupts

additionalProperties: false

examples:
  - |
    interrupt-controller@2006000 {
        compatible = "img,pdc-intc";
        reg = <0x02006000 0x1000>;
        interrupts = <18 4>, <30 4>, <29 4>, <31 4>;
        interrupt-controller;
        #interrupt-cells = <2>;
        num-perips = <3>;
        num-syswakes = <4>;
    };
```

## Documentation/devicetree/bindings/interrupt-controller/ingenic,intc.txt
```
Ingenic SoC Interrupt Controller

Required properties:

- compatible : should be "ingenic,<socname>-intc". Valid strings are:
    ingenic,jz4740-intc
    ingenic,jz4725b-intc
    ingenic,jz4770-intc
    ingenic,jz4775-intc
    ingenic,jz4780-intc
- reg : Specifies base physical address and size of the registers.
- interrupt-controller : Identifies the node as an interrupt controller
- #interrupt-cells : Specifies the number of cells needed to encode an
  interrupt source. The value shall be 1.
- interrupt-parent : phandle of the CPU interrupt controller.
- interrupts : Specifies the CPU interrupt the controller is connected to.

Example:

intc: interrupt-controller@10001000 {
	compatible = "ingenic,jz4740-intc";
	reg = <0x10001000 0x14>;

	interrupt-controller;
	#interrupt-cells = <1>;

	interrupt-parent = <&cpuintc>;
	interrupts = <2>;
};
```

## Documentation/devicetree/bindings/interrupt-controller/ingenic,intc.yaml
```yaml
# SPDX-License-Identifier: (GPL-2.0-only OR BSD-2-Clause)
%YAML 1.2
---
$id: http://devicetree.org/schemas/interrupt-controller/ingenic,intc.yaml#
$schema: http://devicetree.org/meta-schemas/core.yaml#

title: Ingenic SoCs interrupt controller devicetree bindings

maintainers:
  - Paul Cercueil <paul@crapouillou.net>

properties:
  $nodename:
    pattern: "^interrupt-controller@[0-9a-f]+$"

  compatible:
    oneOf:
      - enum:
          - ingenic,jz4740-intc
          - ingenic,jz4760-intc
          - ingenic,jz4780-intc
      - items:
          - enum:
              - ingenic,jz4775-intc
              - ingenic,jz4770-intc
          - const: ingenic,jz4760-intc
      - items:
          - const: ingenic,x1000-intc
          - const: ingenic,jz4780-intc
      - items:
          - const: ingenic,jz4725b-intc
          - const: ingenic,jz4740-intc

  "#interrupt-cells":
    const: 1

  reg:
    maxItems: 1

  interrupts:
    maxItems: 1

  interrupt-controller: true

required:
  - compatible
  - reg
  - interrupts
  - "#interrupt-cells"
  - interrupt-controller

additionalProperties: false

examples:
  - |
    intc: interrupt-controller@10001000 {
      compatible = "ingenic,jz4770-intc", "ingenic,jz4760-intc";
      reg = <0x10001000 0x40>;

      interrupt-controller;
      #interrupt-cells = <1>;

      interrupt-parent = <&cpuintc>;
      interrupts = <2>;
    };
```
