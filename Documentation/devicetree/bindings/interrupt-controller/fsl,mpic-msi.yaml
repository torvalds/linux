## Documentation/devicetree/bindings/interrupt-controller/intel,ce4100-ioapic.txt
```
Interrupt chips
---------------

* Intel I/O Advanced Programmable Interrupt Controller (IO APIC)

  Required properties:
  --------------------
     compatible = "intel,ce4100-ioapic";
     #interrupt-cells = <2>;

  Device's interrupt property:

     interrupts = <P S>;

  The first number (P) represents the interrupt pin which is wired to the
  IO APIC. The second number (S) represents the sense of interrupt which
  should be configured and can be one of:
    0 - Edge Rising
    1 - Level Low
    2 - Level High
    3 - Edge Falling

* Local APIC
  Required property:

     compatible = "intel,ce4100-lapic";
```

## Documentation/devicetree/bindings/interrupt-controller/intel,ce4100-ioapic.yaml
```yaml
# SPDX-License-Identifier: (GPL-2.0 OR BSD-2-Clause)
%YAML 1.2
---
$id: http://devicetree.org/schemas/interrupt-controller/intel,ce4100-ioapic.yaml#
$schema: http://devicetree.org/meta-schemas/core.yaml#

title: Intel I/O Advanced Programmable Interrupt Controller (IO APIC)

maintainers:
  - Rahul Tanwar <rtanwar@maxlinear.com>

description: |
  Intel's Advanced Programmable Interrupt Controller (APIC) is a
  family of interrupt controllers. The APIC is a split
  architecture design, with a local component (LAPIC) integrated
  into the processor itself and an external I/O APIC. Local APIC
  (lapic) receives interrupts from the processor's interrupt pins,
  from internal sources and from an external I/O APIC (ioapic).
  And it sends these to the processor core for handling.
  See [1] Chapter 8 for more details.

  Many of the Intel's generic devices like hpet, ioapic, lapic have
  the ce4100 name in their compatible property names because they
  first appeared in CE4100 SoC.

  This schema defines bindings for I/O APIC interrupt controller.

  [1] https://pdos.csail.mit.edu/6.828/2008/readings/ia32/IA32-3A.pdf

properties:
  compatible:
    const: intel,ce4100-ioapic

  reg:
    maxItems: 1

  interrupt-controller: true

  '#interrupt-cells':
    const: 2

  interrupts:
    maxItems: 1

required:
  - compatible
  - reg
  - interrupt-controller
  - '#interrupt-cells'

additionalProperties: false

examples:
  - |
    ioapic1: interrupt-controller@fec00000 {
        compatible = "intel,ce4100-ioapic";
        reg = <0xfec00000 0x1000>;
        interrupt-controller;
        #interrupt-cells = <2>;
    };
```

## Documentation/devicetree/bindings/interrupt-controller/intel,ce4100-lapic.yaml
```yaml
# SPDX-License-Identifier: (GPL-2.0 OR BSD-2-Clause)
%YAML 1.2
---
$id: http://devicetree.org/schemas/interrupt-controller/intel,ce4100-lapic.yaml#
$schema: http://devicetree.org/meta-schemas/core.yaml#

title: Intel Local Advanced Programmable Interrupt Controller (LAPIC)

maintainers:
  - Rahul Tanwar <rtanwar@maxlinear.com>

description: |
  Intel's Advanced Programmable Interrupt Controller (APIC) is a
  family of interrupt controllers. The APIC is a split
  architecture design, with a local component (LAPIC) integrated
  into the processor itself and an external I/O APIC. Local APIC
  (lapic) receives interrupts from the processor's interrupt pins,
  from internal sources and from an external I/O APIC (ioapic).
  And it sends these to the processor core for handling.
  See [1] Chapter 8 for more details.

  Many of the Intel's generic devices like hpet, ioapic, lapic have
  the ce4100 name in their compatible property names because they
  first appeared in CE4100 SoC.

  This schema defines bindings for local APIC interrupt controller.

  [1] https://pdos.csail.mit.edu/6.828/2008/readings/ia32/IA32-3A.pdf

properties:
  compatible:
    const: intel,ce4100-lapic

  reg:
    maxItems: 1

  interrupt-controller: true

  '#interrupt-cells':
    const: 2

  intel,virtual-wire-mode:
    description: Intel defines a few possible interrupt delivery
      modes. With respect to boot/init time, mainly two interrupt
      delivery modes are possible.
      PIC Mode - Legacy external 8259 compliant PIC interrupt controller.
      Virtual Wire Mode - use lapic as virtual wire interrupt delivery mode.
      For ACPI or MPS spec compliant systems, it is figured out by some read
      only bit field/s available in their respective defined data structures.
      For OF based systems, it is by default set to PIC mode.
      But if this optional boolean property is set, then the interrupt delivery
      mode is configured to virtual wire compatibility mode.
    type: boolean

required:
  - compatible
  - reg
  - interrupt-controller
  - '#interrupt-cells'

additionalProperties: false

examples:
  - |
    lapic0: interrupt-controller@fee00000 {
        compatible = "intel,ce4100-lapic";
        reg = <0xfee00000 0x1000>;
        interrupt-controller;
        #interrupt-cells = <2>;
        intel,virtual-wire-mode;
    };
```

## Documentation/devicetree/bindings/interrupt-controller/intel,ixp4xx-interrupt.yaml
```yaml
# SPDX-License-Identifier: (GPL-2.0 OR BSD-2-Clause)
# Copyright 2018 Linaro Ltd.
%YAML 1.2
---
$id: http://devicetree.org/schemas/interrupt-controller/intel,ixp4xx-interrupt.yaml#
$schema: http://devicetree.org/meta-schemas/core.yaml#

title: Intel IXP4xx XScale Networking Processors Interrupt Controller

maintainers:
  - Linus Walleij <linus.walleij@linaro.org>

description: |
  This interrupt controller is found in the Intel IXP4xx processors.
  Some processors have 32 interrupts, some have up to 64 interrupts.
  The exact number of interrupts is determined from the compatible
  string.

  The distinct IXP4xx families with different interrupt controller
  variations are IXP42x, IXP43x, IXP45x and IXP46x. Those four
  families were the only ones to reach the developer and consumer
  market.

properties:
  compatible:
    items:
      - enum:
          - intel,ixp42x-interrupt
          - intel,ixp43x-interrupt
          - intel,ixp45x-interrupt
          - intel,ixp46x-interrupt

  reg:
    maxItems: 1

  interrupt-controller: true

  '#interrupt-cells':
    const: 2

required:
  - compatible
  - reg
  - interrupt-controller
  - '#interrupt-cells'

additionalProperties: false

examples:
  - |
    intcon: interrupt-controller@c8003000 {
        compatible = "intel,ixp43x-interrupt";
        reg = <0xc8003000 0x100>;
        interrupt-controller;
        #interrupt-cells = <2>;
    };
```

## Documentation/devicetree/bindings/interrupt-controller/interrupts.txt
```
Specifying interrupt information for devices
============================================

1) Interrupt client nodes
-------------------------

Nodes that describe devices which generate interrupts must contain an
"interrupts" property, an "interrupts-extended" property, or both. If both are
present, the latter should take precedence; the former may be provided simply
for compatibility with software that does not recognize the latter. These
properties contain a list of interrupt specifiers, one per output interrupt. The
format of the interrupt specifier is determined by the interrupt controller to
which the interrupts are routed; see section 2 below for details.

  Example:
	interrupt-parent = <&intc1>;
	interrupts = <5 0>, <6 0>;

The "interrupt-parent" property is used to specify the controller to which
interrupts are routed and contains a single phandle referring to the interrupt
controller node. This property is inherited, so it may be specified in an
interrupt client node or in any of its parent nodes. Interrupts listed in the
"interrupts" property are always in reference to the node's interrupt parent.

The "interrupts-extended" property is a special form; useful when a node needs
to reference multiple interrupt parents or a different interrupt parent than
the inherited one. Each entry in this property contains both the parent phandle
and the interrupt specifier.

  Example:
	interrupts-extended = <&intc1 5 1>, <&intc2 1 0>;

2) Interrupt controller nodes
-----------------------------

A device is marked as an interrupt controller with the "interrupt-controller"
property. This is a empty, boolean property. An additional "#interrupt-cells"
property defines the number of cells needed to specify a single interrupt.

It is the responsibility of the interrupt controller's binding to define the
length and format of the interrupt specifier. The following two variants are
commonly used:

  a) one cell
  -----------
  The #interrupt-cells property is set to 1 and the single cell defines the
  index of the interrupt within the controller.

  Example:

	vic: intc@10140000 {
		compatible = "arm,versatile-vic";
		interrupt-controller;
		#interrupt-cells = <1>;
		reg = <0x10140000 0x1000>;
	};

	sic: intc@10003000 {
		compatible = "arm,versatile-sic";
		interrupt-controller;
		#interrupt-cells = <1>;
		reg = <0x10003000 0x1000>;
		interrupt-parent = <&vic>;
		interrupts = <31>; /* Cascaded to vic */
	};

  b) two cells
  ------------
  The #interrupt-cells property is set to 2 and the first cell defines the
  index of the interrupt within the controller, while the second cell is used
  to specify any of the following flags:
    - bits[3:0] trigger type and level flags
        1 = low-to-high edge triggered
        2 = high-to-low edge triggered
        4 = active high level-sensitive
        8 = active low level-sensitive

  Example:

	i2c@7000c000 {
		gpioext: gpio-adnp@41 {
			compatible = "ad,gpio-adnp";
			reg = <0x41>;

			interrupt-parent = <&gpio>;
			interrupts = <160 1>;

			gpio-controller;
			#gpio-cells = <1>;

			interrupt-controller;
			#interrupt-cells = <2>;

			nr-gpios = <64>;
		};

		sx8634@2b {
			compatible = "smtc,sx8634";
			reg = <0x2b>;

			interrupt-parent = <&gpioext>;
			interrupts = <3 0x8>;

			#address-cells = <1>;
			#size-cells = <0>;

			threshold = <0x40>;
			sensitivity = <7>;
		};
	};

3) Interrupt wakeup parent
--------------------------

Some interrupt controllers in a SoC, are always powered on and have a select
interrupts routed to them, so that they can wakeup the SoC from suspend. These
interrupt controllers do not fall into the category of a parent interrupt
controller and can be specified by the "wakeup-parent" property and contain a
single phandle referring to the wakeup capable interrupt controller.

   Example:
	wakeup-parent = <&pdc_intc>;
```

## Documentation/devicetree/bindings/interrupt-controller/jcore,aic.txt
```
J-Core Advanced Interrupt Controller

Required properties:

- compatible: Should be "jcore,aic1" for the (obsolete) first-generation aic
  with 8 interrupt lines with programmable priorities, or "jcore,aic2" for
  the "aic2" core with 64 interrupts.

- reg: Memory region(s) for configuration. For SMP, there should be one
  region per cpu, indexed by the sequential, zero-based hardware cpu
  number.

- interrupt-controller: Identifies the node as an interrupt controller

- #interrupt-cells: Specifies the number of cells needed to encode an
  interrupt source. The value shall be 1.


Example:

aic: interrupt-controller@200 {
	compatible = "jcore,aic2";
	reg = < 0x200 0x30 0x500 0x30 >;
	interrupt-controller;
	#interrupt-cells = <1>;
};
```

## Documentation/devicetree/bindings/interrupt-controller/jcore,aic.yaml
```yaml
# SPDX-License-Identifier: (GPL-2.0-only OR BSD-2-Clause)
# Copyright 2018 Linaro Ltd.
%YAML 1.2
---
$id: http://devicetree.org/schemas/interrupt-controller/jcore,aic.yaml#
$schema: http://devicetree.org/meta-schemas/core.yaml#

title: J-Core Advanced Interrupt Controller

maintainers:
  - Rich Felker <dalias@libc.org>

properties:
  compatible:
    enum:
      - jcore,aic1
      - jcore,aic2

  reg:
    description: Memory region(s) for configuration. For SMP, there should be one
      region per CPU, indexed by the sequential, zero-based hardware CPU number.

  interrupt-controller: true

  '#interrupt-cells':
    const: 1

required:
  - compatible
  - reg
  - interrupt-controller
  - '#interrupt-cells'

additionalProperties: false

examples:
  - |
    aic: interrupt-controller@200 {
        compatible = "jcore,aic2";
        reg = <0x200 0x30>, <0x500 0x30>;
        interrupt-controller;
        #interrupt-cells = <1>;
    };
```

## Documentation/devicetree/bindings/interrupt-controller/kontron,sl28cpld-intc.yaml
```yaml
# SPDX-License-Identifier: (GPL-2.0-only OR BSD-2-Clause)
%YAML 1.2
---
$id: http://devicetree.org/schemas/interrupt-controller/kontron,sl28cpld-intc.yaml#
$schema: http://devicetree.org/meta-schemas/core.yaml#

title: Interrupt controller driver for the sl28cpld board management controller

maintainers:
  - Michael Walle <michael@walle.cc>

description: |
  This module is part of the sl28cpld multi-function device. For more
  details see ../embedded-controller/kontron,sl28cpld.yaml.

  The following interrupts are available. All types and levels are fixed
  and handled by the board management controller.

  ==== ============= ==================================
   IRQ line/device   description
  ==== ============= ==================================
    0  RTC_INT#      Interrupt line from on-board RTC
    1  SMB_ALERT#    Event on SMB_ALERT# line (P1)
    2  ESPI_ALERT0#  Event on ESPI_ALERT0# line (S43)
    3  ESPI_ALERT1#  Event on ESPI_ALERT1# line (S44)
    4  PWR_BTN#      Event on PWR_BTN# line (P128)
    5  SLEEP#        Event on SLEEP# line (S149)
    6  watchdog      Interrupt of the internal watchdog
    7  n/a           not used
  ==== ============= ==================================

properties:
  compatible:
    enum:
      - kontron,sl28cpld-intc

  reg:
    maxItems: 1

  interrupts:
    maxItems: 1

  "#interrupt-cells":
    const: 2

  interrupt-controller: true

required:
  - compatible
  - interrupts
  - "#interrupt-cells"
  - interrupt-controller

additionalProperties: false
```

## Documentation/devicetree/bindings/interrupt-controller/loongarch,cpu-interrupt-controller.yaml
```yaml
# SPDX-License-Identifier: GPL-2.0-only OR BSD-2-Clause
%YAML 1.2
---
$id: http://devicetree.org/schemas/interrupt-controller/loongarch,cpu-interrupt-controller.yaml#
$schema: http://devicetree.org/meta-schemas/core.yaml#

title: LoongArch CPU Interrupt Controller

maintainers:
  - Liu Peibao <liupeibao@loongson.cn>

properties:
  compatible:
    const: loongarch,cpu-interrupt-controller

  '#interrupt-cells':
    const: 1

  interrupt-controller: true

additionalProperties: false

required:
  - compatible
  - '#interrupt-cells'
  - interrupt-controller

examples:
  - |
    interrupt-controller {
      compatible = "loongarch,cpu-interrupt-controller";
      #interrupt-cells = <1>;
      interrupt-controller;
    };
```

## Documentation/devicetree/bindings/interrupt-controller/loongson,cpu-interrupt-controller.yaml
```yaml
# SPDX-License-Identifier: GPL-2.0-only OR BSD-2-Clause
%YAML 1.2
---
$id: http://devicetree.org/schemas/interrupt-controller/loongson,cpu-interrupt-controller.yaml#
$schema: http://devicetree.org/meta-schemas/core.yaml#

title: LoongArch CPU Interrupt Controller

maintainers:
  - Liu Peibao <liupeibao@loongson.cn>

properties:
  compatible:
    const: loongson,cpu-interrupt-controller

  '#interrupt-cells':
    const: 1

  interrupt-controller: true

additionalProperties: false

required:
  - compatible
  - '#interrupt-cells'
  - interrupt-controller

examples:
  - |
    interrupt-controller {
      compatible = "loongson,cpu-interrupt-controller";
      #interrupt-cells = <1>;
      interrupt-controller;
    };
```
