## Documentation/devicetree/bindings/interrupt-controller/loongson,eiointc.yaml
```yaml
# SPDX-License-Identifier: (GPL-2.0-only OR BSD-2-Clause)
%YAML 1.2
---
$id: http://devicetree.org/schemas/interrupt-controller/loongson,eiointc.yaml#
$schema: http://devicetree.org/meta-schemas/core.yaml#

title: Loongson Extended I/O Interrupt Controller

maintainers:
  - Binbin Zhou <zhoubinbin@loongson.cn>

description: |
  This interrupt controller is found on the Loongson-3 family chips and
  Loongson-2K series chips and is used to distribute interrupts directly to
  individual cores without forwarding them through the HT's interrupt line.

allOf:
  - $ref: /schemas/interrupt-controller.yaml#

properties:
  compatible:
    enum:
      - loongson,ls2k0500-eiointc
      - loongson,ls2k2000-eiointc

  reg:
    maxItems: 1

  interrupts:
    maxItems: 1

  interrupt-controller: true

  '#interrupt-cells':
    const: 1

required:
  - compatible
  - reg
  - interrupts
  - interrupt-controller
  - '#interrupt-cells'

unevaluatedProperties: false

examples:
  - |
    eiointc: interrupt-controller@1fe11600 {
      compatible = "loongson,ls2k0500-eiointc";
      reg = <0x1fe10000 0x10000>;

      interrupt-controller;
      #interrupt-cells = <1>;

      interrupt-parent = <&cpuintc>;
      interrupts = <3>;
    };

...
```

## Documentation/devicetree/bindings/interrupt-controller/loongson,htpic.yaml
```yaml
# SPDX-License-Identifier: (GPL-2.0-only OR BSD-2-Clause)
%YAML 1.2
---
$id: "http://devicetree.org/schemas/interrupt-controller/loongson,htpic.yaml#"
$schema: "http://devicetree.org/meta-schemas/core.yaml#"

title: Loongson-3 HyperTransport Interrupt Controller

maintainers:
  - Jiaxun Yang <jiaxun.yang@flygoat.com>

allOf:
  - $ref: /schemas/interrupt-controller.yaml#

description: |
  This interrupt controller is found in the Loongson-3 family of chips to transmit
  interrupts from PCH PIC connected on HyperTransport bus.

properties:
  compatible:
    const: loongson,htpic-1.0

  reg:
    maxItems: 1

  interrupts:
    minItems: 1
    maxItems: 4
    description: |
      Four parent interrupts that receive chained interrupts.

  interrupt-controller: true

  '#interrupt-cells':
    const: 1

required:
  - compatible
  - reg
  - interrupts
  - interrupt-controller
  - '#interrupt-cells'

examples:
  - |
    #include <dt-bindings/interrupt-controller/irq.h>
    htintc: interrupt-controller@1fb000080 {
      compatible = "loongson,htintc-1.0";
      reg = <0xfb000080 0x40>;
      interrupt-controller;
      #interrupt-cells = <1>;

      interrupt-parent = <&liointc>;
      interrupts = <24 IRQ_TYPE_LEVEL_HIGH>,
                    <25 IRQ_TYPE_LEVEL_HIGH>,
                    <26 IRQ_TYPE_LEVEL_HIGH>,
                    <27 IRQ_TYPE_LEVEL_HIGH>;
    };
...
```

## Documentation/devicetree/bindings/interrupt-controller/loongson,htvec.yaml
```yaml
# SPDX-License-Identifier: (GPL-2.0-only OR BSD-2-Clause)
%YAML 1.2
---
$id: http://devicetree.org/schemas/interrupt-controller/loongson,htvec.yaml#
$schema: http://devicetree.org/meta-schemas/core.yaml#

title: Loongson-3 HyperTransport Interrupt Vector Controller

maintainers:
  - Jiaxun Yang <jiaxun.yang@flygoat.com>

description:
  This interrupt controller is found in the Loongson-3 family of chips for
  receiving vectorized interrupts from PCH's interrupt controller.

properties:
  compatible:
    const: loongson,htvec-1.0

  reg:
    maxItems: 1

  interrupts:
    minItems: 1
    maxItems: 8
    description: Eight parent interrupts that receive chained interrupts.

  interrupt-controller: true

  '#interrupt-cells':
    const: 1

required:
  - compatible
  - reg
  - interrupts
  - interrupt-controller
  - '#interrupt-cells'

additionalProperties: false

examples:
  - |
    #include <dt-bindings/interrupt-controller/irq.h>
    htvec: interrupt-controller@fb000080 {
      compatible = "loongson,htvec-1.0";
      reg = <0xfb000080 0x40>;
      interrupt-controller;
      #interrupt-cells = <1>;

      interrupt-parent = <&liointc>;
      interrupts = <24 IRQ_TYPE_LEVEL_HIGH>,
                    <25 IRQ_TYPE_LEVEL_HIGH>,
                    <26 IRQ_TYPE_LEVEL_HIGH>,
                    <27 IRQ_TYPE_LEVEL_HIGH>;
    };
...
```

## Documentation/devicetree/bindings/interrupt-controller/loongson,liointc.yaml
```yaml
# SPDX-License-Identifier: (GPL-2.0-only OR BSD-2-Clause)
%YAML 1.2
---
$id: "http://devicetree.org/schemas/interrupt-controller/loongson,liointc.yaml#"
$schema: "http://devicetree.org/meta-schemas/core.yaml#"

title: Loongson Local I/O Interrupt Controller

maintainers:
  - Jiaxun Yang <jiaxun.yang@flygoat.com>

description: |
  This interrupt controller is found in the Loongson-3 family of chips as the primary
  package interrupt controller which can route local I/O interrupt to interrupt lines
  of cores.

allOf:
  - $ref: /schemas/interrupt-controller.yaml#

properties:
  compatible:
    oneOf:
      - const: loongson,liointc-1.0
      - const: loongson,liointc-1.0a

  reg:
    maxItems: 1

  interrupt-controller: true

  interrupts:
    description:
      Interrupt source of the CPU interrupts.
    minItems: 1
    maxItems: 4

  interrupt-names:
    description: List of names for the parent interrupts.
    items:
      - const: int0
      - const: int1
      - const: int2
      - const: int3
    minItems: 1
    maxItems: 4

  '#interrupt-cells':
    const: 2

  'loongson,parent_int_map':
    description: |
      This property points how the children interrupts will be mapped into CPU
      interrupt lines. Each cell refers to a parent interrupt line from 0 to 3
      and each bit in the cell refers to a child interrupt from 0 to 31.
      If a CPU interrupt line didn't connect with liointc, then keep its
      cell with zero.
    $ref: /schemas/types.yaml#/definitions/uint32-array
    minItems: 4
    maxItems: 4

required:
  - compatible
  - reg
  - interrupts
  - interrupt-controller
  - '#interrupt-cells'
  - 'loongson,parent_int_map'


examples:
  - |
    iointc: interrupt-controller@3ff01400 {
      compatible = "loongson,liointc-1.0";
      reg = <0x3ff01400 0x64>;

      interrupt-controller;
      #interrupt-cells = <2>;

      interrupt-parent = <&cpuintc>;
      interrupts = <2>, <3>;
      interrupt-names = "int0", "int1";

      loongson,parent_int_map = <0xf0ffffff>, /* int0 */
                                <0x0f000000>, /* int1 */
                                <0x00000000>, /* int2 */
                                <0x00000000>; /* int3 */

    };

...
```

## Documentation/devicetree/bindings/interrupt-controller/loongson,ls1x-intc.txt
```
Loongson ls1x Interrupt Controller

Required properties:

- compatible : should be "loongson,ls1x-intc". Valid strings are:

- reg : Specifies base physical address and size of the registers.
- interrupt-controller : Identifies the node as an interrupt controller
- #interrupt-cells : Specifies the number of cells needed to encode an
  interrupt source. The value shall be 2.
- interrupts : Specifies the CPU interrupt the controller is connected to.

Example:

intc: interrupt-controller@1fd01040 {
	compatible = "loongson,ls1x-intc";
	reg = <0x1fd01040 0x18>;

	interrupt-controller;
	#interrupt-cells = <2>;

	interrupt-parent = <&cpu_intc>;
	interrupts = <2>;
};
```

## Documentation/devicetree/bindings/interrupt-controller/loongson,ls1x-intc.yaml
```yaml
# SPDX-License-Identifier: (GPL-2.0-only OR BSD-2-Clause)
%YAML 1.2
---
$id: http://devicetree.org/schemas/interrupt-controller/loongson,ls1x-intc.yaml#
$schema: http://devicetree.org/meta-schemas/core.yaml#

title: Loongson-1 Interrupt Controller

maintainers:
  - Keguang Zhang <keguang.zhang@gmail.com>

description:
  Loongson-1 interrupt controller is connected to the MIPS core interrupt
  controller, which controls several groups of interrupts.

properties:
  compatible:
    const: loongson,ls1x-intc

  reg:
    maxItems: 1

  interrupt-controller: true

  '#interrupt-cells':
    const: 2

  interrupts:
    maxItems: 1

required:
  - compatible
  - reg
  - interrupt-controller
  - '#interrupt-cells'
  - interrupts

additionalProperties: false

examples:
  - |
    intc0: interrupt-controller@1fd01040 {
        compatible = "loongson,ls1x-intc";
        reg = <0x1fd01040 0x18>;

        interrupt-controller;
        #interrupt-cells = <2>;

        interrupt-parent = <&cpu_intc>;
        interrupts = <2>;
    };
```

## Documentation/devicetree/bindings/interrupt-controller/loongson,pch-lpc.yaml
```yaml
# SPDX-License-Identifier: (GPL-2.0-only OR BSD-2-Clause)
%YAML 1.2
---
$id: http://devicetree.org/schemas/interrupt-controller/loongson,pch-lpc.yaml#
$schema: http://devicetree.org/meta-schemas/core.yaml#

title: Loongson PCH LPC Controller

maintainers:
  - Jiaxun Yang <jiaxun.yang@flygoat.com>

description:
  This interrupt controller is found in the Loongson LS7A family of PCH for
  accepting interrupts sent by LPC-connected peripherals and signalling PIC
  via a single interrupt line when interrupts are available.

properties:
  compatible:
    const: loongson,ls7a-lpc

  reg:
    maxItems: 1

  interrupt-controller: true

  interrupts:
    maxItems: 1

  '#interrupt-cells':
    const: 2

required:
  - compatible
  - reg
  - interrupt-controller
  - interrupts
  - '#interrupt-cells'

additionalProperties: false

examples:
  - |
    #include <dt-bindings/interrupt-controller/irq.h>
    lpc: interrupt-controller@10002000 {
      compatible = "loongson,ls7a-lpc";
      reg = <0x10002000 0x400>;
      interrupt-controller;
      #interrupt-cells = <2>;
      interrupt-parent = <&pic>;
      interrupts = <19 IRQ_TYPE_LEVEL_HIGH>;
    };
...
```

## Documentation/devicetree/bindings/interrupt-controller/loongson,pch-msi.yaml
```yaml
# SPDX-License-Identifier: (GPL-2.0-only OR BSD-2-Clause)
%YAML 1.2
---
$id: "http://devicetree.org/schemas/interrupt-controller/loongson,pch-msi.yaml#"
$schema: "http://devicetree.org/meta-schemas/core.yaml#"

title: Loongson PCH MSI Controller

maintainers:
  - Jiaxun Yang <jiaxun.yang@flygoat.com>

description:
  This interrupt controller is found in the Loongson LS7A family of PCH for
  transforming interrupts from PCIe MSI into HyperTransport vectorized
  interrupts.

properties:
  compatible:
    const: loongson,pch-msi-1.0

  reg:
    maxItems: 1

  loongson,msi-base-vec:
    description:
      u32 value of the base of parent HyperTransport vector allocated
      to PCH MSI.
    $ref: "/schemas/types.yaml#/definitions/uint32"
    minimum: 0
    maximum: 255

  loongson,msi-num-vecs:
    description:
      u32 value of the number of parent HyperTransport vectors allocated
      to PCH MSI.
    $ref: "/schemas/types.yaml#/definitions/uint32"
    minimum: 1
    maximum: 256

  msi-controller: true

required:
  - compatible
  - reg
  - msi-controller
  - loongson,msi-base-vec
  - loongson,msi-num-vecs

additionalProperties: true #fixme

examples:
  - |
    #include <dt-bindings/interrupt-controller/irq.h>
    msi: msi-controller@2ff00000 {
      compatible = "loongson,pch-msi-1.0";
      reg = <0x2ff00000 0x4>;
      msi-controller;
      loongson,msi-base-vec = <64>;
      loongson,msi-num-vecs = <64>;
      interrupt-parent = <&htvec>;
    };
...
```

## Documentation/devicetree/bindings/interrupt-controller/loongson,pch-pic.yaml
```yaml
# SPDX-License-Identifier: (GPL-2.0-only OR BSD-2-Clause)
%YAML 1.2
---
$id: "http://devicetree.org/schemas/interrupt-controller/loongson,pch-pic.yaml#"
$schema: "http://devicetree.org/meta-schemas/core.yaml#"

title: Loongson PCH PIC Controller

maintainers:
  - Jiaxun Yang <jiaxun.yang@flygoat.com>

description:
  This interrupt controller is found in the Loongson LS7A family of PCH for
  transforming interrupts from on-chip devices into HyperTransport vectorized
  interrupts.

properties:
  compatible:
    const: loongson,pch-pic-1.0

  reg:
    maxItems: 1

  loongson,pic-base-vec:
    description:
      u32 value of the base of parent HyperTransport vector allocated
      to PCH PIC.
    $ref: "/schemas/types.yaml#/definitions/uint32"
    minimum: 0
    maximum: 192

  interrupt-controller: true

  '#interrupt-cells':
    const: 2

required:
  - compatible
  - reg
  - loongson,pic-base-vec
  - interrupt-controller
  - '#interrupt-cells'

examples:
  - |
    #include <dt-bindings/interrupt-controller/irq.h>
    pic: interrupt-controller@10000000 {
      compatible = "loongson,pch-pic-1.0";
      reg = <0x10000000 0x400>;
      interrupt-controller;
      #interrupt-cells = <2>;
      loongson,pic-base-vec = <64>;
      interrupt-parent = <&htvec>;
    };
...
```

## Documentation/devicetree/bindings/interrupt-controller/lsi,zevio-intc.txt
```
TI-NSPIRE interrupt controller

Required properties:
- compatible: Compatible property value should be "lsi,zevio-intc".

- reg: Physical base address of the controller and length of memory mapped
	region.

- interrupt-controller : Identifies the node as an interrupt controller

Example:

interrupt-controller {
	compatible = "lsi,zevio-intc";
	interrupt-controller;
	reg = <0xDC000000 0x1000>;
	#interrupt-cells = <1>;
};
```

## Documentation/devicetree/bindings/interrupt-controller/lsi,zevio-intc.yaml
```yaml
# SPDX-License-Identifier: (GPL-2.0-only OR BSD-2-Clause)
# Copyright 2025 Daniel Tang <dt.tangr@gmail.com>
%YAML 1.2
---
$id: http://devicetree.org/schemas/interrupt-controller/lsi,zevio-intc.yaml#
$schema: http://devicetree.org/meta-schemas/core.yaml#

title: TI-NSPIRE Interrupt Controller

maintainers:
  - Daniel Tang <dt.tangr@gmail.com>

description: |
  TI-NSPIRE interrupt controller

properties:
  compatible:
    const: lsi,zevio-intc

  reg:
    maxItems: 1

  interrupt-controller: true

  '#interrupt-cells':
    const: 1

required:
  - compatible
  - reg
  - interrupt-controller
  - '#interrupt-cells'

additionalProperties: false

examples:
  - |
    interrupt-controller@dc000000 {
        compatible = "lsi,zevio-intc";
        interrupt-controller;
        reg = <0xdc000000 0x1000>;
        #interrupt-cells = <1>;
    };
```

## Documentation/devicetree/bindings/interrupt-controller/marvell,ap806-gicp.yaml
```yaml
# SPDX-License-Identifier: (GPL-2.0-only OR BSD-2-Clause)
%YAML 1.2
---
$id: http://devicetree.org/schemas/interrupt-controller/marvell,ap806-gicp.yaml#
$schema: http://devicetree.org/meta-schemas/core.yaml#

title: Marvell GICP Controller

maintainers:
  - Thomas Petazzoni <thomas.petazzoni@bootlin.com>

description:
  GICP is a Marvell extension of the GIC that allows to trigger GIC SPI
  interrupts by doing a memory transaction. It is used by the ICU
  located in the Marvell CP110 to turn wired interrupts inside the CP
  into GIC SPI interrupts.

properties:
  compatible:
    const: marvell,ap806-gicp

  reg:
    maxItems: 1

  marvell,spi-ranges:
    description: Tuples of GIC SPI interrupt ranges available for this GICP
    $ref: /schemas/types.yaml#/definitions/uint32-matrix
    items:
      items:
        - description: SPI interrupt base
        - description: Number of interrupts in the range

  msi-controller: true

required:
  - compatible
  - reg
  - msi-controller
  - marvell,spi-ranges

additionalProperties: false

examples:
  - |
    msi-controller@3f0040 {
        compatible = "marvell,ap806-gicp";
        reg = <0x3f0040 0x10>;
        marvell,spi-ranges = <64 64>, <288 64>;
        msi-controller;
    };
```
