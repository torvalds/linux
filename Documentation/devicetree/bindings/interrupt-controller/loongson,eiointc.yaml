## Documentation/devicetree/bindings/interrupt-controller/marvell,ap806-sei.yaml
```yaml
# SPDX-License-Identifier: (GPL-2.0-only OR BSD-2-Clause)
%YAML 1.2
---
$id: http://devicetree.org/schemas/interrupt-controller/marvell,ap806-sei.yaml#
$schema: http://devicetree.org/meta-schemas/core.yaml#

title: Marvell SEI (System Error Interrupt) Controller

maintainers:
  - Miquel Raynal <miquel.raynal@bootlin.com>

description: >
  Marvell SEI (System Error Interrupt) controller is an interrupt aggregator. It
  receives interrupts from several sources and aggregates them to a single
  interrupt line (an SPI) on the parent interrupt controller.

  This interrupt controller can handle up to 64 SEIs, a set comes from the AP
  and is wired while a second set comes from the CPs by the mean of MSIs.

properties:
  compatible:
    const: marvell,ap806-sei

  reg:
    maxItems: 1

  interrupts:
    maxItems: 1

  '#interrupt-cells':
    const: 1

  interrupt-controller: true

  msi-controller: true

required:
  - compatible
  - reg
  - interrupts
  - '#interrupt-cells'
  - interrupt-controller
  - msi-controller

additionalProperties: false

examples:
  - |
    #include <dt-bindings/interrupt-controller/arm-gic.h>

    interrupt-controller@3f0200 {
        compatible = "marvell,ap806-sei";
        reg = <0x3f0200 0x40>;
        interrupts = <GIC_SPI 0 IRQ_TYPE_LEVEL_HIGH>;
        #interrupt-cells = <1>;
        interrupt-controller;
        msi-controller;
    };
```

## Documentation/devicetree/bindings/interrupt-controller/marvell,armada-370-xp-mpic.txt
```
Marvell Armada 370, 375, 38x, XP Interrupt Controller
-----------------------------------------------------

Required properties:
- compatible: Should be "marvell,mpic"
- interrupt-controller: Identifies the node as an interrupt controller.
- msi-controller: Identifies the node as an PCI Message Signaled
  Interrupt controller.
- #interrupt-cells: The number of cells to define the interrupts. Should be 1.
  The cell is the IRQ number

- reg: Should contain PMIC registers location and length. First pair
  for the main interrupt registers, second pair for the per-CPU
  interrupt registers. For this last pair, to be compliant with SMP
  support, the "virtual" must be use (For the record, these registers
  automatically map to the interrupt controller registers of the
  current CPU)

Optional properties:

- interrupts: If defined, then it indicates that this MPIC is
  connected as a slave to another interrupt controller. This is
  typically the case on Armada 375 and Armada 38x, where the MPIC is
  connected as a slave to the Cortex-A9 GIC. The provided interrupt
  indicate to which GIC interrupt the MPIC output is connected.

Example:

        mpic: interrupt-controller@d0020000 {
              compatible = "marvell,mpic";
              #interrupt-cells = <1>;
              #address-cells = <1>;
              #size-cells = <1>;
              interrupt-controller;
              msi-controller;
              reg = <0xd0020a00 0x1d0>,
                    <0xd0021070 0x58>;
        };
```

## Documentation/devicetree/bindings/interrupt-controller/marvell,armada-8k-pic.txt
```
Marvell Armada 7K/8K PIC Interrupt controller
---------------------------------------------

This is the Device Tree binding for the PIC, a secondary interrupt
controller available on the Marvell Armada 7K/8K ARM64 SoCs, and
typically connected to the GIC as the primary interrupt controller.

Required properties:
- compatible: should be "marvell,armada-8k-pic"
- interrupt-controller: identifies the node as an interrupt controller
- #interrupt-cells: the number of cells to define interrupts on this
  controller. Should be 1
- reg: the register area for the PIC interrupt controller
- interrupts: the interrupt to the primary interrupt controller,
  typically the GIC

Example:

	pic: interrupt-controller@3f0100 {
		compatible = "marvell,armada-8k-pic";
		reg = <0x3f0100 0x10>;
		#interrupt-cells = <1>;
		interrupt-controller;
		interrupts = <GIC_PPI 15 IRQ_TYPE_LEVEL_HIGH>;
	};
```

## Documentation/devicetree/bindings/interrupt-controller/marvell,armada-8k-pic.yaml
```yaml
# SPDX-License-Identifier: (GPL-2.0-only OR BSD-2-Clause)
%YAML 1.2
---
$id: http://devicetree.org/schemas/interrupt-controller/marvell,armada-8k-pic.yaml#
$schema: http://devicetree.org/meta-schemas/core.yaml#

title: Marvell Armada 7K/8K PIC Interrupt controller

maintainers:
  - Thomas Petazzoni <thomas.petazzoni@bootlin.com>

description:
  The Marvell Armada 7K/8K PIC is a secondary interrupt controller available on
  the Marvell Armada 7K/8K ARM64 SoCs, and typically connected to the GIC as the
  primary interrupt controller.

properties:
  compatible:
    const: marvell,armada-8k-pic

  reg:
    maxItems: 1

  "#interrupt-cells":
    const: 1

  interrupt-controller: true

  interrupts:
    maxItems: 1
    description: Interrupt to the primary interrupt controller (GIC).

required:
  - compatible
  - reg
  - "#interrupt-cells"
  - interrupt-controller
  - interrupts

additionalProperties: false

examples:
  - |
    #include <dt-bindings/interrupt-controller/arm-gic.h>

    interrupt-controller@3f0100 {
        compatible = "marvell,armada-8k-pic";
        reg = <0x3f0100 0x10>;
        #interrupt-cells = <1>;
        interrupt-controller;
        interrupts = <GIC_PPI 15 IRQ_TYPE_LEVEL_HIGH>;
    };
```

## Documentation/devicetree/bindings/interrupt-controller/marvell,cp110-icu.yaml
```yaml
# SPDX-License-Identifier: (GPL-2.0-only OR BSD-2-Clause)
%YAML 1.2
---
$id: http://devicetree.org/schemas/interrupt-controller/marvell,cp110-icu.yaml#
$schema: http://devicetree.org/meta-schemas/core.yaml#

maintainers:
  - Miquel Raynal <miquel.raynal@bootlin.com>
  - Thomas Petazzoni <thomas.petazzoni@bootlin.com>

title: Marvell ICU Interrupt Controller

description:
  The Marvell ICU (Interrupt Consolidation Unit) controller is responsible for
  collecting all wired-interrupt sources in the CP and communicating them to the
  GIC in the AP. The unit translates interrupt requests on input wires to MSG
  memory mapped transactions to the GIC. These messages access different GIC
  memory areas depending on their type (NSR, SR, SEI, REI, etc).

properties:
  compatible:
    const: marvell,cp110-icu

  reg:
    maxItems: 1

  '#address-cells':
    const: 1

  '#size-cells':
    const: 1

  ranges: true

patternProperties:
  "^interrupt-controller@":
    type: object
    description: Interrupt group child nodes
    additionalProperties: false

    properties:
      compatible:
        enum:
          - marvell,cp110-icu-nsr
          - marvell,cp110-icu-sr
          - marvell,cp110-icu-sei
          - marvell,cp110-icu-rei

      reg:
        maxItems: 1

      '#address-cells':
        const: 0

      '#interrupt-cells':
        const: 2

      interrupt-controller: true

      msi-parent:
        maxItems: 1
        description: Phandle to the GICP controller

    required:
      - compatible
      - reg
      - '#interrupt-cells'
      - interrupt-controller
      - msi-parent

required:
  - compatible
  - reg

additionalProperties: false

examples:
  - |
    interrupt-controller@1e0000 {
        compatible = "marvell,cp110-icu";
        reg = <0x1e0000 0x440>;
        #address-cells = <1>;
        #size-cells = <1>;
        ranges;

        interrupt-controller@10 {
                compatible = "marvell,cp110-icu-nsr";
                reg = <0x10 0x20>;
                #interrupt-cells = <2>;
                interrupt-controller;
                msi-parent = <&gicp>;
        };

        interrupt-controller@50 {
                compatible = "marvell,cp110-icu-sei";
                reg = <0x50 0x10>;
                #interrupt-cells = <2>;
                interrupt-controller;
                msi-parent = <&sei>;
        };
    };
```

## Documentation/devicetree/bindings/interrupt-controller/marvell,dove-pmu-intc.txt
```
Marvell Dove Power Management Unit interrupt controller

Required properties:
- compatible: shall be "marvell,dove-pmu-intc"
- reg: base address of PMU interrupt registers starting with CAUSE register
- interrupts: PMU interrupt of the main interrupt controller
- interrupt-controller: identifies the node as an interrupt controller
- #interrupt-cells: number of cells to encode an interrupt source, shall be 1

Example:
	pmu_intc: pmu-interrupt-ctrl@d0050 {
		compatible = "marvell,dove-pmu-intc";
		interrupt-controller;
		#interrupt-cells = <1>;
		reg = <0xd0050 0x8>;
		interrupts = <33>;
	};
```

## Documentation/devicetree/bindings/interrupt-controller/marvell,gicp.txt
```
Marvell GICP Controller
-----------------------

GICP is a Marvell extension of the GIC that allows to trigger GIC SPI
interrupts by doing a memory transaction. It is used by the ICU
located in the Marvell CP110 to turn wired interrupts inside the CP
into GIC SPI interrupts.

Required properties:

- compatible: Must be "marvell,ap806-gicp"

- reg: Must be the address and size of the GICP SPI registers

- marvell,spi-ranges: tuples of GIC SPI interrupts ranges available
  for this GICP

- msi-controller: indicates that this is an MSI controller

Example:

gicp_spi: gicp-spi@3f0040 {
	compatible = "marvell,ap806-gicp";
	reg = <0x3f0040 0x10>;
	marvell,spi-ranges = <64 64>, <288 64>;
	msi-controller;
};
```

## Documentation/devicetree/bindings/interrupt-controller/marvell,icu.txt
```
Marvell ICU Interrupt Controller
--------------------------------

The Marvell ICU (Interrupt Consolidation Unit) controller is
responsible for collecting all wired-interrupt sources in the CP and
communicating them to the GIC in the AP, the unit translates interrupt
requests on input wires to MSG memory mapped transactions to the GIC.
These messages will access a different GIC memory area depending on
their type (NSR, SR, SEI, REI, etc).

Required properties:

- compatible: Should be "marvell,cp110-icu"

- reg: Should contain ICU registers location and length.

Subnodes: Each group of interrupt is declared as a subnode of the ICU,
with their own compatible.

Required properties for the icu_nsr/icu_sei subnodes:

- compatible: Should be one of:
              * "marvell,cp110-icu-nsr"
	      * "marvell,cp110-icu-sr"
	      * "marvell,cp110-icu-sei"
	      * "marvell,cp110-icu-rei"

- #interrupt-cells: Specifies the number of cells needed to encode an
  interrupt source. The value shall be 2.

  The 1st cell is the index of the interrupt in the ICU unit.

  The 2nd cell is the type of the interrupt. See arm,gic.txt for
  details.

- interrupt-controller: Identifies the node as an interrupt
  controller.

- msi-parent: Should point to the GICP controller, the GIC extension
  that allows to trigger interrupts using MSG memory mapped
  transactions.

Note: each 'interrupts' property referring to any 'icu_xxx' node shall
      have a different number within [0:206].

Example:

icu: interrupt-controller@1e0000 {
	compatible = "marvell,cp110-icu";
	reg = <0x1e0000 0x440>;

	CP110_LABEL(icu_nsr): interrupt-controller@10 {
		compatible = "marvell,cp110-icu-nsr";
		reg = <0x10 0x20>;
		#interrupt-cells = <2>;
		interrupt-controller;
		msi-parent = <&gicp>;
	};

	CP110_LABEL(icu_sei): interrupt-controller@50 {
		compatible = "marvell,cp110-icu-sei";
		reg = <0x50 0x10>;
		#interrupt-cells = <2>;
		interrupt-controller;
		msi-parent = <&sei>;
	};
};

node1 {
	interrupt-parent = <&icu_nsr>;
	interrupts = <106 IRQ_TYPE_LEVEL_HIGH>;
};

node2 {
	interrupt-parent = <&icu_sei>;
	interrupts = <107 IRQ_TYPE_LEVEL_HIGH>;
};

/* Would not work with the above nodes */
node3 {
	interrupt-parent = <&icu_nsr>;
	interrupts = <107 IRQ_TYPE_LEVEL_HIGH>;
};

The legacy bindings were different in this way:

- #interrupt-cells: The value was 3.
	The 1st cell was the group type of the ICU interrupt. Possible
	group types were:
	ICU_GRP_NSR (0x0) : Shared peripheral interrupt, non-secure
	ICU_GRP_SR  (0x1) : Shared peripheral interrupt, secure
	ICU_GRP_SEI (0x4) : System error interrupt
	ICU_GRP_REI (0x5) : RAM error interrupt
	The 2nd cell was the index of the interrupt in the ICU unit.
	The 3rd cell was the type of the interrupt. See arm,gic.txt for
	details.

Example:

icu: interrupt-controller@1e0000 {
	compatible = "marvell,cp110-icu";
	reg = <0x1e0000 0x440>;

	#interrupt-cells = <3>;
	interrupt-controller;
	msi-parent = <&gicp>;
};

node1 {
	interrupt-parent = <&icu>;
	interrupts = <ICU_GRP_NSR 106 IRQ_TYPE_LEVEL_HIGH>;
};
```

## Documentation/devicetree/bindings/interrupt-controller/marvell,mpic.yaml
```yaml
# SPDX-License-Identifier: (GPL-2.0 OR BSD-2-Clause)
%YAML 1.2
---
$id: http://devicetree.org/schemas/interrupt-controller/marvell,mpic.yaml#
$schema: http://devicetree.org/meta-schemas/core.yaml#

title: Marvell Armada 370, 375, 38x, 39x, XP Interrupt Controller

maintainers:
  - Marek Behún <kabel@kernel.org>

description: |
  The top-level interrupt controller on Marvell Armada 370 and XP. On these
  platforms it also provides inter-processor interrupts.

  On Marvell Armada 375, 38x and 39x this controller is wired under ARM GIC.

  Provides MSI handling for the PCIe controllers.

properties:
  compatible:
    const: marvell,mpic

  reg:
    items:
      - description: main registers
      - description: per-cpu registers

  interrupts:
    items:
      - description: |
          Parent interrupt on platforms where MPIC is not the top-level
          interrupt controller.

  interrupt-controller: true

  '#interrupt-cells':
    const: 1

  msi-controller: true

required:
  - compatible
  - reg
  - interrupt-controller
  - '#interrupt-cells'
  - msi-controller

additionalProperties: false

examples:
  - |
    #include <dt-bindings/interrupt-controller/arm-gic.h>
    #include <dt-bindings/interrupt-controller/irq.h>

    interrupt-controller@20a00 {
        compatible = "marvell,mpic";
        reg = <0x20a00 0x2d0>, <0x21070 0x58>;
        interrupts = <GIC_PPI 15 IRQ_TYPE_LEVEL_HIGH>;
        interrupt-controller;
        #interrupt-cells = <1>;
        msi-controller;
    };
```

## Documentation/devicetree/bindings/interrupt-controller/marvell,odmi-controller.txt
```
* Marvell ODMI for MSI support

Some Marvell SoCs have an On-Die Message Interrupt (ODMI) controller
which can be used by on-board peripheral for MSI interrupts.

Required properties:

- compatible           : The value here should contain:

    "marvell,ap806-odmi-controller", "marvell,odmi-controller".

- interrupt,controller : Identifies the node as an interrupt controller.

- msi-controller       : Identifies the node as an MSI controller.

- marvell,odmi-frames  : Number of ODMI frames available. Each frame
                         provides a number of events.

- reg                  : List of register definitions, one for each
                         ODMI frame.

- marvell,spi-base     : List of GIC base SPI interrupts, one for each
                         ODMI frame. Those SPI interrupts are 0-based,
                         i.e marvell,spi-base = <128> will use SPI #96.
                         See Documentation/devicetree/bindings/interrupt-controller/arm,gic.yaml
                         for details about the GIC Device Tree binding.

Example:

	odmi: odmi@300000 {
		compatible = "marvell,ap806-odmi-controller",
			     "marvell,odmi-controller";
		interrupt-controller;
		msi-controller;
		marvell,odmi-frames = <4>;
		reg = <0x300000 0x4000>,
		      <0x304000 0x4000>,
		      <0x308000 0x4000>,
		      <0x30C000 0x4000>;
		marvell,spi-base = <128>, <136>, <144>, <152>;
	};
```
