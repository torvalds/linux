## Documentation/devicetree/bindings/interrupt-controller/marvell,odmi-controller.yaml
```yaml
# SPDX-License-Identifier: (GPL-2.0-only OR BSD-2-Clause)
%YAML 1.2
---
$id: http://devicetree.org/schemas/interrupt-controller/marvell,odmi-controller.yaml#
$schema: http://devicetree.org/meta-schemas/core.yaml#

title: Marvell ODMI controller

maintainers:
  - Thomas Petazzoni <thomas.petazzoni@free-electrons.com>

description:
  Some Marvell SoCs have an On-Die Message Interrupt (ODMI) controller which can
  be used by on-board peripherals for MSI interrupts.

properties:
  compatible:
    const: marvell,odmi-controller

  reg:
    description: List of register definitions, one for each ODMI frame.

  msi-controller: true

  marvell,odmi-frames:
    description: Number of ODMI frames available. Each frame provides a number of events.
    $ref: /schemas/types.yaml#/definitions/uint32

  marvell,spi-base:
    description: >
      List of GIC base SPI interrupts, one for each ODMI frame. Those SPI
      interrupts are 0-based, i.e. marvell,spi-base = <128> will use SPI #96.
      See Documentation/devicetree/bindings/interrupt-controller/arm,gic.yaml
      for details.
    $ref: /schemas/types.yaml#/definitions/uint32-array

required:
  - compatible
  - reg
  - msi-controller
  - marvell,odmi-frames
  - marvell,spi-base

additionalProperties: false

examples:
  - |
    msi-controller@300000 {
        compatible = "marvell,odmi-controller";
        msi-controller;
        marvell,odmi-frames = <4>;
        reg = <0x300000 0x4000>, <0x304000 0x4000>, <0x308000 0x4000>, <0x30C000 0x4000>;
        marvell,spi-base = <128>, <136>, <144>, <152>;
    };
```

## Documentation/devicetree/bindings/interrupt-controller/marvell,orion-bridge-intc.yaml
```yaml
# SPDX-License-Identifier: (GPL-2.0-only OR BSD-2-Clause)
---
$id: http://devicetree.org/schemas/interrupt-controller/marvell,orion-bridge-intc.yaml#
$schema: http://devicetree.org/meta-schemas/core.yaml#

title: Marvell Orion SoC Bridge Interrupt Controller

maintainers:
  - Andrew Lunn <andrew@lunn.ch>
  - Gregory Clement <gregory.clement@bootlin.com>

properties:
  compatible:
    const: marvell,orion-bridge-intc

  reg:
    minItems: 1
    maxItems: 2

  interrupt-controller: true

  '#interrupt-cells':
    const: 1

  interrupts:
    description: Bridge interrupt of the main interrupt controller

  marvell,#interrupts:
    description: Number of interrupts provided by bridge interrupt controller.
    $ref: /schemas/types.yaml#/definitions/uint32
    default: 32

required:
  - compatible
  - reg
  - interrupt-controller
  - '#interrupt-cells'
  - interrupts

additionalProperties: false

examples:
  - |
    interrupt-controller@20110 {
        compatible = "marvell,orion-bridge-intc";
        reg = <0x20110 0x8>;
        interrupt-controller;
        #interrupt-cells = <1>;
        interrupts = <0>;
        /* Dove bridge provides 5 interrupts */
        marvell,#interrupts = <5>;
    };
```

## Documentation/devicetree/bindings/interrupt-controller/marvell,orion-intc.txt
```
Marvell Orion SoC interrupt controllers

* Main interrupt controller

Required properties:
- compatible: shall be "marvell,orion-intc"
- reg: base address(es) of interrupt registers starting with CAUSE register
- interrupt-controller: identifies the node as an interrupt controller
- #interrupt-cells: number of cells to encode an interrupt source, shall be 1

The interrupt sources map to the corresponding bits in the interrupt
registers, i.e.
- 0 maps to bit 0 of first base address,
- 1 maps to bit 1 of first base address,
- 32 maps to bit 0 of second base address, and so on.

Example:
	intc: interrupt-controller {
		compatible = "marvell,orion-intc";
		interrupt-controller;
		#interrupt-cells = <1>;
		 /* Dove has 64 first level interrupts */
		reg = <0x20200 0x10>, <0x20210 0x10>;
	};

* Bridge interrupt controller

Required properties:
- compatible: shall be "marvell,orion-bridge-intc"
- reg: base address of bridge interrupt registers starting with CAUSE register
- interrupts: bridge interrupt of the main interrupt controller
- interrupt-controller: identifies the node as an interrupt controller
- #interrupt-cells: number of cells to encode an interrupt source, shall be 1

Optional properties:
- marvell,#interrupts: number of interrupts provided by bridge interrupt
      controller, defaults to 32 if not set

Example:
	bridge_intc: interrupt-controller {
		compatible = "marvell,orion-bridge-intc";
		interrupt-controller;
		#interrupt-cells = <1>;
		reg = <0x20110 0x8>;
		interrupts = <0>;
		/* Dove bridge provides 5 interrupts */
		marvell,#interrupts = <5>;
	};
```
