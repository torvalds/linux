## Documentation/devicetree/bindings/interrupt-controller/brcm,bcm6345-l1-intc.txt
```
Broadcom BCM6345-style Level 1 interrupt controller

This block is a first level interrupt controller that is typically connected
directly to one of the HW INT lines on each CPU.

Key elements of the hardware design include:

- 32, 64 or 128 incoming level IRQ lines

- Most onchip peripherals are wired directly to an L1 input

- A separate instance of the register set for each CPU, allowing individual
  peripheral IRQs to be routed to any CPU

- Contains one or more enable/status word pairs per CPU

- No atomic set/clear operations

- No polarity/level/edge settings

- No FIFO or priority encoder logic; software is expected to read all
  2-4 status words to determine which IRQs are pending

Required properties:

- compatible: should be "brcm,bcm<soc>-l1-intc", "brcm,bcm6345-l1-intc"
- reg: specifies the base physical address and size of the registers;
  the number of supported IRQs is inferred from the size argument
- interrupt-controller: identifies the node as an interrupt controller
- #interrupt-cells: specifies the number of cells needed to encode an interrupt
  source, should be 1.
- interrupt-parent: specifies the phandle to the parent interrupt controller(s)
  this one is cascaded from
- interrupts: specifies the interrupt line(s) in the interrupt-parent controller
  node; valid values depend on the type of parent interrupt controller

If multiple reg ranges and interrupt-parent entries are present on an SMP
system, the driver will allow IRQ SMP affinity to be set up through the
/proc/irq/ interface.  In the simplest possible configuration, only one
reg range and one interrupt-parent is needed.

The driver operates in native CPU endian by default, there is no support for
specifying an alternative endianness.

Example:

periph_intc: interrupt-controller@10000000 {
        compatible = "brcm,bcm63168-l1-intc", "brcm,bcm6345-l1-intc";
        reg = <0x10000020 0x20>,
              <0x10000040 0x20>;

        interrupt-controller;
        #interrupt-cells = <1>;

        interrupt-parent = <&cpu_intc>;
        interrupts = <2>, <3>;
};
```

## Documentation/devicetree/bindings/interrupt-controller/brcm,bcm6345-l1-intc.yaml
```yaml
# SPDX-License-Identifier: (GPL-2.0-only OR BSD-2-Clause)
%YAML 1.2
---
$id: http://devicetree.org/schemas/interrupt-controller/brcm,bcm6345-l1-intc.yaml#
$schema: http://devicetree.org/meta-schemas/core.yaml#

title: Broadcom BCM6345-style Level 1 interrupt controller

maintainers:
  - Simon Arlott <simon@octiron.net>

description: >
  This block is a first level interrupt controller that is typically connected
  directly to one of the HW INT lines on each CPU.

  Key elements of the hardware design include:

    - 32, 64 or 128 incoming level IRQ lines

    - Most onchip peripherals are wired directly to an L1 input

    - A separate instance of the register set for each CPU, allowing individual
      peripheral IRQs to be routed to any CPU

    - Contains one or more enable/status word pairs per CPU

    - No atomic set/clear operations

    - No polarity/level/edge settings

    - No FIFO or priority encoder logic; software is expected to read all
      2-4 status words to determine which IRQs are pending

  If multiple reg ranges and interrupt-parent entries are present on an SMP
  system, the driver will allow IRQ SMP affinity to be set up through the
  /proc/irq/ interface.  In the simplest possible configuration, only one
  reg range and one interrupt-parent is needed.

  The driver operates in native CPU endian by default, there is no support for
  specifying an alternative endianness.

properties:
  compatible:
    const: brcm,bcm6345-l1-intc

  reg:
    description: One entry per CPU core
    minItems: 1
    maxItems: 2

  interrupt-controller: true

  "#interrupt-cells":
    const: 1

  interrupts:
    description: One entry per CPU core
    minItems: 1
    maxItems: 2

required:
  - compatible
  - reg
  - interrupt-controller
  - '#interrupt-cells'
  - interrupts

additionalProperties: false

examples:
  - |
    interrupt-controller@10000000 {
        compatible = "brcm,bcm6345-l1-intc";
        reg = <0x10000020 0x20>,
              <0x10000040 0x20>;

        interrupt-controller;
        #interrupt-cells = <1>;

        interrupts = <2>, <3>;
    };
```

## Documentation/devicetree/bindings/interrupt-controller/brcm,bcm7038-l1-intc.txt
```
Broadcom BCM7038-style Level 1 interrupt controller

This block is a first level interrupt controller that is typically connected
directly to one of the HW INT lines on each CPU.  Every BCM7xxx set-top chip
since BCM7038 has contained this hardware.

Key elements of the hardware design include:

- 64, 96, 128, or 160 incoming level IRQ lines

- Most onchip peripherals are wired directly to an L1 input

- A separate instance of the register set for each CPU, allowing individual
  peripheral IRQs to be routed to any CPU

- Atomic mask/unmask operations

- No polarity/level/edge settings

- No FIFO or priority encoder logic; software is expected to read all
  2-5 status words to determine which IRQs are pending

Required properties:

- compatible: should be "brcm,bcm7038-l1-intc"
- reg: specifies the base physical address and size of the registers;
  the number of supported IRQs is inferred from the size argument
- interrupt-controller: identifies the node as an interrupt controller
- #interrupt-cells: specifies the number of cells needed to encode an interrupt
  source, should be 1.
- interrupt-parent: specifies the phandle to the parent interrupt controller(s)
  this one is cascaded from
- interrupts: specifies the interrupt line(s) in the interrupt-parent controller
  node; valid values depend on the type of parent interrupt controller

If multiple reg ranges and interrupt-parent entries are present on an SMP
system, the driver will allow IRQ SMP affinity to be set up through the
/proc/irq/ interface.  In the simplest possible configuration, only one
reg range and one interrupt-parent is needed.

Example:

periph_intc: periph_intc@1041a400 {
        compatible = "brcm,bcm7038-l1-intc";
        reg = <0x1041a400 0x30 0x1041a600 0x30>;

        interrupt-controller;
        #interrupt-cells = <1>;

        interrupt-parent = <&cpu_intc>;
        interrupts = <2>, <3>;
};
```

## Documentation/devicetree/bindings/interrupt-controller/brcm,bcm7038-l1-intc.yaml
```yaml
# SPDX-License-Identifier: (GPL-2.0-only OR BSD-2-Clause)
%YAML 1.2
---
$id: http://devicetree.org/schemas/interrupt-controller/brcm,bcm7038-l1-intc.yaml#
$schema: http://devicetree.org/meta-schemas/core.yaml#

title: Broadcom BCM7038-style Level 1 interrupt controller

description: >
  This block is a first level interrupt controller that is typically connected
  directly to one of the HW INT lines on each CPU.  Every BCM7xxx set-top chip
  since BCM7038 has contained this hardware.

  Key elements of the hardware design include:

   - 64, 96, 128, or 160 incoming level IRQ lines

   - Most onchip peripherals are wired directly to an L1 input

   - A separate instance of the register set for each CPU, allowing individual
     peripheral IRQs to be routed to any CPU

   - Atomic mask/unmask operations

   - No polarity/level/edge settings

   - No FIFO or priority encoder logic; software is expected to read all
     2-5 status words to determine which IRQs are pending

   If multiple reg ranges and interrupt-parent entries are present on an SMP
   system, the driver will allow IRQ SMP affinity to be set up through the
   /proc/irq/ interface.  In the simplest possible configuration, only one
   reg range and one interrupt-parent is needed.

maintainers:
  - Florian Fainelli <f.fainelli@gmail.com>

allOf:
  - $ref: /schemas/interrupt-controller.yaml#

properties:
  compatible:
    const: brcm,bcm7038-l1-intc

  reg:
    description: >
      Specifies the base physical address and size of the registers
      the number of supported IRQs is inferred from the size argument

  interrupt-controller: true

  "#interrupt-cells":
    const: 1

  interrupts:
    description: >
     Specifies the interrupt line(s) in the interrupt-parent controller node;
     valid values depend on the type of parent interrupt controller

  brcm,irq-can-wake:
    type: boolean
    description: >
      If present, this means the L1 controller can be used as a
      wakeup source for system suspend/resume.

  brcm,int-fwd-mask:
    $ref: /schemas/types.yaml#/definitions/uint32-array
    description:
      If present, a bit mask to indicate which interrupts have already been
      configured by the firmware and should be left unmanaged. This should
      have one 32-bit word per status/set/clear/mask group.

required:
  - compatible
  - reg
  - interrupt-controller
  - "#interrupt-cells"
  - interrupts

additionalProperties: false

examples:
  - |
    periph_intc: interrupt-controller@1041a400 {
      compatible = "brcm,bcm7038-l1-intc";
      reg = <0x1041a400 0x30>, <0x1041a600 0x30>;
      interrupt-controller;
      #interrupt-cells = <1>;
      interrupt-parent = <&cpu_intc>;
      interrupts = <2>, <3>;
    };
```

## Documentation/devicetree/bindings/interrupt-controller/brcm,bcm7120-l2-intc.txt
```
Broadcom BCM7120-style Level 2 interrupt controller

This interrupt controller hardware is a second level interrupt controller that
is hooked to a parent interrupt controller: e.g: ARM GIC for ARM-based
platforms. It can be found on BCM7xxx products starting with BCM7120.

Such an interrupt controller has the following hardware design:

- outputs multiple interrupts signals towards its interrupt controller parent

- controls how some of the interrupts will be flowing, whether they will
  directly output an interrupt signal towards the interrupt controller parent,
  or if they will output an interrupt signal at this 2nd level interrupt
  controller, in particular for UARTs

- typically has one 32-bit enable word and one 32-bit status word, but on
  some hardware may have more than one enable/status pair

- no atomic set/clear operations

- not all bits within the interrupt controller actually map to an interrupt

The typical hardware layout for this controller is represented below:

2nd level interrupt line		Outputs for the parent controller (e.g: ARM GIC)

0 -----[ MUX ] ------------|==========> GIC interrupt 75
          \-----------\
                       |
1 -----[ MUX ] --------)---|==========> GIC interrupt 76
          \------------|
                       |
2 -----[ MUX ] --------)---|==========> GIC interrupt 77
          \------------|
                       |
3 ---------------------|
4 ---------------------|
5 ---------------------|
7 ---------------------|---|===========> GIC interrupt 66
9 ---------------------|
10 --------------------|
11 --------------------/

6 ------------------------\
                           |===========> GIC interrupt 64
8 ------------------------/

12 ........................ X
13 ........................ X 		(not connected)
..
31 ........................ X

Required properties:

- compatible: should be "brcm,bcm7120-l2-intc"
- reg: specifies the base physical address and size of the registers;
  multiple pairs may be specified, with the first pair handling IRQ offsets
  0..31 and the second pair handling 32..63
- interrupt-controller: identifies the node as an interrupt controller
- #interrupt-cells: specifies the number of cells needed to encode an interrupt
  source, should be 1.
- interrupt-parent: specifies the phandle to the parent interrupt controller
  this one is cascaded from
- interrupts: specifies the interrupt line(s) in the interrupt-parent controller
  node, valid values depend on the type of parent interrupt controller
- brcm,int-map-mask: 32-bits bit mask describing how many and which interrupts
  are wired to this 2nd level interrupt controller, and how they match their
  respective interrupt parents. Should match exactly the number of interrupts
  specified in the 'interrupts' property, multiplied by the number of
  enable/status register pairs implemented by this controller.  For
  multiple parent IRQs with multiple enable/status words, this looks like:
  <irq0_w0 irq0_w1 irq1_w0 irq1_w1 ...>

Optional properties:

- brcm,irq-can-wake: if present, this means the L2 controller can be used as a
  wakeup source for system suspend/resume.

- brcm,int-fwd-mask: if present, a bit mask to configure the interrupts which
  have a mux gate, typically UARTs. Setting these bits will make their
  respective interrupt outputs bypass this 2nd level interrupt controller
  completely; it is completely transparent for the interrupt controller
  parent. This should have one 32-bit word per enable/status pair.

Example:

irq0_intc: interrupt-controller@f0406800 {
	compatible = "brcm,bcm7120-l2-intc";
	interrupt-parent = <&intc>;
	#interrupt-cells = <1>;
	reg = <0xf0406800 0x8>;
	interrupt-controller;
	interrupts = <0x0 0x42 0x0>, <0x0 0x40 0x0>;
	brcm,int-map-mask = <0xeb8>, <0x140>;
	brcm,int-fwd-mask = <0x7>;
};
```
