## Documentation/devicetree/bindings/interrupt-controller/aspeed,ast2xxx-scu-ic.txt
```
Aspeed AST25XX, AST26XX and AST27xx SCU Interrupt Controller

Required Properties:
 - #interrupt-cells		: must be 1
 - compatible			: must be "aspeed,ast2500-scu-ic",
				  "aspeed,ast2600-scu-ic0",
				  "aspeed,ast2600-scu-ic1",
                  "aspeed,ast2700-scu-ic0" or
                  "aspeed,ast2700-scu-ic1"
 - interrupts			: interrupt from the parent controller
 - interrupt-controller		: indicates that the controller receives and
				  fires new interrupts for child busses

Example:

    syscon@1e6e2000 {
        ranges = <0 0x1e6e2000 0x1a8>;

        scu_ic: interrupt-controller@18 {
            #interrupt-cells = <1>;
            compatible = "aspeed,ast2500-scu-ic";
            interrupts = <21>;
            interrupt-controller;
        };
    };
```

## Documentation/devicetree/bindings/interrupt-controller/atmel,aic.txt
```
* Advanced Interrupt Controller (AIC)

Required properties:
- compatible: Should be "atmel,<chip>-aic"
  <chip> can be "at91rm9200", "sama5d3" or "sama5d4"
- interrupt-controller: Identifies the node as an interrupt controller.
- interrupt-parent: For single AIC system, it is an empty property.
- #interrupt-cells: The number of cells to define the interrupts. It should be 3.
  The first cell is the IRQ number (aka "Peripheral IDentifier" on datasheet).
  The second cell is used to specify flags:
    bits[3:0] trigger type and level flags:
      1 = low-to-high edge triggered.
      2 = high-to-low edge triggered.
      4 = active high level-sensitive.
      8 = active low level-sensitive.
      Valid combinations are 1, 2, 3, 4, 8.
      Default flag for internal sources should be set to 4 (active high).
  The third cell is used to specify the irq priority from 0 (lowest) to 7
  (highest).
- reg: Should contain AIC registers location and length
- atmel,external-irqs: u32 array of external irqs.

Examples:
	/*
	 * AIC
	 */
	aic: interrupt-controller@fffff000 {
		compatible = "atmel,at91rm9200-aic";
		interrupt-controller;
		interrupt-parent;
		#interrupt-cells = <3>;
		reg = <0xfffff000 0x200>;
	};

	/*
	 * An interrupt generating device that is wired to an AIC.
	 */
	dma: dma-controller@ffffec00 {
		compatible = "atmel,at91sam9g45-dma";
		reg = <0xffffec00 0x200>;
		interrupts = <21 4 5>;
	};
```

## Documentation/devicetree/bindings/interrupt-controller/atmel,aic.yaml
```yaml
# SPDX-License-Identifier: (GPL-2.0 OR BSD-2-Clause)
%YAML 1.2
---
$id: http://devicetree.org/schemas/interrupt-controller/atmel,aic.yaml#
$schema: http://devicetree.org/meta-schemas/core.yaml#

title: Advanced Interrupt Controller (AIC)

maintainers:
  - Nicolas Ferre <nicolas.ferre@microchip.com>
  - Dharma balasubiramani <dharma.b@microchip.com>

description:
  The Advanced Interrupt Controller (AIC) is an 8-level priority, individually
  maskable, vectored interrupt controller providing handling of up to one
  hundred and twenty-eight interrupt sources.

properties:
  compatible:
    enum:
      - atmel,at91rm9200-aic
      - atmel,sama5d2-aic
      - atmel,sama5d3-aic
      - atmel,sama5d4-aic
      - microchip,sam9x60-aic

  reg:
    maxItems: 1

  interrupt-controller: true

  "#interrupt-cells":
    const: 3
    description: |
      The 1st cell is the IRQ number (Peripheral IDentifier on datasheet).
      The 2nd cell specifies flags:
        bits[3:0] trigger type and level flags:
          1 = low-to-high edge triggered.
          2 = high-to-low edge triggered.
          4 = active high level-sensitive.
          8 = active low level-sensitive.
        Valid combinations: 1, 2, 3, 4, 8.
        Default for internal sources: 4 (active high).
      The 3rd cell specifies irq priority from 0 (lowest) to 7 (highest).

  interrupts:
    maxItems: 1

  atmel,external-irqs:
    $ref: /schemas/types.yaml#/definitions/uint32-array
    description: u32 array of external irqs.

allOf:
  - $ref: /schemas/interrupt-controller.yaml#
  - if:
      properties:
        compatible:
          contains:
            const: atmel,at91rm9200-aic
    then:
      properties:
        atmel,external-irqs:
          minItems: 1
          maxItems: 7
    else:
      properties:
        atmel,external-irqs:
          minItems: 1
          maxItems: 1

required:
  - compatible
  - reg
  - interrupt-controller
  - "#interrupt-cells"
  - atmel,external-irqs

unevaluatedProperties: false

examples:
  - |
    interrupt-controller@fffff000 {
      compatible = "atmel,at91rm9200-aic";
      reg = <0xfffff000 0x200>;
      interrupt-controller;
      #interrupt-cells = <3>;
      atmel,external-irqs = <31>;
    };
...
```

## Documentation/devicetree/bindings/interrupt-controller/axis,crisv32-intc.txt
```
* CRISv32 Interrupt Controller

Interrupt controller for the CRISv32 SoCs.

Main node required properties:

- compatible : should be:
	"axis,crisv32-intc"
- interrupt-controller : Identifies the node as an interrupt controller
- #interrupt-cells : Specifies the number of cells needed to encode an
  interrupt source. The type shall be a <u32> and the value shall be 1.
- reg: physical base address and size of the intc registers map.

Example:

	intc: interrupt-controller {
		compatible = "axis,crisv32-intc";
		reg = <0xb001c000 0x1000>;
		interrupt-controller;
		#interrupt-cells = <1>;
	};
```

## Documentation/devicetree/bindings/interrupt-controller/brcm,bcm2712-msix.yaml
```yaml
# SPDX-License-Identifier: (GPL-2.0-only OR BSD-2-Clause)
%YAML 1.2
---
$id: http://devicetree.org/schemas/interrupt-controller/brcm,bcm2712-msix.yaml#
$schema: http://devicetree.org/meta-schemas/core.yaml#

title: Broadcom bcm2712 MSI-X Interrupt Peripheral support

maintainers:
  - Stanimir Varbanov <svarbanov@suse.de>

description:
  This interrupt controller is used to provide interrupt vectors to the
  generic interrupt controller (GIC) on bcm2712. It will be used as
  external MSI-X controller for PCIe root complex.

allOf:
  - $ref: /schemas/interrupt-controller/msi-controller.yaml#

properties:
  compatible:
    const: brcm,bcm2712-mip

  reg:
    items:
      - description: Base register address
      - description: PCIe message address

  "#msi-cells":
    const: 0

  brcm,msi-offset:
    $ref: /schemas/types.yaml#/definitions/uint32
    description: Shift the allocated MSI's.

unevaluatedProperties: false

required:
  - compatible
  - reg
  - msi-controller
  - msi-ranges

examples:
  - |
    #include <dt-bindings/interrupt-controller/arm-gic.h>

    axi {
        #address-cells = <2>;
        #size-cells = <2>;

        msi-controller@1000130000 {
            compatible = "brcm,bcm2712-mip";
            reg = <0x10 0x00130000 0x00 0xc0>,
                  <0xff 0xfffff000 0x00 0x1000>;
            msi-controller;
            #msi-cells = <0>;
            msi-ranges = <&gicv2 GIC_SPI 128 IRQ_TYPE_EDGE_RISING 64>;
        };
    };
```

## Documentation/devicetree/bindings/interrupt-controller/brcm,bcm2835-armctrl-ic.txt
```
BCM2835 Top-Level ("ARMCTRL") Interrupt Controller

The BCM2835 contains a custom top-level interrupt controller, which supports
72 interrupt sources using a 2-level register scheme. The interrupt
controller, or the HW block containing it, is referred to occasionally
as "armctrl" in the SoC documentation, hence naming of this binding.

The BCM2836 contains the same interrupt controller with the same
interrupts, but the per-CPU interrupt controller is the root, and an
interrupt there indicates that the ARMCTRL has an interrupt to handle.

Required properties:

- compatible : should be "brcm,bcm2835-armctrl-ic" or
                 "brcm,bcm2836-armctrl-ic"
- reg : Specifies base physical address and size of the registers.
- interrupt-controller : Identifies the node as an interrupt controller
- #interrupt-cells : Specifies the number of cells needed to encode an
  interrupt source. The value shall be 2.

  The 1st cell is the interrupt bank; 0 for interrupts in the "IRQ basic
  pending" register, or 1/2 respectively for interrupts in the "IRQ pending
  1/2" register.

  The 2nd cell contains the interrupt number within the bank. Valid values
  are 0..7 for bank 0, and 0..31 for bank 1.

Additional required properties for brcm,bcm2836-armctrl-ic:
- interrupt-parent : Specifies the parent interrupt controller when this
  controller is the second level.
- interrupts : Specifies the interrupt on the parent for this interrupt
  controller to handle.

The interrupt sources are as follows:

Bank 0:
0: ARM_TIMER
1: ARM_MAILBOX
2: ARM_DOORBELL_0
3: ARM_DOORBELL_1
4: VPU0_HALTED
5: VPU1_HALTED
6: ILLEGAL_TYPE0
7: ILLEGAL_TYPE1

Bank 1:
0: TIMER0
1: TIMER1
2: TIMER2
3: TIMER3
4: CODEC0
5: CODEC1
6: CODEC2
7: VC_JPEG
8: ISP
9: VC_USB
10: VC_3D
11: TRANSPOSER
12: MULTICORESYNC0
13: MULTICORESYNC1
14: MULTICORESYNC2
15: MULTICORESYNC3
16: DMA0
17: DMA1
18: VC_DMA2
19: VC_DMA3
20: DMA4
21: DMA5
22: DMA6
23: DMA7
24: DMA8
25: DMA9
26: DMA10
27: DMA11
28: DMA12
29: AUX
30: ARM
31: VPUDMA

Bank 2:
0: HOSTPORT
1: VIDEOSCALER
2: CCP2TX
3: SDC
4: DSI0
5: AVE
6: CAM0
7: CAM1
8: HDMI0
9: HDMI1
10: PIXELVALVE1
11: I2CSPISLV
12: DSI1
13: PWA0
14: PWA1
15: CPR
16: SMI
17: GPIO0
18: GPIO1
19: GPIO2
20: GPIO3
21: VC_I2C
22: VC_SPI
23: VC_I2SPCM
24: VC_SDIO
25: VC_UART
26: SLIMBUS
27: VEC
28: CPG
29: RNG
30: VC_ARASANSDIO
31: AVSPMON

Example:

/* BCM2835, first level */
intc: interrupt-controller {
	compatible = "brcm,bcm2835-armctrl-ic";
	reg = <0x7e00b200 0x200>;
	interrupt-controller;
	#interrupt-cells = <2>;
};

/* BCM2836, second level */
intc: interrupt-controller {
	compatible = "brcm,bcm2836-armctrl-ic";
	reg = <0x7e00b200 0x200>;
	interrupt-controller;
	#interrupt-cells = <2>;

	interrupt-parent = <&local_intc>;
	interrupts = <8>;
};
```

## Documentation/devicetree/bindings/interrupt-controller/brcm,bcm2835-armctrl-ic.yaml
```yaml
%YAML 1.2
---
$id: http://devicetree.org/schemas/interrupt-controller/brcm,bcm2835-armctrl-ic.yaml#
$schema: http://devicetree.org/meta-schemas/core.yaml#

title: BCM2835 ARMCTRL Interrupt Controller

maintainers:
  - Florian Fainelli <florian.fainelli@broadcom.com>
  - Raspberry Pi Kernel Maintenance <kernel-list@raspberrypi.com>

description: >
  The BCM2835 contains a custom top-level interrupt controller, which supports
  72 interrupt sources using a 2-level register scheme. The interrupt
  controller, or the HW block containing it, is referred to occasionally as
  "armctrl" in the SoC documentation, hence naming of this binding.

  The BCM2836 contains the same interrupt controller with the same interrupts,
  but the per-CPU interrupt controller is the root, and an interrupt there
  indicates that the ARMCTRL has an interrupt to handle.

  The interrupt sources are as follows:

  Bank 0:
    0: ARM_TIMER
    1: ARM_MAILBOX
    2: ARM_DOORBELL_0
    3: ARM_DOORBELL_1
    4: VPU0_HALTED
    5: VPU1_HALTED
    6: ILLEGAL_TYPE0
    7: ILLEGAL_TYPE1

  Bank 1:
    0: TIMER0
    1: TIMER1
    2: TIMER2
    3: TIMER3
    4: CODEC0
    5: CODEC1
    6: CODEC2
    7: VC_JPEG
    8: ISP
    9: VC_USB
    10: VC_3D
    11: TRANSPOSER
    12: MULTICORESYNC0
    13: MULTICORESYNC1
    14: MULTICORESYNC2
    15: MULTICORESYNC3
    16: DMA0
    17: DMA1
    18: VC_DMA2
    19: VC_DMA3
    20: DMA4
    21: DMA5
    22: DMA6
    23: DMA7
    24: DMA8
    25: DMA9
    26: DMA10
    27: DMA11-14 - shared interrupt for DMA 11 to 14
    28: DMAALL - triggers on all dma interrupts (including channel 15)
    29: AUX
    30: ARM
    31: VPUDMA

  Bank 2:
    0: HOSTPORT
    1: VIDEOSCALER
    2: CCP2TX
    3: SDC
    4: DSI0
    5: AVE
    6: CAM0
    7: CAM1
    8: HDMI0
    9: HDMI1
    10: PIXELVALVE1
    11: I2CSPISLV
    12: DSI1
    13: PWA0
    14: PWA1
    15: CPR
    16: SMI
    17: GPIO0
    18: GPIO1
    19: GPIO2
    20: GPIO3
    21: VC_I2C
    22: VC_SPI
    23: VC_I2SPCM
    24: VC_SDIO
    25: VC_UART
    26: SLIMBUS
    27: VEC
    28: CPG
    29: RNG
    30: VC_ARASANSDIO
    31: AVSPMON

properties:
  compatible:
    enum:
      - brcm,bcm2835-armctrl-ic
      - brcm,bcm2836-armctrl-ic

  reg:
    maxItems: 1

  interrupt-controller: true

  '#interrupt-cells':
    const: 2
    description: >
      The 1st cell is the interrupt bank; 0 for interrupts in the "IRQ basic
      pending" register, or 1/2 respectively for interrupts in the "IRQ pending
      1/2" register.

      The 2nd cell contains the interrupt number within the bank. Valid values
      are 0..7 for bank 0, and 0..31 for bank 1.

  interrupts:
    maxItems: 1

required:
  - compatible
  - reg
  - interrupt-controller
  - '#interrupt-cells'

allOf:
  - if:
      properties:
        compatible:
          contains:
            const: brcm,bcm2836-armctrl-ic
    then:
      required:
        - interrupts
    else:
      properties:
        interrupts: false

additionalProperties: false

examples:
  - |
    interrupt-controller@7e00b200 {
        compatible = "brcm,bcm2835-armctrl-ic";
        reg = <0x7e00b200 0x200>;
        interrupt-controller;
        #interrupt-cells = <2>;
    };
  - |
    interrupt-controller@7e00b200 {
        compatible = "brcm,bcm2836-armctrl-ic";
        reg = <0x7e00b200 0x200>;
        interrupt-controller;
        #interrupt-cells = <2>;
        interrupts = <8>;
    };
```

## Documentation/devicetree/bindings/interrupt-controller/brcm,bcm2836-l1-intc.yaml
```yaml
# SPDX-License-Identifier: (GPL-2.0-only OR BSD-2-Clause)
%YAML 1.2
---
$id: http://devicetree.org/schemas/interrupt-controller/brcm,bcm2836-l1-intc.yaml#
$schema: http://devicetree.org/meta-schemas/core.yaml#

title: BCM2836 per-CPU interrupt controller

maintainers:
  - Stefan Wahren <wahrenst@gmx.net>
  - Raspberry Pi Kernel Maintenance <kernel-list@raspberrypi.com>

description:
  The BCM2836 has a per-cpu interrupt controller for the timer, PMU
  events, and SMP IPIs. One of the CPUs may receive interrupts for the
  peripheral (GPU) events, which chain to the BCM2835-style interrupt
  controller.

allOf:
  - $ref: /schemas/interrupt-controller.yaml#

properties:
  compatible:
    const: brcm,bcm2836-l1-intc

  reg:
    maxItems: 1

  interrupt-controller: true

  '#interrupt-cells':
    const: 2

required:
  - compatible
  - reg
  - interrupt-controller
  - '#interrupt-cells'

additionalProperties: false

examples:
  - |
    local_intc: interrupt-controller@40000000 {
        compatible = "brcm,bcm2836-l1-intc";
        reg = <0x40000000 0x100>;
        interrupt-controller;
        #interrupt-cells = <2>;
        interrupt-parent = <&local_intc>;
    };
...
```
