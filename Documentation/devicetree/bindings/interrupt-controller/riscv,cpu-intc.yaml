## Documentation/devicetree/bindings/interrupt-controller/riscv,cpu-intc.yaml
```yaml
# SPDX-License-Identifier: GPL-2.0 OR BSD-2-Clause
%YAML 1.2
---
$id: http://devicetree.org/schemas/interrupt-controller/riscv,cpu-intc.yaml#
$schema: http://devicetree.org/meta-schemas/core.yaml#

title: RISC-V Hart-Level Interrupt Controller (HLIC)

description:
  RISC-V cores include Control Status Registers (CSRs) which are local to
  each CPU core (HART in RISC-V terminology) and can be read or written by
  software. Some of these CSRs are used to control local interrupts connected
  to the core. Every interrupt is ultimately routed through a hart's HLIC
  before it interrupts that hart.

  The RISC-V supervisor ISA manual specifies three interrupt sources that are
  attached to every HLIC namely software interrupts, the timer interrupt, and
  external interrupts. Software interrupts are used to send IPIs between
  cores.  The timer interrupt comes from an architecturally mandated real-
  time timer that is controlled via Supervisor Binary Interface (SBI) calls
  and CSR reads. External interrupts connect all other device interrupts to
  the HLIC, which are routed via the platform-level interrupt controller
  (PLIC).

  All RISC-V systems that conform to the supervisor ISA specification are
  required to have a HLIC with these three interrupt sources present.  Since
  the interrupt map is defined by the ISA it's not listed in the HLIC's device
  tree entry, though external interrupt controllers (like the PLIC, for
  example) will need to define how their interrupts map to the relevant HLICs.
  This means a PLIC interrupt property will typically list the HLICs for all
  present HARTs in the system.

maintainers:
  - Palmer Dabbelt <palmer@dabbelt.com>
  - Paul Walmsley <paul.walmsley@sifive.com>

properties:
  compatible:
    oneOf:
      - items:
          - const: andestech,cpu-intc
          - const: riscv,cpu-intc
      - const: riscv,cpu-intc

  interrupt-controller: true

  '#interrupt-cells':
    const: 1
    description: |
      The interrupt sources are defined by the RISC-V supervisor ISA manual,
      with only the following three interrupts being defined for
      supervisor mode:
        - Source 1 is the supervisor software interrupt, which can be sent by
          an SBI call and is reserved for use by software.
        - Source 5 is the supervisor timer interrupt, which can be configured
          by SBI calls and implements a one-shot timer.
        - Source 9 is the supervisor external interrupt, which chains to all
          other device interrupts.

required:
  - compatible
  - '#interrupt-cells'
  - interrupt-controller

additionalProperties: false

examples:
  - |
    interrupt-controller {
        #interrupt-cells = <1>;
        compatible = "riscv,cpu-intc";
        interrupt-controller;
    };
```

## Documentation/devicetree/bindings/interrupt-controller/riscv,imsics.yaml
```yaml
# SPDX-License-Identifier: (GPL-2.0-only OR BSD-2-Clause)
%YAML 1.2
---
$id: http://devicetree.org/schemas/interrupt-controller/riscv,imsics.yaml#
$schema: http://devicetree.org/meta-schemas/core.yaml#

title: RISC-V Incoming MSI Controller (IMSIC)

maintainers:
  - Anup Patel <anup@brainfault.org>

description: |
  The RISC-V advanced interrupt architecture (AIA) defines a per-CPU incoming
  MSI controller (IMSIC) for handling MSIs in a RISC-V platform. The RISC-V
  AIA specification can be found at https://github.com/riscv/riscv-aia.

  The IMSIC is a per-CPU (or per-HART) device with separate interrupt file
  for each privilege level (machine or supervisor). The configuration of
  a IMSIC interrupt file is done using AIA CSRs and it also has a 4KB MMIO
  space to receive MSIs from devices. Each IMSIC interrupt file supports a
  fixed number of interrupt identities (to distinguish MSIs from devices)
  which is same for given privilege level across CPUs (or HARTs).

  The device tree of a RISC-V platform will have one IMSIC device tree node
  for each privilege level (machine or supervisor) which collectively describe
  IMSIC interrupt files at that privilege level across CPUs (or HARTs).

  The arrangement of IMSIC interrupt files in MMIO space of a RISC-V platform
  follows a particular scheme defined by the RISC-V AIA specification. A IMSIC
  group is a set of IMSIC interrupt files co-located in MMIO space and we can
  have multiple IMSIC groups (i.e. clusters, sockets, chiplets, etc) in a
  RISC-V platform. The MSI target address of a IMSIC interrupt file at given
  privilege level (machine or supervisor) encodes group index, HART index,
  and guest index (shown below).

  XLEN-1            > (HART Index MSB)                  12    0
  |                  |                                  |     |
  -------------------------------------------------------------
  |xxxxxx|Group Index|xxxxxxxxxxx|HART Index|Guest Index|  0  |
  -------------------------------------------------------------

allOf:
  - $ref: /schemas/interrupt-controller.yaml#
  - $ref: /schemas/interrupt-controller/msi-controller.yaml#

properties:
  compatible:
    items:
      - enum:
          - qemu,imsics
      - const: riscv,imsics

  reg:
    minItems: 1
    maxItems: 16384
    description:
      Base address of each IMSIC group.

  interrupt-controller: true

  "#interrupt-cells":
    const: 0

  msi-controller: true

  "#msi-cells":
    const: 0

  interrupts-extended:
    minItems: 1
    maxItems: 16384
    description:
      This property represents the set of CPUs (or HARTs) for which given
      device tree node describes the IMSIC interrupt files. Each node pointed
      to should be a riscv,cpu-intc node, which has a CPU node (i.e. RISC-V
      HART) as parent.

  riscv,num-ids:
    $ref: /schemas/types.yaml#/definitions/uint32
    minimum: 63
    maximum: 2047
    description:
      Number of interrupt identities supported by IMSIC interrupt file.

  riscv,num-guest-ids:
    $ref: /schemas/types.yaml#/definitions/uint32
    minimum: 63
    maximum: 2047
    description:
      Number of interrupt identities are supported by IMSIC guest interrupt
      file. When not specified it is assumed to be same as specified by the
      riscv,num-ids property.

  riscv,guest-index-bits:
    minimum: 0
    maximum: 7
    default: 0
    description:
      Number of guest index bits in the MSI target address.

  riscv,hart-index-bits:
    minimum: 0
    maximum: 15
    description:
      Number of HART index bits in the MSI target address. When not
      specified it is calculated based on the interrupts-extended property.

  riscv,group-index-bits:
    minimum: 0
    maximum: 7
    default: 0
    description:
      Number of group index bits in the MSI target address.

  riscv,group-index-shift:
    $ref: /schemas/types.yaml#/definitions/uint32
    minimum: 0
    maximum: 55
    default: 24
    description:
      The least significant bit position of the group index bits in the
      MSI target address.

required:
  - compatible
  - reg
  - interrupt-controller
  - msi-controller
  - "#msi-cells"
  - interrupts-extended
  - riscv,num-ids

unevaluatedProperties: false

examples:
  - |
    // Example 1 (Machine-level IMSIC files with just one group):

    interrupt-controller@24000000 {
      compatible = "qemu,imsics", "riscv,imsics";
      interrupts-extended = <&cpu1_intc 11>,
                            <&cpu2_intc 11>,
                            <&cpu3_intc 11>,
                            <&cpu4_intc 11>;
      reg = <0x28000000 0x4000>;
      interrupt-controller;
      #interrupt-cells = <0>;
      msi-controller;
      #msi-cells = <0>;
      riscv,num-ids = <127>;
    };

  - |
    // Example 2 (Supervisor-level IMSIC files with two groups):

    interrupt-controller@28000000 {
      compatible = "qemu,imsics", "riscv,imsics";
      interrupts-extended = <&cpu1_intc 9>,
                            <&cpu2_intc 9>,
                            <&cpu3_intc 9>,
                            <&cpu4_intc 9>;
      reg = <0x28000000 0x2000>, /* Group0 IMSICs */
            <0x29000000 0x2000>; /* Group1 IMSICs */
      interrupt-controller;
      #interrupt-cells = <0>;
      msi-controller;
      #msi-cells = <0>;
      riscv,num-ids = <127>;
      riscv,group-index-bits = <1>;
      riscv,group-index-shift = <24>;
    };
...
```

## Documentation/devicetree/bindings/interrupt-controller/riscv,rpmi-mpxy-system-msi.yaml
```yaml
# SPDX-License-Identifier: (GPL-2.0-only OR BSD-2-Clause)
%YAML 1.2
---
$id: http://devicetree.org/schemas/interrupt-controller/riscv,rpmi-mpxy-system-msi.yaml#
$schema: http://devicetree.org/meta-schemas/core.yaml#

title: RISC-V RPMI system MSI service group based message proxy

maintainers:
  - Anup Patel <anup@brainfault.org>

description: |
  The RISC-V Platform Management Interface (RPMI) [1] defines a
  messaging protocol which is modular and extensible. The supervisor
  software can send/receive RPMI messages via SBI MPXY extension [2]
  or some dedicated supervisor-mode RPMI transport.

  The RPMI specification [1] defines system MSI service group which
  allow application processors to receive MSIs upon system events
  such as P2A doorbell, graceful shutdown/reboot request, CPU hotplug
  event, memory hotplug event, etc from the platform microcontroller.
  The SBI implementation (machine mode firmware or hypervisor) can
  implement an SBI MPXY channel to allow RPMI system MSI service
  group access to the supervisor software.

  ===========================================
  References
  ===========================================

  [1] RISC-V Platform Management Interface (RPMI) v1.0 (or higher)
      https://github.com/riscv-non-isa/riscv-rpmi/releases

  [2] RISC-V Supervisor Binary Interface (SBI) v3.0 (or higher)
      https://github.com/riscv-non-isa/riscv-sbi-doc/releases

properties:
  compatible:
    description:
      Intended for use by the SBI implementation.
    const: riscv,rpmi-mpxy-system-msi

  mboxes:
    maxItems: 1
    description:
      Mailbox channel of the underlying RPMI transport.

  riscv,sbi-mpxy-channel-id:
    $ref: /schemas/types.yaml#/definitions/uint32
    description:
      The SBI MPXY channel id to be used for providing RPMI access to
      the supervisor software.

required:
  - compatible
  - mboxes
  - riscv,sbi-mpxy-channel-id

additionalProperties: false

examples:
  - |
    interrupt-controller {
        compatible = "riscv,rpmi-mpxy-system-msi";
        mboxes = <&rpmi_shmem_mbox 0x2>;
        riscv,sbi-mpxy-channel-id = <0x2000>;
    };
...
```

## Documentation/devicetree/bindings/interrupt-controller/riscv,rpmi-system-msi.yaml
```yaml
# SPDX-License-Identifier: (GPL-2.0-only OR BSD-2-Clause)
%YAML 1.2
---
$id: http://devicetree.org/schemas/interrupt-controller/riscv,rpmi-system-msi.yaml#
$schema: http://devicetree.org/meta-schemas/core.yaml#

title: RISC-V RPMI system MSI service group based interrupt controller

maintainers:
  - Anup Patel <anup@brainfault.org>

description: |
  The RISC-V Platform Management Interface (RPMI) [1] defines a
  messaging protocol which is modular and extensible. The supervisor
  software can send/receive RPMI messages via SBI MPXY extension [2]
  or some dedicated supervisor-mode RPMI transport.

  The RPMI specification [1] defines system MSI service group which
  allow application processors to receive MSIs upon system events
  such as P2A doorbell, graceful shutdown/reboot request, CPU hotplug
  event, memory hotplug event, etc from the platform microcontroller.
  The supervisor software can access RPMI system MSI service group via
  SBI MPXY channel or some dedicated supervisor-mode RPMI transport.

  ===========================================
  References
  ===========================================

  [1] RISC-V Platform Management Interface (RPMI) v1.0 (or higher)
      https://github.com/riscv-non-isa/riscv-rpmi/releases

  [2] RISC-V Supervisor Binary Interface (SBI) v3.0 (or higher)
      https://github.com/riscv-non-isa/riscv-sbi-doc/releases

allOf:
  - $ref: /schemas/interrupt-controller.yaml#

properties:
  compatible:
    description:
      Intended for use by the supervisor software.
    const: riscv,rpmi-system-msi

  mboxes:
    maxItems: 1
    description:
      Mailbox channel of the underlying RPMI transport or SBI message proxy channel.

  msi-parent: true

  interrupt-controller: true

  "#interrupt-cells":
    const: 1

required:
  - compatible
  - mboxes
  - msi-parent
  - interrupt-controller
  - "#interrupt-cells"

additionalProperties: false

examples:
  - |
    interrupt-controller {
        compatible = "riscv,rpmi-system-msi";
        mboxes = <&mpxy_mbox 0x2000 0x0>;
        msi-parent = <&imsic_slevel>;
        interrupt-controller;
        #interrupt-cells = <1>;
    };
...
```
