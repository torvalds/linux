## Documentation/devicetree/bindings/interrupt-controller/sophgo,sg2042-msi.yaml
```yaml
# SPDX-License-Identifier: (GPL-2.0 OR BSD-2-Clause)
%YAML 1.2
---
$id: http://devicetree.org/schemas/interrupt-controller/sophgo,sg2042-msi.yaml#
$schema: http://devicetree.org/meta-schemas/core.yaml#

title: Sophgo SG2042 MSI Controller

maintainers:
  - Chen Wang <unicorn_wang@outlook.com>

description:
  This interrupt controller is in Sophgo SG2042 for transforming interrupts from
  PCIe MSI to PLIC interrupts.

allOf:
  - $ref: /schemas/interrupt-controller/msi-controller.yaml#

properties:
  compatible:
    enum:
      - sophgo,sg2042-msi
      - sophgo,sg2044-msi

  reg:
    items:
      - description: clear register
      - description: msi doorbell address

  reg-names:
    items:
      - const: clr
      - const: doorbell

  msi-controller: true

  msi-ranges:
    maxItems: 1

  "#msi-cells":
    const: 0

required:
  - compatible
  - reg
  - reg-names
  - msi-controller
  - msi-ranges
  - "#msi-cells"

unevaluatedProperties: false

examples:
  - |
    #include <dt-bindings/interrupt-controller/irq.h>
    msi-controller@30000000 {
      compatible = "sophgo,sg2042-msi";
      reg = <0x30000000 0x4>, <0x30000008 0x4>;
      reg-names = "clr", "doorbell";
      msi-controller;
      #msi-cells = <0>;
      msi-ranges = <&plic 64 IRQ_TYPE_LEVEL_HIGH 32>;
    };
```

## Documentation/devicetree/bindings/interrupt-controller/st,spear300-shirq.yaml
```yaml
# SPDX-License-Identifier: (GPL-2.0-only OR BSD-2-Clause)
%YAML 1.2
---
$id: http://devicetree.org/schemas/interrupt-controller/st,spear300-shirq.yaml#
$schema: http://devicetree.org/meta-schemas/core.yaml#

title: SPEAr3xx Shared IRQ controller

maintainers:
  - Viresh Kumar <vireshk@kernel.org>
  - Shiraz Hashim <shiraz.linux.kernel@gmail.com>

description: |
  SPEAr3xx architecture includes shared/multiplexed irqs for certain set of
  devices. The multiplexor provides a single interrupt to parent interrupt
  controller (VIC) on behalf of a group of devices.

  There can be multiple groups available on SPEAr3xx variants but not exceeding
  4. The number of devices in a group can differ, further they may share same
  set of status/mask registers spanning across different bit masks. Also in some
  cases the group may not have enable or other registers. This makes software
  little complex.

  A single node in the device tree is used to describe the shared interrupt
  multiplexer (one node for all groups). A group in the interrupt controller
  shares config/control registers with other groups. For example, a 32-bit
  interrupt enable/disable config register can accommodate up to 4 interrupt
  groups.

properties:
  compatible:
    enum:
      - st,spear300-shirq
      - st,spear310-shirq
      - st,spear320-shirq

  reg:
    maxItems: 1

  '#interrupt-cells':
    const: 1

  interrupt-controller: true

  interrupts:
    description: Interrupt specifier array for SHIRQ groups
    minItems: 1
    maxItems: 4

required:
  - compatible
  - reg
  - '#interrupt-cells'
  - interrupt-controller
  - interrupts

additionalProperties: false

examples:
  - |
    interrupt-controller@b3000000 {
        compatible = "st,spear320-shirq";
        reg = <0xb3000000 0x1000>;
        interrupts = <28 29 30 1>;
        #interrupt-cells = <1>;
        interrupt-controller;
    };
```

## Documentation/devicetree/bindings/interrupt-controller/st,spear3xx-shirq.txt
```
* SPEAr Shared IRQ layer (shirq)

SPEAr3xx architecture includes shared/multiplexed irqs for certain set
of devices. The multiplexor provides a single interrupt to parent
interrupt controller (VIC) on behalf of a group of devices.

There can be multiple groups available on SPEAr3xx variants but not
exceeding 4. The number of devices in a group can differ, further they
may share same set of status/mask registers spanning across different
bit masks. Also in some cases the group may not have enable or other
registers. This makes software little complex.

A single node in the device tree is used to describe the shared
interrupt multiplexor (one node for all groups). A group in the
interrupt controller shares config/control registers with other groups.
For example, a 32-bit interrupt enable/disable config register can
accommodate up to 4 interrupt groups.

Required properties:
  - compatible: should be, either of
     - "st,spear300-shirq"
     - "st,spear310-shirq"
     - "st,spear320-shirq"
  - interrupt-controller: Identifies the node as an interrupt controller.
  - #interrupt-cells: should be <1> which basically contains the offset
    (starting from 0) of interrupts for all the groups.
  - reg: Base address and size of shirq registers.
  - interrupts: The list of interrupts generated by the groups which are
    then connected to a parent interrupt controller. Each group is
    associated with one of the interrupts, hence number of interrupts (to
    parent) is equal to number of groups. The format of the interrupt
    specifier depends in the interrupt parent controller.

Example:

The following is an example from the SPEAr320 SoC dtsi file.

shirq: interrupt-controller@b3000000 {
	compatible = "st,spear320-shirq";
	reg = <0xb3000000 0x1000>;
	interrupts = <28 29 30 1>;
	#interrupt-cells = <1>;
	interrupt-controller;
};
```

## Documentation/devicetree/bindings/interrupt-controller/st,sti-irq-syscfg.txt
```
STMicroelectronics STi System Configuration Controlled IRQs
-----------------------------------------------------------

On STi based systems; External, CTI (Core Sight), PMU (Performance Management),
and PL310 L2 Cache IRQs are controlled using System Configuration registers.
This driver is used to unmask them prior to use.

Required properties:
- compatible	: Should be "st,stih407-irq-syscfg"
- st,syscfg	: Phandle to Cortex-A9 IRQ system config registers
- st,irq-device	: Array of IRQs to enable - should be 2 in length
- st,fiq-device	: Array of FIQs to enable - should be 2 in length

Optional properties:
- st,invert-ext	: External IRQs can be inverted at will.  This property inverts
		  these IRQs using bitwise logic.  A number of defines have been
		  provided for convenience:
			ST_IRQ_SYSCFG_EXT_1_INV
			ST_IRQ_SYSCFG_EXT_2_INV
			ST_IRQ_SYSCFG_EXT_3_INV
Example:

irq-syscfg {
	compatible    = "st,stih407-irq-syscfg";
	st,syscfg     = <&syscfg_cpu>;
	st,irq-device = <ST_IRQ_SYSCFG_PMU_0>,
			<ST_IRQ_SYSCFG_PMU_1>;
	st,fiq-device = <ST_IRQ_SYSCFG_DISABLED>,
			<ST_IRQ_SYSCFG_DISABLED>;
};
```
