## Documentation/devicetree/bindings/interrupt-controller/snps,arc700-intc.yaml
```yaml
# SPDX-License-Identifier: (GPL-2.0-only OR BSD-2-Clause)
%YAML 1.2
---
$id: http://devicetree.org/schemas/snps,arc700-intc.yaml#
$schema: http://devicetree.org/meta-schemas/core.yaml#

title: ARC700 incore Interrupt Controller

maintainers:
  - Vineet Gupta <vgupta@kernel.org>

description: >
  The core interrupt controller provides 32 prioritized interrupts (2 levels)
  to ARC700 core.

  intc accessed via the special ARC AUX register interface, hence "reg" property
  is not specified.

properties:
  compatible:
    const: snps,arc700-intc

  interrupt-controller: true

  '#interrupt-cells':
    description: An interrupt number 0-31
    const: 1

required:
  - compatible
  - interrupt-controller
  - '#interrupt-cells'

additionalProperties: false

examples:
  - |
    interrupt-controller {
        compatible = "snps,arc700-intc";
        interrupt-controller;
        #interrupt-cells = <1>;
    };
```

## Documentation/devicetree/bindings/interrupt-controller/snps,archs-idu-intc.txt
```
* ARC-HS Interrupt Distribution Unit

  This optional 2nd level interrupt controller can be used in SMP configurations
  for dynamic IRQ routing, load balancing of common/external IRQs towards core
  intc.

Properties:

- compatible: "snps,archs-idu-intc"
- interrupt-controller: This is an interrupt controller.
- #interrupt-cells: Must be <1> or <2>.

  Value of the first cell specifies the "common" IRQ from peripheral to IDU.
  Number N of the particular interrupt line of IDU corresponds to the line N+24
  of the core interrupt controller.

  The (optional) second cell specifies any of the following flags:
    - bits[3:0] trigger type and level flags
        1 = low-to-high edge triggered
        2 = NOT SUPPORTED (high-to-low edge triggered)
        4 = active high level-sensitive <<< DEFAULT
        8 = NOT SUPPORTED (active low level-sensitive)
  When no second cell is specified, the interrupt is assumed to be level
  sensitive.

  The interrupt controller is accessed via the special ARC AUX register
  interface, hence "reg" property is not specified.

Example:
	core_intc: core-interrupt-controller {
		compatible = "snps,archs-intc";
		interrupt-controller;
		#interrupt-cells = <1>;
	};

	idu_intc: idu-interrupt-controller {
		compatible = "snps,archs-idu-intc";
		interrupt-controller;
		interrupt-parent = <&core_intc>;
		#interrupt-cells = <1>;
	};

	some_device: serial@c0fc1000 {
		interrupt-parent = <&idu_intc>;
		interrupts = <0>;	/* upstream idu IRQ #24 */
	};
```

## Documentation/devicetree/bindings/interrupt-controller/snps,archs-idu-intc.yaml
```yaml
# SPDX-License-Identifier: (GPL-2.0-only OR BSD-2-Clause)
%YAML 1.2
---
$id: http://devicetree.org/schemas/snps,archs-idu-intc.yaml#
$schema: http://devicetree.org/meta-schemas/core.yaml#

title: ARC-HS Interrupt Distribution Unit

maintainers:
  - Vineet Gupta <vgupta@kernel.org>

description: >
  ARC-HS Interrupt Distribution Unit is an optional 2nd level interrupt
  controller which can be used in SMP configurations for dynamic IRQ routing,
  load balancing of common/external IRQs towards core intc.

  The interrupt controller is accessed via the special ARC AUX register
  interface, hence "reg" property is not specified.

properties:
  compatible:
    const: snps,archs-idu-intc

  interrupt-controller: true

  '#interrupt-cells':
    description: |
      Number of interrupt specifier cells:
        - 1: only a common IRQ is specified.
        - 2: a second cell encodes trigger type and level flags:
            1 = low-to-high edge triggered
            4 = active high level-sensitive (default)
    enum: [1, 2]

required:
  - compatible
  - interrupt-controller
  - '#interrupt-cells'

additionalProperties: false

examples:
  - |
    interrupt-controller {
        compatible = "snps,archs-idu-intc";
        interrupt-controller;
        #interrupt-cells = <1>;
    };
```

## Documentation/devicetree/bindings/interrupt-controller/snps,archs-intc.txt
```
* ARC-HS incore Interrupt Controller (Provided by cores implementing ARCv2 ISA)

Properties:

- compatible: "snps,archs-intc"
- interrupt-controller: This is an interrupt controller.
- #interrupt-cells: Must be <1>.

  Single Cell "interrupts" property of a device specifies the IRQ number
  between 16 to 256

  intc accessed via the special ARC AUX register interface, hence "reg" property
  is not specified.

Example:

	intc: interrupt-controller {
		compatible = "snps,archs-intc";
		interrupt-controller;
		#interrupt-cells = <1>;
		interrupts = <16 17 18 19 20 21 22 23 24 25>;
	};
```

## Documentation/devicetree/bindings/interrupt-controller/snps,archs-intc.yaml
```yaml
# SPDX-License-Identifier: (GPL-2.0-only OR BSD-2-Clause)
%YAML 1.2
---
$id: http://devicetree.org/schemas/interrupt-controller/snps,archs-intc.yaml#
$schema: http://devicetree.org/meta-schemas/core.yaml#

title: ARC-HS incore Interrupt Controller

maintainers:
  - Vineet Gupta <vgupta@kernel.org>

description:
  ARC-HS incore Interrupt Controller provided by cores implementing ARCv2 ISA.
  intc accessed via the special ARC AUX register interface, hence "reg" property
  is not specified.

properties:
  compatible:
    const: snps,archs-intc

  interrupt-controller: true

  '#interrupt-cells':
    const: 1

  interrupts:
    description: List of IRQ numbers between 16 and 256
    items:
      items:
        - minimum: 16
          maximum: 256

required:
  - compatible
  - interrupt-controller
  - '#interrupt-cells'
  - interrupts

additionalProperties: false

examples:
  - |
    interrupt-controller {
        compatible = "snps,archs-intc";
        interrupt-controller;
        #interrupt-cells = <1>;
        interrupts = <16>, <17>, <18>, <19>, <20>, <21>, <22>, <23>, <24>, <25>;
    };
```

## Documentation/devicetree/bindings/interrupt-controller/snps,dw-apb-ictl.txt
```
Synopsys DesignWare APB interrupt controller (dw_apb_ictl)

Synopsys DesignWare provides interrupt controller IP for APB known as
dw_apb_ictl. The IP is used as secondary interrupt controller in some SoCs with
APB bus, e.g. Marvell Armada 1500.

Required properties:
- compatible: shall be "snps,dw-apb-ictl"
- reg: physical base address of the controller and length of memory mapped
  region starting with ENABLE_LOW register
- interrupt-controller: identifies the node as an interrupt controller
- #interrupt-cells: number of cells to encode an interrupt-specifier, shall be 1
- interrupts: interrupt reference to primary interrupt controller

The interrupt sources map to the corresponding bits in the interrupt
registers, i.e.
- 0 maps to bit 0 of low interrupts,
- 1 maps to bit 1 of low interrupts,
- 32 maps to bit 0 of high interrupts,
- 33 maps to bit 1 of high interrupts,
- (optional) fast interrupts start at 64.

Example:
	aic: interrupt-controller@3000 {
		compatible = "snps,dw-apb-ictl";
		reg = <0x3000 0xc00>;
		interrupt-controller;
		#interrupt-cells = <1>;
		interrupt-parent = <&gic>;
		interrupts = <GIC_SPI 3 IRQ_TYPE_LEVEL_HIGH>;
	};
```

## Documentation/devicetree/bindings/interrupt-controller/snps,dw-apb-ictl.yaml
```yaml
# SPDX-License-Identifier: (GPL-2.0-only OR BSD-2-Clause)
%YAML 1.2
---
$id: http://devicetree.org/schemas/interrupt-controller/snps,dw-apb-ictl.yaml#
$schema: http://devicetree.org/meta-schemas/core.yaml#

title: Synopsys DesignWare APB interrupt controller

maintainers:
  - Sebastian Hesselbarth <sebastian.hesselbarth@gmail.com>
  - Zhen Lei <thunder.leizhen@huawei.com>

description:
  Synopsys DesignWare provides interrupt controller IP for APB known as
  dw_apb_ictl. The IP is used as secondary interrupt controller in some SoCs
  with APB bus, e.g. Marvell Armada 1500. It can also be used as primary
  interrupt controller in some SoCs, e.g. Hisilicon SD5203.

properties:
  compatible:
    const: snps,dw-apb-ictl

  reg:
    maxItems: 1

  interrupt-controller: true

  '#interrupt-cells':
    const: 1

  interrupts:
    maxItems: 1
    description: >
      Interrupt input connected to the primary interrupt controller when used
      as a secondary controller. The interrupt specifier maps to bits in the
      low and high interrupt registers (0⇒bit 0 low, 1⇒bit 1 low, 32⇒bit 0 high,
      33⇒bit 1 high, fast interrupts start at 64).

required:
  - compatible
  - reg
  - interrupt-controller
  - '#interrupt-cells'

additionalProperties: false

examples:
  - |
    #include <dt-bindings/interrupt-controller/arm-gic.h>

    interrupt-controller@3000 {
        compatible = "snps,dw-apb-ictl";
        reg = <0x3000 0xc00>;
        interrupt-controller;
        #interrupt-cells = <1>;
        interrupts = <GIC_SPI 3 IRQ_TYPE_LEVEL_HIGH>;
    };
  - |
    interrupt-controller@10130000 {
        compatible = "snps,dw-apb-ictl";
        reg = <0x10130000 0x1000>;
        interrupt-controller;
        #interrupt-cells = <1>;
    };
```

## Documentation/devicetree/bindings/interrupt-controller/socionext,synquacer-exiu.txt
```
Socionext SynQuacer External Interrupt Unit (EXIU)

The Socionext Synquacer SoC has an external interrupt unit (EXIU)
that forwards a block of 32 configurable input lines to 32 adjacent
level-high type GICv3 SPIs.

Required properties:

- compatible           : Should be "socionext,synquacer-exiu".
- reg                  : Specifies base physical address and size of the
                         control registers.
- interrupt-controller : Identifies the node as an interrupt controller.
- #interrupt-cells     : Specifies the number of cells needed to encode an
                         interrupt source. The value must be 3.
- interrupt-parent     : phandle of the GIC these interrupts are routed to.
- socionext,spi-base   : The SPI number of the first SPI of the 32 adjacent
                         ones the EXIU forwards its interrups to.

Notes:

- Only SPIs can use the EXIU as an interrupt parent.

Example:

	exiu: interrupt-controller@510c0000 {
		compatible = "socionext,synquacer-exiu";
		reg = <0x0 0x510c0000 0x0 0x20>;
		interrupt-controller;
		interrupt-parent = <&gic>;
		#interrupt-cells = <3>;
		socionext,spi-base = <112>;
	};
```

## Documentation/devicetree/bindings/interrupt-controller/socionext,synquacer-exiu.yaml
```yaml
# SPDX-License-Identifier: (GPL-2.0-only OR BSD-2-Clause)
%YAML 1.2
---
$id: http://devicetree.org/schemas/interrupt-controller/socionext,synquacer-exiu.yaml#
$schema: http://devicetree.org/meta-schemas/core.yaml#

title: Socionext SynQuacer External Interrupt Unit (EXIU)

maintainers:
  - Ard Biesheuvel <ardb@kernel.org>

description: |+
  The Socionext SynQuacer SoC has an external interrupt unit (EXIU)
  that forwards a block of 32 configurable input lines to 32 adjacent
  level-high type GICv3 SPIs.

properties:
  compatible:
    const: socionext,synquacer-exiu

  reg:
    maxItems: 1

  '#interrupt-cells':
    const: 3

  interrupt-controller: true

  socionext,spi-base:
    $ref: /schemas/types.yaml#/definitions/uint32
    description: The SPI number of the first SPI of the 32 adjacent ones the
      EXIU forwards its interrupts to.

required:
  - compatible
  - reg
  - '#interrupt-cells'
  - interrupt-controller
  - socionext,spi-base

unevaluatedProperties: false

examples:
  - |
    interrupt-controller@510c0000 {
        compatible = "socionext,synquacer-exiu";
        reg = <0x510c0000 0x20>;
        interrupt-controller;
        interrupt-parent = <&gic>;
        #interrupt-cells = <3>;
        socionext,spi-base = <112>;
    };
...
```

## Documentation/devicetree/bindings/interrupt-controller/socionext,uniphier-aidet.txt
```
UniPhier AIDET

UniPhier AIDET (ARM Interrupt Detector) is an add-on block for ARM GIC (Generic
Interrupt Controller).  GIC itself can handle only high level and rising edge
interrupts.  The AIDET provides logic inverter to support low level and falling
edge interrupts.

Required properties:
- compatible: Should be one of the following:
    "socionext,uniphier-ld4-aidet"  - for LD4 SoC
    "socionext,uniphier-pro4-aidet" - for Pro4 SoC
    "socionext,uniphier-sld8-aidet" - for sLD8 SoC
    "socionext,uniphier-pro5-aidet" - for Pro5 SoC
    "socionext,uniphier-pxs2-aidet" - for PXs2/LD6b SoC
    "socionext,uniphier-ld11-aidet" - for LD11 SoC
    "socionext,uniphier-ld20-aidet" - for LD20 SoC
    "socionext,uniphier-pxs3-aidet" - for PXs3 SoC
- reg: Specifies offset and length of the register set for the device.
- interrupt-controller: Identifies the node as an interrupt controller
- #interrupt-cells : Specifies the number of cells needed to encode an interrupt
  source.  The value should be 2.  The first cell defines the interrupt number
  (corresponds to the SPI interrupt number of GIC).  The second cell specifies
  the trigger type as defined in interrupts.txt in this directory.

Example:

	aidet: aidet@5fc20000 {
		compatible = "socionext,uniphier-pro4-aidet";
		reg = <0x5fc20000 0x200>;
		interrupt-controller;
		#interrupt-cells = <2>;
	};
```

## Documentation/devicetree/bindings/interrupt-controller/socionext,uniphier-aidet.yaml
```yaml
# SPDX-License-Identifier: GPL-2.0-only OR BSD-2-Clause
%YAML 1.2
---
$id: http://devicetree.org/schemas/interrupt-controller/socionext,uniphier-aidet.yaml#
$schema: http://devicetree.org/meta-schemas/core.yaml#

title: UniPhier AIDET

description: |
  UniPhier AIDET (ARM Interrupt Detector) is an add-on block for ARM GIC
  (Generic Interrupt Controller). GIC itself can handle only high level and
  rising edge interrupts. The AIDET provides logic inverter to support low
  level and falling edge interrupts.

maintainers:
  - Masahiro Yamada <yamada.masahiro@socionext.com>

allOf:
  - $ref: /schemas/interrupt-controller.yaml#

properties:
  compatible:
    enum:
      - socionext,uniphier-ld4-aidet
      - socionext,uniphier-pro4-aidet
      - socionext,uniphier-sld8-aidet
      - socionext,uniphier-pro5-aidet
      - socionext,uniphier-pxs2-aidet
      - socionext,uniphier-ld6b-aidet
      - socionext,uniphier-ld11-aidet
      - socionext,uniphier-ld20-aidet
      - socionext,uniphier-pxs3-aidet

  reg:
    maxItems: 1

  interrupt-controller: true

  '#interrupt-cells':
    description: |
      The first cell defines the interrupt number (corresponds to the SPI
      interrupt number of GIC). The second cell specifies the trigger type as
      defined in interrupts.txt in this directory.
    const: 2

required:
  - compatible
  - reg
  - interrupt-controller
  - '#interrupt-cells'

additionalProperties: false

examples:
  - |
    interrupt-controller@5fc20000 {
        compatible = "socionext,uniphier-pro4-aidet";
        reg = <0x5fc20000 0x200>;
        interrupt-controller;
        #interrupt-cells = <2>;
    };
```
