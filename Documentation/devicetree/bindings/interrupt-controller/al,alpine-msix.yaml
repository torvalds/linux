## Documentation/devicetree/bindings/interrupt-controller/al,alpine-msix.yaml
```yaml
# SPDX-License-Identifier: (GPL-2.0-only OR BSD-2-Clause)
%YAML 1.2
---
$id: http://devicetree.org/schemas/interrupt-controller/al,alpine-msix.yaml#
$schema: http://devicetree.org/meta-schemas/core.yaml#

title: Alpine MSIX controller

maintainers:
  - Antoine Tenart <atenart@kernel.org>

properties:
  compatible:
    const: al,alpine-msix

  reg:
    maxItems: 1

  interrupt-parent: true

  msi-controller: true

  al,msi-base-spi:
    description: SPI base of the MSI frame
    $ref: /schemas/types.yaml#/definitions/uint32

  al,msi-num-spis:
    description: number of SPIs assigned to the MSI frame, relative to SPI0
    $ref: /schemas/types.yaml#/definitions/uint32

required:
  - compatible
  - reg
  - msi-controller
  - al,msi-base-spi
  - al,msi-num-spis

additionalProperties: false

examples:
  - |
    msi-controller@fbe00000 {
        compatible = "al,alpine-msix";
        reg = <0xfbe00000 0x100000>;
        interrupt-parent = <&gic>;
        msi-controller;
        al,msi-base-spi = <160>;
        al,msi-num-spis = <160>;
    };
```

## Documentation/devicetree/bindings/interrupt-controller/allwinner,sun4i-a10-ic.yaml
```yaml
# SPDX-License-Identifier: GPL-2.0
%YAML 1.2
---
$id: http://devicetree.org/schemas/interrupt-controller/allwinner,sun4i-a10-ic.yaml#
$schema: http://devicetree.org/meta-schemas/core.yaml#

title: Allwinner A10 Interrupt Controller Device Tree Bindings

maintainers:
  - Chen-Yu Tsai <wens@csie.org>
  - Maxime Ripard <mripard@kernel.org>

allOf:
  - $ref: /schemas/interrupt-controller.yaml#

properties:
  "#interrupt-cells":
    const: 1

  compatible:
    enum:
      - allwinner,sun4i-a10-ic
      - allwinner,suniv-f1c100s-ic

  reg:
    maxItems: 1

  interrupt-controller: true

required:
  - "#interrupt-cells"
  - compatible
  - reg
  - interrupt-controller

additionalProperties: false

examples:
  - |
    intc: interrupt-controller@1c20400 {
        compatible = "allwinner,sun4i-a10-ic";
        reg = <0x01c20400 0x400>;
        interrupt-controller;
        #interrupt-cells = <1>;
    };

...
```

## Documentation/devicetree/bindings/interrupt-controller/allwinner,sun4i-ic.txt
```
Allwinner Sunxi Interrupt Controller

Required properties:

- compatible : should be "allwinner,sun4i-ic"
- reg : Specifies base physical address and size of the registers.
- interrupt-controller : Identifies the node as an interrupt controller
- #interrupt-cells : Specifies the number of cells needed to encode an
  interrupt source. The value shall be 1.

Example:

intc: interrupt-controller {
	compatible = "allwinner,sun4i-ic";
	reg = <0x01c20400 0x400>;
	interrupt-controller;
	#interrupt-cells = <2>;
};
```

## Documentation/devicetree/bindings/interrupt-controller/allwinner,sun6i-a31-r-intc.yaml
```yaml
# SPDX-License-Identifier: GPL-2.0
%YAML 1.2
---
$id: http://devicetree.org/schemas/interrupt-controller/allwinner,sun6i-a31-r-intc.yaml#
$schema: http://devicetree.org/meta-schemas/core.yaml#

title: Allwinner A31 NMI/Wakeup Interrupt Controller Device Tree Bindings

maintainers:
  - Chen-Yu Tsai <wens@csie.org>
  - Maxime Ripard <mripard@kernel.org>

allOf:
  - $ref: /schemas/interrupt-controller.yaml#

properties:
  "#interrupt-cells":
    const: 3
    description:
      The first cell is GIC_SPI (0), the second cell is the IRQ number, and
      the third cell is the trigger type as defined in interrupt.txt in this
      directory.

  compatible:
    oneOf:
      - const: allwinner,sun6i-a31-r-intc
      - items:
          - enum:
              - allwinner,sun8i-a83t-r-intc
              - allwinner,sun8i-h3-r-intc
              - allwinner,sun50i-a64-r-intc
          - const: allwinner,sun6i-a31-r-intc
      - const: allwinner,sun50i-h6-r-intc

  reg:
    maxItems: 1

  interrupts:
    maxItems: 1
    description:
      The GIC interrupt labeled as "External NMI".

  interrupt-controller: true

required:
  - "#interrupt-cells"
  - compatible
  - reg
  - interrupts
  - interrupt-controller

additionalProperties: false

examples:
  - |
    #include <dt-bindings/interrupt-controller/arm-gic.h>

    r_intc: interrupt-controller@1f00c00 {
            compatible = "allwinner,sun50i-a64-r-intc",
                         "allwinner,sun6i-a31-r-intc";
            interrupt-controller;
            #interrupt-cells = <3>;
            reg = <0x01f00c00 0x400>;
            interrupts = <GIC_SPI 32 IRQ_TYPE_LEVEL_HIGH>;
    };

...
```

## Documentation/devicetree/bindings/interrupt-controller/allwinner,sun7i-a20-sc-nmi.yaml
```yaml
# SPDX-License-Identifier: GPL-2.0
%YAML 1.2
---
$id: http://devicetree.org/schemas/interrupt-controller/allwinner,sun7i-a20-sc-nmi.yaml#
$schema: http://devicetree.org/meta-schemas/core.yaml#

title: Allwinner A20 Non-Maskable Interrupt Controller

maintainers:
  - Chen-Yu Tsai <wens@csie.org>
  - Maxime Ripard <mripard@kernel.org>

allOf:
  - $ref: /schemas/interrupt-controller.yaml#

properties:
  "#interrupt-cells":
    const: 2
    description:
      The first cell is the IRQ number, the second cell the trigger
      type as defined in interrupt.txt in this directory.

  compatible:
    oneOf:
      - const: allwinner,sun6i-a31-sc-nmi
        deprecated: true
      - const: allwinner,sun7i-a20-sc-nmi
      - const: allwinner,sun9i-a80-nmi
      - items:
          - enum:
              - allwinner,sun8i-v3s-nmi
              - allwinner,sun50i-a100-nmi
              - allwinner,sun50i-h616-nmi
          - const: allwinner,sun9i-a80-nmi

  reg:
    maxItems: 1

  interrupts:
    maxItems: 1

  interrupt-controller: true

required:
  - "#interrupt-cells"
  - compatible
  - reg
  - interrupts
  - interrupt-controller

unevaluatedProperties: false

examples:
  - |
    interrupt-controller@1c00030 {
        compatible = "allwinner,sun7i-a20-sc-nmi";
        interrupt-controller;
        #interrupt-cells = <2>;
        reg = <0x01c00030 0x0c>;
        interrupt-parent = <&gic>;
        interrupts = <0 0 4>;
    };

...
```

## Documentation/devicetree/bindings/interrupt-controller/allwinner,sunxi-nmi.txt
```
Allwinner Sunxi NMI Controller
==============================

Required properties:

- compatible : should be "allwinner,sun7i-a20-sc-nmi" or
  "allwinner,sun6i-a31-sc-nmi" or "allwinner,sun9i-a80-nmi"
- reg : Specifies base physical address and size of the registers.
- interrupt-controller : Identifies the node as an interrupt controller
- #interrupt-cells : Specifies the number of cells needed to encode an
  interrupt source. The value shall be 2. The first cell is the IRQ number, the
  second cell the trigger type as defined in interrupt.txt in this directory.
- interrupt-parent: Specifies the parent interrupt controller.
- interrupts: Specifies the interrupt line (NMI) which is handled by
  the interrupt controller in the parent controller's notation. This value
  shall be the NMI.

Example:

sc-nmi-intc@01c00030 {
	compatible = "allwinner,sun7i-a20-sc-nmi";
	interrupt-controller;
	#interrupt-cells = <2>;
	reg = <0x01c00030 0x0c>;
	interrupt-parent = <&gic>;
	interrupts = <0 0 4>;
};
```

## Documentation/devicetree/bindings/interrupt-controller/amazon,al-fic.txt
```
Amazon's Annapurna Labs Fabric Interrupt Controller

Required properties:

- compatible: should be "amazon,al-fic"
- reg: physical base address and size of the registers
- interrupt-controller: identifies the node as an interrupt controller
- #interrupt-cells : must be 2. Specifies the number of cells needed to encode
  an interrupt source. Supported trigger types are low-to-high edge
  triggered and active high level-sensitive.
- interrupts: describes which input line in the interrupt parent, this
  fic's output is connected to. This field property depends on the parent's
  binding

Please refer to interrupts.txt in this directory for details of the common
Interrupt Controllers bindings used by client devices.

Example:

amazon_fic: interrupt-controller@fd8a8500 {
	compatible = "amazon,al-fic";
	interrupt-controller;
	#interrupt-cells = <2>;
	reg = <0x0 0xfd8a8500 0x0 0x1000>;
	interrupt-parent = <&gic>;
	interrupts = <GIC_SPI 0x0 IRQ_TYPE_LEVEL_HIGH>;
};
```

## Documentation/devicetree/bindings/interrupt-controller/amlogic,meson-gpio-intc.txt
```
Amlogic meson GPIO interrupt controller

Meson SoCs contains an interrupt controller which is able to watch the SoC
pads and generate an interrupt on edge or level. The controller is essentially
a 256 pads to 8 GIC interrupt multiplexer, with a filter block to select edge
or level and polarity. It does not expose all 256 mux inputs because the
documentation shows that the upper part is not mapped to any pad. The actual
number of interrupt exposed depends on the SoC.

Required properties:

- compatible : must have "amlogic,meson8-gpio-intc" and either
    "amlogic,meson8-gpio-intc" for meson8 SoCs (S802) or
    "amlogic,meson8b-gpio-intc" for meson8b SoCs (S805) or
    "amlogic,meson-gxbb-gpio-intc" for GXBB SoCs (S905) or
    "amlogic,meson-gxl-gpio-intc" for GXL SoCs (S905X, S912)
    "amlogic,meson-axg-gpio-intc" for AXG SoCs (A113D, A113X)
- reg : Specifies base physical address and size of the registers.
- interrupt-controller : Identifies the node as an interrupt controller.
- #interrupt-cells : Specifies the number of cells needed to encode an
   interrupt source. The value must be 2.
- meson,channel-interrupts: Array with the 8 upstream hwirq numbers. These
   are the hwirqs used on the parent interrupt controller.

Example:

gpio_interrupt: interrupt-controller@9880 {
	compatible = "amlogic,meson-gxbb-gpio-intc",
		     "amlogic,meson-gpio-intc";
	reg = <0x0 0x9880 0x0 0x10>;
	interrupt-controller;
	#interrupt-cells = <2>;
	meson,channel-interrupts = <64 65 66 67 68 69 70 71>;
};
```

## Documentation/devicetree/bindings/interrupt-controller/amlogic,meson-gpio-intc.yaml
```yaml
# SPDX-License-Identifier: (GPL-2.0-only OR BSD-2-Clause)
%YAML 1.2
---
$id: http://devicetree.org/schemas/interrupt-controller/amlogic,meson-gpio-intc.yaml#
$schema: http://devicetree.org/meta-schemas/core.yaml#

title: Amlogic Meson GPIO interrupt controller

maintainers:
  - Heiner Kallweit <hkallweit1@gmail.com>

description: |
  Meson SoCs contains an interrupt controller which is able to watch the SoC
  pads and generate an interrupt on edge or level. The controller is essentially
  a 256 pads to 8 or 12 GIC interrupt multiplexer, with a filter block to select
  edge or level and polarity. It does not expose all 256 mux inputs because the
  documentation shows that the upper part is not mapped to any pad. The actual
  number of interrupts exposed depends on the SoC.

allOf:
  - $ref: /schemas/interrupt-controller.yaml#

properties:
  compatible:
    oneOf:
      - const: amlogic,meson-gpio-intc
      - items:
          - enum:
              - amlogic,meson8-gpio-intc
              - amlogic,meson8b-gpio-intc
              - amlogic,meson-gxbb-gpio-intc
              - amlogic,meson-gxl-gpio-intc
              - amlogic,meson-axg-gpio-intc
              - amlogic,meson-g12a-gpio-intc
              - amlogic,meson-sm1-gpio-intc
              - amlogic,meson-a1-gpio-intc
              - amlogic,meson-s4-gpio-intc
              - amlogic,c3-gpio-intc
          - const: amlogic,meson-gpio-intc

  reg:
    maxItems: 1

  interrupt-controller: true

  "#interrupt-cells":
    const: 2

  amlogic,channel-interrupts:
    description: Array with the upstream hwirq numbers
    minItems: 8
    maxItems: 12
    $ref: /schemas/types.yaml#/definitions/uint32-array

required:
  - compatible
  - reg
  - interrupt-controller
  - "#interrupt-cells"
  - amlogic,channel-interrupts

additionalProperties: false

examples:
  - |
    interrupt-controller@9880 {
      compatible = "amlogic,meson-gxbb-gpio-intc",
                   "amlogic,meson-gpio-intc";
      reg = <0x9880 0x10>;
      interrupt-controller;
      #interrupt-cells = <2>;
      amlogic,channel-interrupts = <64 65 66 67 68 69 70 71>;
    };
```

## Documentation/devicetree/bindings/interrupt-controller/andestech,ativic32.txt
```
* Andestech Internal Vector Interrupt Controller

The Internal Vector Interrupt Controller (IVIC) is a basic interrupt controller
suitable for a simpler SoC platform yest requiring a more sophisticated and
bigger External Vector Interrupt Controller.


Main yesde required properties:

- compatible : should at least contain  "andestech,ativic32".
- interrupt-controller : Identifies the yesde as an interrupt controller
- #interrupt-cells: 1 cells and refer to interrupt-controller/interrupts

Examples:
	intc: interrupt-controller {
		compatible = "andestech,ativic32";
		#interrupt-cells = <1>;
		interrupt-controller;
	};
```

## Documentation/devicetree/bindings/interrupt-controller/andestech,plicsw.yaml
```yaml
# SPDX-License-Identifier: (GPL-2.0-only OR BSD-2-Clause)
%YAML 1.2
---
$id: http://devicetree.org/schemas/interrupt-controller/andestech,plicsw.yaml#
$schema: http://devicetree.org/meta-schemas/core.yaml#

title: Andes machine-level software interrupt controller

description:
  In the Andes platform such as QiLai SoC, the PLIC module is instantiated a
  second time with all interrupt sources tied to zero as the software interrupt
  controller (PLIC_SW). PLIC_SW directly connects to the machine-mode
  inter-processor interrupt lines of CPUs, so RISC-V per-CPU local interrupt
  controller is the parent interrupt controller for PLIC_SW. PLIC_SW can
  generate machine-mode inter-processor interrupts through programming its
  registers.

maintainers:
  - Ben Zong-You Xie <ben717@andestech.com>

properties:
  compatible:
    items:
      - enum:
          - andestech,qilai-plicsw
      - const: andestech,plicsw

  reg:
    maxItems: 1

  interrupts-extended:
    minItems: 1
    maxItems: 15872
    description:
      Specifies which harts are connected to the PLIC_SW. Each item must points
      to a riscv,cpu-intc node, which has a riscv cpu node as parent.

additionalProperties: false

required:
  - compatible
  - reg
  - interrupts-extended

examples:
  - |
    interrupt-controller@400000 {
      compatible = "andestech,qilai-plicsw", "andestech,plicsw";
      reg = <0x400000 0x400000>;
      interrupts-extended = <&cpu0intc 3>,
                            <&cpu1intc 3>,
                            <&cpu2intc 3>,
                            <&cpu3intc 3>;
    };
```

## Documentation/devicetree/bindings/interrupt-controller/apm,xgene1-msi.yaml
```yaml
# SPDX-License-Identifier: (GPL-2.0-only OR BSD-2-Clause)
%YAML 1.2
---
$id: http://devicetree.org/schemas/interrupt-controller/apm,xgene1-msi.yaml#
$schema: http://devicetree.org/meta-schemas/core.yaml#

title: AppliedMicro X-Gene v1 PCIe MSI controller

maintainers:
  - Toan Le <toan@os.amperecomputing.com>

properties:
  compatible:
    const: apm,xgene1-msi

  msi-controller: true

  reg:
    maxItems: 1

  interrupts:
    maxItems: 16

required:
  - compatible
  - msi-controller
  - reg
  - interrupts

additionalProperties: false

examples:
  - |
    msi@79000000 {
        compatible = "apm,xgene1-msi";
        msi-controller;
        reg = <0x79000000 0x900000>;
        interrupts = <0x0 0x10 0x4>,
                     <0x0 0x11 0x4>,
                     <0x0 0x12 0x4>,
                     <0x0 0x13 0x4>,
                     <0x0 0x14 0x4>,
                     <0x0 0x15 0x4>,
                     <0x0 0x16 0x4>,
                     <0x0 0x17 0x4>,
                     <0x0 0x18 0x4>,
                     <0x0 0x19 0x4>,
                     <0x0 0x1a 0x4>,
                     <0x0 0x1b 0x4>,
                     <0x0 0x1c 0x4>,
                     <0x0 0x1d 0x4>,
                     <0x0 0x1e 0x4>,
                     <0x0 0x1f 0x4>;
    };
```
