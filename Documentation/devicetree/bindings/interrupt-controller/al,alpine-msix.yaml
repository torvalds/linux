## Documentation/devicetree/bindings/interrupt-controller/arm,nvic.yaml
```yaml
# SPDX-License-Identifier: (GPL-2.0-only OR BSD-2-Clause)
%YAML 1.2
---
$id: http://devicetree.org/schemas/interrupt-controller/arm,nvic.yaml#
$schema: http://devicetree.org/meta-schemas/core.yaml#

title: ARM Nested Vector Interrupt Controller (NVIC)

maintainers:
  - Rob Herring <robh@kernel.org>

description:
  The NVIC provides an interrupt controller that is tightly coupled to Cortex-M
  based processor cores.  The NVIC implemented on different SoCs vary in the
  number of interrupts and priority bits per interrupt.

properties:
  compatible:
    enum:
      - arm,armv7m-nvic # deprecated
      - arm,v6m-nvic
      - arm,v7m-nvic
      - arm,v8m-nvic

  reg:
    maxItems: 1

  '#address-cells':
    const: 0

  interrupt-controller: true

  '#interrupt-cells':
    enum: [1, 2]
    description: |
      Number of cells to encode an interrupt source:
      first = interrupt number, second = priority.

  arm,num-irq-priority-bits:
    description: Number of priority bits implemented by the SoC
    minimum: 1
    maximum: 8

required:
  - compatible
  - reg
  - interrupt-controller
  - '#interrupt-cells'
  - arm,num-irq-priority-bits

additionalProperties: false

examples:
  - |
    interrupt-controller@e000e100 {
        compatible = "arm,v7m-nvic";
        #interrupt-cells = <2>;
        #address-cells = <0>;
        interrupt-controller;
        reg = <0xe000e100 0xc00>;
        arm,num-irq-priority-bits = <4>;
    };
```

## Documentation/devicetree/bindings/interrupt-controller/arm,versatile-fpga-irq.txt
```
* ARM Versatile FPGA interrupt controller

One or more FPGA IRQ controllers can be synthesized in an ARM reference board
such as the Integrator or Versatile family. The output of these different
controllers are OR:ed together and fed to the CPU tile's IRQ input. Each
instance can handle up to 32 interrupts.

Required properties:
- compatible: "arm,versatile-fpga-irq"
- interrupt-controller: Identifies the node as an interrupt controller
- #interrupt-cells: The number of cells to define the interrupts.  Must be 1
  as the FPGA IRQ controller has no configuration options for interrupt
  sources.  The cell is a u32 and defines the interrupt number.
- reg: The register bank for the FPGA interrupt controller.
- clear-mask: a u32 number representing the mask written to clear all IRQs
  on the controller at boot for example.
- valid-mask: a u32 number representing a bit mask determining which of
  the interrupts are valid. Unconnected/unused lines are set to 0, and
  the system till not make it possible for devices to request these
  interrupts.

Example:

pic: pic@14000000 {
        compatible = "arm,versatile-fpga-irq";
        #interrupt-cells = <1>;
        interrupt-controller;
        reg = <0x14000000 0x100>;
        clear-mask = <0xffffffff>;
        valid-mask = <0x003fffff>;
};

Optional properties:
- interrupts: if the FPGA IRQ controller is cascaded, i.e. if its IRQ
  output is simply connected to the input of another IRQ controller,
  then the parent IRQ shall be specified in this property.
```

## Documentation/devicetree/bindings/interrupt-controller/arm,versatile-fpga-irq.yaml
```yaml
# SPDX-License-Identifier: (GPL-2.0-only OR BSD-2-Clause)
%YAML 1.2
---
$id: http://devicetree.org/schemas/interrupt-controller/arm,versatile-fpga-irq.yaml#
$schema: http://devicetree.org/meta-schemas/core.yaml#

title: ARM Versatile FPGA IRQ Controller

maintainers:
  - Linus Walleij <linus.walleij@linaro.org>

description:
  One or more FPGA IRQ controllers can be synthesized in an ARM reference board
  such as the Integrator or Versatile family. The output of these different
  controllers are OR:ed together and fed to the CPU tile's IRQ input. Each
  instance can handle up to 32 interrupts.

properties:
  compatible:
    const: arm,versatile-fpga-irq

  interrupt-controller: true

  '#interrupt-cells':
    const: 1

  reg:
    maxItems: 1

  clear-mask:
    description: A mask written to clear all IRQs on the controller at boot.
    $ref: /schemas/types.yaml#/definitions/uint32

  valid-mask:
    description:
      A bit mask determining which interrupts are valid; unused lines are set to 0.
    $ref: /schemas/types.yaml#/definitions/uint32

  interrupts:
    maxItems: 1

additionalProperties: false

required:
  - compatible
  - interrupt-controller
  - '#interrupt-cells'
  - reg
  - clear-mask
  - valid-mask

examples:
  - |
    interrupt-controller@14000000 {
        compatible = "arm,versatile-fpga-irq";
        #interrupt-cells = <1>;
        interrupt-controller;
        reg = <0x14000000 0x100>;
        clear-mask = <0xffffffff>;
        valid-mask = <0x003fffff>;
    };
```

## Documentation/devicetree/bindings/interrupt-controller/arm,vic.txt
```
* ARM Vectored Interrupt Controller

One or more Vectored Interrupt Controllers (VIC's) can be connected in an ARM
system for interrupt routing.  For multiple controllers they can either be
nested or have the outputs wire-OR'd together.

Required properties:

- compatible : should be one of
	"arm,pl190-vic"
	"arm,pl192-vic"
- interrupt-controller : Identifies the node as an interrupt controller
- #interrupt-cells : The number of cells to define the interrupts.  Must be 1 as
  the VIC has no configuration options for interrupt sources.  The cell is a u32
  and defines the interrupt number.
- reg : The register bank for the VIC.

Optional properties:

- interrupts : Interrupt source for parent controllers if the VIC is nested.
- valid-mask : A one cell big bit mask of valid interrupt sources. Each bit
  represents single interrupt source, starting from source 0 at LSb and ending
  at source 31 at MSb. A bit that is set means that the source is wired and
  clear means otherwise. If unspecified, defaults to all valid.
- valid-wakeup-mask : A one cell big bit mask of interrupt sources that can be
  configured as wake up source for the system. Order of bits is the same as for
  valid-mask property. A set bit means that this interrupt source can be
  configured as a wake up source for the system. If unspecied, defaults to all
  interrupt sources configurable as wake up sources.

Example:

	vic0: interrupt-controller@60000 {
		compatible = "arm,pl192-vic";
		interrupt-controller;
		#interrupt-cells = <1>;
		reg = <0x60000 0x1000>;

		valid-mask = <0xffffff7f>;
		valid-wakeup-mask = <0x0000ff7f>;
	};
```

## Documentation/devicetree/bindings/interrupt-controller/arm,vic.yaml
```yaml
# SPDX-License-Identifier: GPL-2.0
%YAML 1.2
---
$id: http://devicetree.org/schemas/interrupt-controller/arm,vic.yaml#
$schema: http://devicetree.org/meta-schemas/core.yaml#

title: ARM Vectored Interrupt Controller

maintainers:
  - Rob Herring <robh@kernel.org>

description: |+
  One or more Vectored Interrupt Controllers (VIC's) can be connected in an
  ARM system for interrupt routing.  For multiple controllers they can either
  be nested or have the outputs wire-OR'd together.

allOf:
  - $ref: /schemas/interrupt-controller.yaml#

properties:
  compatible:
    enum:
      - arm,pl190-vic
      - arm,pl192-vic
      - arm,versatile-vic

  interrupt-controller: true

  "#interrupt-cells":
    const: 1
    description:
      The number of cells to define the interrupts.  It must be 1 as the
      VIC has no configuration options for interrupt sources. The single
      cell defines the interrupt number.

  reg:
    maxItems: 1

  interrupts:
    maxItems: 1

  valid-mask:
    description:
      A one cell big bit mask of valid interrupt sources. Each bit
      represents single interrupt source, starting from source 0 at
      LSb and ending at source 31 at MSb. A bit that is set means
      that the source is wired and clear means otherwise. If unspecified,
      defaults to all valid.
    $ref: /schemas/types.yaml#/definitions/uint32

  valid-wakeup-mask:
    description:
      A one cell big bit mask of interrupt sources that can be configured
      as wake up source for the system. Order of bits is the same as for
      valid-mask property. A set bit means that this interrupt source
      can be configured as a wake up source for the system. If unspecied,
      defaults to all interrupt sources configurable as wake up sources.
    $ref: /schemas/types.yaml#/definitions/uint32

required:
  - compatible
  - reg
  - interrupt-controller
  - "#interrupt-cells"

additionalProperties: false

examples:
  - |
    // PL192 VIC
    vic0: interrupt-controller@60000 {
      compatible = "arm,pl192-vic";
      interrupt-controller;
      #interrupt-cells = <1>;
      reg = <0x60000 0x1000>;

      valid-mask = <0xffffff7f>;
      valid-wakeup-mask = <0x0000ff7f>;
    };

...
```
