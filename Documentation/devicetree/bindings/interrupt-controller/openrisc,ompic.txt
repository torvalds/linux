## Documentation/devicetree/bindings/interrupt-controller/qcom,pdc.yaml
```yaml
# SPDX-License-Identifier: GPL-2.0-only OR BSD-2-Clause
%YAML 1.2
---
$id: http://devicetree.org/schemas/interrupt-controller/qcom,pdc.yaml#
$schema: http://devicetree.org/meta-schemas/core.yaml#

title: PDC interrupt controller

maintainers:
  - Bjorn Andersson <bjorn.andersson@linaro.org>

description: |
  Qualcomm Technologies Inc. SoCs based on the RPM Hardened architecture have a
  Power Domain Controller (PDC) that is on always-on domain. In addition to
  providing power control for the power domains, the hardware also has an
  interrupt controller that can be used to help detect edge low interrupts as
  well detect interrupts when the GIC is non-operational.

  GIC is parent interrupt controller at the highest level. Platform interrupt
  controller PDC is next in hierarchy, followed by others. Drivers requiring
  wakeup capabilities of their device interrupts routed through the PDC, must
  specify PDC as their interrupt controller and request the PDC port associated
  with the GIC interrupt. See example below.

properties:
  compatible:
    items:
      - enum:
          - qcom,qdu1000-pdc
          - qcom,sa8255p-pdc
          - qcom,sa8775p-pdc
          - qcom,sar2130p-pdc
          - qcom,sc7180-pdc
          - qcom,sc7280-pdc
          - qcom,sc8180x-pdc
          - qcom,sc8280xp-pdc
          - qcom,sdm670-pdc
          - qcom,sdm845-pdc
          - qcom,sdx55-pdc
          - qcom,sdx65-pdc
          - qcom,sdx75-pdc
          - qcom,sm4450-pdc
          - qcom,sm6350-pdc
          - qcom,sm8150-pdc
          - qcom,sm8250-pdc
          - qcom,sm8350-pdc
          - qcom,sm8450-pdc
          - qcom,sm8550-pdc
          - qcom,sm8650-pdc
          - qcom,x1e80100-pdc
      - const: qcom,pdc

  reg:
    minItems: 1
    items:
      - description: PDC base register region
      - description: Edge or Level config register for SPI interrupts

  '#interrupt-cells':
    const: 2

  interrupt-controller: true

  qcom,pdc-ranges:
    $ref: /schemas/types.yaml#/definitions/uint32-matrix
    minItems: 1
    maxItems: 128 # no hard limit
    items:
      items:
        - description: starting PDC port
        - description: GIC hwirq number for the PDC port
        - description: number of interrupts in sequence
    description: |
      Specifies the PDC pin offset and the number of PDC ports.
      The tuples indicates the valid mapping of valid PDC ports
      and their hwirq mapping.

required:
  - compatible
  - reg
  - '#interrupt-cells'
  - interrupt-controller
  - qcom,pdc-ranges

additionalProperties: false

examples:
  - |
    #include <dt-bindings/interrupt-controller/irq.h>

    pdc: interrupt-controller@b220000 {
        compatible = "qcom,sdm845-pdc", "qcom,pdc";
        reg = <0xb220000 0x30000>;
        qcom,pdc-ranges = <0 512 94>, <94 641 15>, <115 662 7>;
        #interrupt-cells = <2>;
        interrupt-parent = <&intc>;
        interrupt-controller;
    };

    wake-device {
        interrupts-extended = <&pdc 2 IRQ_TYPE_LEVEL_HIGH>;
    };
```

## Documentation/devicetree/bindings/interrupt-controller/ralink,rt2880-intc.yaml
```yaml
# SPDX-License-Identifier: (GPL-2.0-only OR BSD-2-Clause)
%YAML 1.2
---
$id: http://devicetree.org/schemas/interrupt-controller/ralink,rt2880-intc.yaml#
$schema: http://devicetree.org/meta-schemas/core.yaml#

title: Ralink SoCs Interrupt Controller

maintainers:
  - Sergio Paracuellos <sergio.paracuellos@gmail.com>

allOf:
  - $ref: /schemas/interrupt-controller.yaml#

description:
  This interrupt controller support a central point for interrupt aggregation
  for platform related blocks.

properties:
  compatible:
    const: ralink,rt2880-intc

  reg:
    maxItems: 1

  interrupts:
    maxItems: 1

  interrupt-controller: true

  '#interrupt-cells':
    const: 1

required:
  - compatible
  - reg
  - interrupts
  - interrupt-controller
  - '#interrupt-cells'

additionalProperties: false

examples:
  - |
    interrupt-controller@200 {
      compatible = "ralink,rt2880-intc";
      reg = <0x200 0x100>;
      interrupt-controller;
      #interrupt-cells = <1>;

      interrupt-parent = <&cpuintc>;
      interrupts = <2>;
    };
...
```

## Documentation/devicetree/bindings/interrupt-controller/rda,8810pl-intc.txt
```
RDA Micro RDA8810PL Interrupt Controller

The interrupt controller in RDA8810PL SoC is a custom interrupt controller
which supports up to 32 interrupts.

Required properties:

- compatible: Should be "rda,8810pl-intc".
- reg: Specifies base physical address of the registers set.
- interrupt-controller: Identifies the node as an interrupt controller.
- #interrupt-cells: Specifies the number of cells needed to encode an
  interrupt source. The value shall be 2.

The interrupt sources are as follows:

ID	Name
------------
0:	PULSE_DUMMY
1:	I2C
2:	NAND_NFSC
3:	SDMMC1
4:	SDMMC2
5:	SDMMC3
6:	SPI1
7:	SPI2
8:	SPI3
9:	UART1
10:	UART2
11:	UART3
12:	GPIO1
13:	GPIO2
14:	GPIO3
15:	KEYPAD
16:	TIMER
17:	TIMEROS
18:	COMREG0
19:	COMREG1
20:	USB
21:	DMC
22:	DMA
23:	CAMERA
24:	GOUDA
25:	GPU
26:	VPU_JPG
27:	VPU_HOST
28:	VOC
29:	AUIFC0
30:	AUIFC1
31:	L2CC

Example:
		apb@20800000 {
			compatible = "simple-bus";
			...
			intc: interrupt-controller@0 {
				compatible = "rda,8810pl-intc";
				reg = <0x0 0x1000>;
				interrupt-controller;
				#interrupt-cells = <2>;
			};
		};
```

## Documentation/devicetree/bindings/interrupt-controller/rda,8810pl-intc.yaml
```yaml
# SPDX-License-Identifier: (GPL-2.0-only OR BSD-2-Clause)
%YAML 1.2
---
$id: http://devicetree.org/schemas/interrupt-controller/rda,8810pl-intc.yaml#
$schema: http://devicetree.org/meta-schemas/core.yaml#

title: RDA Micro RDA8810PL interrupt controller

maintainers:
  - Manivannan Sadhasivam <manivannan.sadhasivam@linaro.org>

allOf:
  - $ref: /schemas/interrupt-controller.yaml#

properties:
  compatible:
    const: rda,8810pl-intc

  reg:
    maxItems: 1

  interrupt-controller: true

  '#interrupt-cells':
    const: 2

required:
  - compatible
  - reg
  - interrupt-controller
  - '#interrupt-cells'

additionalProperties: false

examples:
  - |
    intc: interrupt-controller@0 {
      compatible = "rda,8810pl-intc";
      reg = <0x0 0x1000>;
      interrupt-controller;
      #interrupt-cells = <2>;
    };
...
```

## Documentation/devicetree/bindings/interrupt-controller/realtek,rtl-intc.yaml
```yaml
# SPDX-License-Identifier: (GPL-2.0-only OR BSD-2-Clause)
%YAML 1.2
---
$id: http://devicetree.org/schemas/interrupt-controller/realtek,rtl-intc.yaml#
$schema: http://devicetree.org/meta-schemas/core.yaml#

title: Realtek RTL SoC interrupt controller

description:
  Interrupt controller and router for Realtek MIPS SoCs, allowing each SoC
  interrupt to be routed to one parent CPU (hardware) interrupt, or left
  disconnected.
  All connected input lines from SoC peripherals can be masked individually,
  and an interrupt status register is present to indicate which interrupts are
  pending.

maintainers:
  - Birger Koblitz <mail@birger-koblitz.de>
  - Bert Vermeulen <bert@biot.com>
  - John Crispin <john@phrozen.org>

properties:
  compatible:
    oneOf:
      - items:
          - enum:
              - realtek,rtl8380-intc
          - const: realtek,rtl-intc
      - const: realtek,rtl-intc
        deprecated: true

  "#interrupt-cells":
    description:
      SoC interrupt line index.
    const: 1

  reg:
    maxItems: 1

  interrupts:
    minItems: 1
    maxItems: 15
    description:
      List of parent interrupts, in the order that they are connected to this
      interrupt router's outputs, starting at the first output.

  interrupt-controller: true

  interrupt-map:
    deprecated: true
    description: Describes mapping from SoC interrupts to CPU interrupts

required:
  - compatible
  - reg
  - "#interrupt-cells"
  - interrupt-controller

allOf:
  - if:
      properties:
        compatible:
          const: realtek,rtl-intc
    then:
      properties:
        "#address-cells":
          const: 0
      required:
        - "#address-cells"
        - interrupt-map
    else:
      required:
        - interrupts

additionalProperties: false

examples:
  - |
    interrupt-controller@3000 {
      compatible = "realtek,rtl8380-intc", "realtek,rtl-intc";
      #interrupt-cells = <1>;
      interrupt-controller;
      reg = <0x3000 0x18>;

      interrupt-parent = <&cpuintc>;
      interrupts = <2>, <3>, <4>, <5>, <6>;
    };
```

## Documentation/devicetree/bindings/interrupt-controller/renesas,h8300h-intc.txt
```
* H8/300H Interrupt controller

Required properties:

- compatible: has to be "renesas,h8300h-intc", "renesas,h8300-intc" as fallback.
- #interrupt-cells: has to be <2>: an interrupt index and flags, as defined in
  interrupts.txt in this directory
- regs: Base address of interrupt controller registers.

Optional properties:

- any properties, listed in interrupts.txt, and any standard resource allocation
  properties

Example:

	h8intc: interrupt-controller@fee012 {
		compatible = "renesas,h8300h-intc", "renesas,h8300-intc";
		#interrupt-cells = <2>;
		interrupt-controller;
		reg = <0xfee012 7>;
	};
```

## Documentation/devicetree/bindings/interrupt-controller/renesas,h8s-intc.txt
```
* H8S Interrupt controller

Required properties:

- compatible: has to be "renesas,h8s-intc", "renesas,h8300-intc" as fallback.
- #interrupt-cells: has to be <2>: an interrupt index and flags, as defined in
  interrupts.txt in this directory
- regs: Base address of interrupt controller registers.

Optional properties:

- any properties, listed in interrupts.txt, and any standard resource allocation
  properties

Example:

	h8intc: interrupt-controller@fffe00 {
		compatible = "renesas,h8s-intc", "renesas,h8300-intc";
		#interrupt-cells = <2>;
		interrupt-controller;
		reg = <0xfffe00 24>;
	};
```

## Documentation/devicetree/bindings/interrupt-controller/renesas,intc-irqpin.txt
```
DT bindings for the R-/SH-Mobile irqpin controller

Required properties:

- compatible: has to be "renesas,intc-irqpin-<soctype>", "renesas,intc-irqpin"
  as fallback.
  Examples with soctypes are:
    - "renesas,intc-irqpin-r8a7740" (R-Mobile A1)
    - "renesas,intc-irqpin-r8a7778" (R-Car M1A)
    - "renesas,intc-irqpin-r8a7779" (R-Car H1)
    - "renesas,intc-irqpin-sh73a0" (SH-Mobile AG5)

- reg: Base address and length of each register bank used by the external
  IRQ pins driven by the interrupt controller hardware module. The base
  addresses, length and number of required register banks varies with soctype.
- interrupt-controller: Identifies the node as an interrupt controller.
- #interrupt-cells: has to be <2>: an interrupt index and flags, as defined in
  interrupts.txt in this directory.
- interrupts: Must contain a list of interrupt specifiers. For each interrupt
  provided by this irqpin controller instance, there must be one entry,
  referring to the corresponding parent interrupt.

Optional properties:

- any properties, listed in interrupts.txt, and any standard resource allocation
  properties
- sense-bitfield-width: width of a single sense bitfield in the SENSE register,
  if different from the default 4 bits
- control-parent: disable and enable interrupts on the parent interrupt
  controller, needed for some broken implementations
- clocks: Must contain a reference to the functional clock.  This property is
  mandatory if the hardware implements a controllable functional clock for
  the irqpin controller instance.
- power-domains: Must contain a reference to the power domain. This property is
  mandatory if the irqpin controller instance is part of a controllable power
  domain.


Example
-------

	irqpin1: interrupt-controller@e6900004 {
		compatible = "renesas,intc-irqpin-r8a7740",
			     "renesas,intc-irqpin";
		#interrupt-cells = <2>;
		interrupt-controller;
		reg = <0xe6900004 4>,
			<0xe6900014 4>,
			<0xe6900024 1>,
			<0xe6900044 1>,
			<0xe6900064 1>;
		interrupts = <0 149 IRQ_TYPE_LEVEL_HIGH
			      0 149 IRQ_TYPE_LEVEL_HIGH
			      0 149 IRQ_TYPE_LEVEL_HIGH
			      0 149 IRQ_TYPE_LEVEL_HIGH
			      0 149 IRQ_TYPE_LEVEL_HIGH
			      0 149 IRQ_TYPE_LEVEL_HIGH
			      0 149 IRQ_TYPE_LEVEL_HIGH
			      0 149 IRQ_TYPE_LEVEL_HIGH>;
		clocks = <&mstp2_clks R8A7740_CLK_INTCA>;
		power-domains = <&pd_a4s>;
	};
```

## Documentation/devicetree/bindings/interrupt-controller/renesas,intc-irqpin.yaml
```yaml
# SPDX-License-Identifier: (GPL-2.0-only OR BSD-2-Clause)
%YAML 1.2
---
$id: http://devicetree.org/schemas/interrupt-controller/renesas,intc-irqpin.yaml#
$schema: http://devicetree.org/meta-schemas/core.yaml#

title: Renesas Interrupt Controller (INTC) for external pins

maintainers:
  - Geert Uytterhoeven <geert+renesas@glider.be>

properties:
  compatible:
    items:
      - enum:
          - renesas,intc-irqpin-r8a7740  # R-Mobile A1
          - renesas,intc-irqpin-r8a7778  # R-Car M1A
          - renesas,intc-irqpin-r8a7779  # R-Car H1
          - renesas,intc-irqpin-sh73a0   # SH-Mobile AG5
      - const: renesas,intc-irqpin

  reg:
    minItems: 5
    items:
      - description: Interrupt control register
      - description: Interrupt priority register
      - description: Interrupt source register
      - description: Interrupt mask register
      - description: Interrupt mask clear register
      - description: Interrupt control register for ICR0 with IRLM0 bit

  interrupt-controller: true

  '#interrupt-cells':
    const: 2

  interrupts:
    minItems: 1
    maxItems: 8

  sense-bitfield-width:
    $ref: /schemas/types.yaml#/definitions/uint32
    enum: [2, 4]
    default: 4
    description:
      Width of a single sense bitfield in the SENSE register, if different from the
      default.

  control-parent:
    type: boolean
    description:
      Disable and enable interrupts on the parent interrupt controller, needed for some
      broken implementations.

  clocks:
    maxItems: 1

  power-domains:
    maxItems: 1

required:
  - compatible
  - reg
  - interrupt-controller
  - '#interrupt-cells'
  - interrupts

if:
  properties:
    compatible:
      contains:
        enum:
          - renesas,intc-irqpin-r8a7740
          - renesas,intc-irqpin-sh73a0
then:
  required:
    - clocks
    - power-domains

additionalProperties: false

examples:
  - |
    #include <dt-bindings/clock/r8a7740-clock.h>
    #include <dt-bindings/interrupt-controller/arm-gic.h>
    #include <dt-bindings/interrupt-controller/irq.h>

    irqpin1: interrupt-controller@e6900004 {
        compatible = "renesas,intc-irqpin-r8a7740", "renesas,intc-irqpin";
        reg = <0xe6900004 4>,
              <0xe6900014 4>,
              <0xe6900024 1>,
              <0xe6900044 1>,
              <0xe6900064 1>;
        interrupt-controller;
        #interrupt-cells = <2>;
        interrupts = <GIC_SPI 149 IRQ_TYPE_LEVEL_HIGH>,
                     <GIC_SPI 149 IRQ_TYPE_LEVEL_HIGH>,
                     <GIC_SPI 149 IRQ_TYPE_LEVEL_HIGH>,
                     <GIC_SPI 149 IRQ_TYPE_LEVEL_HIGH>,
                     <GIC_SPI 149 IRQ_TYPE_LEVEL_HIGH>,
                     <GIC_SPI 149 IRQ_TYPE_LEVEL_HIGH>,
                     <GIC_SPI 149 IRQ_TYPE_LEVEL_HIGH>,
                     <GIC_SPI 149 IRQ_TYPE_LEVEL_HIGH>;
        clocks = <&mstp2_clks R8A7740_CLK_INTCA>;
        power-domains = <&pd_a4s>;
    };
```
