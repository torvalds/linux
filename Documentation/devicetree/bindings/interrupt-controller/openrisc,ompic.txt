## Documentation/devicetree/bindings/interrupt-controller/renesas,irqc.txt
```
DT bindings for the R-Mobile/R-Car/RZ/G interrupt controller

Required properties:

- compatible: has to be "renesas,irqc-<soctype>", "renesas,irqc" as fallback.
  Examples with soctypes are:
    - "renesas,irqc-r8a73a4" (R-Mobile APE6)
    - "renesas,irqc-r8a7743" (RZ/G1M)
    - "renesas,irqc-r8a7745" (RZ/G1E)
    - "renesas,irqc-r8a7790" (R-Car H2)
    - "renesas,irqc-r8a7791" (R-Car M2-W)
    - "renesas,irqc-r8a7792" (R-Car V2H)
    - "renesas,irqc-r8a7793" (R-Car M2-N)
    - "renesas,irqc-r8a7794" (R-Car E2)
    - "renesas,intc-ex-r8a7795" (R-Car H3)
    - "renesas,intc-ex-r8a7796" (R-Car M3-W)
    - "renesas,intc-ex-r8a77965" (R-Car M3-N)
    - "renesas,intc-ex-r8a77970" (R-Car V3M)
    - "renesas,intc-ex-r8a77995" (R-Car D3)
- #interrupt-cells: has to be <2>: an interrupt index and flags, as defined in
  interrupts.txt in this directory
- clocks: Must contain a reference to the functional clock.

Optional properties:

- any properties, listed in interrupts.txt, and any standard resource allocation
  properties

Example:

	irqc0: interrupt-controller@e61c0000 {
		compatible = "renesas,irqc-r8a7790", "renesas,irqc";
		#interrupt-cells = <2>;
		interrupt-controller;
		reg = <0 0xe61c0000 0 0x200>;
		interrupts = <0 0 IRQ_TYPE_LEVEL_HIGH>,
			     <0 1 IRQ_TYPE_LEVEL_HIGH>,
			     <0 2 IRQ_TYPE_LEVEL_HIGH>,
			     <0 3 IRQ_TYPE_LEVEL_HIGH>;
		clocks = <&mstp4_clks R8A7790_CLK_IRQC>;
	};
```

## Documentation/devicetree/bindings/interrupt-controller/renesas,irqc.yaml
```yaml
# SPDX-License-Identifier: GPL-2.0
%YAML 1.2
---
$id: http://devicetree.org/schemas/interrupt-controller/renesas,irqc.yaml#
$schema: http://devicetree.org/meta-schemas/core.yaml#

title: DT bindings for the R-Mobile/R-Car/RZ/G interrupt controller

maintainers:
  - Geert Uytterhoeven <geert+renesas@glider.be>

properties:
  compatible:
    items:
      - enum:
          - renesas,irqc-r8a73a4        # R-Mobile APE6
          - renesas,irqc-r8a7742        # RZ/G1H
          - renesas,irqc-r8a7743        # RZ/G1M
          - renesas,irqc-r8a7744        # RZ/G1N
          - renesas,irqc-r8a7745        # RZ/G1E
          - renesas,irqc-r8a77470       # RZ/G1C
          - renesas,irqc-r8a7790        # R-Car H2
          - renesas,irqc-r8a7791        # R-Car M2-W
          - renesas,irqc-r8a7792        # R-Car V2H
          - renesas,irqc-r8a7793        # R-Car M2-N
          - renesas,irqc-r8a7794        # R-Car E2
          - renesas,intc-ex-r8a774a1    # RZ/G2M
          - renesas,intc-ex-r8a774b1    # RZ/G2N
          - renesas,intc-ex-r8a774c0    # RZ/G2E
          - renesas,intc-ex-r8a7795     # R-Car H3
          - renesas,intc-ex-r8a7796     # R-Car M3-W
          - renesas,intc-ex-r8a77961    # R-Car M3-W+
          - renesas,intc-ex-r8a77965    # R-Car M3-N
          - renesas,intc-ex-r8a77970    # R-Car V3M
          - renesas,intc-ex-r8a77980    # R-Car V3H
          - renesas,intc-ex-r8a77990    # R-Car E3
          - renesas,intc-ex-r8a77995    # R-Car D3
      - const: renesas,irqc

  '#interrupt-cells':
    # an interrupt index and flags, as defined in interrupts.txt in
    # this directory
    const: 2

  interrupt-controller: true

  reg:
    maxItems: 1

  interrupts:
    minItems: 1
    maxItems: 32

  clocks:
    maxItems: 1

  power-domains:
    maxItems: 1

  resets:
    maxItems: 1

required:
  - compatible
  - '#interrupt-cells'
  - interrupt-controller
  - reg
  - interrupts
  - clocks

additionalProperties: false

examples:
  - |
    #include <dt-bindings/clock/r8a7790-cpg-mssr.h>
    #include <dt-bindings/interrupt-controller/arm-gic.h>
    #include <dt-bindings/interrupt-controller/irq.h>

    irqc0: interrupt-controller@e61c0000 {
        compatible = "renesas,irqc-r8a7790", "renesas,irqc";
        #interrupt-cells = <2>;
        interrupt-controller;
        reg = <0xe61c0000 0x200>;
        interrupts = <GIC_SPI 0 IRQ_TYPE_LEVEL_HIGH>,
                     <GIC_SPI 1 IRQ_TYPE_LEVEL_HIGH>,
                     <GIC_SPI 2 IRQ_TYPE_LEVEL_HIGH>,
                     <GIC_SPI 3 IRQ_TYPE_LEVEL_HIGH>;
        clocks = <&cpg CPG_MOD 407>;
    };
```

## Documentation/devicetree/bindings/interrupt-controller/renesas,r9a09g077-icu.yaml
```yaml
# SPDX-License-Identifier: (GPL-2.0-only OR BSD-2-Clause)
%YAML 1.2
---
$id: http://devicetree.org/schemas/interrupt-controller/renesas,r9a09g077-icu.yaml#
$schema: http://devicetree.org/meta-schemas/core.yaml#

title: Renesas RZ/{T2H,N2H} Interrupt Controller

maintainers:
  - Cosmin Tanislav <cosmin-gabriel.tanislav.xa@renesas.com>

allOf:
  - $ref: /schemas/interrupt-controller.yaml#

description:
  The Interrupt Controller (ICU) handles software-triggered interrupts
  (INTCPU), external interrupts (IRQ and SEI), error interrupts and DMAC
  requests.

properties:
  compatible:
    oneOf:
      - const: renesas,r9a09g077-icu # RZ/T2H

      - items:
          - enum:
              - renesas,r9a09g087-icu # RZ/N2H
          - const: renesas,r9a09g077-icu

  reg:
    items:
      - description: Non-safety registers (INTCPU0-13, IRQ0-13)
      - description: Safety registers (INTCPU14-15, IRQ14-15, SEI)

  '#interrupt-cells':
    description: The first cell is the SPI number of the interrupt, as per user
      manual. The second cell is used to specify the flag.
    const: 2

  '#address-cells':
    const: 0

  interrupt-controller: true

  interrupts:
    items:
      - description: Software interrupt 0
      - description: Software interrupt 1
      - description: Software interrupt 2
      - description: Software interrupt 3
      - description: Software interrupt 4
      - description: Software interrupt 5
      - description: Software interrupt 6
      - description: Software interrupt 7
      - description: Software interrupt 8
      - description: Software interrupt 9
      - description: Software interrupt 10
      - description: Software interrupt 11
      - description: Software interrupt 12
      - description: Software interrupt 13
      - description: Software interrupt 14
      - description: Software interrupt 15
      - description: External pin interrupt 0
      - description: External pin interrupt 1
      - description: External pin interrupt 2
      - description: External pin interrupt 3
      - description: External pin interrupt 4
      - description: External pin interrupt 5
      - description: External pin interrupt 6
      - description: External pin interrupt 7
      - description: External pin interrupt 8
      - description: External pin interrupt 9
      - description: External pin interrupt 10
      - description: External pin interrupt 11
      - description: External pin interrupt 12
      - description: External pin interrupt 13
      - description: External pin interrupt 14
      - description: External pin interrupt 15
      - description: System error interrupt
      - description: Cortex-A55 error event 0
      - description: Cortex-A55 error event 1
      - description: Cortex-R52 CPU 0 error event 0
      - description: Cortex-R52 CPU 0 error event 1
      - description: Cortex-R52 CPU 1 error event 0
      - description: Cortex-R52 CPU 1 error event 1
      - description: Peripherals error event 0
      - description: Peripherals error event 1
      - description: DSMIF error event 0
      - description: DSMIF error event 1
      - description: ENCIF error event 0
      - description: ENCIF error event 1

  interrupt-names:
    items:
      - const: intcpu0
      - const: intcpu1
      - const: intcpu2
      - const: intcpu3
      - const: intcpu4
      - const: intcpu5
      - const: intcpu6
      - const: intcpu7
      - const: intcpu8
      - const: intcpu9
      - const: intcpu10
      - const: intcpu11
      - const: intcpu12
      - const: intcpu13
      - const: intcpu14
      - const: intcpu15
      - const: irq0
      - const: irq1
      - const: irq2
      - const: irq3
      - const: irq4
      - const: irq5
      - const: irq6
      - const: irq7
      - const: irq8
      - const: irq9
      - const: irq10
      - const: irq11
      - const: irq12
      - const: irq13
      - const: irq14
      - const: irq15
      - const: sei
      - const: ca55-err0
      - const: ca55-err1
      - const: cr520-err0
      - const: cr520-err1
      - const: cr521-err0
      - const: cr521-err1
      - const: peri-err0
      - const: peri-err1
      - const: dsmif-err0
      - const: dsmif-err1
      - const: encif-err0
      - const: encif-err1

  clocks:
    maxItems: 1

  power-domains:
    maxItems: 1

required:
  - compatible
  - reg
  - '#interrupt-cells'
  - '#address-cells'
  - interrupt-controller
  - interrupts
  - interrupt-names
  - clocks
  - power-domains

unevaluatedProperties: false

examples:
  - |
    #include <dt-bindings/interrupt-controller/arm-gic.h>
    #include <dt-bindings/clock/renesas,r9a09g077-cpg-mssr.h>

    icu: interrupt-controller@802a0000 {
      compatible = "renesas,r9a09g077-icu";
      reg = <0x802a0000 0x10000>,
            <0x812a0000 0x50>;
      #interrupt-cells = <2>;
      #address-cells = <0>;
      interrupt-controller;
      interrupts = <GIC_SPI 0 IRQ_TYPE_EDGE_RISING>,
                   <GIC_SPI 1 IRQ_TYPE_EDGE_RISING>,
                   <GIC_SPI 2 IRQ_TYPE_EDGE_RISING>,
                   <GIC_SPI 3 IRQ_TYPE_EDGE_RISING>,
                   <GIC_SPI 4 IRQ_TYPE_EDGE_RISING>,
                   <GIC_SPI 5 IRQ_TYPE_EDGE_RISING>,
                   <GIC_SPI 6 IRQ_TYPE_EDGE_RISING>,
                   <GIC_SPI 7 IRQ_TYPE_EDGE_RISING>,
                   <GIC_SPI 8 IRQ_TYPE_EDGE_RISING>,
                   <GIC_SPI 9 IRQ_TYPE_EDGE_RISING>,
                   <GIC_SPI 10 IRQ_TYPE_EDGE_RISING>,
                   <GIC_SPI 11 IRQ_TYPE_EDGE_RISING>,
                   <GIC_SPI 12 IRQ_TYPE_EDGE_RISING>,
                   <GIC_SPI 13 IRQ_TYPE_EDGE_RISING>,
                   <GIC_SPI 14 IRQ_TYPE_EDGE_RISING>,
                   <GIC_SPI 15 IRQ_TYPE_EDGE_RISING>,
                   <GIC_SPI 16 IRQ_TYPE_EDGE_RISING>,
                   <GIC_SPI 17 IRQ_TYPE_EDGE_RISING>,
                   <GIC_SPI 18 IRQ_TYPE_EDGE_RISING>,
                   <GIC_SPI 19 IRQ_TYPE_EDGE_RISING>,
                   <GIC_SPI 20 IRQ_TYPE_EDGE_RISING>,
                   <GIC_SPI 21 IRQ_TYPE_EDGE_RISING>,
                   <GIC_SPI 22 IRQ_TYPE_EDGE_RISING>,
                   <GIC_SPI 23 IRQ_TYPE_EDGE_RISING>,
                   <GIC_SPI 24 IRQ_TYPE_EDGE_RISING>,
                   <GIC_SPI 25 IRQ_TYPE_EDGE_RISING>,
                   <GIC_SPI 26 IRQ_TYPE_EDGE_RISING>,
                   <GIC_SPI 27 IRQ_TYPE_EDGE_RISING>,
                   <GIC_SPI 28 IRQ_TYPE_EDGE_RISING>,
                   <GIC_SPI 29 IRQ_TYPE_EDGE_RISING>,
                   <GIC_SPI 30 IRQ_TYPE_EDGE_RISING>,
                   <GIC_SPI 31 IRQ_TYPE_EDGE_RISING>,
                   <GIC_SPI 406 IRQ_TYPE_EDGE_RISING>,
                   <GIC_SPI 407 IRQ_TYPE_EDGE_RISING>,
                   <GIC_SPI 408 IRQ_TYPE_EDGE_RISING>,
                   <GIC_SPI 409 IRQ_TYPE_EDGE_RISING>,
                   <GIC_SPI 410 IRQ_TYPE_EDGE_RISING>,
                   <GIC_SPI 411 IRQ_TYPE_EDGE_RISING>,
                   <GIC_SPI 412 IRQ_TYPE_EDGE_RISING>,
                   <GIC_SPI 413 IRQ_TYPE_EDGE_RISING>,
                   <GIC_SPI 414 IRQ_TYPE_EDGE_RISING>,
                   <GIC_SPI 415 IRQ_TYPE_EDGE_RISING>,
                   <GIC_SPI 416 IRQ_TYPE_EDGE_RISING>,
                   <GIC_SPI 417 IRQ_TYPE_EDGE_RISING>,
                   <GIC_SPI 418 IRQ_TYPE_EDGE_RISING>;
      interrupt-names = "intcpu0", "intcpu1", "intcpu2",
                        "intcpu3", "intcpu4", "intcpu5",
                        "intcpu6", "intcpu7", "intcpu8",
                        "intcpu9", "intcpu10", "intcpu11",
                        "intcpu12", "intcpu13", "intcpu14",
                        "intcpu15",
                        "irq0", "irq1", "irq2", "irq3",
                        "irq4", "irq5", "irq6", "irq7",
                        "irq8", "irq9", "irq10", "irq11",
                        "irq12", "irq13", "irq14", "irq15",
                        "sei",
                        "ca55-err0", "ca55-err1",
                        "cr520-err0", "cr520-err1",
                        "cr521-err0", "cr521-err1",
                        "peri-err0", "peri-err1",
                        "dsmif-err0", "dsmif-err1",
                        "encif-err0", "encif-err1";
      clocks = <&cpg CPG_CORE R9A09G077_CLK_PCLKM>;
      power-domains = <&cpg>;
    };
```

## Documentation/devicetree/bindings/interrupt-controller/renesas,rza1-irqc.txt
```
DT bindings for the Renesas RZ/A1 Interrupt Controller

The RZ/A1 Interrupt Controller is a front-end for the GIC found on Renesas
RZ/A1 and RZ/A2 SoCs:
  - IRQ sense select for 8 external interrupts, 1:1-mapped to 8 GIC SPI
    interrupts,
  - NMI edge select.

Required properties:
  - compatible: Must be "renesas,<soctype>-irqc", and "renesas,rza1-irqc" as
		fallback.
		Examples with soctypes are:
		  - "renesas,r7s72100-irqc" (RZ/A1H)
		  - "renesas,r7s9210-irqc" (RZ/A2M)
  - #interrupt-cells: Must be 2 (an interrupt index and flags, as defined
				 in interrupts.txt in this directory)
  - #address-cells: Must be zero
  - interrupt-controller: Marks the device as an interrupt controller
  - reg: Base address and length of the memory resource used by the interrupt
         controller
  - interrupt-map: Specifies the mapping from external interrupts to GIC
		   interrupts
  - interrupt-map-mask: Must be <7 0>

Example:

	irqc: interrupt-controller@fcfef800 {
		compatible = "renesas,r7s72100-irqc", "renesas,rza1-irqc";
		#interrupt-cells = <2>;
		#address-cells = <0>;
		interrupt-controller;
		reg = <0xfcfef800 0x6>;
		interrupt-map =
			<0 0 &gic GIC_SPI 0 IRQ_TYPE_LEVEL_HIGH>,
			<1 0 &gic GIC_SPI 1 IRQ_TYPE_LEVEL_HIGH>,
			<2 0 &gic GIC_SPI 2 IRQ_TYPE_LEVEL_HIGH>,
			<3 0 &gic GIC_SPI 3 IRQ_TYPE_LEVEL_HIGH>,
			<4 0 &gic GIC_SPI 4 IRQ_TYPE_LEVEL_HIGH>,
			<5 0 &gic GIC_SPI 5 IRQ_TYPE_LEVEL_HIGH>,
			<6 0 &gic GIC_SPI 6 IRQ_TYPE_LEVEL_HIGH>,
			<7 0 &gic GIC_SPI 7 IRQ_TYPE_LEVEL_HIGH>;
		interrupt-map-mask = <7 0>;
	};
```
