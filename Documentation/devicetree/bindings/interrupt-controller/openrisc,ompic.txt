## Documentation/devicetree/bindings/interrupt-controller/openrisc,ompic.txt
```
Open Multi-Processor Interrupt Controller

Required properties:

- compatible : This should be "openrisc,ompic"
- reg : Specifies base physical address and size of the register space. The
  size is based on the number of cores the controller has been configured
  to handle, this should be set to 8 bytes per cpu core.
- interrupt-controller : Identifies the node as an interrupt controller.
- #interrupt-cells : This should be set to 0 as this will not be an irq
  parent.
- interrupts : Specifies the interrupt line to which the ompic is wired.

Example:

ompic: interrupt-controller@98000000 {
	compatible = "openrisc,ompic";
	reg = <0x98000000 16>;
	interrupt-controller;
	#interrupt-cells = <0>;
	interrupts = <1>;
};
```

## Documentation/devicetree/bindings/interrupt-controller/openrisc,ompic.yaml
```yaml
# SPDX-License-Identifier: (GPL-2.0-only OR BSD-2-Clause)
%YAML 1.2
---
$id: http://devicetree.org/schemas/interrupt-controller/openrisc,ompic.yaml#
$schema: http://devicetree.org/meta-schemas/core.yaml#

title: Open Multi-Processor Interrupt Controller

maintainers:
  - Stafford Horne <shorne@gmail.com>

properties:
  compatible:
    items:
      - const: openrisc,ompic

  reg:
    maxItems: 1

  interrupt-controller: true

  '#interrupt-cells':
    const: 0

  interrupts:
    maxItems: 1

required:
  - compatible
  - reg
  - interrupt-controller
  - '#interrupt-cells'
  - interrupts

additionalProperties: false

examples:
  - |
    interrupt-controller@98000000 {
        compatible = "openrisc,ompic";
        reg = <0x98000000 16>;
        interrupt-controller;
        #interrupt-cells = <0>;
        interrupts = <1>;
    };
```

## Documentation/devicetree/bindings/interrupt-controller/qca,ar7100-cpu-intc.yaml
```yaml
# SPDX-License-Identifier: (GPL-2.0-only OR BSD-2-Clause)
%YAML 1.2
---
$id: http://devicetree.org/schemas/interrupt-controller/qca,ar7100-cpu-intc.yaml#
$schema: http://devicetree.org/meta-schemas/core.yaml#

title: Qualcomm Atheros ath79 CPU interrupt controller

maintainers:
  - Alban Bedel <albeu@free.fr>

description:
  On most SoC the IRQ controller need to flush the DDR FIFO before running the
  interrupt handler of some devices. This is configured using the
  qca,ddr-wb-channels and qca,ddr-wb-channel-interrupts properties.

properties:
  compatible:
    oneOf:
      - items:
          - const: qca,ar9132-cpu-intc
          - const: qca,ar7100-cpu-intc
      - items:
          - const: qca,ar7100-cpu-intc

  interrupt-controller: true

  '#interrupt-cells':
    const: 1

  qca,ddr-wb-channel-interrupts:
    description: List of interrupts needing a write buffer flush
    $ref: /schemas/types.yaml#/definitions/uint32-array

  qca,ddr-wb-channels:
    description: List of write buffer channel phandles for each interrupt
    $ref: /schemas/types.yaml#/definitions/phandle-array

required:
  - compatible
  - interrupt-controller
  - '#interrupt-cells'

additionalProperties: false

examples:
  - |
      interrupt-controller {
          compatible = "qca,ar9132-cpu-intc", "qca,ar7100-cpu-intc";

          interrupt-controller;
          #interrupt-cells = <1>;

          qca,ddr-wb-channel-interrupts = <2>, <3>, <4>, <5>;
          qca,ddr-wb-channels = <&ddr_ctrl 3>, <&ddr_ctrl 2>,
                                <&ddr_ctrl 0>, <&ddr_ctrl 1>;
      };

      ddr_ctrl: memory-controller {
          #qca,ddr-wb-channel-cells = <1>;
      };
```

## Documentation/devicetree/bindings/interrupt-controller/qca,ar7100-misc-intc.yaml
```yaml
# SPDX-License-Identifier: (GPL-2.0-only OR BSD-2-Clause)
%YAML 1.2
---
$id: http://devicetree.org/schemas/interrupt-controller/qca,ar7100-misc-intc.yaml#
$schema: http://devicetree.org/meta-schemas/core.yaml#

title: Qualcomm Atheros AR7xxx/AR9XXX MISC interrupt controller

maintainers:
  - Alban Bedel <albeu@free.fr>
  - Alexander Couzens <lynxis@fe80.eu>

description:
  The Qualcomm Atheros AR7xxx/AR9XXX MISC interrupt controller is a secondary
  controller for lower priority interrupts.

properties:
  compatible:
    oneOf:
      - items:
          - const: qca,ar9132-misc-intc
          - const: qca,ar7100-misc-intc
      - const: qca,ar7240-misc-intc
  reg:
    maxItems: 1

  interrupts:
    maxItems: 1

  interrupt-controller: true

  '#interrupt-cells':
    const: 1

additionalProperties: false

required:
  - compatible
  - reg
  - interrupts
  - interrupt-controller
  - "#interrupt-cells"

examples:
  - |
    interrupt-controller@18060010 {
        compatible = "qca,ar9132-misc-intc", "qca,ar7100-misc-intc";
        reg = <0x18060010 0x4>;
        interrupts = <6>;
        interrupt-controller;
        #interrupt-cells = <1>;
    };
```

## Documentation/devicetree/bindings/interrupt-controller/qca,ath79-cpu-intc.txt
```
Binding for Qualcomm Atheros AR7xxx/AR9XXX CPU interrupt controller

On most SoC the IRQ controller need to flush the DDR FIFO before running
the interrupt handler of some devices. This is configured using the
qca,ddr-wb-channels and qca,ddr-wb-channel-interrupts properties.

Required Properties:

- compatible: has to be "qca,<soctype>-cpu-intc", "qca,ar7100-cpu-intc"
  as fallback
- interrupt-controller : Identifies the node as an interrupt controller
- #interrupt-cells : Specifies the number of cells needed to encode interrupt
		     source, should be 1 for intc

Please refer to interrupts.txt in this directory for details of the common
Interrupt Controllers bindings used by client devices.

Optional Properties:

- qca,ddr-wb-channel-interrupts: List of the interrupts needing a write
  buffer flush
- qca,ddr-wb-channels: List of phandles to the write buffer channels for
  each interrupt. If qca,ddr-wb-channel-interrupts is not present the interrupt
  default to the entry's index.

Example:

	interrupt-controller {
		compatible = "qca,ar9132-cpu-intc", "qca,ar7100-cpu-intc";

		interrupt-controller;
		#interrupt-cells = <1>;

		qca,ddr-wb-channel-interrupts = <2>, <3>, <4>, <5>;
		qca,ddr-wb-channels = <&ddr_ctrl 3>, <&ddr_ctrl 2>,
					<&ddr_ctrl 0>, <&ddr_ctrl 1>;
	};

	...

	ddr_ctrl: memory-controller@18000000 {
		...
		#qca,ddr-wb-channel-cells = <1>;
	};
```

## Documentation/devicetree/bindings/interrupt-controller/qca,ath79-misc-intc.txt
```
Binding for Qualcomm Atheros AR7xxx/AR9XXX MISC interrupt controller

The MISC interrupt controller is a secondary controller for lower priority
interrupt.

Required Properties:
- compatible: has to be "qca,<soctype>-cpu-intc", "qca,ar7100-misc-intc" or
  "qca,<soctype>-cpu-intc", "qca,ar7240-misc-intc"
- reg: Base address and size of the controllers memory area
- interrupts: Interrupt specifier for the controllers interrupt.
- interrupt-controller : Identifies the node as an interrupt controller
- #interrupt-cells : Specifies the number of cells needed to encode interrupt
		     source, should be 1

Compatible fallback depends on the SoC. Use ar7100 for ar71xx and ar913x,
use ar7240 for all other SoCs.

Please refer to interrupts.txt in this directory for details of the common
Interrupt Controllers bindings used by client devices.

Example:

	interrupt-controller@18060010 {
		compatible = "qca,ar9132-misc-intc", "qca,ar7100-misc-intc";
		reg = <0x18060010 0x4>;

		interrupt-parent = <&cpuintc>;
		interrupts = <6>;

		interrupt-controller;
		#interrupt-cells = <1>;
	};

Another example:

	interrupt-controller@18060010 {
		compatible = "qca,ar9331-misc-intc", qca,ar7240-misc-intc";
		reg = <0x18060010 0x4>;

		interrupt-parent = <&cpuintc>;
		interrupts = <6>;

		interrupt-controller;
		#interrupt-cells = <1>;
	};
```

## Documentation/devicetree/bindings/interrupt-controller/qcom,mpm.yaml
```yaml
# SPDX-License-Identifier: (GPL-2.0-only OR BSD-2-Clause)
%YAML 1.2
---
$id: http://devicetree.org/schemas/interrupt-controller/qcom,mpm.yaml#
$schema: http://devicetree.org/meta-schemas/core.yaml#

title: Qualcom MPM Interrupt Controller

maintainers:
  - Shawn Guo <shawn.guo@linaro.org>

description:
  Qualcomm Technologies Inc. SoCs based on the RPM architecture have a
  MSM Power Manager (MPM) that is in always-on domain. In addition to managing
  resources during sleep, the hardware also has an interrupt controller that
  monitors the interrupts when the system is asleep, wakes up the APSS when
  one of these interrupts occur and replays it to GIC interrupt controller
  after GIC becomes operational.

allOf:
  - $ref: /schemas/interrupt-controller.yaml#

properties:
  compatible:
    items:
      - const: qcom,mpm

  reg:
    maxItems: 1
    description:
      Specifies the base address and size of vMPM registers in RPM MSG RAM.
    deprecated: true

  qcom,rpm-msg-ram:
    $ref: /schemas/types.yaml#/definitions/phandle
    description:
      Phandle to the APSS MPM slice of the RPM Message RAM

  interrupts:
    maxItems: 1
    description:
      Specify the IRQ used by RPM to wakeup APSS.

  mboxes:
    maxItems: 1
    description:
      Specify the mailbox used to notify RPM for writing vMPM registers.

  interrupt-controller: true

  '#interrupt-cells':
    const: 2
    description:
      The first cell is the MPM pin number for the interrupt, and the second
      is the trigger type.

  qcom,mpm-pin-count:
    description:
      Specify the total MPM pin count that a SoC supports.
    $ref: /schemas/types.yaml#/definitions/uint32

  qcom,mpm-pin-map:
    description:
      A set of MPM pin numbers and the corresponding GIC SPIs.
    $ref: /schemas/types.yaml#/definitions/uint32-matrix
    items:
      items:
        - description: MPM pin number
        - description: GIC SPI number for the MPM pin

  '#power-domain-cells':
    const: 0

required:
  - compatible
  - interrupts
  - mboxes
  - interrupt-controller
  - '#interrupt-cells'
  - qcom,mpm-pin-count
  - qcom,mpm-pin-map
  - qcom,rpm-msg-ram

additionalProperties: false

examples:
  - |
    #include <dt-bindings/interrupt-controller/arm-gic.h>

    remoteproc-rpm {
        compatible = "qcom,msm8998-rpm-proc", "qcom,rpm-proc";

        glink-edge {
            compatible = "qcom,glink-rpm";

            interrupts = <GIC_SPI 168 IRQ_TYPE_EDGE_RISING>;
            qcom,rpm-msg-ram = <&rpm_msg_ram>;
            mboxes = <&apcs_glb 0>;
        };

        mpm: interrupt-controller {
            compatible = "qcom,mpm";
            qcom,rpm-msg-ram = <&apss_mpm>;
            interrupts = <GIC_SPI 197 IRQ_TYPE_EDGE_RISING>;
            mboxes = <&apcs_glb 1>;
            interrupt-controller;
            #interrupt-cells = <2>;
            interrupt-parent = <&intc>;
            qcom,mpm-pin-count = <96>;
            qcom,mpm-pin-map = <2 275>,
                               <5 296>,
                               <12 422>,
                               <24 79>,
                               <86 183>,
                               <91 260>;
            #power-domain-cells = <0>;
        };
    };
```

## Documentation/devicetree/bindings/interrupt-controller/qcom,pdc.txt
```
PDC interrupt controller

Qualcomm Technologies Inc. SoCs based on the RPM Hardened architecture have a
Power Domain Controller (PDC) that is on always-on domain. In addition to
providing power control for the power domains, the hardware also has an
interrupt controller that can be used to help detect edge low interrupts as
well detect interrupts when the GIC is non-operational.

GIC is parent interrupt controller at the highest level. Platform interrupt
controller PDC is next in hierarchy, followed by others. Drivers requiring
wakeup capabilities of their device interrupts routed through the PDC, must
specify PDC as their interrupt controller and request the PDC port associated
with the GIC interrupt. See example below.

Properties:

- compatible:
	Usage: required
	Value type: <string>
	Definition: Should contain "qcom,<soc>-pdc" and "qcom,pdc"
		    - "qcom,sc7180-pdc": For SC7180
		    - "qcom,sdm845-pdc": For SDM845
		    - "qcom,sdm8250-pdc": For SM8250
		    - "qcom,sdm8350-pdc": For SM8350

- reg:
	Usage: required
	Value type: <prop-encoded-array>
	Definition: Specifies the base physical address for PDC hardware.
		    Optionally, specify the PDC's GIC interface registers that
		    need to be configured for wakeup capable GPIOs routed to
		    the PDC.

- interrupt-cells:
	Usage: required
	Value type: <u32>
	Definition: Specifies the number of cells needed to encode an interrupt
		    source.
		    Must be 2.
		    The first element of the tuple is the PDC pin for the
		    interrupt.
		    The second element is the trigger type.

- interrupt-controller:
	Usage: required
	Value type: <bool>
	Definition: Identifies the node as an interrupt controller.

- qcom,pdc-ranges:
	Usage: required
	Value type: <u32 array>
	Definition: Specifies the PDC pin offset and the number of PDC ports.
		    The tuples indicates the valid mapping of valid PDC ports
		    and their hwirq mapping.
		    The first element of the tuple is the starting PDC port.
		    The second element is the GIC hwirq number for the PDC port.
		    The third element is the number of interrupts in sequence.

- qcom,scm-spi-cfg:
	Usage: optional
	Value type: <bool>
	Definition: Specifies if the SPI configuration registers have to be
		    written from the firmware. Sometimes the PDC interface
		    register to the GIC can only be written from the firmware.

Example:

	pdc: interrupt-controller@b220000 {
		compatible = "qcom,sdm845-pdc";
		reg = <0 0x0b220000 0 0x30000>, <0 0x179900f0 0 0x60>;
		qcom,pdc-ranges = <0 512 94>, <94 641 15>, <115 662 7>;
		#interrupt-cells = <2>;
		interrupt-parent = <&intc>;
		interrupt-controller;
		qcom,scm-spi-cfg;
	};

DT binding of a device that wants to use the GIC SPI 514 as a wakeup
interrupt, must do -

	wake-device {
		interrupts-extended = <&pdc 2 IRQ_TYPE_LEVEL_HIGH>;
	};

In this case interrupt 514 would be mapped to port 2 on the PDC as defined by
the qcom,pdc-ranges property.
```
