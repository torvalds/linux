## Documentation/devicetree/bindings/i2c/brcm,brcmstb-i2c.yaml
```yaml
# SPDX-License-Identifier: GPL-2.0
%YAML 1.2
---
$id: http://devicetree.org/schemas/i2c/brcm,brcmstb-i2c.yaml#
$schema: http://devicetree.org/meta-schemas/core.yaml#

title: Broadcom STB BSC IIC Master Controller

maintainers:
  - Kamal Dasu <kdasu.kdev@gmail.com>

allOf:
  - $ref: /schemas/i2c/i2c-controller.yaml#

properties:
  compatible:
    enum:
      - brcm,bcm2711-hdmi-i2c
      - brcm,brcmstb-i2c
      - brcm,brcmper-i2c

  reg:
    minItems: 1
    maxItems: 2
    items:
      - description: BSC register range
      - description: Auto-I2C register range

  reg-names:
    items:
      - const: bsc
      - const: auto-i2c

  interrupts:
    maxItems: 1

  interrupt-names:
    maxItems: 1

  clock-frequency:
    enum:
      - 46875
      - 50000
      - 93750
      - 97500
      - 187500
      - 200000
      - 375000
      - 390000

required:
  - compatible
  - reg
  - clock-frequency

unevaluatedProperties: false

if:
  properties:
    compatible:
      contains:
        enum:
          - brcm,bcm2711-hdmi-i2c

then:
  properties:
    reg:
      minItems: 2

  required:
    - reg-names

else:
  properties:
    reg:
      maxItems: 1

examples:
  - |
      bsca: i2c@f0406200 {
          clock-frequency = <390000>;
          compatible = "brcm,brcmstb-i2c";
          interrupt-parent = <&irq0_intc>;
          reg = <0xf0406200 0x58>;
          interrupts = <0x18>;
          interrupt-names = "upg_bsca";
      };

  - |
      ddc0: i2c@7ef04500 {
          compatible = "brcm,bcm2711-hdmi-i2c";
          reg = <0x7ef04500 0x100>, <0x7ef00b00 0x300>;
          reg-names = "bsc", "auto-i2c";
          clock-frequency = <390000>;
      };

...
```

## Documentation/devicetree/bindings/i2c/brcm,iproc-i2c.txt
```
Broadcom iProc I2C controller

Required properties:

- compatible:
    Must be "brcm,iproc-i2c"

- reg:
    Define the base and range of the I/O address space that contain the iProc
    I2C controller registers

- interrupts:
    Should contain the I2C interrupt

- clock-frequency:
    This is the I2C bus clock. Need to be either 100000 or 400000

- #address-cells:
    Always 1 (for I2C addresses)

- #size-cells:
    Always 0

Example:
	i2c0: i2c@18008000 {
		compatible = "brcm,iproc-i2c";
		reg = <0x18008000 0x100>;
		#address-cells = <1>;
		#size-cells = <0>;
		interrupts = <GIC_SPI 85 IRQ_TYPE_NONE>;
		clock-frequency = <100000>;

		codec: wm8750@1a {
			compatible = "wlf,wm8750";
			reg = <0x1a>;
		};
	};
```

## Documentation/devicetree/bindings/i2c/brcm,iproc-i2c.yaml
```yaml
# SPDX-License-Identifier: GPL-2.0-only OR BSD-2-Clause
%YAML 1.2
---
$id: http://devicetree.org/schemas/i2c/brcm,iproc-i2c.yaml#
$schema: http://devicetree.org/meta-schemas/core.yaml#

title: Broadcom iProc I2C controller

maintainers:
  - Rafał Miłecki <rafal@milecki.pl>

properties:
  compatible:
    enum:
      - brcm,iproc-i2c
      - brcm,iproc-nic-i2c

  reg:
    maxItems: 1

  clock-frequency:
    enum: [ 100000, 400000 ]

  interrupts:
    description: |
      Should contain the I2C interrupt. For certain revisions of the I2C
      controller, I2C interrupt is unwired to the interrupt controller. In such
      case, this property should be left unspecified, and driver will fall back
      to polling mode
    maxItems: 1

  brcm,ape-hsls-addr-mask:
    $ref: /schemas/types.yaml#/definitions/uint32
    description: Host view of address mask into the 'APE' co-processor

allOf:
  - $ref: /schemas/i2c/i2c-controller.yaml#
  - if:
      properties:
        compatible:
          contains:
            const: brcm,iproc-nic-i2c
    then:
      required:
        - brcm,ape-hsls-addr-mask

unevaluatedProperties: false

required:
  - reg
  - clock-frequency
  - '#address-cells'
  - '#size-cells'

examples:
  - |
    #include <dt-bindings/interrupt-controller/arm-gic.h>

    i2c@18008000 {
        compatible = "brcm,iproc-i2c";
        reg = <0x18008000 0x100>;
        #address-cells = <1>;
        #size-cells = <0>;
        interrupts = <GIC_SPI 85 IRQ_TYPE_NONE>;
        clock-frequency = <100000>;

        wm8750@1a {
            compatible = "wlf,wm8750";
            reg = <0x1a>;
        };
    };
```

## Documentation/devicetree/bindings/i2c/brcm,kona-i2c.txt
```
Broadcom Kona Family I2C
=========================

This I2C controller is used in the following Broadcom SoCs:

  BCM11130
  BCM11140
  BCM11351
  BCM28145
  BCM28155

Required Properties
-------------------
- compatible: "brcm,bcm11351-i2c", "brcm,kona-i2c"
- reg: Physical base address and length of controller registers
- interrupts: The interrupt number used by the controller
- clocks: clock specifier for the kona i2c external clock
- clock-frequency: The I2C bus frequency in Hz
- #address-cells: Should be <1>
- #size-cells: Should be <0>

Refer to clocks/clock-bindings.txt for generic clock consumer
properties.

Example:

i2c@3e016000 {
	compatible = "brcm,bcm11351-i2c","brcm,kona-i2c";
	reg = <0x3e016000 0x80>;
	interrupts = <GIC_SPI 103 IRQ_TYPE_LEVEL_HIGH>;
	clocks = <&bsc1_clk>;
	clock-frequency = <400000>;
	#address-cells = <1>;
	#size-cells = <0>;
};
```

## Documentation/devicetree/bindings/i2c/brcm,kona-i2c.yaml
```yaml
# SPDX-License-Identifier: (GPL-2.0-only OR BSD-2-Clause)
%YAML 1.2
---
$id: http://devicetree.org/schemas/i2c/brcm,kona-i2c.yaml#
$schema: http://devicetree.org/meta-schemas/core.yaml#

title: Broadcom Kona family I2C controller

maintainers:
  - Florian Fainelli <f.fainelli@gmail.com>

allOf:
  - $ref: /schemas/i2c/i2c-controller.yaml#

properties:
  compatible:
    items:
      - enum:
          - brcm,bcm11351-i2c
          - brcm,bcm21664-i2c
          - brcm,bcm23550-i2c
      - const: brcm,kona-i2c

  reg:
    maxItems: 1

  interrupts:
    maxItems: 1

  clocks:
    maxItems: 1

  clock-frequency:
    enum: [ 100000, 400000, 1000000, 3400000 ]

required:
  - compatible
  - reg
  - interrupts
  - clocks
  - clock-frequency

unevaluatedProperties: false

examples:
  - |
    #include <dt-bindings/interrupt-controller/arm-gic.h>
    #include <dt-bindings/interrupt-controller/irq.h>

    i2c@3e016000 {
        compatible = "brcm,bcm11351-i2c", "brcm,kona-i2c";
        reg = <0x3e016000 0x80>;
        interrupts = <GIC_SPI 103 IRQ_TYPE_LEVEL_HIGH>;
        clocks = <&bsc1_clk>;
        clock-frequency = <400000>;
        #address-cells = <1>;
        #size-cells = <0>;
    };
...
```

## Documentation/devicetree/bindings/i2c/cdns,i2c-r1p10.yaml
```yaml
# SPDX-License-Identifier: (GPL-2.0 OR BSD-2-Clause)
%YAML 1.2
---
$id: http://devicetree.org/schemas/i2c/cdns,i2c-r1p10.yaml#
$schema: http://devicetree.org/meta-schemas/core.yaml#

title: Cadence I2C controller

maintainers:
  - Michal Simek <michal.simek@amd.com>

allOf:
  - $ref: /schemas/i2c/i2c-controller.yaml#

properties:
  compatible:
    enum:
      - cdns,i2c-r1p10 # cadence i2c controller version 1.0
      - cdns,i2c-r1p14 # cadence i2c controller version 1.4

  reg:
    maxItems: 1

  clocks:
    minItems: 1

  resets:
    maxItems: 1

  interrupts:
    maxItems: 1

  clock-frequency:
    minimum: 1
    maximum: 400000
    description: |
      Desired operating frequency, in Hz, of the bus.

  clock-name:
    const: pclk
    description: |
      Input clock name.

  fifo-depth:
    description:
      Size of the data FIFO in bytes.
    $ref: /schemas/types.yaml#/definitions/uint32
    default: 16
    enum: [2, 4, 8, 16, 32, 64, 128, 256]

  power-domains:
    maxItems: 1

required:
  - compatible
  - reg
  - clocks
  - interrupts

unevaluatedProperties: false

examples:
  - |
    #include <dt-bindings/interrupt-controller/arm-gic.h>
    i2c@e0004000 {
        compatible = "cdns,i2c-r1p10";
        clocks = <&clkc 38>;
        resets = <&rstc 288>;
        interrupts = <GIC_SPI 25 IRQ_TYPE_LEVEL_HIGH>;
        reg = <0xe0004000 0x1000>;
        clock-frequency = <400000>;
        #address-cells = <1>;
        #size-cells = <0>;
        fifo-depth = <8>;
    };
```

## Documentation/devicetree/bindings/i2c/davinci.txt
```
* Texas Instruments Davinci I2C

This file provides information, what the device node for the
davinci i2c interface contain.

Required properties:
- compatible: "ti,davinci-i2c";
- reg : Offset and length of the register set for the device

Recommended properties :
- interrupts : standard interrupt property.
- clock-frequency : desired I2C bus clock frequency in Hz.

Example (enbw_cmc board):
	i2c@1c22000 {
		compatible = "ti,davinci-i2c";
		reg = <0x22000 0x1000>;
		clock-frequency = <100000>;
		interrupts = <15>;
		interrupt-parent = <&intc>;
		#address-cells = <1>;
		#size-cells = <0>;

		dtt@48 {
			compatible = "national,lm75";
			reg = <0x48>;
		};
	};
```

## Documentation/devicetree/bindings/i2c/google,cros-ec-i2c-tunnel.yaml
```yaml
# SPDX-License-Identifier: (GPL-2.0 OR BSD-2-Clause)
%YAML 1.2
---

$id: http://devicetree.org/schemas/i2c/google,cros-ec-i2c-tunnel.yaml#
$schema: http://devicetree.org/meta-schemas/core.yaml#

title: I2C bus that tunnels through the ChromeOS EC (cros-ec)

maintainers:
  - Doug Anderson <dianders@chromium.org>
  - Benson Leung <bleung@chromium.org>

description: |
  On some ChromeOS board designs we've got a connection to the EC
  (embedded controller) but no direct connection to some devices on the
  other side of the EC (like a battery and PMIC).  To get access to
  those devices we need to tunnel our i2c commands through the EC.

  The node for this device should be under a cros-ec node like
  google,cros-ec-spi or google,cros-ec-i2c.

allOf:
  - $ref: i2c-controller.yaml#

properties:
  compatible:
    const: google,cros-ec-i2c-tunnel

  google,remote-bus:
    description: The EC bus we'd like to talk to.
    $ref: /schemas/types.yaml#/definitions/uint32

required:
  - compatible
  - google,remote-bus

unevaluatedProperties: false

examples:
  - |
    spi0 {
        #address-cells = <1>;
        #size-cells = <0>;

        cros-ec@0 {
            compatible = "google,cros-ec-spi";
            reg = <0>;
            spi-max-frequency = <5000000>;

            i2c-tunnel {
                compatible = "google,cros-ec-i2c-tunnel";
                #address-cells = <1>;
                #size-cells = <0>;

                google,remote-bus = <0>;

                battery: sbs-battery@b {
                    compatible = "sbs,sbs-battery";
                    reg = <0xb>;
                    sbs,poll-retry-count = <1>;
                };
            };
        };
    };
```

## Documentation/devicetree/bindings/i2c/hisilicon,ascend910-i2c.yaml
```yaml
# SPDX-License-Identifier: (GPL-2.0 OR BSD-2-Clause)
%YAML 1.2
---
$id: http://devicetree.org/schemas/i2c/hisilicon,ascend910-i2c.yaml#
$schema: http://devicetree.org/meta-schemas/core.yaml#

title: HiSilicon common I2C controller

maintainers:
  - Yicong Yang <yangyicong@hisilicon.com>

description:
  The HiSilicon common I2C controller can be used for many different
  types of SoC such as Huawei Ascend AI series chips.

allOf:
  - $ref: /schemas/i2c/i2c-controller.yaml#

properties:
  compatible:
    const: hisilicon,ascend910-i2c

  reg:
    maxItems: 1

  interrupts:
    maxItems: 1

  clocks:
    maxItems: 1

  clock-frequency:
    default: 400000

  i2c-sda-falling-time-ns:
    default: 343

  i2c-scl-falling-time-ns:
    default: 203

  i2c-sda-hold-time-ns:
    default: 830

  i2c-scl-rising-time-ns:
    default: 365

  i2c-digital-filter-width-ns:
    default: 0

required:
  - compatible
  - reg
  - interrupts

unevaluatedProperties: false

examples:
  - |
    #include <dt-bindings/interrupt-controller/arm-gic.h>

    i2c@38b0000 {
      compatible = "hisilicon,ascend910-i2c";
      reg = <0x38b0000 0x10000>;
      interrupts = <GIC_SPI 120 IRQ_TYPE_LEVEL_HIGH>;
      i2c-sda-falling-time-ns = <56>;
      i2c-scl-falling-time-ns = <56>;
      i2c-sda-hold-time-ns = <56>;
      i2c-scl-rising-time-ns = <56>;
      i2c-digital-filter;
      i2c-digital-filter-width-ns = <0x0>;
      clocks = <&alg_clk>;
      clock-frequency = <400000>;
    };
```

## Documentation/devicetree/bindings/i2c/hisilicon,hix5hd2-i2c.yaml
```yaml
# SPDX-License-Identifier: GPL-2.0-only OR BSD-2-Clause
%YAML 1.2
---
$id: http://devicetree.org/schemas/i2c/hisilicon,hix5hd2-i2c.yaml#
$schema: http://devicetree.org/meta-schemas/core.yaml#
title: I2C for HiSilicon hix5hd2 chipset platform

maintainers:
  - Wei Yan <sledge.yanwei@huawei.com>

allOf:
  - $ref: /schemas/i2c/i2c-controller.yaml#

properties:
  compatible:
    enum:
      - hisilicon,hix5hd2-i2c

  reg:
    maxItems: 1

  interrupts:
    maxItems: 1

  clocks:
    maxItems: 1

  clock-frequency:
    description: Desired I2C bus frequency in Hz
    default: 100000

required:
  - compatible
  - reg
  - interrupts
  - clocks

unevaluatedProperties: false

examples:
  - |
    #include <dt-bindings/clock/hix5hd2-clock.h>

    i2c@f8b10000 {
        compatible = "hisilicon,hix5hd2-i2c";
        reg = <0xf8b10000 0x1000>;
        interrupts = <0 38 4>;
        clocks = <&clock HIX5HD2_I2C0_RST>;
        #address-cells = <1>;
        #size-cells = <0>;
    };
```

## Documentation/devicetree/bindings/i2c/hpe,gxp-i2c.yaml
```yaml
# SPDX-License-Identifier: (GPL-2.0-only OR BSD-2-Clause)
%YAML 1.2
---
$id: http://devicetree.org/schemas/i2c/hpe,gxp-i2c.yaml#
$schema: http://devicetree.org/meta-schemas/core.yaml#

title: HPE GXP SoC I2C Controller

maintainers:
  - Nick Hawkins <nick.hawkins@hpe.com>

allOf:
  - $ref: /schemas/i2c/i2c-controller.yaml#

properties:
  compatible:
    const: hpe,gxp-i2c

  reg:
    maxItems: 1

  interrupts:
    maxItems: 1

  clock-frequency:
    default: 100000

  hpe,sysreg:
    $ref: /schemas/types.yaml#/definitions/phandle
    description:
      Phandle to the global status and enable interrupt registers shared
      between each I2C engine controller instance. It enables the I2C
      engine controller to act as both a master or slave by being able to
      arm and respond to interrupts from its engine. Each bit in the
      registers represent the respective bit position.

required:
  - compatible
  - reg
  - interrupts

unevaluatedProperties: false

examples:
  - |
    i2c@2600 {
        compatible = "hpe,gxp-i2c";
        reg = <0x2500 0x70>;
        interrupts = <9>;
        #address-cells = <1>;
        #size-cells = <0>;
        hpe,sysreg = <&sysreg_system_controller>;
        clock-frequency = <10000>;

        eeprom@50 {
            compatible = "atmel,24c128";
            reg = <0x50>;
        };
    };
```

## Documentation/devicetree/bindings/i2c/i2c-altera.txt
```
* Altera I2C Controller
* This is Altera's synthesizable logic block I2C Controller for use
* in Altera's FPGAs.

Required properties :
 - compatible : should be "altr,softip-i2c-v1.0"
 - reg        : Offset and length of the register set for the device
 - interrupts : <IRQ> where IRQ is the interrupt number.
 - clocks     : phandle to input clock.
 - #address-cells = <1>;
 - #size-cells = <0>;

Recommended properties :
 - clock-frequency : desired I2C bus clock frequency in Hz.

Optional properties :
 - fifo-size : Size of the RX and TX FIFOs in bytes.
 - Child nodes conforming to i2c bus binding

Example :

	i2c@100080000 {
		compatible = "altr,softip-i2c-v1.0";
		reg = <0x00000001 0x00080000 0x00000040>;
		interrupt-parent = <&intc>;
		interrupts = <0 43 4>;
		clocks = <&clk_0>;
		clock-frequency = <100000>;
		#address-cells = <1>;
		#size-cells = <0>;
		fifo-size = <4>;

		eeprom@51 {
			compatible = "atmel,24c32";
			reg = <0x51>;
			pagesize = <32>;
		};
	};
```
