## Documentation/devicetree/bindings/hypervisor/mediatek,geniezone-hyp.yaml
```yaml
# SPDX-License-Identifier: (GPL-2.0-only OR BSD-2-Clause)
%YAML 1.2
---
$id: http://devicetree.org/schemas/hypervisor/mediatek,geniezone-hyp.yaml#
$schema: http://devicetree.org/meta-schemas/core.yaml#

title: MediaTek GenieZone hypervisor

maintainers:
  - Yingshiuan Pan <yingshiuan.pan@mediatek.com>

description:
  This interface is designed for integrating GenieZone hypervisor into Android
  Virtualization Framework(AVF) along with Crosvm as a VMM.
  It acts like a wrapper for every hypercall to GenieZone hypervisor in
  order to control guest VM lifecycles and virtual interrupt injections.

properties:
  compatible:
    const: mediatek,geniezone-hyp

required:
  - compatible

additionalProperties: false

examples:
  - |
    hypervisor {
        compatible = "mediatek,geniezone-hyp";
    };
```

## Documentation/devicetree/bindings/i2c/allwinner,sun6i-a31-p2wi.yaml
```yaml
# SPDX-License-Identifier: GPL-2.0
%YAML 1.2
---
$id: http://devicetree.org/schemas/i2c/allwinner,sun6i-a31-p2wi.yaml#
$schema: http://devicetree.org/meta-schemas/core.yaml#

title: Allwinner A31 P2WI (Push/Pull 2 Wires Interface)

maintainers:
  - Chen-Yu Tsai <wens@csie.org>
  - Maxime Ripard <mripard@kernel.org>

allOf:
  - $ref: /schemas/i2c/i2c-controller.yaml#

properties:
  compatible:
    const: allwinner,sun6i-a31-p2wi

  reg:
    maxItems: 1

  interrupts:
    maxItems: 1

  clocks:
    maxItems: 1

  resets:
    maxItems: 1

  clock-frequency:
    minimum: 1
    maximum: 6000000

required:
  - compatible
  - reg
  - interrupts
  - clocks
  - resets

unevaluatedProperties: false

examples:
  - |
    i2c@1f03400 {
        compatible = "allwinner,sun6i-a31-p2wi";
        reg = <0x01f03400 0x400>;
        interrupts = <0 39 4>;
        clocks = <&apb0_gates 3>;
        clock-frequency = <100000>;
        resets = <&apb0_rst 3>;
        #address-cells = <1>;
        #size-cells = <0>;

        axp221: pmic@68 {
            /* compatible = "x-powers,axp221"; */
            reg = <0x68>;
        };
    };

...
```

## Documentation/devicetree/bindings/i2c/altr,softip-i2c-v1.0.yaml
```yaml
# SPDX-License-Identifier: (GPL-2.0-only OR BSD-2-Clause)
%YAML 1.2
---
$id: http://devicetree.org/schemas/i2c/altr,softip-i2c-v1.0.yaml#
$schema: http://devicetree.org/meta-schemas/core.yaml#

title: Altera I2C Controller

maintainers:
  - Thor Thayer <thor.thayer@linux.intel.com>
  - Chaitanya Sabnis <chaitanya.msabnis@gmail.com>

description:
  Altera's synthesizable logic block I2C Controller for use in Altera's FPGAs.

allOf:
  - $ref: /schemas/i2c/i2c-controller.yaml#

properties:
  compatible:
    const: altr,softip-i2c-v1.0

  reg:
    maxItems: 1

  interrupts:
    maxItems: 1

  clocks:
    maxItems: 1

  fifo-size:
    $ref: /schemas/types.yaml#/definitions/uint32
    description: Size of the RX and TX FIFOs in bytes.

required:
  - compatible
  - reg
  - interrupts
  - clocks

unevaluatedProperties: false

examples:
  - |
    i2c@80000 {
        compatible = "altr,softip-i2c-v1.0";
        reg = <0x80000 0x40>;
        interrupt-parent = <&intc>;
        interrupts = <0 43 4>;
        clocks = <&clk_0>;
        clock-frequency = <100000>;
        #address-cells = <1>;
        #size-cells = <0>;
        fifo-size = <4>;

        eeprom@51 {
            compatible = "atmel,24c32";
            reg = <0x51>;
            pagesize = <32>;
        };
    };
```

## Documentation/devicetree/bindings/i2c/amlogic,meson6-i2c.yaml
```yaml
# SPDX-License-Identifier: (GPL-2.0 OR BSD-2-Clause)
# Copyright 2019 BayLibre, SAS
%YAML 1.2
---
$id: "http://devicetree.org/schemas/i2c/amlogic,meson6-i2c.yaml#"
$schema: "http://devicetree.org/meta-schemas/core.yaml#"

title: Amlogic Meson I2C Controller

maintainers:
  - Neil Armstrong <neil.armstrong@linaro.org>
  - Beniamino Galvani <b.galvani@gmail.com>

allOf:
  - $ref: /schemas/i2c/i2c-controller.yaml#

properties:
  compatible:
    enum:
      - amlogic,meson6-i2c # Meson6, Meson8 and compatible SoCs
      - amlogic,meson-gxbb-i2c # GXBB and compatible SoCs
      - amlogic,meson-axg-i2c # AXG and compatible SoCs

  reg:
    maxItems: 1

  interrupts:
    maxItems: 1

  clocks:
    minItems: 1

required:
  - compatible
  - reg
  - interrupts
  - clocks

unevaluatedProperties: false

examples:
  - |
    i2c@c8100500 {
        compatible = "amlogic,meson6-i2c";
        reg = <0xc8100500 0x20>;
        interrupts = <92>;
        clocks = <&clk81>;
        #address-cells = <1>;
        #size-cells = <0>;

        eeprom@52 {
            compatible = "atmel,24c32";
            reg = <0x52>;
        };
    };
```

## Documentation/devicetree/bindings/i2c/apm,xgene-slimpro-i2c.yaml
```yaml
# SPDX-License-Identifier: (GPL-2.0-only OR BSD-2-Clause)
%YAML 1.2
---
$id: http://devicetree.org/schemas/i2c/apm,xgene-slimpro-i2c.yaml#
$schema: http://devicetree.org/meta-schemas/core.yaml#

title: APM X-Gene SLIMpro Mailbox I2C

maintainers:
  - Khuong Dinh <khuong@os.amperecomputing.com>

description:
  An I2C controller accessed over the "SLIMpro" mailbox.

allOf:
  - $ref: /schemas/i2c/i2c-controller.yaml#

properties:
  compatible:
    const: apm,xgene-slimpro-i2c

  mboxes:
    maxItems: 1

required:
  - compatible
  - mboxes

unevaluatedProperties: false

examples:
  - |
    i2c {
        compatible = "apm,xgene-slimpro-i2c";
        mboxes = <&mailbox 0>;
    };
```

## Documentation/devicetree/bindings/i2c/apple,i2c.yaml
```yaml
# SPDX-License-Identifier: (GPL-2.0 OR BSD-2-Clause)
%YAML 1.2
---
$id: "http://devicetree.org/schemas/i2c/apple,i2c.yaml#"
$schema: "http://devicetree.org/meta-schemas/core.yaml#"

title: Apple/PASemi I2C controller

maintainers:
  - Sven Peter <sven@svenpeter.dev>

description: |
  Apple SoCs such as the M1 come with a I2C controller based on the one found
  in machines with P. A. Semi's PWRficient processors.
  The bus is used to communicate with e.g. USB PD chips or the speaker
  amp.

allOf:
  - $ref: /schemas/i2c/i2c-controller.yaml#

properties:
  compatible:
    enum:
      - apple,t8103-i2c
      - apple,i2c

  reg:
    maxItems: 1

  clocks:
    items:
      - description: I2C bus reference clock

  interrupts:
    maxItems: 1

  clock-frequency:
    description: |
      Desired I2C bus clock frequency in Hz. If not specified, 100 kHz will be
      used. This frequency is generated by dividing the reference clock.
      Allowed values are between ref_clk/(16*4) and ref_clk/(16*255).

required:
  - compatible
  - reg
  - clocks
  - interrupts

unevaluatedProperties: false

examples:
  - |
    i2c@35010000 {
      compatible = "apple,t8103-i2c";
      reg = <0x35010000 0x4000>;
      interrupt-parent = <&aic>;
      interrupts = <0 627 4>;
      clocks = <&ref_clk>;
      #address-cells = <1>;
      #size-cells = <0>;
    };
```

## Documentation/devicetree/bindings/i2c/arm,i2c-versatile.yaml
```yaml
# SPDX-License-Identifier: GPL-2.0 OR BSD-2-Clause
%YAML 1.2
---
$id: http://devicetree.org/schemas/i2c/arm,i2c-versatile.yaml#
$schema: http://devicetree.org/meta-schemas/core.yaml#

title: I2C Controller on ARM Ltd development platforms

maintainers:
  - Linus Walleij <linus.walleij@linaro.org>

allOf:
  - $ref: /schemas/i2c/i2c-controller.yaml#

properties:
  compatible:
    const: arm,versatile-i2c

  reg:
    maxItems: 1

required:
  - compatible
  - reg

unevaluatedProperties: false

...
```

## Documentation/devicetree/bindings/i2c/aspeed,i2c.yaml
```yaml
# SPDX-License-Identifier: (GPL-2.0-only OR BSD-2-Clause)
%YAML 1.2
---
$id: http://devicetree.org/schemas/i2c/aspeed,i2c.yaml#
$schema: http://devicetree.org/meta-schemas/core.yaml#

title: ASPEED I2C on the AST24XX, AST25XX, and AST26XX SoCs Device Tree Bindings

maintainers:
  - Rayn Chen <rayn_chen@aspeedtech.com>

allOf:
  - $ref: /schemas/i2c/i2c-controller.yaml#

properties:
  compatible:
    enum:
      - aspeed,ast2400-i2c-bus
      - aspeed,ast2500-i2c-bus
      - aspeed,ast2600-i2c-bus

  reg:
    minItems: 1
    items:
      - description: address offset and range of bus
      - description: address offset and range of bus buffer

  interrupts:
    maxItems: 1

  clocks:
    maxItems: 1
    description:
      root clock of bus, should reference the APB
      clock in the second cell

  resets:
    maxItems: 1

  bus-frequency:
    minimum: 500
    maximum: 4000000
    default: 100000
    description: frequency of the bus clock in Hz defaults to 100 kHz when not
      specified

  multi-master:
    type: boolean
    description:
      states that there is another master active on this bus

required:
  - reg
  - compatible
  - clocks
  - resets

unevaluatedProperties: false

examples:
  - |
    #include <dt-bindings/clock/aspeed-clock.h>
    i2c0: i2c-bus@40 {
      #address-cells = <1>;
      #size-cells = <0>;
      #interrupt-cells = <1>;
      compatible = "aspeed,ast2500-i2c-bus";
      reg = <0x40 0x40>;
      clocks = <&syscon ASPEED_CLK_APB>;
      resets = <&syscon ASPEED_RESET_I2C>;
      bus-frequency = <100000>;
      interrupts = <0>;
      interrupt-parent = <&i2c_ic>;
    };
```

## Documentation/devicetree/bindings/i2c/atmel,at91sam-i2c.yaml
```yaml
# SPDX-License-Identifier: (GPL-2.0-only OR BSD-2-Clause)
# Copyright (C) 2022 Microchip Technology, Inc. and its subsidiaries
%YAML 1.2
---
$id: http://devicetree.org/schemas/i2c/atmel,at91sam-i2c.yaml#
$schema: http://devicetree.org/meta-schemas/core.yaml#

title: I2C for Atmel/Microchip platforms

maintainers:
  - Alexandre Belloni <alexandre.belloni@bootlin.com>

properties:
  compatible:
    oneOf:
      - items:
          - enum:
              - atmel,at91rm9200-i2c
              - atmel,at91sam9261-i2c
              - atmel,at91sam9260-i2c
              - atmel,at91sam9g20-i2c
              - atmel,at91sam9g10-i2c
              - atmel,at91sam9x5-i2c
              - atmel,sama5d4-i2c
              - atmel,sama5d2-i2c
              - microchip,sam9x60-i2c
      - items:
          - enum:
              - microchip,sama7g5-i2c
              - microchip,sam9x7-i2c
          - const: microchip,sam9x60-i2c

  reg:
    maxItems: 1

  interrupts:
    maxItems: 1

  "#address-cells":
    const: 1

  "#size-cells":
    const: 0

  clocks:
    maxItems: 1

  clock-frequency:
    default: 100000

  dmas:
    items:
      - description: TX DMA Channel Specifier
      - description: RX DMA Channel Specifier

  dma-names:
    items:
      - const: tx
      - const: rx

  atmel,fifo-size:
    $ref: /schemas/types.yaml#/definitions/uint32
    description: |
      Maximum number of data the RX and TX FIFOs can store for
      FIFO capable I2C controllers.

  scl-gpios: true

  sda-gpios: true

required:
  - compatible
  - reg
  - interrupts
  - "#address-cells"
  - "#size-cells"
  - clocks

allOf:
  - $ref: i2c-controller.yaml
  - if:
      properties:
        compatible:
          contains:
            enum:
              - atmel,sama5d4-i2c
              - atmel,sama5d2-i2c
              - microchip,sam9x60-i2c
              - microchip,sama7g5-i2c
    then:
      properties:
        i2c-sda-hold-time-ns:
          description:
            TWD hold time
          maxItems: 1

unevaluatedProperties: false

examples:
  - |
    #include <dt-bindings/interrupt-controller/irq.h>
    #include <dt-bindings/dma/at91.h>
    #include <dt-bindings/gpio/gpio.h>

    i2c0: i2c@fff84000 {
        compatible = "atmel,at91sam9g20-i2c";
        reg = <0xfff84000 0x100>;
        interrupts = <12 IRQ_TYPE_LEVEL_HIGH 6>;
        #address-cells = <1>;
        #size-cells = <0>;
        clocks = <&twi0_clk>;
        clock-frequency = <400000>;

        eeprom@50 {
            compatible = "atmel,24c512";
            reg = <0x50>;
            pagesize = <128>;
        };
    };

    i2c1: i2c@f8034600 {
        compatible = "atmel,sama5d2-i2c";
        reg = <0xf8034600 0x100>;
        interrupts = <19 IRQ_TYPE_LEVEL_HIGH 7>;
        dmas = <&dma0
            (AT91_XDMAC_DT_MEM_IF(0) | AT91_XDMAC_DT_PER_IF(1))
            AT91_XDMAC_DT_PERID(11)>,
               <&dma0
            (AT91_XDMAC_DT_MEM_IF(0) | AT91_XDMAC_DT_PER_IF(1))
            AT91_XDMAC_DT_PERID(12)>;
        dma-names = "tx", "rx";
        #address-cells = <1>;
        #size-cells = <0>;
        clocks = <&flx0>;
        atmel,fifo-size = <16>;
        i2c-sda-hold-time-ns = <336>;
        pinctrl-names = "default", "gpio";
        pinctrl-0 = <&pinctrl_i2c0>;
        pinctrl-1 = <&pinctrl_i2c0_gpio>;
        sda-gpios = <&pioA 30 GPIO_ACTIVE_HIGH>;
        scl-gpios = <&pioA 31 (GPIO_ACTIVE_HIGH | GPIO_OPEN_DRAIN)>;

        eeprom@54 {
            compatible = "atmel,24c02";
            reg = <0x54>;
            pagesize = <16>;
        };
    };
```

## Documentation/devicetree/bindings/i2c/brcm,bcm2835-i2c.txt
```
Broadcom BCM2835 I2C controller

Required properties:
- compatible : Should be "brcm,bcm2835-i2c".
- reg: Should contain register location and length.
- interrupts: Should contain interrupt.
- clocks : The clock feeding the I2C controller.

Recommended properties:
- clock-frequency : desired I2C bus clock frequency in Hz.

Example:

i2c@20205000 {
	compatible = "brcm,bcm2835-i2c";
	reg = <0x7e205000 0x1000>;
	interrupts = <2 21>;
	clocks = <&clk_i2c>;
	clock-frequency = <100000>;
};
```

## Documentation/devicetree/bindings/i2c/brcm,bcm2835-i2c.yaml
```yaml
# SPDX-License-Identifier: (GPL-2.0-only OR BSD-2-Clause)
%YAML 1.2
---
$id: http://devicetree.org/schemas/i2c/brcm,bcm2835-i2c.yaml#
$schema: http://devicetree.org/meta-schemas/core.yaml#

title: Broadcom BCM2835 I2C controller

maintainers:
  - Stephen Warren <swarren@wwwdotorg.org>

allOf:
  - $ref: /schemas/i2c/i2c-controller.yaml#

properties:
  compatible:
    oneOf:
      - enum:
          - brcm,bcm2835-i2c
      - items:
          - const: brcm,bcm2711-i2c
          - const: brcm,bcm2835-i2c

  reg:
    maxItems: 1

  interrupts:
    maxItems: 1

  clock-names:
    maxItems: 1

  clocks:
    maxItems: 1

  clock-frequency: true

required:
  - compatible
  - reg
  - interrupts
  - clocks

unevaluatedProperties: false

examples:
  - |
    i2c@7e205000 {
        compatible = "brcm,bcm2835-i2c";
        reg = <0x7e205000 0x1000>;
        interrupts = <2 21>;
        clocks = <&clk_i2c>;
        clock-frequency = <100000>;
    };
```
