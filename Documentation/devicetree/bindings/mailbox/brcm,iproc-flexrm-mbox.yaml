## Documentation/devicetree/bindings/mailbox/meson-mhu.txt
```
Amlogic Meson MHU Mailbox Driver
================================

The Amlogic's Meson SoCs Message-Handling-Unit (MHU) is a mailbox controller
that has 3 independent channels/links to communicate with remote processor(s).
MHU links are hardwired on a platform. A link raises interrupt for any
received data. However, there is no specified way of knowing if the sent
data has been read by the remote. This driver assumes the sender polls
STAT register and the remote clears it after having read the data.

Mailbox Device Node:
====================

Required properties:
--------------------
- compatible:		Shall be "amlogic,meson-gxbb-mhu"
- reg:			Contains the mailbox register address range (base
			address and length)
- #mbox-cells		Shall be 1 - the index of the channel needed.
- interrupts:		Contains the interrupt information corresponding to
			each of the 2 links of MHU.

Example:
--------

	mailbox: mailbox@c883c404 {
		#mbox-cells = <1>;
		compatible = "amlogic,meson-gxbb-mhu";
		reg = <0 0xc883c404 0 0x4c>;
		interrupts = <0 208 IRQ_TYPE_EDGE_RISING>,
			     <0 209 IRQ_TYPE_EDGE_RISING>,
			     <0 210 IRQ_TYPE_EDGE_RISING>;
		#mbox-cells = <1>;
	};
```

## Documentation/devicetree/bindings/mailbox/microchip,mpfs-mailbox.yaml
```yaml
# SPDX-License-Identifier: (GPL-2.0-only OR BSD-2-Clause)
%YAML 1.2
---
$id: http://devicetree.org/schemas/mailbox/microchip,mpfs-mailbox.yaml#
$schema: http://devicetree.org/meta-schemas/core.yaml#

title: Microchip PolarFire SoC (MPFS) MSS (microprocessor subsystem) mailbox controller

maintainers:
  - Conor Dooley <conor.dooley@microchip.com>

properties:
  compatible:
    const: microchip,mpfs-mailbox

  reg:
    oneOf:
      - items:
          - description: mailbox data registers
      - items:
          - description: mailbox control & data registers
          - description: mailbox interrupt registers
        deprecated: true
      - items:
          - description: mailbox control registers
          - description: mailbox interrupt registers
          - description: mailbox data registers
        deprecated: true

  interrupts:
    maxItems: 1

  "#mbox-cells":
    const: 1

required:
  - compatible
  - reg
  - interrupts
  - "#mbox-cells"

additionalProperties: false

examples:
  - |
    soc {
      #address-cells = <1>;
      #size-cells = <1>;

      mailbox@37020800 {
        compatible = "microchip,mpfs-mailbox";
        reg = <0x37020800 0x100>;
        interrupt-parent = <&L1>;
        interrupts = <96>;
        #mbox-cells = <1>;
      };
    };
```

## Documentation/devicetree/bindings/mailbox/microchip,polarfire-soc-mailbox.yaml
```yaml
# SPDX-License-Identifier: (GPL-2.0-only OR BSD-2-Clause)
%YAML 1.2
---
$id: "http://devicetree.org/schemas/mailbox/microchip,polarfire-soc-mailbox.yaml#"
$schema: "http://devicetree.org/meta-schemas/core.yaml#"

title: Microchip PolarFire SoC (MPFS) MSS (microprocessor subsystem) mailbox controller

maintainers:
  - Conor Dooley <conor.dooley@microchip.com>

properties:
  compatible:
    const: microchip,polarfire-soc-mailbox

  reg:
    items:
      - description: mailbox data registers
      - description: mailbox interrupt registers

  interrupts:
    maxItems: 1

  "#mbox-cells":
    const: 1

required:
  - compatible
  - reg
  - interrupts
  - "#mbox-cells"

additionalProperties: false

examples:
  - |
    soc {
      #address-cells = <2>;
      #size-cells = <2>;
      mbox: mailbox@37020000 {
        compatible = "microchip,polarfire-soc-mailbox";
        reg = <0x0 0x37020000 0x0 0x1000>, <0x0 0x2000318c 0x0 0x40>;
        interrupt-parent = <&L1>;
        interrupts = <96>;
        #mbox-cells = <1>;
      };
    };
```

## Documentation/devicetree/bindings/mailbox/microchip,sbi-ipc.yaml
```yaml
# SPDX-License-Identifier: (GPL-2.0-only OR BSD-2-Clause)
%YAML 1.2
---
$id: http://devicetree.org/schemas/mailbox/microchip,sbi-ipc.yaml#
$schema: http://devicetree.org/meta-schemas/core.yaml#

title: Microchip Inter-processor communication (IPC) mailbox controller

maintainers:
  - Valentina Fernandez <valentina.fernandezalanis@microchip.com>

description:
  The Microchip Inter-processor Communication (IPC) facilitates
  message passing between processors using an interrupt signaling
  mechanism.

properties:
  compatible:
    oneOf:
      - description:
          Intended for use by software running in supervisor privileged
          mode (s-mode). This SBI interface is compatible with the Mi-V
          Inter-hart Communication (IHC) IP.
        const: microchip,sbi-ipc

      - description:
          Intended for use by the SBI implementation in machine mode
          (m-mode), this compatible string is for the MIV_IHC Soft-IP.
        const: microchip,miv-ihc-rtl-v2

  reg:
    maxItems: 1

  interrupts:
    minItems: 1
    maxItems: 5

  interrupt-names:
    minItems: 1
    maxItems: 5
    items:
      enum:
        - hart-0
        - hart-1
        - hart-2
        - hart-3
        - hart-4
        - hart-5

  "#mbox-cells":
    description: >
      For "microchip,sbi-ipc", the cell represents the global "logical"
      channel IDs. The meaning of channel IDs are platform firmware dependent.

      For "microchip,miv-ihc-rtl-v2", the cell represents the physical
      channel and does not vary based on the platform firmware.
    const: 1

  microchip,ihc-chan-disabled-mask:
    description: >
      Represents the enable/disable state of the bi-directional IHC
      channels within the MIV-IHC IP configuration.

      A bit set to '1' indicates that the corresponding channel is disabled,
      and any read or write operations to that channel will return zero.

      A bit set to '0' indicates that the corresponding channel is enabled
      and will be accessible through its dedicated address range registers.

      The actual enable/disable state of each channel is determined by the
      IP block’s configuration.
    $ref: /schemas/types.yaml#/definitions/uint16
    maximum: 0x7fff
    default: 0

required:
  - compatible
  - interrupts
  - interrupt-names
  - "#mbox-cells"

allOf:
  - if:
      properties:
        compatible:
          contains:
            const: microchip,sbi-ipc
    then:
      properties:
        reg:
          not: {}
          description:
            The 'microchip,sbi-ipc' operates in a programming model
            that does not require memory-mapped I/O (MMIO) registers
            since it uses SBI ecalls provided by the m-mode/firmware
            SBI implementation to access hardware registers.
        microchip,ihc-chan-disabled-mask: false
    else:
      required:
        - reg
        - microchip,ihc-chan-disabled-mask

additionalProperties: false

examples:
  - |
    mailbox {
      compatible = "microchip,sbi-ipc";
      interrupt-parent = <&plic>;
      interrupts = <180>, <179>, <178>;
      interrupt-names = "hart-1", "hart-2", "hart-3";
      #mbox-cells = <1>;
    };
  - |
    mailbox@50000000 {
      compatible = "microchip,miv-ihc-rtl-v2";
      microchip,ihc-chan-disabled-mask = /bits/ 16 <0>;
      reg = <0x50000000 0x1c000>;
      interrupt-parent = <&plic>;
      interrupts = <180>, <179>, <178>;
      interrupt-names = "hart-1", "hart-2", "hart-3";
      #mbox-cells = <1>;
    };
```

## Documentation/devicetree/bindings/mailbox/mtk,adsp-mbox.yaml
```yaml
# SPDX-License-Identifier: (GPL-2.0-only OR BSD-2-Clause)
%YAML 1.2
---
$id: http://devicetree.org/schemas/mailbox/mtk,adsp-mbox.yaml#
$schema: http://devicetree.org/meta-schemas/core.yaml#

title: Mediatek ADSP mailbox

maintainers:
  - Allen-KH Cheng <Allen-KH.Cheng@mediatek.com>

description: |
  The MTK ADSP mailbox Inter-Processor Communication (IPC) enables the SoC
  to ommunicate with ADSP by passing messages through two mailbox channels.
  The MTK ADSP mailbox IPC also provides the ability for one processor to
  signal the other processor using interrupts.

properties:
  compatible:
    items:
      - const: mediatek,mt8195-adsp-mbox

  "#mbox-cells":
    const: 0

  reg:
    maxItems: 1

  interrupts:
    maxItems: 1

required:
  - compatible
  - "#mbox-cells"
  - reg
  - interrupts

additionalProperties: false

examples:
  - |
    #include <dt-bindings/interrupt-controller/arm-gic.h>
    #include <dt-bindings/interrupt-controller/irq.h>

    adsp_mailbox0:mailbox@10816000 {
        compatible = "mediatek,mt8195-adsp-mbox";
        #mbox-cells = <0>;
        reg = <0x10816000 0x1000>;
        interrupts = <GIC_SPI 702 IRQ_TYPE_LEVEL_HIGH 0>;
    };
```

## Documentation/devicetree/bindings/mailbox/mtk-gce.txt
```
MediaTek GCE
===============

The Global Command Engine (GCE) is used to help read/write registers with
critical time limitation, such as updating display configuration during the
vblank. The GCE can be used to implement the Command Queue (CMDQ) driver.

CMDQ driver uses mailbox framework for communication. Please refer to
mailbox.txt for generic information about mailbox device-tree bindings.

Required properties:
- compatible: can be "mediatek,mt8173-gce", "mediatek,mt8183-gce",
  "mediatek,mt8192-gce", "mediatek,mt8195-gce" or "mediatek,mt6779-gce".
- reg: Address range of the GCE unit
- interrupts: The interrupt signal from the GCE block
- clock: Clocks according to the common clock binding
- clock-names: Must be "gce" to stand for GCE clock
- #mbox-cells: Should be 2.
	<&phandle channel priority>
	phandle: Label name of a gce node.
	channel: Channel of mailbox. Be equal to the thread id of GCE.
	priority: Priority of GCE thread.

Required properties for a client device:
- mboxes: Client use mailbox to communicate with GCE, it should have this
  property and list of phandle, mailbox specifiers.
Optional properties for a client device:
- mediatek,gce-client-reg: Specify the sub-system id which is corresponding
  to the register address, it should have this property and list of phandle,
  sub-system specifiers.
  <&phandle subsys_number start_offset size>
  phandle: Label name of a gce node.
  subsys_number: specify the sub-system id which is corresponding
                 to the register address.
  start_offset: the start offset of register address that GCE can access.
  size: the total size of register address that GCE can access.

Optional properties for a client mutex node:
- mediatek,gce-events: GCE events used by clients. The event numbers are
  defined in 'dt-bindings/gce/<chip>-gce.h'.

Some vaules of properties are defined in 'dt-bindings/gce/mt8173-gce.h',
'dt-binding/gce/mt8183-gce.h', 'dt-binding/gce/mt8192-gce.h',
'dt-binding/gce/mt8195-gce.h' or 'dt-bindings/gce/mt6779-gce.h'.
Such as sub-system ids, thread priority, event ids.

Example:

	gce: gce@10212000 {
		compatible = "mediatek,mt8173-gce";
		reg = <0 0x10212000 0 0x1000>;
		interrupts = <GIC_SPI 135 IRQ_TYPE_LEVEL_LOW>;
		clocks = <&infracfg CLK_INFRA_GCE>;
		clock-names = "gce";
		#mbox-cells = <2>;
	};

Example for a client device:

	mmsys: clock-controller@14000000 {
		compatible = "mediatek,mt8173-mmsys";
		mboxes = <&gce 0 CMDQ_THR_PRIO_LOWEST>,
			 <&gce 1 CMDQ_THR_PRIO_LOWEST>;
		mutex-event-eof = <CMDQ_EVENT_MUTEX0_STREAM_EOF
				CMDQ_EVENT_MUTEX1_STREAM_EOF>;
		mediatek,gce-client-reg = <&gce SUBSYS_1400XXXX 0x3000 0x1000>,
					  <&gce SUBSYS_1401XXXX 0x2000 0x100>;
		...
	};

Example for a client mutex node:
	mutex: mutex@14020000 {
		compatible = "mediatek,mt8173-disp-mutex";
		reg = <0 0x14020000 0 0x1000>;
		interrupts = <GIC_SPI 169 IRQ_TYPE_LEVEL_LOW>;
		power-domains = <&scpsys MT8173_POWER_DOMAIN_MM>;
		clocks = <&mmsys CLK_MM_MUTEX_32K>;
		mediatek,gce-events = <CMDQ_EVENT_MUTEX0_STREAM_EOF>,
				      <CMDQ_EVENT_MUTEX1_STREAM_EOF>;
	};
```

## Documentation/devicetree/bindings/mailbox/nvidia,tegra186-hsp.txt
```
NVIDIA Tegra Hardware Synchronization Primitives (HSP)

The HSP modules are used for the processors to share resources and communicate
together. It provides a set of hardware synchronization primitives for
interprocessor communication. So the interprocessor communication (IPC)
protocols can use hardware synchronization primitives, when operating between
two processors not in an SMP relationship.

The features that HSP supported are shared mailboxes, shared semaphores,
arbitrated semaphores and doorbells.

Required properties:
- name : Should be hsp
- compatible
    Array of strings.
    one of:
    - "nvidia,tegra186-hsp"
    - "nvidia,tegra194-hsp", "nvidia,tegra186-hsp"
- reg : Offset and length of the register set for the device.
- interrupt-names
    Array of strings.
    Contains a list of names for the interrupts described by the interrupt
    property. May contain the following entries, in any order:
    - "doorbell"
    - "sharedN", where 'N' is a number from zero up to the number of
      external interrupts supported by the HSP instance minus one.
    Users of this binding MUST look up entries in the interrupt property
    by name, using this interrupt-names property to do so.
- interrupts
    Array of interrupt specifiers.
    Must contain one entry per entry in the interrupt-names property,
    in a matching order.
- #mbox-cells : Should be 2.

The mbox specifier of the "mboxes" property in the client node should contain
two cells. The first cell determines the HSP type and the second cell is used
to identify the mailbox that the client is going to use.

For doorbells, the second cell specifies the index of the doorbell to use.

For shared mailboxes, the second cell is composed of two fields:
- bits 31..24:
    A bit mask of flags that further specify how the shared mailbox will be
    used. Valid flags are:
    - bit 31:
        Defines the direction of the mailbox. If set, the mailbox will be used
        as a producer (i.e. used to send data). If cleared, the mailbox is the
        consumer of data sent by a producer.

- bits 23.. 0:
    The index of the shared mailbox to use. The number of available mailboxes
    may vary by instance of the HSP block and SoC generation.

The following file contains definitions that can be used to construct mailbox
specifiers:

    <dt-bindings/mailbox/tegra186-hsp.h>

Example:

hsp_top0: hsp@3c00000 {
	compatible = "nvidia,tegra186-hsp";
	reg = <0x0 0x03c00000 0x0 0xa0000>;
	interrupts = <GIC_SPI 176 IRQ_TYPE_LEVEL_HIGH>;
	interrupt-names = "doorbell";
	#mbox-cells = <2>;
};

client {
	...
	mboxes = <&hsp_top0 TEGRA_HSP_MBOX_TYPE_DB TEGRA_HSP_DB_MASTER_XXX>;
};
```
