## Documentation/devicetree/bindings/mailbox/hisilicon,hi3660-mailbox.txt
```
Hisilicon Hi3660 Mailbox Controller

Hisilicon Hi3660 mailbox controller supports up to 32 channels.  Messages
are passed between processors, including application & communication
processors, MCU, HIFI, etc.  Each channel is unidirectional and accessed
by using MMIO registers; it supports maximum to 8 words message.

Controller
----------

Required properties:
- compatible:		: Shall be "hisilicon,hi3660-mbox"
- reg:			: Offset and length of the device's register set
- #mbox-cells:		: Must be 3
			  <&phandle channel dst_irq ack_irq>
			    phandle	: Label name of controller
			    channel	: Channel number
			    dst_irq	: Remote interrupt vector
			    ack_irq	: Local interrupt vector

- interrupts:		: Contains the two IRQ lines for mailbox.

Example:

mailbox: mailbox@e896b000 {
	compatible = "hisilicon,hi3660-mbox";
	reg = <0x0 0xe896b000 0x0 0x1000>;
	interrupts = <0x0 0xc0 0x4>,
		     <0x0 0xc1 0x4>;
	#mbox-cells = <3>;
};

Client
------

Required properties:
- compatible		: See the client docs
- mboxes		: Standard property to specify a Mailbox (See ./mailbox.txt)
			  Cells must match 'mbox-cells' (See Controller docs above)

Optional properties
- mbox-names		: Name given to channels seen in the 'mboxes' property.

Example:

stub_clock: stub_clock@e896b500 {
	compatible = "hisilicon,hi3660-stub-clk";
	reg = <0x0 0xe896b500 0x0 0x0100>;
	#clock-cells = <1>;
	mboxes = <&mailbox 13 3 0>;
};
```

## Documentation/devicetree/bindings/mailbox/hisilicon,hi6220-mailbox.txt
```
Hisilicon Hi6220 Mailbox Driver
===============================

Hisilicon Hi6220 mailbox supports up to 32 channels. Each channel
is unidirectional with a maximum message size of 8 words. I/O is
performed using register access (there is no DMA) and the cell
raises an interrupt when messages are received.

Mailbox Device Node:
====================

Required properties:
--------------------
- compatible:		Shall be "hisilicon,hi6220-mbox"
- reg:			Contains the mailbox register address range (base
			address and length); the first item is for IPC
			registers, the second item is shared buffer for
			slots.
- #mbox-cells:		Common mailbox binding property to identify the number
			of cells required for the mailbox specifier. Must be 3.
			<&phandle slot_id dst_irq ack_irq>
			  phandle: Label name of mailbox controller
			  slot_id: Slot id used either for TX or RX
			  dst_irq: IRQ identifier index number which used by MCU
			  ack_irq: IRQ identifier index number with generating a
			           TX/RX interrupt to application processor,
				   mailbox driver uses it to acknowledge interrupt
- interrupts:		Contains the interrupt information for the mailbox
			device. The format is dependent on which interrupt
			controller the SoCs use.

Optional Properties:
--------------------
- hi6220,mbox-tx-noirq: Property of MCU firmware's feature, so mailbox driver
			use this flag to ask MCU to enable "automatic idle
			flag" mode or IRQ generated mode to acknowledge a TX
			completion.

Example:
--------

	mailbox: mailbox@f7510000 {
		compatible = "hisilicon,hi6220-mbox";
		reg = <0x0 0xf7510000 0x0 0x1000>, /* IPC_S */
		      <0x0 0x06dff800 0x0 0x0800>; /* Mailbox */
		interrupt-parent = <&gic>;
		interrupts = <GIC_SPI 94 IRQ_TYPE_LEVEL_HIGH>;
		#mbox-cells = <3>;
	};


Mailbox client
===============

Required properties:
--------------------
- compatible:		Many (See the client docs).
- mboxes:		Standard property to specify a Mailbox (See ./mailbox.txt)
			Cells must match 'mbox-cells' (See Mailbox Device Node above).

Optional Properties:
--------------------
- mbox-names:		Name given to channels seen in the 'mboxes' property.

Example:
--------

	stub_clock: stub_clock {
		compatible = "hisilicon,hi6220-stub-clk";
		hisilicon,hi6220-clk-sram = <&sram>;
		#clock-cells = <1>;
		mbox-names = "mbox-tx", "mbox-rx";
		mboxes = <&mailbox 1 0 11>, <&mailbox 0 1 10>;
	};
```

## Documentation/devicetree/bindings/mailbox/mailbox-altera.txt
```
Altera mailbox (simple) soft IP

Required properties:
- compatible : "altr,mailbox-1.0".
- reg : physical base address of the mailbox and length of memory mapped
     region.
- linux,mailbox-name : Mailbox instance name

Optional properties:
- interrupt-parent : interrupt source phandle.
- interrupts : interrupt number. The interrupt specifier format depends on the
	       interrupt controller parent.

The property of "linux,mailbox-name" must be unique. This name will be used as
controller name in driver to identify the controller and the mailbox client will
use this name when requesting a mailbox channel.

Example:
	mailbox0: mailbox0@0x100 {
		compatible = "altr,mailbox-1.0";
		reg = <0x100 0x8>;
		interrupt-parent = < &gic_0 >;
		interrupts = <5>;
		linux,mailbox-name = "mailbox0";
	};

Example of mailbox's client node that includes mailbox phandle.
	mclient0: mclient0@0x200 {
		compatible = "client-1.0";
		reg = <0x200 0x10>;
		mailbox = <&mailbox0>;
	};
```

## Documentation/devicetree/bindings/mailbox/mailbox.txt
```
* Generic Mailbox Controller and client driver bindings

Generic binding to provide a way for Mailbox controller drivers to
assign appropriate mailbox channel to client drivers.

* Mailbox Controller

Required property:
- #mbox-cells: Must be at least 1. Number of cells in a mailbox
		specifier.

Example:
	mailbox: mailbox {
		...
		#mbox-cells = <1>;
	};


* Mailbox Client

Required property:
- mboxes: List of phandle and mailbox channel specifiers.

Optional property:
- mbox-names: List of identifier strings for each mailbox channel.
- shmem : List of phandle pointing to the shared memory(SHM) area between the
	  users of these mailboxes for IPC, one for each mailbox. This shared
	  memory can be part of any memory reserved for the purpose of this
	  communication between the mailbox client and the remote.


Example:
	pwr_cntrl: power {
		...
		mbox-names = "pwr-ctrl", "rpc";
		mboxes = <&mailbox 0 &mailbox 1>;
	};

Example with shared memory(shmem):

	sram: sram@50000000 {
		compatible = "mmio-sram";
		reg = <0x50000000 0x10000>;

		#address-cells = <1>;
		#size-cells = <1>;
		ranges = <0 0x50000000 0x10000>;

		cl_shmem: shmem@0 {
			compatible = "client-shmem";
			reg = <0x0 0x200>;
		};
	};

	client@2e000000 {
		...
		mboxes = <&mailbox 0>;
		shmem = <&cl_shmem>;
		..
	};
```

## Documentation/devicetree/bindings/mailbox/marvell,armada-3700-rwtm-mailbox.txt
```
* rWTM BIU Mailbox driver for Armada 37xx

Required properties:
- compatible:	must be "marvell,armada-3700-rwtm-mailbox"
- reg:		physical base address of the mailbox and length of memory mapped
		region
- interrupts:	the IRQ line for the mailbox
- #mbox-cells:	must be 1

Example:
	rwtm: mailbox@b0000 {
		compatible = "marvell,armada-3700-rwtm-mailbox";
		reg = <0xb0000 0x100>;
		interrupts = <GIC_SPI 18 IRQ_TYPE_LEVEL_HIGH>;
		#mbox-cells = <1>;
	};
```

## Documentation/devicetree/bindings/mailbox/marvell,armada-3700-rwtm-mailbox.yaml
```yaml
# SPDX-License-Identifier: (GPL-2.0-only OR BSD-2-Clause)
%YAML 1.2
---
$id: http://devicetree.org/schemas/mailbox/marvell,armada-3700-rwtm-mailbox.yaml#
$schema: http://devicetree.org/meta-schemas/core.yaml#

title: Marvell Armada 3700 rWTM Mailbox

maintainers:
  - Marek Behún <kabel@kernel.org>

properties:
  compatible:
    const: marvell,armada-3700-rwtm-mailbox

  reg:
    maxItems: 1

  interrupts:
    maxItems: 1

  '#mbox-cells':
    const: 1

required:
  - compatible
  - reg
  - interrupts
  - '#mbox-cells'

additionalProperties: false

examples:
  - |
    #include <dt-bindings/interrupt-controller/arm-gic.h>

    mailbox@b0000 {
        compatible = "marvell,armada-3700-rwtm-mailbox";
        reg = <0xb0000 0x100>;
        interrupts = <GIC_SPI 18 IRQ_TYPE_LEVEL_HIGH>;
        #mbox-cells = <1>;
    };
```

## Documentation/devicetree/bindings/mailbox/mediatek,gce-mailbox.yaml
```yaml
# SPDX-License-Identifier: (GPL-2.0-only OR BSD-2-Clause)
%YAML 1.2
---
$id: http://devicetree.org/schemas/mailbox/mediatek,gce-mailbox.yaml#
$schema: http://devicetree.org/meta-schemas/core.yaml#

title: Mediatek Global Command Engine Mailbox

maintainers:
  - Houlong Wei <houlong.wei@mediatek.com>

description:
  The Global Command Engine (GCE) is used to help read/write registers with
  critical time limitation, such as updating display configuration during the
  vblank. The GCE can be used to implement the Command Queue (CMDQ) driver.

properties:
  compatible:
    oneOf:
      - enum:
          - mediatek,mt6779-gce
          - mediatek,mt8173-gce
          - mediatek,mt8183-gce
          - mediatek,mt8186-gce
          - mediatek,mt8188-gce
          - mediatek,mt8192-gce
          - mediatek,mt8195-gce
      - items:
          - const: mediatek,mt6795-gce
          - const: mediatek,mt8173-gce

  "#mbox-cells":
    const: 2
    description:
      The first cell describes the Thread ID of the GCE,
      the second cell describes the priority of the GCE thread

  reg:
    maxItems: 1

  interrupts:
    maxItems: 1

  clocks:
    items:
      - description: Global Command Engine clock

  clock-names:
    items:
      - const: gce

required:
  - compatible
  - "#mbox-cells"
  - reg
  - interrupts
  - clocks

allOf:
  - if:
      not:
        properties:
          compatible:
            contains:
              const: mediatek,mt8195-gce
    then:
      required:
        - clock-names

additionalProperties: false

examples:
  - |
    #include <dt-bindings/clock/mt8173-clk.h>
    #include <dt-bindings/interrupt-controller/arm-gic.h>
    #include <dt-bindings/interrupt-controller/irq.h>

    soc {
        #address-cells = <2>;
        #size-cells = <2>;

        gce: mailbox@10212000 {
            compatible = "mediatek,mt8173-gce";
            reg = <0 0x10212000 0 0x1000>;
            interrupts = <GIC_SPI 135 IRQ_TYPE_LEVEL_LOW>;
            #mbox-cells = <2>;
            clocks = <&infracfg CLK_INFRA_GCE>;
            clock-names = "gce";
        };
    };
```

## Documentation/devicetree/bindings/mailbox/mediatek,gce-props.yaml
```yaml
# SPDX-License-Identifier: (GPL-2.0-only OR BSD-2-Clause)
%YAML 1.2
---
$id: http://devicetree.org/schemas/mailbox/mediatek,gce-props.yaml#
$schema: http://devicetree.org/meta-schemas/core.yaml#

title: MediaTek Global Command Engine Common Properties

maintainers:
  - Houlong Wei <houlong.wei@mediatek.com>

description:
  The Global Command Engine (GCE) is an instruction based, multi-threaded,
  single-core command dispatcher for MediaTek hardware. The Command Queue
  (CMDQ) mailbox driver is a driver for GCE, implemented using the Linux
  mailbox framework. It is used to receive messages from mailbox consumers
  and configure GCE to execute the specified instruction set in the message.
  We use mediatek,gce-mailbox.yaml to define the properties for CMDQ mailbox
  driver. A device driver that uses the CMDQ driver to configure its hardware
  registers is a mailbox consumer. The mailbox consumer can request a mailbox
  channel corresponding to a GCE hardware thread to send a message, specifying
  that the GCE thread to configure its hardware. The mailbox provider can also
  reserve a mailbox channel to configure GCE hardware register by the specific
  GCE thread. This binding defines the common GCE properties for both mailbox
  provider and consumers.

properties:
  mediatek,gce-events:
    description:
      GCE has an event table in SRAM, consisting of 1024 event IDs (0~1023).
      Each event ID has a boolean event value with the default value 0.
      The property mediatek,gce-events is used to obtain the event IDs.
      Some gce-events are hardware-bound and cannot be changed by software.
      For instance, in MT8195, when VDO0_MUTEX is stream done, VDO_MUTEX will
      send an event signal to GCE, setting the value of event ID 597 to 1.
      Similarly, in MT8188, the value of event ID 574 will be set to 1 when
      VOD0_MUTEX is stream done.
      On the other hand, some gce-events are not hardware-bound and can be
      changed by software. For example, in MT8188, we can set the value of
      event ID 855, which is not bound to any hardware, to 1 when the driver
      in the secure world completes a task. However, in MT8195, event ID 855
      is already bound to VDEC_LAT1, so we need to select another event ID to
      achieve the same purpose. This event ID can be any ID that is not bound
      to any hardware and is not yet used in any software driver.
      To determine if the event ID is bound to the hardware or used by a
      software driver, refer to the GCE header
      include/dt-bindings/gce/<chip>-gce.h of each chip.
    $ref: /schemas/types.yaml#/definitions/uint32-array
    minItems: 1
    maxItems: 32

additionalProperties: true
```

## Documentation/devicetree/bindings/mailbox/mediatek,mt8196-gpueb-mbox.yaml
```yaml
# SPDX-License-Identifier: GPL-2.0-only OR BSD-2-Clause
%YAML 1.2
---
$id: http://devicetree.org/schemas/mailbox/mediatek,mt8196-gpueb-mbox.yaml#
$schema: http://devicetree.org/meta-schemas/core.yaml#

title: MediaTek MFlexGraphics GPUEB Mailbox Controller

maintainers:
  - Nicolas Frattaroli <nicolas.frattaroli@collabora.com>

properties:
  compatible:
    enum:
      - mediatek,mt8196-gpueb-mbox

  reg:
    items:
      - description: mailbox data registers
      - description: mailbox control registers

  reg-names:
    items:
      - const: data
      - const: ctl

  clocks:
    items:
      - description: main clock of the GPUEB MCU

  interrupts:
    items:
      - description: fires when a new message is received

  "#mbox-cells":
    const: 1
    description:
      The number of the mailbox channel.

required:
  - compatible
  - reg
  - reg-names
  - clocks
  - interrupts
  - "#mbox-cells"

additionalProperties: false

examples:
  - |
    #include <dt-bindings/clock/mediatek,mt8196-clock.h>
    #include <dt-bindings/interrupt-controller/arm-gic.h>
    #include <dt-bindings/interrupt-controller/irq.h>

    mailbox@4b09fd80 {
        compatible = "mediatek,mt8196-gpueb-mbox";
        reg = <0x4b09fd80 0x280>,
              <0x4b170000 0x7c>;
        reg-names = "data", "ctl";
        clocks = <&topckgen CLK_TOP_MFG_EB>;
        interrupts = <GIC_SPI 608 IRQ_TYPE_LEVEL_HIGH 0>;
        #mbox-cells = <1>;
    };
```

## Documentation/devicetree/bindings/mailbox/mediatek,mt8196-vcp-mbox.yaml
```yaml
# SPDX-License-Identifier: (GPL-2.0-only OR BSD-2-Clause)
%YAML 1.2
---
$id: http://devicetree.org/schemas/mailbox/mediatek,mt8196-vcp-mbox.yaml#
$schema: http://devicetree.org/meta-schemas/core.yaml#

title: MediaTek Video Companion Processor (VCP) mailbox

maintainers:
  - Jjian Zhou <Jjian.Zhou@mediatek.com>

description:
  The MTK VCP mailbox enables the SoC to communicate with the VCP by passing
  messages through 64 32-bit wide registers. It has 32 interrupt vectors in
  either direction for signalling purposes.

properties:
  compatible:
    enum:
      - mediatek,mt8196-vcp-mbox

  reg:
    maxItems: 1

  interrupts:
    maxItems: 1

  "#mbox-cells":
    const: 0

required:
  - compatible
  - reg
  - interrupts
  - "#mbox-cells"

additionalProperties: false

examples:
  - |
    #include <dt-bindings/interrupt-controller/arm-gic.h>
    #include <dt-bindings/interrupt-controller/irq.h>

    mailbox@31b80000 {
        compatible = "mediatek,mt8196-vcp-mbox";
        reg = <0x31b80000 0x1000>;
        interrupts = <GIC_SPI 789 IRQ_TYPE_LEVEL_HIGH 0>;
        #mbox-cells = <0>;
    };
```
