## Documentation/devicetree/bindings/mailbox/brcm,iproc-flexrm-mbox.yaml
```yaml
# SPDX-License-Identifier: (GPL-2.0-only OR BSD-2-Clause)
%YAML 1.2
---
$id: http://devicetree.org/schemas/mailbox/brcm,iproc-flexrm-mbox.yaml#
$schema: http://devicetree.org/meta-schemas/core.yaml#

title: Broadcom FlexRM Ring Manager

maintainers:
  - Ray Jui <rjui@broadcom.com>
  - Scott Branden <sbranden@broadcom.com>

description:
  The Broadcom FlexRM ring manager provides a set of rings which can be used to
  submit work to offload engines. An SoC may have multiple FlexRM hardware
  blocks. There is one device tree entry per FlexRM block. The FlexRM driver
  will create a mailbox-controller instance for given FlexRM hardware block
  where each mailbox channel is a separate FlexRM ring.

properties:
  compatible:
    const: brcm,iproc-flexrm-mbox

  reg:
    maxItems: 1

  msi-parent:
    maxItems: 1

  '#mbox-cells':
    description: >
      The 1st cell is the mailbox channel number.

      The 2nd cell contains MSI completion threshold. This is the number of
      completion messages for which FlexRM will inject one MSI interrupt to CPU.

      The 3rd cell contains MSI timer value representing time for which FlexRM
      will wait to accumulate N completion messages where N is the value
      specified by 2nd cell above. If FlexRM does not get required number of
      completion messages in time specified by this cell then it will inject one
      MSI interrupt to CPU provided at least one completion message is
      available.
    const: 3

  dma-coherent: true

required:
  - compatible
  - reg
  - msi-parent
  - '#mbox-cells'

additionalProperties: false

examples:
  - |
    mailbox@67000000 {
        compatible = "brcm,iproc-flexrm-mbox";
        reg = <0x67000000 0x200000>;
        msi-parent = <&gic_its 0x7f00>;
        #mbox-cells = <3>;
        dma-coherent;
    };
```

## Documentation/devicetree/bindings/mailbox/brcm,iproc-pdc-mbox.txt
```
The PDC driver manages data transfer to and from various offload engines
on some Broadcom SoCs. An SoC may have multiple PDC hardware blocks. There is
one device tree entry per block.  On some chips, the PDC functionality is
handled by the FA2 (Northstar Plus).

Required properties:
- compatible : Should be "brcm,iproc-pdc-mbox" or "brcm,iproc-fa2-mbox" for
  FA2/Northstar Plus.
- reg: Should contain PDC registers location and length.
- interrupts: Should contain the IRQ line for the PDC.
- #mbox-cells: 1
- brcm,rx-status-len: Length of metadata preceding received frames, in bytes.

Optional properties:
- brcm,use-bcm-hdr:  present if a BCM header precedes each frame.

Example:
	pdc0: iproc-pdc0@612c0000 {
		compatible = "brcm,iproc-pdc-mbox";
		reg = <0 0x612c0000 0 0x445>;  /* PDC FS0 regs */
		interrupts = <GIC_SPI 187 IRQ_TYPE_LEVEL_HIGH>;
		#mbox-cells = <1>;   /* one cell per mailbox channel */
		brcm,rx-status-len = <32>;
		brcm,use-bcm-hdr;
	};
```

## Documentation/devicetree/bindings/mailbox/brcm,iproc-pdc-mbox.yaml
```yaml
# SPDX-License-Identifier: (GPL-2.0-only OR BSD-2-Clause)
%YAML 1.2
---
$id: http://devicetree.org/schemas/mailbox/brcm,iproc-pdc-mbox.yaml#
$schema: http://devicetree.org/meta-schemas/core.yaml#

title: Broadcom iProc PDC mailbox

maintainers:
  - Ray Jui <rjui@broadcom.com>
  - Scott Branden <sbranden@broadcom.com>

description:
  The PDC driver manages data transfer to and from various offload engines on
  some Broadcom SoCs. An SoC may have multiple PDC hardware blocks. There is one
  device tree entry per block. On some chips, the PDC functionality is handled
  by the FA2 (Northstar Plus).

properties:
  compatible:
    enum:
      - brcm,iproc-pdc-mbox
      - brcm,iproc-fa2-mbox

  reg:
    maxItems: 1

  dma-coherent: true

  interrupts:
    maxItems: 1

  '#mbox-cells':
    const: 1

  brcm,rx-status-len:
    description:
      Length of metadata preceding received frames, in bytes.
    $ref: /schemas/types.yaml#/definitions/uint32

  brcm,use-bcm-hdr:
    type: boolean
    description:
      Present if a BCM header precedes each frame.

required:
  - compatible
  - reg
  - interrupts
  - '#mbox-cells'
  - brcm,rx-status-len

additionalProperties: false

examples:
  - |
    #include <dt-bindings/interrupt-controller/arm-gic.h>

    mailbox0@612c0000 {
        compatible = "brcm,iproc-pdc-mbox";
        reg = <0x612c0000 0x445>;
        interrupts = <GIC_SPI 187 IRQ_TYPE_LEVEL_HIGH>;
        #mbox-cells = <1>;
        brcm,rx-status-len = <32>;
        brcm,use-bcm-hdr;
    };
```

## Documentation/devicetree/bindings/mailbox/cix,sky1-mbox.yaml
```yaml
# SPDX-License-Identifier: (GPL-2.0 OR BSD-2-Clause)
%YAML 1.2
---
$id: http://devicetree.org/schemas/mailbox/cix,sky1-mbox.yaml#
$schema: http://devicetree.org/meta-schemas/core.yaml#

title: Cixtech mailbox controller

maintainers:
  - Guomin Chen <Guomin.Chen@cixtech.com>

description:
  The Cixtech mailbox controller, used in the Cixtech Sky1 SoC,
  is used for message transmission between multiple processors
  within the SoC, such as the AP, PM, audio DSP, SensorHub MCU,
  and others

  Each Cixtech mailbox controller is unidirectional, so they are
  typically used in pairs-one for receiving and one for transmitting.

  Each Cixtech mailbox supports 11 channels with different transmission modes
    channel 0-7 - Fast channel with 32bit transmit register and IRQ support
    channel 8   - Doorbell mode,using the mailbox as an interrupt-generating
                   mechanism.
    channel 9   - Fifo based channel with 32*32bit depth fifo and IRQ support
    channel 10  - Reg based channel with 32*32bit transmit register and
                   Doorbell+transmit acknowledgment IRQ support

  In the CIX Sky1 SoC use case, there are 4 pairs of mailbox controllers
    AP <--> PM - using Doorbell transfer mode
    AP <--> SE - using REG transfer mode
    AP <--> DSP - using FIFO transfer mode
    AP <--> SensorHub - using FIFO transfer mode

properties:
  compatible:
    const: cix,sky1-mbox

  reg:
    maxItems: 1

  interrupts:
    maxItems: 1

  "#mbox-cells":
    const: 1

  cix,mbox-dir:
    $ref: /schemas/types.yaml#/definitions/string
    description: Direction of the mailbox relative to the AP
    enum: [tx, rx]

required:
  - compatible
  - reg
  - interrupts
  - "#mbox-cells"
  - cix,mbox-dir

additionalProperties: false

examples:
  - |
    #include <dt-bindings/interrupt-controller/arm-gic.h>

    soc {
        #address-cells = <2>;
        #size-cells = <2>;

        mbox_ap2pm: mailbox@30000000 {
            compatible = "cix,sky1-mbox";
            reg = <0 0x30000000 0 0x10000>;
            interrupts = <GIC_SPI 136 IRQ_TYPE_LEVEL_HIGH 0>;
            #mbox-cells = <1>;
            cix,mbox-dir = "tx";
        };
    };
```

## Documentation/devicetree/bindings/mailbox/fsl,mu.txt
```
NXP i.MX Messaging Unit (MU)
--------------------------------------------------------------------

The Messaging Unit module enables two processors within the SoC to
communicate and coordinate by passing messages (e.g. data, status
and control) through the MU interface. The MU also provides the ability
for one processor to signal the other processor using interrupts.

Because the MU manages the messaging between processors, the MU uses
different clocks (from each side of the different peripheral buses).
Therefore, the MU must synchronize the accesses from one side to the
other. The MU accomplishes synchronization using two sets of matching
registers (Processor A-facing, Processor B-facing).

Messaging Unit Device Node:
=============================

Required properties:
-------------------
- compatible :	should be "fsl,<chip>-mu", the supported chips include
		imx6sx, imx7s, imx8qxp, imx8qm.
		The "fsl,imx6sx-mu" compatible is seen as generic and should
		be included together with SoC specific compatible.
		There is a version 1.0 MU on imx7ulp, use "fsl,imx7ulp-mu"
		compatible to support it.
		To communicate with i.MX8 SCU, "fsl,imx8-mu-scu" could be
		used for fast IPC
- reg :		Should contain the registers location and length
- interrupts :	Interrupt number. The interrupt specifier format depends
		on the interrupt controller parent.
- #mbox-cells:  Must be 2.
			  <&phandle type channel>
			    phandle   : Label name of controller
			    type      : Channel type
			    channel   : Channel number

		This MU support 4 type of unidirectional channels, each type
		has 4 channels. A total of 16 channels. Following types are
		supported:
		0 - TX channel with 32bit transmit register and IRQ transmit
		acknowledgment support.
		1 - RX channel with 32bit receive register and IRQ support
		2 - TX doorbell channel. Without own register and no ACK support.
		3 - RX doorbell channel.

Optional properties:
-------------------
- clocks :	phandle to the input clock.
- fsl,mu-side-b : Should be set for side B MU.

Examples:
--------
lsio_mu0: mailbox@5d1b0000 {
	compatible = "fsl,imx8qxp-mu";
	reg = <0x0 0x5d1b0000 0x0 0x10000>;
	interrupts = <GIC_SPI 176 IRQ_TYPE_LEVEL_HIGH>;
	#mbox-cells = <2>;
};
```

## Documentation/devicetree/bindings/mailbox/fsl,mu.yaml
```yaml
# SPDX-License-Identifier: (GPL-2.0-only OR BSD-2-Clause)
%YAML 1.2
---
$id: http://devicetree.org/schemas/mailbox/fsl,mu.yaml#
$schema: http://devicetree.org/meta-schemas/core.yaml#

title: NXP i.MX Messaging Unit (MU)

maintainers:
  - Dong Aisheng <aisheng.dong@nxp.com>

description: |
  The Messaging Unit module enables two processors within the SoC to
  communicate and coordinate by passing messages (e.g. data, status
  and control) through the MU interface. The MU also provides the ability
  for one processor to signal the other processor using interrupts.

  Because the MU manages the messaging between processors, the MU uses
  different clocks (from each side of the different peripheral buses).
  Therefore, the MU must synchronize the accesses from one side to the
  other. The MU accomplishes synchronization using two sets of matching
  registers (Processor A-facing, Processor B-facing).

properties:
  compatible:
    oneOf:
      - const: fsl,imx6sx-mu
      - const: fsl,imx7ulp-mu
      - const: fsl,imx8ulp-mu
      - const: fsl,imx8-mu-scu
      - const: fsl,imx8-mu-seco
      - const: fsl,imx8ulp-mu-s4
      - const: fsl,imx93-mu-s4
      - const: fsl,imx95-mu
      - const: fsl,imx95-mu-ele
      - const: fsl,imx95-mu-v2x
      - items:
          - const: fsl,imx93-mu
          - const: fsl,imx8ulp-mu
      - items:
          - enum:
              - fsl,imx7s-mu
              - fsl,imx8mq-mu
              - fsl,imx8mm-mu
              - fsl,imx8mn-mu
              - fsl,imx8mp-mu
              - fsl,imx8qm-mu
              - fsl,imx8qxp-mu
          - const: fsl,imx6sx-mu
      - description: To communicate with i.MX8 SCU with fast IPC
        items:
          - const: fsl,imx8-mu-scu
          - enum:
              - fsl,imx8qm-mu
              - fsl,imx8qxp-mu
          - const: fsl,imx6sx-mu
      - items:
          - enum:
              - fsl,imx94-mu
          - const: fsl,imx95-mu

  reg:
    maxItems: 1

  interrupts:
    minItems: 1
    maxItems: 2

  interrupt-names:
    minItems: 1
    items:
      - const: tx
      - const: rx

  "#mbox-cells":
    description: |
      <&phandle type channel>
      phandle   : Label name of controller
      type      : Channel type
      channel   : Channel number

      This MU support 6 type of unidirectional channels, each type
      has 4 channels except RST channel which only has 1 channel.
      A total of 21 channels.  Following types are
      supported:
      0 - TX channel with 32bit transmit register and IRQ transmit
          acknowledgment support.
      1 - RX channel with 32bit receive register and IRQ support
      2 - TX doorbell channel. Without own register and no ACK support.
      3 - RX doorbell channel.
      4 - RST channel
      5 - Tx doorbell channel. With S/W ACK from the other side.
    const: 2

  clocks:
    maxItems: 1

  fsl,mu-side-b:
    description: boolean, if present, means it is for side B MU.
    type: boolean

  power-domains:
    maxItems: 1

  ranges: true

  '#address-cells':
    const: 1

  '#size-cells':
    const: 1

patternProperties:
  "^sram@[a-f0-9]+":
    $ref: /schemas/sram/sram.yaml#
    unevaluatedProperties: false

required:
  - compatible
  - reg
  - interrupts
  - "#mbox-cells"

allOf:
  - if:
      properties:
        compatible:
          enum:
            - fsl,imx93-mu-s4
    then:
      properties:
        interrupt-names:
          minItems: 2
        interrupts:
          minItems: 2

    else:
      properties:
        interrupts:
          maxItems: 1
      not:
        required:
          - interrupt-names

  - if:
      not:
        properties:
          compatible:
            contains:
              const: fsl,imx95-mu
    then:
      patternProperties:
        "^sram@[a-f0-9]+": false

additionalProperties: false

examples:
  - |
    #include <dt-bindings/interrupt-controller/arm-gic.h>

    mailbox@5d1b0000 {
        compatible = "fsl,imx8qxp-mu", "fsl,imx6sx-mu";
        reg = <0x5d1b0000 0x10000>;
        interrupts = <GIC_SPI 176 IRQ_TYPE_LEVEL_HIGH>;
        #mbox-cells = <2>;
    };

  - |
    #include <dt-bindings/interrupt-controller/arm-gic.h>

    mailbox@445b0000 {
        compatible = "fsl,imx95-mu";
        reg = <0x445b0000 0x10000>;
        ranges;
        interrupts = <GIC_SPI 226 IRQ_TYPE_LEVEL_HIGH>;
        #address-cells = <1>;
        #size-cells = <1>;
        #mbox-cells = <2>;

        sram@445b1000 {
            compatible = "mmio-sram";
            reg = <0x445b1000 0x400>;
            ranges = <0x0 0x445b1000 0x400>;
            #address-cells = <1>;
            #size-cells = <1>;

            scmi-sram-section@0 {
                compatible = "arm,scmi-shmem";
                reg = <0x0 0x80>;
            };

            scmi-sram-section@80 {
                compatible = "arm,scmi-shmem";
                reg = <0x80 0x80>;
            };
        };
    };
```

## Documentation/devicetree/bindings/mailbox/google,gs101-mbox.yaml
```yaml
# SPDX-License-Identifier: (GPL-2.0-only OR BSD-2-Clause)
# Copyright 2024 Linaro Ltd.
%YAML 1.2
---
$id: http://devicetree.org/schemas/mailbox/google,gs101-mbox.yaml#
$schema: http://devicetree.org/meta-schemas/core.yaml#

title: Samsung Exynos Mailbox Controller

maintainers:
  - Tudor Ambarus <tudor.ambarus@linaro.org>

description:
  The Samsung Exynos mailbox controller, used on Google GS101 SoC, has 16 flag
  bits for hardware interrupt generation and a shared register for passing
  mailbox messages. When the controller is used by the ACPM interface
  the shared register is ignored and the mailbox controller acts as a doorbell.
  The controller just raises the interrupt to the firmware after the
  ACPM interface has written the message to SRAM.

properties:
  compatible:
    const: google,gs101-mbox

  reg:
    maxItems: 1

  clocks:
    maxItems: 1

  clock-names:
    items:
      - const: pclk

  interrupts:
    description: IRQ line for the RX mailbox.
    maxItems: 1

  '#mbox-cells':
    const: 0

required:
  - compatible
  - reg
  - clocks
  - clock-names
  - interrupts
  - '#mbox-cells'

additionalProperties: false

examples:
  - |
    #include <dt-bindings/interrupt-controller/arm-gic.h>
    #include <dt-bindings/clock/google,gs101.h>

    soc {
        #address-cells = <1>;
        #size-cells = <1>;

        ap2apm_mailbox: mailbox@17610000 {
            compatible = "google,gs101-mbox";
            reg = <0x17610000 0x1000>;
            clocks = <&cmu_apm CLK_GOUT_APM_MAILBOX_APM_AP_PCLK>;
            clock-names = "pclk";
            interrupts = <GIC_SPI 73 IRQ_TYPE_LEVEL_HIGH 0>;
            #mbox-cells = <0>;
        };
    };
```
