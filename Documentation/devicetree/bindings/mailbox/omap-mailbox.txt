## Documentation/devicetree/bindings/mailbox/st,stm32-ipcc.yaml
```yaml
# SPDX-License-Identifier: (GPL-2.0 OR BSD-2-Clause)
%YAML 1.2
---
$id: "http://devicetree.org/schemas/mailbox/st,stm32-ipcc.yaml#"
$schema: "http://devicetree.org/meta-schemas/core.yaml#"

title: STMicroelectronics STM32 IPC controller

description:
  The IPCC block provides a non blocking signaling mechanism to post and
  retrieve messages in an atomic way between two processors.
  It provides the signaling for N bidirectionnal channels. The number of
  channels (N) can be read from a dedicated register.

maintainers:
  - Fabien Dessenne <fabien.dessenne@foss.st.com>
  - Arnaud Pouliquen <arnaud.pouliquen@foss.st.com>

properties:
  compatible:
    const: st,stm32mp1-ipcc

  reg:
    maxItems: 1

  clocks:
    maxItems: 1

  interrupts:
    items:
      - description: rx channel occupied
      - description: tx channel free

  interrupt-names:
    items:
      - const: rx
      - const: tx

  wakeup-source: true

  "#mbox-cells":
    const: 1

  st,proc-id:
    description: Processor id using the mailbox (0 or 1)
    $ref: /schemas/types.yaml#/definitions/uint32
    enum: [0, 1]

required:
  - compatible
  - reg
  - st,proc-id
  - clocks
  - interrupt-names
  - "#mbox-cells"
  - interrupts

additionalProperties: false

examples:
  - |
    #include <dt-bindings/interrupt-controller/arm-gic.h>
    #include <dt-bindings/clock/stm32mp1-clks.h>
    ipcc: mailbox@4c001000 {
      compatible = "st,stm32mp1-ipcc";
      #mbox-cells = <1>;
      reg = <0x4c001000 0x400>;
      st,proc-id = <0>;
      interrupts-extended = <&exti 61 1>,
                            <&intc GIC_SPI 101 IRQ_TYPE_LEVEL_HIGH>;
      interrupt-names = "rx", "tx";
      clocks = <&rcc_clk IPCC>;
      wakeup-source;
    };

...
```

## Documentation/devicetree/bindings/mailbox/sti-mailbox.txt
```
ST Microelectronics Mailbox Driver

Each ST Mailbox IP currently consists of 4 instances of 32 channels.  Messages
are passed between Application and Remote processors using shared memory.

Controller
----------

Required properties:
- compatible		: Should be "st,stih407-mailbox"
- reg			: Offset and length of the device's register set
- mbox-name		: Name of the mailbox
- #mbox-cells:		: Must be 2
			  <&phandle instance channel direction>
			    phandle   : Label name of controller
			    instance  : Instance number
			    channel   : Channel number

Optional properties
- interrupts		: Contains the IRQ line for a Rx mailbox

Example:

mailbox0: mailbox@0  {
	compatible	= "st,stih407-mailbox";
	reg		= <0x08f00000 0x1000>;
	interrupts	= <GIC_SPI 1 IRQ_TYPE_NONE>;
	#mbox-cells	= <2>;
	mbox-name	= "a9";
};

Client
------

Required properties:
- compatible		: Many (See the client docs)
- reg			: Shared (between Application and Remote) memory address
- mboxes		: Standard property to specify a Mailbox (See ./mailbox.txt)
			  Cells must match 'mbox-cells' (See Controller docs above)

Optional properties
- mbox-names		: Name given to channels seen in the 'mboxes' property.

Example:

mailbox_test {
	compatible	= "mailbox_test";
	reg		= <0x[shared_memory_address], [shared_memory_size]>;
	mboxes		= <&mailbox2 0 1>, <&mailbox0 2 1>;
	mbox-names	= "tx",	"rx";
};
```

## Documentation/devicetree/bindings/mailbox/stm32-ipcc.txt
```
* STMicroelectronics STM32 IPCC (Inter-Processor Communication Controller)

The IPCC block provides a non blocking signaling mechanism to post and
retrieve messages in an atomic way between two processors.
It provides the signaling for N bidirectionnal channels. The number of channels
(N) can be read from a dedicated register.

Required properties:
- compatible:   Must be "st,stm32mp1-ipcc"
- reg:          Register address range (base address and length)
- st,proc-id:   Processor id using the mailbox (0 or 1)
- clocks:       Input clock
- interrupt-names: List of names for the interrupts described by the interrupt
                   property. Must contain the following entries:
                   - "rx"
                   - "tx"
                   - "wakeup"
- interrupts:   Interrupt specifiers for "rx channel occupied", "tx channel
                free" and "system wakeup".
- #mbox-cells:  Number of cells required for the mailbox specifier. Must be 1.
                The data contained in the mbox specifier of the "mboxes"
                property in the client node is the mailbox channel index.

Optional properties:
- wakeup-source: Flag to indicate whether this device can wake up the system



Example:
	ipcc: mailbox@4c001000 {
		compatible = "st,stm32mp1-ipcc";
		#mbox-cells = <1>;
		reg = <0x4c001000 0x400>;
		st,proc-id = <0>;
		interrupts-extended = <&intc GIC_SPI 100 IRQ_TYPE_NONE>,
				      <&intc GIC_SPI 101 IRQ_TYPE_NONE>,
				      <&aiec 62 1>;
		interrupt-names = "rx", "tx", "wakeup";
		clocks = <&rcc_clk IPCC>;
		wakeup-source;
	}

Client:
	mbox_test {
		...
		mboxes = <&ipcc 0>, <&ipcc 1>;
	};
```

## Documentation/devicetree/bindings/mailbox/thead,th1520-mbox.yaml
```yaml
# SPDX-License-Identifier: (GPL-2.0-only OR BSD-2-Clause)
%YAML 1.2
---
$id: http://devicetree.org/schemas/mailbox/thead,th1520-mbox.yaml#
$schema: http://devicetree.org/meta-schemas/core.yaml#

title: T-head TH1520 Mailbox Controller

description:
  The T-head mailbox controller enables communication and coordination between
  cores within the SoC by passing messages (e.g., data, status, and control)
  through mailbox channels. It also allows one core to signal another processor
  using interrupts via the Interrupt Controller Unit (ICU).

maintainers:
  - Michal Wilczynski <m.wilczynski@samsung.com>

properties:
  compatible:
    const: thead,th1520-mbox

  clocks:
    items:
      - description: Clock for the local mailbox
      - description: Clock for remote ICU 0
      - description: Clock for remote ICU 1
      - description: Clock for remote ICU 2

  clock-names:
    items:
      - const: clk-local
      - const: clk-remote-icu0
      - const: clk-remote-icu1
      - const: clk-remote-icu2

  reg:
    items:
      - description: Mailbox local base address
      - description: Remote ICU 0 base address
      - description: Remote ICU 1 base address
      - description: Remote ICU 2 base address

  reg-names:
    items:
      - const: local
      - const: remote-icu0
      - const: remote-icu1
      - const: remote-icu2

  interrupts:
    maxItems: 1

  '#mbox-cells':
    const: 1
    description:
      The one and only cell describes destination CPU ID.

required:
  - compatible
  - clocks
  - clock-names
  - reg
  - reg-names
  - interrupts
  - '#mbox-cells'

additionalProperties: false

examples:
  - |
    #include <dt-bindings/clock/thead,th1520-clk-ap.h>
    soc {
      #address-cells = <2>;
      #size-cells = <2>;
      mailbox@ffffc38000 {
        compatible = "thead,th1520-mbox";
        reg = <0xff 0xffc38000 0x0 0x4000>,
              <0xff 0xffc44000 0x0 0x1000>,
              <0xff 0xffc4c000 0x0 0x1000>,
              <0xff 0xffc54000 0x0 0x1000>;
        reg-names = "local", "remote-icu0", "remote-icu1", "remote-icu2";
        clocks = <&clk CLK_MBOX0>, <&clk CLK_MBOX1>, <&clk CLK_MBOX2>,
                 <&clk CLK_MBOX3>;
        clock-names = "clk-local", "clk-remote-icu0", "clk-remote-icu1",
                      "clk-remote-icu2";
        interrupts = <28>;
        #mbox-cells = <1>;
      };
    };
```

## Documentation/devicetree/bindings/mailbox/ti,message-manager.txt
```
Texas Instruments' Message Manager Driver
========================================

The Texas Instruments' Message Manager is a mailbox controller that has
configurable queues selectable at SoC(System on Chip) integration. The Message
manager is broken up into queues in different address regions that are called
"proxies" - each instance is unidirectional and is instantiated at SoC
integration level to indicate receive or transmit path.

Message Manager Device Node:
===========================
Required properties:
--------------------
- compatible:		Shall be: "ti,k2g-message-manager"
- reg-names 		queue_proxy_region - Map the queue proxy region.
			queue_state_debug_region - Map the queue state debug
			region.
- reg:			Contains the register map per reg-names.
- #mbox-cells		Shall be 2. Contains the queue ID and proxy ID in that
		        order referring to the transfer path.
- interrupt-names:	Contains interrupt names matching the rx transfer path
			for a given SoC. Receive interrupts shall be of the
			format: "rx_<QID>".
			For ti,k2g-message-manager, this shall contain:
				"rx_005", "rx_057"
- interrupts:		Contains the interrupt information corresponding to
			interrupt-names property.

Example(K2G):
------------

	msgmgr: msgmgr@2a00000 {
		compatible = "ti,k2g-message-manager";
		#mbox-cells = <2>;
		reg-names = "queue_proxy_region", "queue_state_debug_region";
		reg = <0x02a00000 0x400000>, <0x028c3400 0x400>;
		interrupt-names = "rx_005", "rx_057";
		interrupts = <GIC_SPI 324 IRQ_TYPE_LEVEL_HIGH>,
			     <GIC_SPI 327 IRQ_TYPE_LEVEL_HIGH>;
	};

	pmmc: pmmc {
		[...]
		mbox-names = "rx", "tx";
		# RX queue ID is 5, proxy ID is 2
		# TX queue ID is 0, proxy ID is 0
		mboxes= <&msgmgr 5 2>,
			<&msgmgr 0 0>;
		[...]
	};
```
