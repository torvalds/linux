## Documentation/devicetree/bindings/mailbox/qcom,cpucp-mbox.yaml
```yaml
# SPDX-License-Identifier: GPL-2.0 OR BSD-2-Clause
%YAML 1.2
---
$id: http://devicetree.org/schemas/mailbox/qcom,cpucp-mbox.yaml#
$schema: http://devicetree.org/meta-schemas/core.yaml#

title: Qualcomm Technologies, Inc. CPUCP Mailbox Controller

maintainers:
  - Sibi Sankar <quic_sibis@quicinc.com>

description:
  The CPUSS Control Processor (CPUCP) mailbox controller enables communication
  between AP and CPUCP by acting as a doorbell between them.

properties:
  compatible:
    items:
      - const: qcom,x1e80100-cpucp-mbox

  reg:
    items:
      - description: CPUCP rx register region
      - description: CPUCP tx register region

  interrupts:
    maxItems: 1

  "#mbox-cells":
    const: 1

required:
  - compatible
  - reg
  - interrupts
  - "#mbox-cells"

additionalProperties: false

examples:
  - |
    #include <dt-bindings/interrupt-controller/arm-gic.h>

    mailbox@17430000 {
        compatible = "qcom,x1e80100-cpucp-mbox";
        reg = <0x17430000 0x10000>, <0x18830000 0x10000>;
        interrupts = <GIC_SPI 28 IRQ_TYPE_LEVEL_HIGH>;
        #mbox-cells = <1>;
    };
```

## Documentation/devicetree/bindings/mailbox/qcom-ipcc.yaml
```yaml
# SPDX-License-Identifier: GPL-2.0 OR BSD-2-Clause
%YAML 1.2
---
$id: http://devicetree.org/schemas/mailbox/qcom-ipcc.yaml#
$schema: http://devicetree.org/meta-schemas/core.yaml#

title: Qualcomm Technologies, Inc. Inter-Processor Communication Controller

maintainers:
  - Manivannan Sadhasivam <manivannan.sadhasivam@linaro.org>

description:
  The Inter-Processor Communication Controller (IPCC) is a centralized hardware
  to route interrupts across various subsystems. It involves a three-level
  addressing scheme called protocol, client and signal. For example, consider an
  entity on the Application Processor Subsystem (APSS) that wants to listen to
  Modem's interrupts via Shared Memory Point to Point (SMP2P) interface. In such
  a case, the client would be Modem (client-id is 2) and the signal would be
  SMP2P (signal-id is 2). The SMP2P itself falls under the Multiprocessor (MPROC)
  protocol (protocol-id is 0). Refer include/dt-bindings/mailbox/qcom-ipcc.h
  for the list of such IDs.

properties:
  compatible:
    items:
      - enum:
        - qcom,sm8250-ipcc
      - const: qcom,ipcc

  reg:
    maxItems: 1

  interrupts:
    maxItems: 1

  interrupt-controller: true

  "#interrupt-cells":
    const: 3
    description:
      The first cell is the client-id, the second cell is the signal-id and the
      third cell is the interrupt type.

  "#mbox-cells":
    const: 2
    description:
      The first cell is the client-id, and the second cell is the signal-id.

required:
  - compatible
  - reg
  - interrupts
  - interrupt-controller
  - "#interrupt-cells"
  - "#mbox-cells"

additionalProperties: false

examples:
  - |
        #include <dt-bindings/interrupt-controller/arm-gic.h>
        #include <dt-bindings/mailbox/qcom-ipcc.h>

        mailbox@408000 {
                compatible = "qcom,sm8250-ipcc", "qcom,ipcc";
                reg = <0x408000 0x1000>;
                interrupts = <GIC_SPI 229 IRQ_TYPE_LEVEL_HIGH>;
                interrupt-controller;
                #interrupt-cells = <3>;
                #mbox-cells = <2>;
        };

        smp2p-modem {
                compatible = "qcom,smp2p";
                interrupts-extended = <&ipcc_mproc IPCC_CLIENT_MPSS
                                IPCC_MPROC_SIGNAL_SMP2P IRQ_TYPE_EDGE_RISING>;
                mboxes = <&ipcc_mproc IPCC_CLIENT_MPSS IPCC_MPROC_SIGNAL_SMP2P>;

                /* Other SMP2P fields */
        };
```

## Documentation/devicetree/bindings/mailbox/riscv,rpmi-shmem-mbox.yaml
```yaml
# SPDX-License-Identifier: (GPL-2.0-only OR BSD-2-Clause)
%YAML 1.2
---
$id: http://devicetree.org/schemas/mailbox/riscv,rpmi-shmem-mbox.yaml#
$schema: http://devicetree.org/meta-schemas/core.yaml#

title: RISC-V Platform Management Interface (RPMI) shared memory mailbox

maintainers:
  - Anup Patel <anup@brainfault.org>

description: |
  The RISC-V Platform Management Interface (RPMI) [1] defines a common shared
  memory based RPMI transport. This RPMI shared memory transport integrates as
  mailbox controller in the SBI implementation or supervisor software whereas
  each RPMI service group is mailbox client in the SBI implementation and
  supervisor software.

  ===========================================
  References
  ===========================================

  [1] RISC-V Platform Management Interface (RPMI) v1.0 (or higher)
      https://github.com/riscv-non-isa/riscv-rpmi/releases

properties:
  compatible:
    const: riscv,rpmi-shmem-mbox

  reg:
    minItems: 2
    items:
      - description: A2P request queue base address
      - description: P2A acknowledgment queue base address
      - description: P2A request queue base address
      - description: A2P acknowledgment queue base address
      - description: A2P doorbell address

  reg-names:
    minItems: 2
    items:
      - const: a2p-req
      - const: p2a-ack
      - enum: [ p2a-req, a2p-doorbell ]
      - const: a2p-ack
      - const: a2p-doorbell

  interrupts:
    maxItems: 1
    description:
      The RPMI shared memory transport supports P2A doorbell as a wired
      interrupt and this property specifies the interrupt source.

  msi-parent:
    description:
      The RPMI shared memory transport supports P2A doorbell as a system MSI
      and this property specifies the target MSI controller.

  riscv,slot-size:
    $ref: /schemas/types.yaml#/definitions/uint32
    minimum: 64
    description:
      Power-of-2 RPMI slot size of the RPMI shared memory transport.

  riscv,a2p-doorbell-value:
    $ref: /schemas/types.yaml#/definitions/uint32
    default: 0x1
    description:
      Value written to the 32-bit A2P doorbell register.

  riscv,p2a-doorbell-sysmsi-index:
    $ref: /schemas/types.yaml#/definitions/uint32
    description:
      The RPMI shared memory transport supports P2A doorbell as a system MSI
      and this property specifies system MSI index to be used for configuring
      the P2A doorbell MSI.

  "#mbox-cells":
    const: 1
    description:
      The first cell specifies RPMI service group ID.

required:
  - compatible
  - reg
  - reg-names
  - riscv,slot-size
  - "#mbox-cells"

anyOf:
  - required:
      - interrupts
  - required:
      - msi-parent

additionalProperties: false

examples:
  - |
    // Example 1 (RPMI shared memory with only 2 queues):
    mailbox@10080000 {
        compatible = "riscv,rpmi-shmem-mbox";
        reg = <0x10080000 0x10000>,
              <0x10090000 0x10000>;
        reg-names = "a2p-req", "p2a-ack";
        msi-parent = <&imsic_mlevel>;
        riscv,slot-size = <64>;
        #mbox-cells = <1>;
    };
  - |
    // Example 2 (RPMI shared memory with only 4 queues):
    mailbox@10001000 {
        compatible = "riscv,rpmi-shmem-mbox";
        reg = <0x10001000 0x800>,
              <0x10001800 0x800>,
              <0x10002000 0x800>,
              <0x10002800 0x800>,
              <0x10003000 0x4>;
        reg-names = "a2p-req", "p2a-ack", "p2a-req", "a2p-ack", "a2p-doorbell";
        msi-parent = <&imsic_mlevel>;
        riscv,slot-size = <64>;
        riscv,a2p-doorbell-value = <0x00008000>;
        #mbox-cells = <1>;
    };
```

## Documentation/devicetree/bindings/mailbox/riscv,sbi-mpxy-mbox.yaml
```yaml
# SPDX-License-Identifier: (GPL-2.0-only OR BSD-2-Clause)
%YAML 1.2
---
$id: http://devicetree.org/schemas/mailbox/riscv,sbi-mpxy-mbox.yaml#
$schema: http://devicetree.org/meta-schemas/core.yaml#

title: RISC-V SBI Message Proxy (MPXY) extension based mailbox

maintainers:
  - Anup Patel <anup@brainfault.org>

description: |
  The RISC-V SBI Message Proxy (MPXY) extension [1] allows supervisor
  software to send messages through the SBI implementation (M-mode
  firmware or HS-mode hypervisor). The underlying message protocol
  and message format used by the supervisor software could be some
  other standard protocol compatible with the SBI MPXY extension
  (such as RISC-V Platform Management Interface (RPMI) [2]).

  ===========================================
  References
  ===========================================

  [1] RISC-V Supervisor Binary Interface (SBI) v3.0 (or higher)
      https://github.com/riscv-non-isa/riscv-sbi-doc/releases

  [2] RISC-V Platform Management Interface (RPMI) v1.0 (or higher)
      https://github.com/riscv-non-isa/riscv-rpmi/releases

properties:
  compatible:
    const: riscv,sbi-mpxy-mbox

  "#mbox-cells":
    const: 2
    description:
      The first cell specifies channel_id of the SBI MPXY channel,
      the second cell specifies MSG_PROT_ID of the SBI MPXY channel

required:
  - compatible
  - "#mbox-cells"

additionalProperties: false

examples:
  - |
    mailbox {
          compatible = "riscv,sbi-mpxy-mbox";
          #mbox-cells = <2>;
    };
```

## Documentation/devicetree/bindings/mailbox/rockchip,rk3368-mailbox.yaml
```yaml
# SPDX-License-Identifier: (GPL-2.0-only OR BSD-2-Clause)
%YAML 1.2
---
$id: http://devicetree.org/schemas/mailbox/rockchip,rk3368-mailbox.yaml#
$schema: http://devicetree.org/meta-schemas/core.yaml#

title: Rockchip RK3368 Mailbox Controller

maintainers:
  - Heiko Stuebner <heiko@sntech.de>

description:
  The Rockchip mailbox is used by the Rockchip CPU cores to communicate
  requests to MCU processor.

properties:
  compatible:
    const: rockchip,rk3368-mailbox

  reg:
    maxItems: 1

  clocks:
    maxItems: 1

  clock-names:
    const: pclk_mailbox

  interrupts:
    description: One interrupt for each channel
    maxItems: 4

  '#mbox-cells':
    const: 1

required:
  - compatible
  - reg
  - interrupts
  - '#mbox-cells'

additionalProperties: false

examples:
  - |
    #include <dt-bindings/interrupt-controller/arm-gic.h>

    mailbox@ff6b0000 {
        compatible = "rockchip,rk3368-mailbox";
        reg = <0xff6b0000 0x1000>;
        interrupts = <GIC_SPI 146 IRQ_TYPE_LEVEL_HIGH>,
                     <GIC_SPI 147 IRQ_TYPE_LEVEL_HIGH>,
                     <GIC_SPI 148 IRQ_TYPE_LEVEL_HIGH>,
                     <GIC_SPI 149 IRQ_TYPE_LEVEL_HIGH>;
        #mbox-cells = <1>;
    };
```

## Documentation/devicetree/bindings/mailbox/rockchip-mailbox.txt
```
Rockchip mailbox

The Rockchip mailbox is used by the Rockchip CPU cores to communicate
requests to MCU processor.

Refer to ./mailbox.txt for generic information about mailbox device-tree
bindings.

Required properties:

 - compatible: should be one of the following.
   - "rockchip,rk3368-mbox" for rk3368
 - reg: physical base address of the controller and length of memory mapped
	region.
	physical base address of the share buffer and length of memory mapped
	region.
 - interrupts: The interrupt number to the cpu. The interrupt specifier format
	depends on the interrupt controller.

Example:
        mbox: mbox@ff6b0000 {
                compatible = "rockchip,rk3368-mailbox";
                reg = <0x0 0xff6b0000 0x0 0x1000>,
                      <0x0 0xff8cf000 0x0 0x1000>; /* the end 4k of sram */
                interrupts = <GIC_SPI 146 IRQ_TYPE_LEVEL_HIGH>,
                             <GIC_SPI 147 IRQ_TYPE_LEVEL_HIGH>,
                             <GIC_SPI 148 IRQ_TYPE_LEVEL_HIGH>,
                             <GIC_SPI 149 IRQ_TYPE_LEVEL_HIGH>;
                #mbox-cells = <1>;
        };

        mbox_scpi: mbox-scpi {
                compatible = "rockchip,mbox-scpi";
                mboxes = <&mbox 0 &mbox 1>;
        };
```

## Documentation/devicetree/bindings/mailbox/sophgo,cv1800b-mailbox.yaml
```yaml
# SPDX-License-Identifier: (GPL-2.0 OR BSD-2-Clause)
%YAML 1.2
---
$id: http://devicetree.org/schemas/mailbox/sophgo,cv1800b-mailbox.yaml#
$schema: http://devicetree.org/meta-schemas/core.yaml#

title: Sophgo CV1800/SG2000 mailbox controller

maintainers:
  - Yuntao Dai <d1581209858@live.com>
  - Junhui Liu <junhui.liu@pigmoral.tech>

description:
  Mailboxes integrated in Sophgo CV1800/SG2000 SoCs have 8 channels, each
  shipping an 8-byte FIFO. Any processor can write to an arbitrary channel
  and raise interrupts to receivers. Sending messages to itself is also
  supported.

properties:
  compatible:
    const: sophgo,cv1800b-mailbox

  reg:
    maxItems: 1

  interrupts:
    maxItems: 1

  "#mbox-cells":
    const: 2
    description: |
      <&phandle channel target>
      phandle : Label name of mailbox controller
      channel : 0-7, Channel index
      target  : 0-3, Target processor ID

      Sophgo CV1800/SG2000 SoCs include the following processors, numbered as:
      <0> Cortex-A53 (Only available on CV181X/SG200X)
      <1> C906B
      <2> C906L
      <3> 8051

required:
  - compatible
  - reg
  - interrupts
  - "#mbox-cells"

additionalProperties: false

examples:
  - |
    #include <dt-bindings/interrupt-controller/irq.h>

    mailbox@1900000 {
        compatible = "sophgo,cv1800b-mailbox";
        reg = <0x01900000 0x1000>;
        interrupts = <101 IRQ_TYPE_LEVEL_HIGH>;
        #mbox-cells = <2>;
    };
```

## Documentation/devicetree/bindings/mailbox/sprd-mailbox.yaml
```yaml
# SPDX-License-Identifier: (GPL-2.0 OR BSD-2-Clause)
%YAML 1.2
---
$id: "http://devicetree.org/schemas/mailbox/sprd-mailbox.yaml#"
$schema: "http://devicetree.org/meta-schemas/core.yaml#"

title: Spreadtrum mailbox controller bindings

maintainers:
  - Orson Zhai <orsonzhai@gmail.com>
  - Baolin Wang <baolin.wang7@gmail.com>
  - Chunyan Zhang <zhang.lyra@gmail.com>

properties:
  compatible:
    enum:
      - sprd,sc9860-mailbox

  reg:
    items:
      - description: inbox registers' base address
      - description: outbox registers' base address

  interrupts:
    items:
      - description: inbox interrupt
      - description: outbox interrupt

  clocks:
    maxItems: 1

  clock-names:
    items:
      - const: enable

  "#mbox-cells":
    const: 1

required:
  - compatible
  - reg
  - interrupts
  - "#mbox-cells"
  - clocks
  - clock-names

additionalProperties: false

examples:
  - |
    #include <dt-bindings/interrupt-controller/arm-gic.h>
    mailbox: mailbox@400a0000 {
      compatible = "sprd,sc9860-mailbox";
      reg = <0 0x400a0000 0 0x8000>, <0 0x400a8000 0 0x8000>;
      #mbox-cells = <1>;
      clock-names = "enable";
      clocks = <&aon_gate 53>;
      interrupts = <GIC_SPI 28 IRQ_TYPE_LEVEL_HIGH>, <GIC_SPI 29 IRQ_TYPE_LEVEL_HIGH>;
    };
...
```

## Documentation/devicetree/bindings/mailbox/st,sti-mailbox.yaml
```yaml
# SPDX-License-Identifier: (GPL-2.0 OR BSD-2-Clause)
%YAML 1.2
---
$id: http://devicetree.org/schemas/mailbox/st,sti-mailbox.yaml#
$schema: http://devicetree.org/meta-schemas/core.yaml#

title: STMicroelectronics Mailbox Driver for STi platform

description:
  Each ST Mailbox IP currently consists of 4 instances of 32 channels.
  Messages are passed between Application and Remote processors using
  shared memory.

maintainers:
  - Patrice Chotard <patrice.chotard@foss.st.com>

properties:
  compatible:
    const: st,stih407-mailbox

  reg:
    maxItems: 1

  mbox-name:
    $ref: /schemas/types.yaml#/definitions/string
    description: name of the mailbox IP

  interrupts:
    description: the irq line for the RX mailbox
    maxItems: 1

  "#mbox-cells":
    const: 2

required:
  - compatible
  - reg
  - "#mbox-cells"

additionalProperties: false

examples:
  - |
    #include <dt-bindings/interrupt-controller/arm-gic.h>
    mailbox0: mailbox@8f00000  {
        compatible = "st,stih407-mailbox";
        reg = <0x8f00000 0x1000>;
        interrupts = <GIC_SPI 1 IRQ_TYPE_LEVEL_HIGH>;
        #mbox-cells = <2>;
        mbox-name = "a9";
    };

...
```
