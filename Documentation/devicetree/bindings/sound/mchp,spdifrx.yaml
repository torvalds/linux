## Documentation/devicetree/bindings/sound/mediatek,mt7986-afe.yaml
```yaml
# SPDX-License-Identifier: (GPL-2.0-only OR BSD-2-Clause)
%YAML 1.2
---
$id: http://devicetree.org/schemas/sound/mediatek,mt7986-afe.yaml#
$schema: http://devicetree.org/meta-schemas/core.yaml#

title: MediaTek AFE PCM controller for MT7986

maintainers:
  - Maso Huang <maso.huang@mediatek.com>

properties:
  compatible:
    oneOf:
      - const: mediatek,mt7986-afe
      - items:
          - enum:
              - mediatek,mt7981-afe
              - mediatek,mt7988-afe
          - const: mediatek,mt7986-afe

  reg:
    maxItems: 1

  interrupts:
    maxItems: 1

  clocks:
    minItems: 5
    items:
      - description: audio bus clock
      - description: audio 26M clock
      - description: audio intbus clock
      - description: audio hopping clock
      - description: audio pll clock
      - description: mux for pcm_mck
      - description: audio i2s/pcm mck

  clock-names:
    minItems: 5
    items:
      - const: bus_ck
      - const: 26m_ck
      - const: l_ck
      - const: aud_ck
      - const: eg2_ck
      - const: sel
      - const: i2s_m

required:
  - compatible
  - reg
  - interrupts
  - clocks
  - clock-names

allOf:
  - if:
      properties:
        compatible:
          contains:
            const: mediatek,mt7986-afe
    then:
      properties:
        clocks:
          items:
            - description: audio bus clock
            - description: audio 26M clock
            - description: audio intbus clock
            - description: audio hopping clock
            - description: audio pll clock
        clock-names:
          items:
            - const: bus_ck
            - const: 26m_ck
            - const: l_ck
            - const: aud_ck
            - const: eg2_ck

  - if:
      properties:
        compatible:
          contains:
            const: mediatek,mt7981-afe
    then:
      properties:
        clocks:
          items:
            - description: audio bus clock
            - description: audio 26M clock
            - description: audio intbus clock
            - description: audio hopping clock
            - description: audio pll clock
            - description: mux for pcm_mck
        clock-names:
          items:
            - const: bus_ck
            - const: 26m_ck
            - const: l_ck
            - const: aud_ck
            - const: eg2_ck
            - const: sel

  - if:
      properties:
        compatible:
          contains:
            const: mediatek,mt7988-afe
    then:
      properties:
        clocks:
          items:
            - description: audio bus clock
            - description: audio 26M clock
            - description: audio intbus clock
            - description: audio hopping clock
            - description: audio pll clock
            - description: mux for pcm_mck
            - description: audio i2s/pcm mck
        clock-names:
          items:
            - const: bus_ck
            - const: 26m_ck
            - const: l_ck
            - const: aud_ck
            - const: eg2_ck
            - const: sel
            - const: i2s_m

additionalProperties: false

examples:
  - |
    #include <dt-bindings/interrupt-controller/arm-gic.h>
    #include <dt-bindings/interrupt-controller/irq.h>
    #include <dt-bindings/clock/mt7986-clk.h>

    afe@11210000 {
        compatible = "mediatek,mt7986-afe";
        reg = <0x11210000 0x9000>;
        interrupts = <GIC_SPI 106 IRQ_TYPE_LEVEL_HIGH>;
        clocks = <&infracfg_ao CLK_INFRA_AUD_BUS_CK>,
                 <&infracfg_ao CLK_INFRA_AUD_26M_CK>,
                 <&infracfg_ao CLK_INFRA_AUD_L_CK>,
                 <&infracfg_ao CLK_INFRA_AUD_AUD_CK>,
                 <&infracfg_ao CLK_INFRA_AUD_EG2_CK>;
        clock-names = "bus_ck",
                      "26m_ck",
                      "l_ck",
                      "aud_ck",
                      "eg2_ck";
        assigned-clocks = <&topckgen CLK_TOP_A1SYS_SEL>,
                          <&topckgen CLK_TOP_AUD_L_SEL>,
                          <&topckgen CLK_TOP_A_TUNER_SEL>;
        assigned-clock-parents = <&topckgen CLK_TOP_APLL2_D4>,
                                 <&apmixedsys CLK_APMIXED_APLL2>,
                                 <&topckgen CLK_TOP_APLL2_D4>;
    };

...
```

## Documentation/devicetree/bindings/sound/mediatek,mt7986-wm8960.yaml
```yaml
# SPDX-License-Identifier: (GPL-2.0-only OR BSD-2-Clause)
%YAML 1.2
---
$id: http://devicetree.org/schemas/sound/mediatek,mt7986-wm8960.yaml#
$schema: http://devicetree.org/meta-schemas/core.yaml#

title: MediaTek MT7986 sound card with WM8960 codec

maintainers:
  - Maso Huang <maso.huang@mediatek.com>

allOf:
  - $ref: sound-card-common.yaml#

properties:
  compatible:
    const: mediatek,mt7986-wm8960-sound

  platform:
    type: object
    additionalProperties: false
    properties:
      sound-dai:
        description: The phandle of MT7986 platform.
        maxItems: 1
    required:
      - sound-dai

  codec:
    type: object
    additionalProperties: false
    properties:
      sound-dai:
        description: The phandle of wm8960 codec.
        maxItems: 1
    required:
      - sound-dai

unevaluatedProperties: false

required:
  - compatible
  - audio-routing
  - platform
  - codec

examples:
  - |
    sound {
        compatible = "mediatek,mt7986-wm8960-sound";
        model = "mt7986-wm8960";
        audio-routing =
            "Headphone", "HP_L",
            "Headphone", "HP_R",
            "LINPUT1", "AMIC",
            "RINPUT1", "AMIC";

        platform {
            sound-dai = <&afe>;
        };

        codec {
            sound-dai = <&wm8960>;
        };
    };

...
```

## Documentation/devicetree/bindings/sound/mediatek,mt8173-afe-pcm.yaml
```yaml
# SPDX-License-Identifier: (GPL-2.0-only OR BSD-2-Clause)
%YAML 1.2
---
$id: http://devicetree.org/schemas/sound/mediatek,mt8173-afe-pcm.yaml#
$schema: http://devicetree.org/meta-schemas/core.yaml#

title: Mediatek AFE PCM controller for MT8173

maintainers:
  - Trevor Wu <trevor.wu@mediatek.com>

properties:
  compatible:
    const: mediatek,mt8173-afe-pcm

  reg:
    maxItems: 1

  interrupts:
    maxItems: 1

  clocks:
    items:
      - description: audio infra sys clock
      - description: audio top mux
      - description: audio intbus mux
      - description: apll1 clock
      - description: apll2 clock
      - description: i2s0 mclk mux
      - description: i2s1 mclk mux
      - description: i2s2 mclk mux
      - description: i2s3 mclk mux
      - description: i2s3 bclk mux

  clock-names:
    items:
      - const: infra_sys_audio_clk
      - const: top_pdn_audio
      - const: top_pdn_aud_intbus
      - const: bck0
      - const: bck1
      - const: i2s0_m
      - const: i2s1_m
      - const: i2s2_m
      - const: i2s3_m
      - const: i2s3_b

  power-domains:
    maxItems: 1

  memory-region:
    description: memory region for audio DMA buffers
    maxItems: 1

required:
  - compatible
  - reg
  - interrupts
  - clocks
  - clock-names
  - power-domains

additionalProperties: false

examples:
  - |
    #include <dt-bindings/clock/mt8173-clk.h>
    #include <dt-bindings/interrupt-controller/arm-gic.h>
    #include <dt-bindings/interrupt-controller/irq.h>
    #include <dt-bindings/power/mt8173-power.h>

    mt8173-afe-pcm@11220000 {
        compatible = "mediatek,mt8173-afe-pcm";
        reg = <0x11220000 0x1000>;
        interrupts = <GIC_SPI 134 IRQ_TYPE_EDGE_FALLING>;
        power-domains = <&spm MT8173_POWER_DOMAIN_AUDIO>;
        clocks = <&infracfg CLK_INFRA_AUDIO>,
                 <&topckgen CLK_TOP_AUDIO_SEL>,
                 <&topckgen CLK_TOP_AUD_INTBUS_SEL>,
                 <&topckgen CLK_TOP_APLL1_DIV0>,
                 <&topckgen CLK_TOP_APLL2_DIV0>,
                 <&topckgen CLK_TOP_I2S0_M_SEL>,
                 <&topckgen CLK_TOP_I2S1_M_SEL>,
                 <&topckgen CLK_TOP_I2S2_M_SEL>,
                 <&topckgen CLK_TOP_I2S3_M_SEL>,
                 <&topckgen CLK_TOP_I2S3_B_SEL>;
         clock-names = "infra_sys_audio_clk",
                       "top_pdn_audio",
                       "top_pdn_aud_intbus",
                       "bck0",
                       "bck1",
                       "i2s0_m",
                       "i2s1_m",
                       "i2s2_m",
                       "i2s3_m",
                       "i2s3_b";
          memory-region = <&afe_dma_mem>;
    };
```

## Documentation/devicetree/bindings/sound/mediatek,mt8173-rt5650-rt5514.yaml
```yaml
# SPDX-License-Identifier: (GPL-2.0-only OR BSD-2-Clause)
%YAML 1.2
---
$id: http://devicetree.org/schemas/sound/mediatek,mt8173-rt5650-rt5514.yaml#
$schema: http://devicetree.org/meta-schemas/core.yaml#

title: Mediatek MT8173 with RT5650 and RT5514 audio codecs

maintainers:
  - Koro Chen <koro.chen@mediatek.com>

properties:
  compatible:
    const: mediatek,mt8173-rt5650-rt5514

  mediatek,audio-codec:
    $ref: /schemas/types.yaml#/definitions/phandle-array
    description: Phandles of rt5650 and rt5514 codecs
    items:
      - description: phandle of rt5650 codec
      - description: phandle of rt5514 codec

  mediatek,platform:
    $ref: /schemas/types.yaml#/definitions/phandle
    description: The phandle of MT8173 ASoC platform.

required:
  - compatible
  - mediatek,audio-codec
  - mediatek,platform

additionalProperties: false

examples:
  - |
    sound {
        compatible = "mediatek,mt8173-rt5650-rt5514";
        mediatek,audio-codec = <&rt5650>, <&rt5514>;
        mediatek,platform = <&afe>;
    };
...
```

## Documentation/devicetree/bindings/sound/mediatek,mt8173-rt5650.yaml
```yaml
# SPDX-License-Identifier: (GPL-2.0 OR BSD-2-Clause)
%YAML 1.2
---
$id: http://devicetree.org/schemas/sound/mediatek,mt8173-rt5650.yaml#
$schema: http://devicetree.org/meta-schemas/core.yaml#

title: Mediatek MT8173 with RT5650 codecs and HDMI via I2S

maintainers:
  - Ariel D'Alessandro <ariel.dalessandro@collabora.com>

properties:
  compatible:
    const: mediatek,mt8173-rt5650

  reg:
    maxItems: 1

  interrupts:
    maxItems: 1

  mediatek,audio-codec:
    $ref: /schemas/types.yaml#/definitions/phandle-array
    description:
      The phandles of rt5650 codecs and of the HDMI encoder node.
    minItems: 2

  mediatek,platform:
    $ref: /schemas/types.yaml#/definitions/phandle
    description:
      The phandle of MT8173 ASoC platform.

  mediatek,mclk:
    $ref: /schemas/types.yaml#/definitions/uint32
    description: |
      The MCLK source.
      0: external oscillator, MCLK = 12.288M
      1: internal source from mt8173, MCLK = sampling rate * 256

  codec-capture:
    description: Subnode of rt5650 codec capture.
    type: object

    properties:
      sound-dai:
        maxItems: 1
        description: phandle of the CPU DAI

    additionalProperties: false

required:
  - compatible
  - mediatek,audio-codec
  - mediatek,platform

additionalProperties: false

examples:
  - |
    sound {
        compatible = "mediatek,mt8173-rt5650";
        mediatek,audio-codec = <&rt5650 &hdmi0>;
        mediatek,platform = <&afe>;
        pinctrl-names = "default";
        pinctrl-0 = <&aud_i2s2>;

        mediatek,mclk = <1>;
        codec-capture {
            sound-dai = <&rt5650 1>;
        };
    };

...
```
