## Documentation/devicetree/bindings/sound/mchp,spdifrx.yaml
```yaml
# SPDX-License-Identifier: (GPL-2.0 OR BSD-2-Clause)
%YAML 1.2
---
$id: http://devicetree.org/schemas/sound/mchp,spdifrx.yaml#
$schema: http://devicetree.org/meta-schemas/core.yaml#

title: Microchip S/PDIF Rx Controller Device Tree Bindings

maintainers:
  - Codrin Ciubotariu <codrin.ciubotariu@microchip.com>

description:
  The Microchip Sony/Philips Digital Interface Receiver is a serial port 
  compliant with the IEC-60958 standard.

properties:
  "#sound-dai-cells":
    const: 0

  compatible:
    const: microchip,sama7g5-spdifrx

  reg:
    maxItems: 1

  interrupts:
    maxItems: 1

  clocks:
    items:
      - description: Peripheral Bus Clock
      - description: Generic Clock

  clock-names:
    items:
      - const: pclk
      - const: gclk

  dmas:
    description: RX DMA Channel
    maxItems: 1

  dma-names:
    const: rx

required:
  - "#sound-dai-cells"
  - compatible
  - reg
  - interrupts
  - clocks
  - clock-names
  - dmas
  - dma-names

additionalProperties: false

examples:
  - |
    #include <dt-bindings/clock/at91.h>
    #include <dt-bindings/dma/at91.h>
    #include <dt-bindings/interrupt-controller/arm-gic.h>

    spdifrx: spdifrx@e1614000 {
        #sound-dai-cells = <0>;
        compatible = "microchip,sama7g5-spdifrx";
        reg = <0xe1614000 0x4000>;
        interrupts = <GIC_SPI 84 IRQ_TYPE_LEVEL_HIGH>;
        dmas = <&dma0 AT91_XDMAC_DT_PERID(49)>;
        dma-names = "rx";
        clocks = <&pmc PMC_TYPE_PERIPHERAL 84>, <&pmc PMC_TYPE_GCK 84>;
        clock-names = "pclk", "gclk";
    };
```

## Documentation/devicetree/bindings/sound/mchp,spdiftx.yaml
```yaml
# SPDX-License-Identifier: (GPL-2.0 OR BSD-2-Clause)
%YAML 1.2
---
$id: http://devicetree.org/schemas/sound/mchp,spdiftx.yaml#
$schema: http://devicetree.org/meta-schemas/core.yaml#

title: Microchip S/PDIF Tx Controller Device Tree Bindings

maintainers:
  - Codrin Ciubotariu <codrin.ciubotariu@microchip.com>

description:
        The Microchip Sony/Philips Digital Interface Transmitter is a
        serial port compliant with the IEC-60958 standard.

properties:
  "#sound-dai-cells":
    const: 0

  compatible:
    const: microchip,sama7g5-spdiftx

  reg:
    maxItems: 1

  interrupts:
    maxItems: 1

  clocks:
    items:
      - description: Peripheral Bus Clock
      - description: Generic Clock

  clock-names:
    items:
      - const: pclk
      - const: gclk

  dmas:
    description: TX DMA Channel
    maxItems: 1

  dma-names:
    const: tx

required:
  - "#sound-dai-cells"
  - compatible
  - reg
  - interrupts
  - clocks
  - clock-names
  - dmas
  - dma-names

additionalProperties: false

examples:
  - |
    #include <dt-bindings/clock/at91.h>
    #include <dt-bindings/dma/at91.h>
    #include <dt-bindings/interrupt-controller/arm-gic.h>

    spdiftx@e1618000 {
        #sound-dai-cells = <0>;
        compatible = "microchip,sama7g5-spdiftx";
        reg = <0xe1618000 0x4000>;
        interrupts = <GIC_SPI 85 IRQ_TYPE_LEVEL_HIGH>;
        dmas = <&dma0 AT91_XDMAC_DT_PERID(50)>;
        dma-names = "tx";
        clocks = <&pmc PMC_TYPE_PERIPHERAL 85>, <&pmc PMC_TYPE_GCK 85>;
        clock-names = "pclk", "gclk";
        pinctrl-names = "default";
        pinctrl-0 = <&pinctrl_spdiftx_default>;
    };
```

## Documentation/devicetree/bindings/sound/mchp-i2s-mcc.txt
```
* Microchip I2S Multi-Channel Controller

Required properties:
- compatible:     Should be "microchip,sam9x60-i2smcc".
- reg:            Should be the physical base address of the controller and the
                  length of memory mapped region.
- interrupts:     Should contain the interrupt for the controller.
- dmas:           Should be one per channel name listed in the dma-names property,
                  as described in atmel-dma.txt and dma.txt files.
- dma-names:      Identifier string for each DMA request line in the dmas property.
		  Two dmas have to be defined, "tx" and "rx".
- clocks:         Must contain an entry for each entry in clock-names.
                  Please refer to clock-bindings.txt.
- clock-names:    Should be one of each entry matching the clocks phandles list:
                  - "pclk" (peripheral clock) Required.
                  - "gclk" (generated clock) Optional (1).

Optional properties:
- pinctrl-0:      Should specify pin control groups used for this controller.
- princtrl-names: Should contain only one value - "default".


(1) : Only the peripheral clock is required. The generated clock is optional
      and should be set mostly when Master Mode is required.

Example:

	i2s@f001c000 {
		compatible = "microchip,sam9x60-i2smcc";
		reg = <0xf001c000 0x100>;
		interrupts = <34 IRQ_TYPE_LEVEL_HIGH 7>;
		dmas = <&dma0
			(AT91_XDMAC_DT_MEM_IF(0) | AT91_XDMAC_DT_PER_IF(1) |
			 AT91_XDMAC_DT_PERID(36))>,
		       <&dma0
			(AT91_XDMAC_DT_MEM_IF(0) | AT91_XDMAC_DT_PER_IF(1) |
			 AT91_XDMAC_DT_PERID(37))>;
		dma-names = "tx", "rx";
		clocks = <&i2s_clk>, <&i2s_gclk>;
		clock-names = "pclk", "gclk";
		pinctrl-names = "default";
		pinctrl-0 = <&pinctrl_i2s_default>;
	};
```

## Documentation/devicetree/bindings/sound/mediatek,mt2701-audio.yaml
```yaml
# SPDX-License-Identifier: (GPL-2.0-only OR BSD-2-Clause)
%YAML 1.2
---
$id: http://devicetree.org/schemas/sound/mediatek,mt2701-audio.yaml#
$schema: http://devicetree.org/meta-schemas/core.yaml#

title: MediaTek Audio Front End (AFE) PCM controller for mt2701

description:
  The AFE PCM node must be a subnode of the MediaTek audsys device tree node.

maintainers:
  - Eugen Hristev <eugen.hristev@collabora.com>

properties:
  compatible:
    enum:
      - mediatek,mt2701-audio
      - mediatek,mt7622-audio

  interrupts:
    items:
      - description: AFE interrupt
      - description: ASYS interrupt

  interrupt-names:
    items:
      - const: afe
      - const: asys

  power-domains:
    maxItems: 1

  clocks:
    items:
      - description: audio infra sys clock
      - description: top audio mux 1
      - description: top audio mux 2
      - description: top audio sys a1 clock
      - description: top audio sys a2 clock
      - description: i2s0 source selection
      - description: i2s1 source selection
      - description: i2s2 source selection
      - description: i2s3 source selection
      - description: i2s0 source divider
      - description: i2s1 source divider
      - description: i2s2 source divider
      - description: i2s3 source divider
      - description: i2s0 master clock
      - description: i2s1 master clock
      - description: i2s2 master clock
      - description: i2s3 master clock
      - description: i2so0 hopping clock
      - description: i2so1 hopping clock
      - description: i2so2 hopping clock
      - description: i2so3 hopping clock
      - description: i2si0 hopping clock
      - description: i2si1 hopping clock
      - description: i2si2 hopping clock
      - description: i2si3 hopping clock
      - description: asrc0 output clock
      - description: asrc1 output clock
      - description: asrc2 output clock
      - description: asrc3 output clock
      - description: audio front end pd clock
      - description: audio front end conn pd clock
      - description: top audio a1 sys pd
      - description: top audio a2 sys pd
      - description: audio merge interface pd

  clock-names:
    items:
      - const: infra_sys_audio_clk
      - const: top_audio_mux1_sel
      - const: top_audio_mux2_sel
      - const: top_audio_a1sys_hp
      - const: top_audio_a2sys_hp
      - const: i2s0_src_sel
      - const: i2s1_src_sel
      - const: i2s2_src_sel
      - const: i2s3_src_sel
      - const: i2s0_src_div
      - const: i2s1_src_div
      - const: i2s2_src_div
      - const: i2s3_src_div
      - const: i2s0_mclk_en
      - const: i2s1_mclk_en
      - const: i2s2_mclk_en
      - const: i2s3_mclk_en
      - const: i2so0_hop_ck
      - const: i2so1_hop_ck
      - const: i2so2_hop_ck
      - const: i2so3_hop_ck
      - const: i2si0_hop_ck
      - const: i2si1_hop_ck
      - const: i2si2_hop_ck
      - const: i2si3_hop_ck
      - const: asrc0_out_ck
      - const: asrc1_out_ck
      - const: asrc2_out_ck
      - const: asrc3_out_ck
      - const: audio_afe_pd
      - const: audio_afe_conn_pd
      - const: audio_a1sys_pd
      - const: audio_a2sys_pd
      - const: audio_mrgif_pd

required:
  - compatible
  - interrupts
  - interrupt-names
  - power-domains
  - clocks
  - clock-names

additionalProperties: false
```

## Documentation/devicetree/bindings/sound/mediatek,mt2701-hdmi-audio.yaml
```yaml
# SPDX-License-Identifier: (GPL-2.0-only OR BSD-2-Clause)
%YAML 1.2
---
$id: http://devicetree.org/schemas/sound/mediatek,mt2701-hdmi-audio.yaml#
$schema: http://devicetree.org/meta-schemas/core.yaml#

title: MediaTek MT2701/MT7623N HDMI audio output

maintainers:
  - Daniel Golle <daniel@makrotopia.org>

description:
  Sound card routing the MT2701/MT7623N Audio Front End HDMI
  playback path to the on-chip HDMI transmitter. The AFE
  provides the DMA memif and internal I2S engine; the HDMI
  transmitter acts as the audio codec on the serialised link.

properties:
  compatible:
    oneOf:
      - const: mediatek,mt2701-hdmi-audio
      - items:
          - const: mediatek,mt7623n-hdmi-audio
          - const: mediatek,mt2701-hdmi-audio

  mediatek,platform:
    $ref: /schemas/types.yaml#/definitions/phandle
    description: Phandle of the MT2701/MT7623N AFE platform node.

  mediatek,audio-codec:
    $ref: /schemas/types.yaml#/definitions/phandle
    description: Phandle of the HDMI transmitter acting as audio codec.

required:
  - compatible
  - mediatek,platform
  - mediatek,audio-codec

additionalProperties: false

examples:
  - |
    sound-hdmi {
        compatible = "mediatek,mt7623n-hdmi-audio",
                     "mediatek,mt2701-hdmi-audio";
        mediatek,platform = <&afe>;
        mediatek,audio-codec = <&hdmi0>;
    };
```

## Documentation/devicetree/bindings/sound/mediatek,mt2701-wm8960.yaml
```yaml
# SPDX-License-Identifier: (GPL-2.0-only OR BSD-2-Clause)
%YAML 1.2
---
$id: http://devicetree.org/schemas/sound/mediatek,mt2701-wm8960.yaml#
$schema: http://devicetree.org/meta-schemas/core.yaml#

title: MediaTek MT2701 with WM8960 CODEC

maintainers:
  - Kartik Agarwala <agarwala.kartik@gmail.com>

properties:
  compatible:
    const: mediatek,mt2701-wm8960-machine

  mediatek,platform:
    $ref: /schemas/types.yaml#/definitions/phandle
    description: The phandle of MT2701 ASoC platform.

  audio-routing:
    $ref: /schemas/types.yaml#/definitions/non-unique-string-array
    description:
      A list of the connections between audio components. Each entry is a
      pair of strings, the first being the connection's sink, the second
      being the connection's source.

  mediatek,audio-codec:
    $ref: /schemas/types.yaml#/definitions/phandle
    description: The phandle of the WM8960 audio codec.

unevaluatedProperties: false

required:
  - compatible
  - mediatek,platform
  - audio-routing
  - mediatek,audio-codec
  - pinctrl-names
  - pinctrl-0

examples:
  - |
    sound {
        compatible = "mediatek,mt2701-wm8960-machine";
        mediatek,platform = <&afe>;
        audio-routing =
            "Headphone", "HP_L",
            "Headphone", "HP_R",
            "LINPUT1", "AMIC",
            "RINPUT1", "AMIC";
        mediatek,audio-codec = <&wm8960>;
        pinctrl-names = "default";
        pinctrl-0 = <&aud_pins_default>;
    };
```

## Documentation/devicetree/bindings/sound/mediatek,mt6351-sound.yaml
```yaml
# SPDX-License-Identifier: (GPL-2.0-only OR BSD-2-Clause)
%YAML 1.2
---
$id: http://devicetree.org/schemas/sound/mediatek,mt6351-sound.yaml#
$schema: http://devicetree.org/meta-schemas/core.yaml#

title: MediaTek MT6351 Audio CODEC

maintainers:
  - KaiChieh Chuang <kaichieh.chuang@mediatek.com>

description:
  MT6351 Audio CODEC is a part of the MediaTek MT6351 PMIC.
  It communicates with the SoC through the MediaTek PMIC wrapper(pwrap).

allOf:
  - $ref: dai-common.yaml#

properties:
  compatible:
    const: mediatek,mt6351-sound

  "#sound-dai-cells":
    const: 0

required:
  - compatible
  - "#sound-dai-cells"

unevaluatedProperties: false

examples:
  - |
    sound {
       compatible = "mediatek,mt6351-sound";
       #sound-dai-cells = <0>;
    };
```
