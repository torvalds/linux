## Documentation/devicetree/bindings/sound/mediatek,mt8365-afe.yaml
```yaml
# SPDX-License-Identifier: (GPL-2.0-only OR BSD-2-Clause)
%YAML 1.2
---
$id: http://devicetree.org/schemas/sound/mediatek,mt8365-afe.yaml#
$schema: http://devicetree.org/meta-schemas/core.yaml#

title: MediaTek Audio Front End PCM controller for MT8365

maintainers:
  - Alexandre Mergnat <amergnat@baylibre.com>

properties:
  compatible:
    const: mediatek,mt8365-afe-pcm

  reg:
    maxItems: 1

  "#sound-dai-cells":
    const: 0

  clocks:
    items:
      - description: 26M clock
      - description: mux for audio clock
      - description: audio i2s0 mck
      - description: audio i2s1 mck
      - description: audio i2s2 mck
      - description: audio i2s3 mck
      - description: engen 1 clock
      - description: engen 2 clock
      - description: audio 1 clock
      - description: audio 2 clock
      - description: mux for i2s0
      - description: mux for i2s1
      - description: mux for i2s2
      - description: mux for i2s3

  clock-names:
    items:
      - const: top_clk26m_clk
      - const: top_audio_sel
      - const: audio_i2s0_m
      - const: audio_i2s1_m
      - const: audio_i2s2_m
      - const: audio_i2s3_m
      - const: engen1
      - const: engen2
      - const: aud1
      - const: aud2
      - const: i2s0_m_sel
      - const: i2s1_m_sel
      - const: i2s2_m_sel
      - const: i2s3_m_sel

  interrupts:
    maxItems: 1

  power-domains:
    maxItems: 1

  mediatek,dmic-mode:
    $ref: /schemas/types.yaml#/definitions/uint32
    description:
      Indicates how many data pins are used to transmit two channels of PDM
      signal. 1 means two wires, 0 means one wire. Default value is 0.
    enum:
      - 0 # one wire
      - 1 # two wires

required:
  - compatible
  - reg
  - clocks
  - clock-names
  - interrupts
  - power-domains

additionalProperties: false

examples:
  - |
    #include <dt-bindings/clock/mediatek,mt8365-clk.h>
    #include <dt-bindings/interrupt-controller/arm-gic.h>
    #include <dt-bindings/interrupt-controller/irq.h>
    #include <dt-bindings/power/mediatek,mt8365-power.h>

    soc {
        #address-cells = <2>;
        #size-cells = <2>;

        audio-controller@11220000 {
            compatible = "mediatek,mt8365-afe-pcm";
            reg = <0 0x11220000 0 0x1000>;
            #sound-dai-cells = <0>;
            clocks = <&clk26m>,
                     <&topckgen CLK_TOP_AUDIO_SEL>,
                     <&topckgen CLK_TOP_AUD_I2S0_M>,
                     <&topckgen CLK_TOP_AUD_I2S1_M>,
                     <&topckgen CLK_TOP_AUD_I2S2_M>,
                     <&topckgen CLK_TOP_AUD_I2S3_M>,
                     <&topckgen CLK_TOP_AUD_ENGEN1_SEL>,
                     <&topckgen CLK_TOP_AUD_ENGEN2_SEL>,
                     <&topckgen CLK_TOP_AUD_1_SEL>,
                     <&topckgen CLK_TOP_AUD_2_SEL>,
                     <&topckgen CLK_TOP_APLL_I2S0_SEL>,
                     <&topckgen CLK_TOP_APLL_I2S1_SEL>,
                     <&topckgen CLK_TOP_APLL_I2S2_SEL>,
                     <&topckgen CLK_TOP_APLL_I2S3_SEL>;
            clock-names = "top_clk26m_clk",
                          "top_audio_sel",
                          "audio_i2s0_m",
                          "audio_i2s1_m",
                          "audio_i2s2_m",
                          "audio_i2s3_m",
                          "engen1",
                          "engen2",
                          "aud1",
                          "aud2",
                          "i2s0_m_sel",
                          "i2s1_m_sel",
                          "i2s2_m_sel",
                          "i2s3_m_sel";
            interrupts = <GIC_SPI 97 IRQ_TYPE_LEVEL_LOW>;
            power-domains = <&spm MT8365_POWER_DOMAIN_AUDIO>;
            mediatek,dmic-mode = <1>;
        };
    };

...
```

## Documentation/devicetree/bindings/sound/mediatek,mt8365-mt6357.yaml
```yaml
# SPDX-License-Identifier: (GPL-2.0-only OR BSD-2-Clause)
%YAML 1.2
---
$id: http://devicetree.org/schemas/sound/mediatek,mt8365-mt6357.yaml#
$schema: http://devicetree.org/meta-schemas/core.yaml#

title: MediaTek MT8365 ASoC sound card

maintainers:
  - Alexandre Mergnat <amergnat@baylibre.com>

properties:
  compatible:
    const: mediatek,mt8365-mt6357

  pinctrl-names:
    minItems: 1
    items:
      - const: default
      - const: dmic
      - const: miso_off
      - const: miso_on
      - const: mosi_off
      - const: mosi_on

  mediatek,platform:
    $ref: /schemas/types.yaml#/definitions/phandle
    description: The phandle of MT8365 ASoC platform.

patternProperties:
  "^dai-link-[0-9]+$":
    type: object
    description:
      Container for dai-link level properties and CODEC sub-nodes.

    properties:
      codec:
        type: object
        description: Holds subnode which indicates codec dai.

        properties:
          sound-dai:
            maxItems: 1
            description: phandle of the codec DAI

        additionalProperties: false

      link-name:
        description: Indicates dai-link name and PCM stream name
        enum:
          - I2S_IN_BE
          - I2S_OUT_BE
          - PCM1_BE
          - PDM1_BE
          - PDM2_BE
          - PDM3_BE
          - PDM4_BE
          - SPDIF_IN_BE
          - SPDIF_OUT_BE
          - TDM_IN_BE
          - TDM_OUT_BE

      sound-dai:
        maxItems: 1
        description: phandle of the CPU DAI

    required:
      - link-name
      - sound-dai

    additionalProperties: false

required:
  - compatible
  - pinctrl-names
  - mediatek,platform

additionalProperties: false

examples:
  - |
    sound {
        compatible = "mediatek,mt8365-mt6357";
        pinctrl-names = "default",
                        "dmic",
                        "miso_off",
                        "miso_on",
                        "mosi_off",
                        "mosi_on";
        pinctrl-0 = <&aud_default_pins>;
        pinctrl-1 = <&aud_dmic_pins>;
        pinctrl-2 = <&aud_miso_off_pins>;
        pinctrl-3 = <&aud_miso_on_pins>;
        pinctrl-4 = <&aud_mosi_off_pins>;
        pinctrl-5 = <&aud_mosi_on_pins>;
        mediatek,platform = <&afe>;

        /* hdmi interface */
        dai-link-0 {
            link-name = "I2S_OUT_BE";
            sound-dai = <&afe>;

            codec {
                sound-dai = <&it66121hdmitx>;
            };
        };
    };
```

## Documentation/devicetree/bindings/sound/mediatek,mtk-btcvsd-snd.yaml
```yaml
# SPDX-License-Identifier: (GPL-2.0-only OR BSD-2-Clause)
%YAML 1.2
---
$id: http://devicetree.org/schemas/sound/mediatek,mtk-btcvsd-snd.yaml#
$schema: http://devicetree.org/meta-schemas/core.yaml#

title: Mediatek ALSA BT SCO CVSD/MSBC

maintainers:
  - Luca Leonardo Scorcia <l.scorcia@gmail.com>

properties:
  compatible:
    const: mediatek,mtk-btcvsd-snd

  reg:
    items:
      - description: PKV region
      - description: SRAM_BANK2 region

  interrupts:
    items:
      - description: BT-SCO interrupt

  mediatek,infracfg:
    $ref: /schemas/types.yaml#/definitions/phandle
    description: The phandle of the infracfg controller

  mediatek,offset:
    $ref: /schemas/types.yaml#/definitions/uint32-array
    description: Array of register offsets and masks
    items:
      - description: infra_misc_offset
      - description: infra_conn_bt_cvsd_mask
      - description: cvsd_mcu_read_offset
      - description: cvsd_mcu_write_offset
      - description: cvsd_packet_indicator_offset

required:
  - compatible
  - reg
  - interrupts
  - mediatek,infracfg
  - mediatek,offset

additionalProperties: false

examples:
  - |
    #include <dt-bindings/interrupt-controller/arm-gic.h>

    mtk-btcvsd-snd@18000000 {
      compatible = "mediatek,mtk-btcvsd-snd";
      reg = <0x18000000 0x1000>,
            <0x18080000 0x8000>;
      interrupts = <GIC_SPI 286 IRQ_TYPE_LEVEL_LOW>;
      mediatek,infracfg = <&infrasys>;
      mediatek,offset = <0xf00 0x800 0xfd0 0xfd4 0xfd8>;
    };
```

## Documentation/devicetree/bindings/sound/microchip,pdmc.yaml
```yaml
# SPDX-License-Identifier: (GPL-2.0 OR BSD-2-Clause)
%YAML 1.2
---
$id: http://devicetree.org/schemas/sound/microchip,pdmc.yaml#
$schema: http://devicetree.org/meta-schemas/core.yaml#

title: Microchip Pulse Density Microphone Controller

maintainers:
  - Codrin Ciubotariu <codrin.ciubotariu@microchip.com>

description:
  The Microchip Pulse Density Microphone Controller (PDMC) interfaces up to 4
  digital microphones having Pulse Density Modulated (PDM) outputs.

properties:
  compatible:
    const: microchip,sama7g5-pdmc

  reg:
    maxItems: 1

  "#sound-dai-cells":
    const: 0

  interrupts:
    maxItems: 1

  clocks:
    items:
      - description: Peripheral Bus Clock
      - description: Generic Clock

  clock-names:
    items:
      - const: pclk
      - const: gclk

  dmas:
    description: RX DMA Channel
    maxItems: 1

  dma-names:
    const: rx

  microchip,mic-pos:
    description: |
      Position of PDM microphones on the DS line and the sampling edge (rising
      or falling) of the CLK line. A microphone is represented as a pair of DS
      line and the sampling edge. The first microphone is mapped to channel 0,
      the second to channel 1, etc.
    $ref: /schemas/types.yaml#/definitions/uint32-matrix
    items:
      items:
        - description: value for DS line
        - description: value for sampling edge
      anyOf:
        - enum:
            - [0, 0]
            - [0, 1]
            - [1, 0]
            - [1, 1]
    minItems: 1
    maxItems: 4
    uniqueItems: true

required:
  - compatible
  - reg
  - "#sound-dai-cells"
  - interrupts
  - clocks
  - clock-names
  - dmas
  - dma-names
  - microchip,mic-pos

additionalProperties: false

examples:
  - |
    #include <dt-bindings/clock/at91.h>
    #include <dt-bindings/dma/at91.h>
    #include <dt-bindings/interrupt-controller/arm-gic.h>
    #include <dt-bindings/sound/microchip,pdmc.h>

    pdmc: sound@e1608000 {
        compatible = "microchip,sama7g5-pdmc";
        reg = <0xe1608000 0x4000>;
        #sound-dai-cells = <0>;
        interrupts = <GIC_SPI 68 IRQ_TYPE_LEVEL_HIGH>;
        dmas = <&dma0 AT91_XDMAC_DT_PERID(37)>;
        dma-names = "rx";
        clocks = <&pmc PMC_TYPE_PERIPHERAL 68>, <&pmc PMC_TYPE_GCK 68>;
        clock-names = "pclk", "gclk";
        microchip,mic-pos = <MCHP_PDMC_DS0 MCHP_PDMC_CLK_POSITIVE>,
                            <MCHP_PDMC_DS0 MCHP_PDMC_CLK_NEGATIVE>,
                            <MCHP_PDMC_DS1 MCHP_PDMC_CLK_POSITIVE>,
                            <MCHP_PDMC_DS1 MCHP_PDMC_CLK_NEGATIVE>;
    };
```
