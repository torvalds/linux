## Documentation/devicetree/bindings/sound/cdns,xtfpga-i2s.yaml
```yaml
# SPDX-License-Identifier: (GPL-2.0-only OR BSD-2-Clause)
%YAML 1.2
---
$id: http://devicetree.org/schemas/sound/cdns,xtfpga-i2s.yaml#
$schema: http://devicetree.org/meta-schemas/core.yaml#

title: I2S controller built into xtfpga Xtensa bitstreams

maintainers:
  - Max Filippov <jcmvbkbc@gmail.com>

allOf:
  - $ref: dai-common.yaml#

properties:
  compatible:
    const: cdns,xtfpga-i2s

  reg:
    maxItems: 1

  interrupts:
    maxItems: 1

  clocks:
    maxItems: 1
    description: phandle to the clk used as master clock. I2S bus clock is derived from it.

  "#sound-dai-cells":
    const: 0

required:
  - compatible
  - reg
  - interrupts
  - clocks

unevaluatedProperties: false

examples:
  - |
    i2s@d080000 {
        compatible = "cdns,xtfpga-i2s";
        reg = <0x0d080000 0x40>;
        interrupts = <2 1>;
        clocks = <&cdce706 4>;
        #sound-dai-cells = <0>;
    };
```

## Documentation/devicetree/bindings/sound/cirrus,cs35l36.yaml
```yaml
# SPDX-License-Identifier: GPL-2.0-only
%YAML 1.2
---
$id: http://devicetree.org/schemas/sound/cirrus,cs35l36.yaml#
$schema: http://devicetree.org/meta-schemas/core.yaml#

title: Cirrus Logic CS35L36 Speaker Amplifier

maintainers:
  - David Rhodes <drhodes@opensource.cirrus.com>
  - patches@opensource.cirrus.com

description:
  CS35L36 is a boosted mono Class D amplifier

allOf:
  - $ref: dai-common.yaml#

properties:
  compatible:
    enum:
      - cirrus,cs35l36

  reg:
    maxItems: 1

  interrupts:
    maxItems: 1

  VA-supply:
    description: Voltage regulator of analog internal section

  VP-supply:
    description: Voltage regulator of boost converter

  reset-gpios:
    maxItems: 1

  cirrus,boost-ctl-millivolt:
    description: Boost converter output voltage (step 50)
    $ref: /schemas/types.yaml#/definitions/uint32
    minimum: 2550
    maximum: 12000

  cirrus,boost-peak-milliamp:
    description: Boost-converter peak current limit (step 50)
    $ref: /schemas/types.yaml#/definitions/uint32
    default: 4500
    minimum: 1600
    maximum: 4500

  cirrus,boost-ind-nanohenry:
    description: Initial inductor estimation reference value (1000=1μH, 1200=1.2μH)
    $ref: /schemas/types.yaml#/definitions/uint32
    default: 1000

  cirrus,multi-amp-mode:
    description: Hi-Z ASP port when more than one amplifier in system
    type: boolean

  cirrus,boost-ctl-select:
    description: Boost converter control source selection
    $ref: /schemas/types.yaml#/definitions/uint32
    default: 1
    enum:
      - 0 # Control Port
      - 1 # Class
      - 2 # Sync

  cirrus,amp-pcm-inv:
    description: Invert incoming PCM data when true
    type: boolean

  cirrus,imon-pol-inv:
    description: Invert polarity of outbound IMON feedback when true
    type: boolean

  cirrus,vmon-pol-inv:
    description: Invert polarity of outbound VMON feedback when true
    type: boolean

  cirrus,dcm-mode-enable:
    description: Enable boost converter automatic Discontinuous Conduction Mode
    type: boolean

  cirrus,weak-fet-disable:
    description: Reduce output driver strength in Weak-FET Drive Mode when true
    type: boolean

  cirrus,classh-wk-fet-delay-ms:
    description: Weak-FET entry delay
    default: 100
    enum: [0, 5, 10, 50, 100, 200, 500, 1000]

  cirrus,classh-weak-fet-thld-millivolt:
    description: Weak-FET drive threshold
    $ref: /schemas/types.yaml#/definitions/uint32
    enum: [50, 100, 150, 200, 250, 300, 350, 400, 450, 500, 550, 600, 650, 700]

  cirrus,temp-warn-threshold:
    description: Overtemperature warning threshold
    $ref: /schemas/types.yaml#/definitions/uint32
    default: 2
    enum:
      - 0 # 105°C
      - 1 # 115°C
      - 2 # 125°C
      - 3 # 135°C

  cirrus,irq-drive-select:
    description: Interrupt output driver type
    $ref: /schemas/types.yaml#/definitions/uint32
    default: 1
    enum:
      - 0 # open-drain
      - 1 # push-pull

  cirrus,irq-gpio-select:
    description: Programmable IRQ pin selection
    $ref: /schemas/types.yaml#/definitions/uint32
    enum:
      - 0 # PDM_DATA/SWIRE_SD/INT
      - 1 # GPIO

  cirrus,vpbr-config:
    $ref: "#/$defs/vpbr-config"

$defs:
  vpbr-config:
    description: Brownout prevention configuration sub-node
    type: object
    additionalProperties: false

    properties:
      cirrus,vpbr-en:
        description: VBST brownout prevention enable
        $ref: /schemas/types.yaml#/definitions/uint32
        default: 0
        enum:
          - 0 # disabled
          - 1 # enabled

      cirrus,vpbr-thld:
        description: Initial VPBR threshold voltage
        $ref: /schemas/types.yaml#/definitions/uint32
        minimum: 2
        maximum: 31

      cirrus,vpbr-atk-rate:
        description: Attenuation attack step rate
        $ref: /schemas/types.yaml#/definitions/uint32
        minimum: 0
        maximum: 7

      cirrus,vpbr-atk-vol:
        description: VP brownout prevention step size
        $ref: /schemas/types.yaml#/definitions/uint32
        minimum: 0
        maximum: 7

      cirrus,vpbr-max-attn:
        description: Maximum attenuation during VP brownout prevention (dB)
        $ref: /schemas/types.yaml#/definitions/uint32
        minimum: 0
        maximum: 15

      cirrus,vpbr-wait:
        description: Delay between brownout clearance and attenuation release (ms)
        $ref: /schemas/types.yaml#/definitions/uint32
        default: 1
        enum:
          - 0 # 10
          - 1 # 100
          - 2 # 250
          - 3 # 500

      cirrus,vpbr-rel-rate:
        description: Attenuation release step rate
        $ref: /schemas/types.yaml#/definitions/uint32
        minimum: 0
        maximum: 7

      cirrus,vpbr-mute-en:
        description: Mute audio if maximum attenuation reached
        $ref: /schemas/types.yaml#/definitions/uint32
        minimum: 0
        maximum: 1

required:
  - compatible
  - reg
  - interrupts
  - VA-supply
  - cirrus,boost-ctl-millivolt
  - cirrus,boost-peak-milliamp

unevaluatedProperties: false

examples:
  - |
    #include <dt-bindings/gpio/gpio.h>
    #include <dt-bindings/interrupt-controller/irq.h>

    i2c {
        #address-cells = <1>;
        #size-cells = <0>;

        codec@40 {
            compatible = "cirrus,cs35l36";
            reg = <0x40>;
            VA-supply = <&dummy_vreg>;
            VP-supply = <&dummy_vreg>;
            reset-gpios = <&gpio0 54 GPIO_ACTIVE_HIGH>;
            interrupts = <3 IRQ_TYPE_LEVEL_LOW>;

            cirrus,boost-ind-nanohenry = <1000>;
            cirrus,boost-ctl-millivolt = <10000>;
            cirrus,boost-peak-milliamp = <4500>;
            cirrus,boost-ctl-select = <0>;
            cirrus,classh-wk-fet-delay-ms = <100>;
            cirrus,classh-weak-fet-thld-millivolt = <100>;
            cirrus,temp-warn-threshold = <1>;
            cirrus,multi-amp-mode;
            cirrus,irq-drive-select = <1>;
            cirrus,irq-gpio-select = <1>;

            cirrus,vpbr-config {
                cirrus,vpbr-en = <0>;
                cirrus,vpbr-thld = <5>;
                cirrus,vpbr-atk-rate = <2>;
                cirrus,vpbr-atk-vol = <1>;
                cirrus,vpbr-max-attn = <9>;
                cirrus,vpbr-wait = <1>;
                cirrus,vpbr-rel-rate = <5>;
                cirrus,vpbr-mute-en = <0>;
            };
        };
    };

...
```

## Documentation/devicetree/bindings/sound/cirrus,cs35l41.yaml
```yaml
# SPDX-License-Identifier: GPL-2.0-only OR BSD-2-Clause
%YAML 1.2
---
$id: http://devicetree.org/schemas/sound/cirrus,cs35l41.yaml#
$schema: http://devicetree.org/meta-schemas/core.yaml#

title: Cirrus Logic CS35L41 Speaker Amplifier

maintainers:
  - david.rhodes@cirrus.com

description: |
  CS35L41 is a boosted mono Class D amplifier with DSP
  speaker protection and equalization

properties:
  compatible:
    enum:
      - cirrus,cs35l40
      - cirrus,cs35l41

  reg:
    maxItems: 1

  interrupts:
    maxItems: 1

  '#sound-dai-cells':
    description:
      The first cell indicating the audio interface.
    const: 1

  reset-gpios:
    maxItems: 1

  VA-supply:
    description: voltage regulator phandle for the VA supply

  VP-supply:
    description: voltage regulator phandle for the VP supply

  cirrus,boost-peak-milliamp:
    description:
      Boost-converter peak current limit in mA.
      Configures the peak current by monitoring the current through the boost FET.
      Range starts at 1600 mA and goes to a maximum of 4500 mA with increments
      of 50 mA. See section 4.3.6 of the datasheet for details.
    $ref: /schemas/types.yaml#/definitions/uint32
    minimum: 1600
    maximum: 4500
    default: 4500

  cirrus,boost-ind-nanohenry:
    description:
      Boost inductor value, expressed in nH. Valid
      values include 1000, 1200, 1500 and 2200.
    $ref: /schemas/types.yaml#/definitions/uint32
    minimum: 1000
    maximum: 2200

  cirrus,boost-cap-microfarad:
    description:
      Total equivalent boost capacitance on the VBST
      and VAMP pins, derated at 11 volts DC. The value must be rounded to the
      nearest integer and expressed in uF.
    $ref: /schemas/types.yaml#/definitions/uint32

  cirrus,asp-sdout-hiz:
    description:
      Audio serial port SDOUT Hi-Z control. Sets the Hi-Z
      configuration for SDOUT pin of amplifier.
      0 = Logic 0 during unused slots, and while all transmit channels disabled
      1 = Hi-Z during unused slots but logic 0 while all transmit channels disabled
      2 = (Default) Logic 0 during unused slots, but Hi-Z while all transmit channels disabled
      3 = Hi-Z during unused slots and while all transmit channels disabled
    $ref: /schemas/types.yaml#/definitions/uint32
    minimum: 0
    maximum: 3
    default: 2

  cirrus,boost-type:
    description:
      Configures the type of Boost being used.
      Internal boost requires boost-peak-milliamp, boost-ind-nanohenry and
      boost-cap-microfarad.
      External Boost must have GPIO1 as GPIO output. GPIO1 will be set high to
      enable boost voltage.
      Shared boost allows two amplifiers to share a single boost circuit by
      communicating on the MDSYNC bus. The active amplifier controls the boost
      circuit using combined data from both amplifiers. GPIO1 should be
      configured for Sync when shared boost is used. Shared boost is not
      compatible with External boost. Active amplifier requires
      boost-peak-milliamp, boost-ind-nanohenry and boost-cap-microfarad.
      0 = Internal Boost
      1 = External Boost
      2 = Shared Boost Active
      3 = Shared Boost Passive
    $ref: /schemas/types.yaml#/definitions/uint32
    minimum: 0
    maximum: 3

  cirrus,gpio1-polarity-invert:
    description:
      Boolean which specifies whether the GPIO1
      level is inverted. If this property is not present the level is not inverted.
    type: boolean

  cirrus,gpio1-output-enable:
    description:
      Boolean which specifies whether the GPIO1 pin
      is configured as an output. If this property is not present the
      pin will be configured as an input.
    type: boolean

  cirrus,gpio1-src-select:
    description:
      Configures the function of the GPIO1 pin.
      Note that the options are different from the GPIO2 pin
      0 = High Impedance (Default)
      1 = GPIO
      2 = Sync
      3 = MCLK input
    $ref: /schemas/types.yaml#/definitions/uint32
    minimum: 0
    maximum: 3

  cirrus,gpio2-polarity-invert:
    description:
      Boolean which specifies whether the GPIO2
      level is inverted. If this property is not present the level is not inverted.
    type: boolean

  cirrus,gpio2-output-enable:
    description:
      Boolean which specifies whether the GPIO2 pin
      is configured as an output. If this property is not present the
      pin will be configured as an input.
    type: boolean

  cirrus,gpio2-src-select:
    description:
      Configures the function of the GPIO2 pin.
      Note that the options are different from the GPIO1 pin.
      0 = High Impedance (Default)
      1 = GPIO
      2 = Open Drain INTB
      3 = MCLK input
      4 = Push-pull INTB (active low)
      5 = Push-pull INT (active high)
    $ref: /schemas/types.yaml#/definitions/uint32
    minimum: 0
    maximum: 5

required:
  - compatible
  - reg
  - "#sound-dai-cells"

allOf:
  - $ref: dai-common.yaml#
  - if:
      properties:
        cirrus,boost-type:
          const: 0
    then:
      required:
        - cirrus,boost-peak-milliamp
        - cirrus,boost-ind-nanohenry
        - cirrus,boost-cap-microfarad
    else:
      if:
        properties:
          cirrus,boost-type:
            const: 1
      then:
        required:
          - cirrus,gpio1-output-enable
          - cirrus,gpio1-src-select
        properties:
          cirrus,boost-peak-milliamp: false
          cirrus,boost-ind-nanohenry: false
          cirrus,boost-cap-microfarad: false
          cirrus,gpio1-src-select:
            enum: [1]

unevaluatedProperties: false

examples:
  - |
    #include <dt-bindings/gpio/gpio.h>

    spi {
        #address-cells = <1>;
        #size-cells = <0>;

        cs35l41: speaker-amp@2 {
            #sound-dai-cells = <1>;
            compatible = "cirrus,cs35l41";
            reg = <2>;
            VA-supply = <&dummy_vreg>;
            VP-supply = <&dummy_vreg>;
            reset-gpios = <&gpio 110 GPIO_ACTIVE_HIGH>;

            cirrus,boost-type = <0>;
            cirrus,boost-peak-milliamp = <4500>;
            cirrus,boost-ind-nanohenry = <1000>;
            cirrus,boost-cap-microfarad = <15>;
        };
    };
```

## Documentation/devicetree/bindings/sound/cirrus,cs4234.yaml
```yaml
# SPDX-License-Identifier: (GPL-2.0+ OR BSD-2-Clause)
%YAML 1.2
---
$id: http://devicetree.org/schemas/sound/cirrus,cs4234.yaml#
$schema: http://devicetree.org/meta-schemas/core.yaml#

title: Cirrus Logic cs4234 audio CODEC

maintainers:
  - patches@opensource.cirrus.com

description:
  The CS4234 is a highly versatile CODEC that combines 4 channels of
  high performance analog to digital conversion, 4 channels of high
  performance digital to analog conversion for audio, and 1 channel of
  digital to analog conversion to provide a nondelayed audio reference
  signal to an external Class H tracking power supply. If not used to
  drive a tracking power supply, the 5th DAC can instead be used as a
  standard audio grade DAC, with performance specifications identical
  to that of the 4 DACs in the audio path. Additionally, the CS4234
  includes tunable group delay for each of the 4 audio DAC paths to
  provide lead time for the external switch-mode power supply, and a
  nondelayed path into the DAC outputs for input signals requiring a
  low-latency path to the outputs.

properties:
  compatible:
    enum:
      - cirrus,cs4234

  reg:
    description:
      The 7-bit I2C address depends on the state of the ADx pins, in
      binary given by [0 0 1 0 AD2 AD1 AD0 0].
    items:
      minimum: 0x10
      maximum: 0x17

  VA-supply:
    description:
      Analogue power supply.

  VL-supply:
    description:
      Interface power supply.

  reset-gpios:
    maxItems: 1

required:
  - compatible
  - reg
  - VA-supply
  - VL-supply

additionalProperties: false

examples:
  - |
    i2c@e0004000 {
        #address-cells = <1>;
        #size-cells = <0>;
        reg = <0xe0004000 0x1000>;

        cs4234: codec@11 {
            compatible = "cirrus,cs4234";
            reg = <0x11>;

            VA-supply = <&vdd3v3>;
            VL-supply = <&vdd3v3>;

            reset-gpios = <&gpio 0>;
        };
    };
```
