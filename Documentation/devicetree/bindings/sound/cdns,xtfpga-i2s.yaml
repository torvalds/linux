## Documentation/devicetree/bindings/sound/cirrus,cs48l32.yaml
```yaml
# SPDX-License-Identifier: GPL-2.0-only OR BSD-2-Clause
%YAML 1.2
---
$id: http://devicetree.org/schemas/sound/cirrus,cs48l32.yaml#
$schema: http://devicetree.org/meta-schemas/core.yaml#

title: Cirrus Logic CS48L32 audio DSP.

maintainers:
  - patches@opensource.cirrus.com

description: |
  The CS48L32 is a high-performance low-power audio DSP for smartphones and
  other portable audio devices. The CS48L32 combines a programmable Halo Core
  DSP with a variety of power-efficient fixed-function audio processors.

  See also the binding headers:

    include/dt-bindings/sound/cs48l32.yaml

allOf:
  - $ref: /schemas/spi/spi-peripheral-props.yaml#
  - $ref: dai-common.yaml#

properties:
  compatible:
    enum:
      - cirrus,cs48l32

  reg:
    description: SPI chip-select number.
    maxItems: 1

  spi-max-frequency:
    maximum: 25000000

  vdd-a-supply:
    description: Regulator supplying VDD_A

  vdd-d-supply:
    description: Regulator supplying VDD_D

  vdd-io-supply:
    description: Regulator supplying VDD_IO

  vdd-cp-supply:
    description: Regulator supplying VDD_CP

  reset-gpios:
    description:
      One entry specifying the GPIO controlling /RESET. Although optional,
      it is strongly recommended to use a hardware reset.
    maxItems: 1

  interrupts:
    maxItems: 1

  clocks:
    items:
      - description: The clock supplied on MCLK1

  clock-names:
    const: mclk1

  '#sound-dai-cells':
    const: 1

  cirrus,in-type:
    description: |
      A list of input type settings for each ADC input.
      Inputs are one of these types:
        CS48L32_IN_TYPE_DIFF : analog differential (default)
        CS48L32_IN_TYPE_SE :   analog single-ended

      The type of the left (L) and right (R) channel on each input is
      independently configured, as are the two groups of pins muxable to
      the input (referred to in the datasheet as "1" and "2").

    $ref: /schemas/types.yaml#/definitions/uint32-array
    items:
      - description:
          IN1L_1 analog input type. One of the CS48L32_IN_TYPE_xxx.
        minimum: 0
        maximum: 1
        default: 0
      - description:
          IN1R_1 analog input type. One of the CS48L32_IN_TYPE_xxx.
        minimum: 0
        maximum: 1
        default: 0
      - description:
          IN1L_2 analog input type. One of the CS48L32_IN_TYPE_xxx.
        minimum: 0
        maximum: 1
        default: 0
      - description:
          IN1R_2 analog input type. One of the CS48L32_IN_TYPE_xxx.
        minimum: 0
        maximum: 1
        default: 0

  cirrus,pdm-sup:
    description: |
      Indicate which MICBIAS output supplies bias to the microphone.
      There is one cell per input (IN1, IN2, ...).

      One of the CS48L32_MICBIAS_xxx values.
        CS48L32_PDM_SUP_VOUT_MIC : mic biased from VOUT_MIC
        CS48L32_PDM_SUP_MICBIAS1 : mic biased from MICBIAS1

      Also see the INn_PDM_SUP field in the datasheet.
    $ref: /schemas/types.yaml#/definitions/uint32-array
    items:
      - description: IN1 PDM supply source
        minimum: 0
        maximum: 1
        default: 0
      - description: IN2 PDM supply source
        minimum: 0
        maximum: 1
        default: 0

required:
  - compatible
  - reg
  - vdd-a-supply
  - vdd-d-supply
  - vdd-io-supply
  - vdd-cp-supply

additionalProperties: false

examples:
  - |
    #include <dt-bindings/sound/cs48l32.h>

    spi@e0006000 {
        #address-cells = <1>;
        #size-cells = <0>;
        reg = <0xe0006000 0x1000>;

        codec@1 {
            compatible = "cirrus,cs48l32";

            reg = <0x1>;
            spi-max-frequency = <2500000>;

            vdd-a-supply = <&regulator_1v8>;
            vdd-d-supply = <&regulator_1v2>;
            vdd-io-supply = <&regulator_1v8>;
            vdd-cp-supply = <&regulator_1v8>;

            reset-gpios = <&gpio 0 0>;

            clocks = <&clks 0>;
            clock-names = "mclk1";

            interrupt-parent = <&gpio0>;
            interrupts = <56 8>;

            #sound-dai-cells = <1>;

            cirrus,in-type = <
                CS48L32_IN_TYPE_DIFF CS48L32_IN_TYPE_DIFF
                CS48L32_IN_TYPE_SE   CS48L32_IN_TYPE_SE
            >;

            cirrus,pdm-sup = <
              CS48L32_PDM_SUP_MICBIAS1 CS48L32_PDM_SUP_MICBIAS1
            >;
        };
    };

#
# Minimal config
#
  - |
    #include <dt-bindings/sound/cs48l32.h>

    spi@e0006000 {
        #address-cells = <1>;
        #size-cells = <0>;
        reg = <0xe0006000 0x1000>;

        codec@1 {
            compatible = "cirrus,cs48l32";

            reg = <0x1>;

            vdd-a-supply = <&regulator_1v8>;
            vdd-d-supply = <&regulator_1v2>;
            vdd-io-supply = <&regulator_1v8>;
            vdd-cp-supply = <&regulator_1v8>;
        };
    };
```

## Documentation/devicetree/bindings/sound/cirrus,cs530x.yaml
```yaml
# SPDX-License-Identifier: GPL-2.0-only OR BSD-2-Clause
%YAML 1.2
---
$id: http://devicetree.org/schemas/sound/cirrus,cs530x.yaml#
$schema: http://devicetree.org/meta-schemas/core.yaml#

title: Cirrus Logic cs530x family of audio ADCs

maintainers:
  - Paul Handrigan <paulha@opensource.cirrus.com>
  - patches@opensource.cirrus.com

description:
  The CS530X devices are a family of high performance audio ADCs.

allOf:
  - $ref: dai-common.yaml#

properties:
  compatible:
    enum:
      - cirrus,cs5302
      - cirrus,cs5304
      - cirrus,cs5308

  reg:
    maxItems: 1

  '#sound-dai-cells':
    const: 1

  reset-gpios:
    maxItems: 1

  vdd-a-supply:
    description: Analog power supply

  vdd-io-supply:
    description: Digital IO power supply

  cirrus,in-hiz-pin12:
    description:
      Sets input channels one and two to high impedance.
    type: boolean

  cirrus,in-hiz-pin34:
    description:
      Sets input channels three and four to high impedance.
    type: boolean

  cirrus,in-hiz-pin56:
    description:
      Sets input channels five and six to high impedance.
    type: boolean

  cirrus,in-hiz-pin78:
    description:
      Sets input channels seven and eight to high impedance.
    type: boolean

required:
  - compatible
  - reg
  - "#sound-dai-cells"

unevaluatedProperties: false

examples:
  - |
    #include <dt-bindings/gpio/gpio.h>

    i2c {
        #address-cells = <1>;
        #size-cells = <0>;

        cs5304: adc@48 {
            compatible = "cirrus,cs5304";
            reg = <0x48>;
            #sound-dai-cells = <1>;
            reset-gpios = <&gpio 110 GPIO_ACTIVE_LOW>;
            vdd-a-supply = <&vreg>;
            vdd-io-supply = <&vreg>;
            cirrus,in-hiz-pin34;
        };
    };
```

## Documentation/devicetree/bindings/sound/cirrus,ep9301-i2s.yaml
```yaml
# SPDX-License-Identifier: (GPL-2.0-only OR BSD-2-Clause)
%YAML 1.2
---
$id: http://devicetree.org/schemas/sound/cirrus,ep9301-i2s.yaml#
$schema: http://devicetree.org/meta-schemas/core.yaml#

title: Cirrus EP93xx I2S Controller

description: |
  The I2S controller is used to stream serial audio data between the external
  I2S CODECs’, ADCs/DACs, and the ARM Core. The controller supports I2S, Left-
  and Right-Justified DSP formats.

maintainers:
  - Alexander Sverdlin <alexander.sverdlin@gmail.com>

allOf:
  - $ref: dai-common.yaml#

properties:
  compatible:
    const: cirrus,ep9301-i2s

  '#sound-dai-cells':
    const: 0

  reg:
    maxItems: 1

  interrupts:
    maxItems: 1

  clocks:
    minItems: 3
    maxItems: 3

  clock-names:
    items:
      - const: mclk
      - const: sclk
      - const: lrclk

  dmas:
    items:
      - description: out DMA channel
      - description: in DMA channel

  dma-names:
    items:
      - const: tx
      - const: rx

  port:
    $ref: audio-graph-port.yaml#
    unevaluatedProperties: false

required:
  - compatible
  - '#sound-dai-cells'
  - reg
  - clocks
  - clock-names

additionalProperties: false

examples:
  - |
    i2s: i2s@80820000 {
        compatible = "cirrus,ep9301-i2s";
        #sound-dai-cells = <0>;
        reg = <0x80820000 0x100>;
        interrupt-parent = <&vic1>;
        interrupts = <28>;
        clocks = <&syscon 29>,
                 <&syscon 30>,
                 <&syscon 31>;
        clock-names = "mclk", "sclk", "lrclk";
        dmas = <&dma0 0 1>, <&dma0 0 2>;
        dma-names = "tx", "rx";
    };

...
```

## Documentation/devicetree/bindings/sound/cirrus,lochnagar.yaml
```yaml
# SPDX-License-Identifier: GPL-2.0-only OR BSD-2-Clause
%YAML 1.2
---
$id: http://devicetree.org/schemas/sound/cirrus,lochnagar.yaml#
$schema: http://devicetree.org/meta-schemas/core.yaml#

title: Cirrus Logic Lochnagar Audio Development Board

maintainers:
  - patches@opensource.cirrus.com

description: |
  Lochnagar is an evaluation and development board for Cirrus Logic
  Smart CODEC and Amp devices. It allows the connection of most Cirrus
  Logic devices on mini-cards, as well as allowing connection of various
  application processor systems to provide a full evaluation platform.
  Audio system topology, clocking and power can all be controlled through
  the Lochnagar, allowing the device under test to be used in a variety of
  possible use cases.

  This binding document describes the binding for the audio portion of the
  driver.

  This binding must be part of the Lochnagar MFD binding:
    [1] ../mfd/cirrus,lochnagar.yaml

allOf:
  - $ref: dai-common.yaml#

properties:
  compatible:
    enum:
      - cirrus,lochnagar2-soundcard

  '#sound-dai-cells':
    description:
      The first cell indicating the audio interface.
    const: 1

  clocks:
    description:
      Master clock source for the sound card, should normally be set to
      LOCHNAGAR_SOUNDCARD_MCLK provided by the Lochnagar clock driver.
    maxItems: 1

  clock-names:
    const: mclk

required:
  - compatible
  - '#sound-dai-cells'
  - clocks
  - clock-names

unevaluatedProperties: false
```

## Documentation/devicetree/bindings/sound/cirrus,madera.yaml
```yaml
# SPDX-License-Identifier: GPL-2.0-only OR BSD-2-Clause
%YAML 1.2
---
$id: http://devicetree.org/schemas/sound/cirrus,madera.yaml#
$schema: http://devicetree.org/meta-schemas/core.yaml#

title: Cirrus Logic Madera class audio CODECs

maintainers:
  - patches@opensource.cirrus.com

description: |
  This describes audio configuration bindings for these codecs.

  See also the core bindings for the parent MFD driver:

    Documentation/devicetree/bindings/mfd/cirrus,madera.yaml

  and defines for values used in these bindings:

    include/dt-bindings/sound/madera.h

  The properties are all contained in the parent MFD node.

allOf:
  - $ref: dai-common.yaml#

properties:
  '#sound-dai-cells':
    description:
      The first cell indicating the audio interface.
    const: 1

  cirrus,inmode:
    description:
      A list of input mode settings for each input. A maximum
      of 24 cells, with four cells per input in the order INnAL,
      INnAR INnBL INnBR.  For non-muxed inputs the first two cells
      for that input set the mode for the left and right channel
      and the second two cells must be 0.  For muxed inputs the
      first two cells for that input set the mode of the left and
      right A inputs and the second two cells set the mode of the
      left and right B inputs.  Valid mode values are one of the
      MADERA_INMODE_xxx. If the array is shorter than the number
      of inputs the unspecified inputs default to MADERA_INMODE_DIFF.
    $ref: /schemas/types.yaml#/definitions/uint32-array
    minItems: 1
    maxItems: 24
    items:
      minimum: 0
      maximum: 1
      default: 0

  cirrus,out-mono:
    description:
      Mono bit for each output, maximum of six cells if the array
      is shorter outputs will be set to stereo.
    $ref: /schemas/types.yaml#/definitions/uint32-array
    minItems: 1
    maxItems: 6
    items:
      minimum: 0
      maximum: 1
      default: 0

  cirrus,dmic-ref:
    description: |
      Indicates how the MICBIAS pins have been externally connected
      to DMICs on each input, one cell per input.

        <IN1 IN2 IN3 ...>

      A value of 0 indicates MICVDD and is the default,
      other values depend on the codec: For CS47L35 one of the
      CS47L35_DMIC_REF_xxx values For all other codecs one of
      the MADERA_DMIC_REF_xxx values Also see the datasheet for a
      description of the INn_DMIC_SUP field.
    $ref: /schemas/types.yaml#/definitions/uint32-array
    minItems: 1
    maxItems: 6
    items:
      minimum: 0
      maximum: 3
      default: 0

  cirrus,max-channels-clocked:
    description:
      Maximum number of channels that I2S clocks will be generated
      for. Useful when clock master for systems where the I2S bus
      has multiple data lines.  One cell for each AIF, use a value
      of zero for AIFs that should be handled normally.
    $ref: /schemas/types.yaml#/definitions/uint32-array
    minItems: 1
    maxItems: 4
    items:
      default: 0

  cirrus,pdm-fmt:
    description:
      PDM speaker data format, must contain 2 cells (OUT5 and
      OUT6). See the PDM_SPKn_FMT field in the datasheet for a
      description of this value. The second cell is ignored for
      codecs that do not have OUT6.
    $ref: /schemas/types.yaml#/definitions/uint32-array
    minItems: 2
    maxItems: 2

  cirrus,pdm-mute:
    description: |
      PDM mute format, must contain 2 cells (OUT5 and OUT6). See the
      PDM_SPKn_CTRL_1 register in the datasheet for a description
      of this value.  The second cell is ignored for codecs that
      do not have OUT6.
    $ref: /schemas/types.yaml#/definitions/uint32-array
    minItems: 2
    maxItems: 2

additionalProperties: true
```

## Documentation/devicetree/bindings/sound/cix,sky1-ipbloq-hda.yaml
```yaml
# SPDX-License-Identifier: (GPL-2.0-only OR BSD-2-Clause)
%YAML 1.2
---
$id: http://devicetree.org/schemas/sound/cix,sky1-ipbloq-hda.yaml#
$schema: http://devicetree.org/meta-schemas/core.yaml#

title: CIX IPBLOQ HDA controller

description:
  CIX IPBLOQ High Definition Audio (HDA) Controller

maintainers:
  - Joakim Zhang <joakim.zhang@cixtech.com>

allOf:
  - $ref: sound-card-common.yaml#

properties:
  compatible:
    const: cix,sky1-ipbloq-hda

  reg:
    maxItems: 1

  interrupts:
    maxItems: 1

  clocks:
    maxItems: 2

  clock-names:
    items:
      - const: ipg
      - const: per

  resets:
    maxItems: 1

required:
  - compatible
  - reg
  - interrupts
  - clocks
  - clock-names
  - resets

unevaluatedProperties: false

examples:
  - |
    #include<dt-bindings/interrupt-controller/arm-gic.h>

    hda@70c0000 {
        compatible = "cix,sky1-ipbloq-hda";
        reg = <0x70c0000 0x10000>;
        interrupts = <GIC_SPI 234 IRQ_TYPE_LEVEL_HIGH>;
        clocks = <&audss_clk 7>,
                 <&audss_clk 8>;
        clock-names = "ipg", "per";
        resets = <&audss_rst 14>;
        model = "CIX SKY1 EVB HDA";
    };
```
