## Documentation/devicetree/bindings/sound/wm8753.txt
```
WM8753 audio CODEC

This device supports both I2C and SPI (configured with pin strapping
on the board).

Required properties:

  - compatible : "wlf,wm8753"

  - reg : the I2C address of the device for I2C, the chip select
          number for SPI.

Pins on the device (for linking into audio routes):

  * LOUT1
  * LOUT2
  * ROUT1
  * ROUT2
  * MONO1
  * MONO2
  * OUT3
  * OUT4
  * LINE1
  * LINE2
  * RXP
  * RXN
  * ACIN
  * ACOP
  * MIC1N
  * MIC1
  * MIC2N
  * MIC2
  * Mic Bias

Example:

codec: wm8753@1a {
	compatible = "wlf,wm8753";
	reg = <0x1a>;
};
```

## Documentation/devicetree/bindings/sound/wm8770.txt
```
WM8770 audio CODEC

This device supports SPI.

Required properties:

  - compatible : "wlf,wm8770"

  - reg : the chip select number.

Example:

wm8770: codec@1 {
	compatible = "wlf,wm8770";
	reg = <1>;
};
```

## Documentation/devicetree/bindings/sound/wm8776.txt
```
WM8776 audio CODEC

This device supports both I2C and SPI (configured with pin strapping
on the board).

Required properties:

  - compatible : "wlf,wm8776"

  - reg : the I2C address of the device for I2C, the chip select
          number for SPI.

Example:

codec: wm8776@1a {
	compatible = "wlf,wm8776";
	reg = <0x1a>;
};
```

## Documentation/devicetree/bindings/sound/wm8782.txt
```
WM8782 stereo ADC

This device does not have any control interface or reset pins.

Required properties:

 - compatible  : "wlf,wm8782"
 - Vdda-supply : phandle to a regulator for the analog power supply (2.7V - 5.5V)
 - Vdd-supply  : phandle to a regulator for the digital power supply (2.7V - 3.6V)

Example:

wm8782: stereo-adc {
	compatible = "wlf,wm8782";
	Vdda-supply = <&vdda_supply>;
	Vdd-supply = <&vdd_supply>;
};
```

## Documentation/devicetree/bindings/sound/wm8804.txt
```
WM8804 audio CODEC

This device supports both I2C and SPI (configured with pin strapping
on the board).

Required properties:

  - compatible : "wlf,wm8804"

  - reg : the I2C address of the device for I2C, the chip select
          number for SPI.

  - PVDD-supply, DVDD-supply : Power supplies for the device, as covered
    in Documentation/devicetree/bindings/regulator/regulator.txt

Optional properties:

  - wlf,reset-gpio: A GPIO specifier for the GPIO controlling the reset pin

Example:

codec: wm8804@1a {
	compatible = "wlf,wm8804";
	reg = <0x1a>;
};
```

## Documentation/devicetree/bindings/sound/wm8903.txt
```
WM8903 audio CODEC

This device supports I2C only.

Required properties:

  - compatible : "wlf,wm8903"

  - reg : the I2C address of the device.

  - gpio-controller : Indicates this device is a GPIO controller.

  - #gpio-cells : Should be two. The first cell is the pin number and the
    second cell is used to specify optional parameters (currently unused).

Optional properties:

  - interrupts : The interrupt line the codec is connected to.

  - micdet-cfg : Default register value for R6 (Mic Bias). If absent, the
    default is 0.

  - micdet-delay : The debounce delay for microphone detection in mS. If
    absent, the default is 100.

  - gpio-cfg : A list of GPIO configuration register values. The list must
    be 5 entries long. If absent, no configuration of these registers is
    performed. If any entry has the value 0xffffffff, that GPIO's
    configuration will not be modified.

  - AVDD-supply : Analog power supply regulator on the AVDD pin.

  - CPVDD-supply : Charge pump supply regulator on the CPVDD pin.

  - DBVDD-supply : Digital buffer supply regulator for the DBVDD pin.

  - DCVDD-supply : Digital core supply regulator for the DCVDD pin.

Pins on the device (for linking into audio routes):

  * IN1L
  * IN1R
  * IN2L
  * IN2R
  * IN3L
  * IN3R
  * DMICDAT
  * HPOUTL
  * HPOUTR
  * LINEOUTL
  * LINEOUTR
  * LOP
  * LON
  * ROP
  * RON
  * MICBIAS

Example:

wm8903: codec@1a {
	compatible = "wlf,wm8903";
	reg = <0x1a>;
	interrupts = < 347 >;

	AVDD-supply = <&fooreg_a>;
	CPVDD-supply = <&fooreg_b>;
	DBVDD-supply = <&fooreg_c>;
	DCVDC-supply = <&fooreg_d>;

	gpio-controller;
	#gpio-cells = <2>;

	micdet-cfg = <0>;
	micdet-delay = <100>;
	gpio-cfg = <
		0x0600 /* DMIC_LR, output */
		0x0680 /* DMIC_DAT, input */
		0x0000 /* GPIO, output, low */
		0x0200 /* Interrupt, output */
		0x01a0 /* BCLK, input, active high */
	>;
};
```

## Documentation/devicetree/bindings/sound/wm8904.txt
```
WM8904 audio CODEC

This device supports I2C only.

Required properties:
  - compatible: "wlf,wm8904"
  - reg: the I2C address of the device.
  - clock-names: "mclk"
  - clocks: reference to
    <Documentation/devicetree/bindings/clock/clock-bindings.txt>

Pins on the device (for linking into audio routes):

  * IN1L
  * IN1R
  * IN2L
  * IN2R
  * IN3L
  * IN3R
  * HPOUTL
  * HPOUTR
  * LINEOUTL
  * LINEOUTR
  * MICBIAS

Examples:

codec: wm8904@1a {
	compatible = "wlf,wm8904";
	reg = <0x1a>;
	clocks = <&pck0>;
	clock-names = "mclk";
};
```

## Documentation/devicetree/bindings/sound/wm8960.txt
```
WM8960 audio CODEC

This device supports I2C only.

Required properties:

  - compatible : "wlf,wm8960"

  - reg : the I2C address of the device.

Optional properties:
  - wlf,shared-lrclk: This is a boolean property. If present, the LRCM bit of
	R24 (Additional control 2) gets set, indicating that ADCLRC and DACLRC pins
	will be disabled only when ADC (Left and Right) and DAC (Left and Right)
	are disabled.
	When wm8960 works on synchronize mode and DACLRC pin is used to supply
	frame clock, it will no frame clock for captrue unless enable DAC to enable
	DACLRC pin. If shared-lrclk is present, no need to enable DAC for captrue.

  - wlf,capless: This is a boolean property. If present, OUT3 pin will be
	enabled and disabled together with HP_L and HP_R pins in response to jack
	detect events.

  - wlf,hp-cfg: A list of headphone jack detect configuration register values.
		The list must be 3 entries long.
		hp-cfg[0]: HPSEL[1:0] of R48 (Additional Control 4).
		hp-cfg[1]: {HPSWEN:HPSWPOL} of R24 (Additional Control 2).
		hp-cfg[2]: {TOCLKSEL:TOEN} of R23 (Additional Control 1).

  - wlf,gpio-cfg: A list of GPIO configuration register values.
		  The list must be 2 entries long.
		  gpio-cfg[0]: ALRCGPIO of R9 (Audio interface)
		  gpio-cfg[1]: {GPIOPOL:GPIOSEL[2:0]} of R48 (Additional Control 4).

Example:

wm8960: codec@1a {
	compatible = "wlf,wm8960";
	reg = <0x1a>;

	wlf,shared-lrclk;
};
```

## Documentation/devicetree/bindings/sound/wm8962.txt
```
WM8962 audio CODEC

This device supports I2C only.

Required properties:

  - compatible : "wlf,wm8962"

  - reg : the I2C address of the device.

Optional properties:
  - spk-mono: This is a boolean property. If present, the SPK_MONO bit
    of R51 (Class D Control 2) gets set, indicating that the speaker is
    in mono mode.

  - mic-cfg : Default register value for R48 (Additional Control 4).
    If absent, the default should be the register default.

  - gpio-cfg : A list of GPIO configuration register values. The list must
    be 6 entries long. If absent, no configuration of these registers is
    performed. And note that only the value within [0x0, 0xffff] is valid.
    Any other value is regarded as setting the GPIO register by its reset
    value 0x0.

Example:

wm8962: codec@1a {
	compatible = "wlf,wm8962";
	reg = <0x1a>;

	gpio-cfg = <
		0x0000 /* 0:Default */
		0x0000 /* 1:Default */
		0x0013 /* 2:FN_DMICCLK */
		0x0000 /* 3:Default */
		0x8014 /* 4:FN_DMICCDAT */
		0x0000 /* 5:Default */
	>;
};
```

## Documentation/devicetree/bindings/sound/wm8994.txt
```
WM1811/WM8994/WM8958 audio CODEC

These devices support both I2C and SPI (configured with pin strapping
on the board).

Required properties:

  - compatible : One of "wlf,wm1811", "wlf,wm8994" or "wlf,wm8958".

  - reg : the I2C address of the device for I2C, the chip select
          number for SPI.

  - gpio-controller : Indicates this device is a GPIO controller.
  - #gpio-cells : Must be 2. The first cell is the pin number and the
    second cell is used to specify optional parameters (currently unused).

  - power supplies for the device, as covered in
    Documentation/devicetree/bindings/regulator/regulator.txt, depending
    on compatible:
    - for wlf,wm1811 and wlf,wm8958:
      AVDD1-supply, AVDD2-supply, DBVDD1-supply, DBVDD2-supply, DBVDD3-supply,
      DCVDD-supply, CPVDD-supply, SPKVDD1-supply, SPKVDD2-supply
    - for wlf,wm8994:
      AVDD1-supply, AVDD2-supply, DBVDD-supply, DCVDD-supply, CPVDD-supply,
      SPKVDD1-supply, SPKVDD2-supply

Optional properties:

  - interrupts : The interrupt line the IRQ signal for the device is
    connected to.  This is optional, if it is not connected then none
    of the interrupt related properties should be specified.
  - interrupt-controller : These devices contain interrupt controllers
    and may provide interrupt services to other devices if they have an
    interrupt line connected.
  - #interrupt-cells: the number of cells to describe an IRQ, this should be 2.
    The first cell is the IRQ number.
    The second cell is the flags, encoded as the trigger masks from
    Documentation/devicetree/bindings/interrupt-controller/interrupts.txt

  - clocks : A list of up to two phandle and clock specifier pairs
  - clock-names : A list of clock names sorted in the same order as clocks.
                  Valid clock names are "MCLK1" and "MCLK2".

  - wlf,gpio-cfg : A list of GPIO configuration register values. If absent,
    no configuration of these registers is performed. If any value is
    over 0xffff then the register will be left as default. If present 11
    values must be supplied.

  - wlf,micbias-cfg : Two MICBIAS register values for WM1811 or
    WM8958.  If absent the register defaults will be used.

  - wlf,ldo1ena : GPIO specifier for control of LDO1ENA input to device.
  - wlf,ldo2ena : GPIO specifier for control of LDO2ENA input to device.

  - wlf,lineout1-se : If present LINEOUT1 is in single ended mode.
  - wlf,lineout2-se : If present LINEOUT2 is in single ended mode.

  - wlf,lineout1-feedback : If present LINEOUT1 has common mode feedback
    connected.
  - wlf,lineout2-feedback : If present LINEOUT2 has common mode feedback
    connected.

  - wlf,ldoena-always-driven : If present LDOENA is always driven.

  - wlf,spkmode-pu : If present enable the internal pull-up resistor on
    the SPKMODE pin.

  - wlf,csnaddr-pd : If present enable the internal pull-down resistor on
    the CS/ADDR pin.

Example:

wm8994: codec@1a {
	compatible = "wlf,wm8994";
	reg = <0x1a>;

	gpio-controller;
	#gpio-cells = <2>;

	lineout1-se;

	AVDD1-supply = <&regulator>;
	AVDD2-supply = <&regulator>;
	CPVDD-supply = <&regulator>;
	DBVDD-supply = <&regulator>;
	DCVDD-supply = <&regulator>;
	SPKVDD1-supply = <&regulator>;
	SPKVDD2-supply = <&regulator>;
};
```

## Documentation/devicetree/bindings/sound/xlnx,audio-formatter.txt
```
Device-Tree bindings for Xilinx PL audio formatter

The IP core supports DMA, data formatting(AES<->PCM conversion)
of audio samples.

Required properties:
 - compatible: "xlnx,audio-formatter-1.0"
 - interrupt-names: Names specified to list of interrupts in same
		    order mentioned under "interrupts".
		    List of supported interrupt names are:
		    "irq_mm2s" : interrupt from MM2S block
		    "irq_s2mm" : interrupt from S2MM block
 - interrupts-parent: Phandle for interrupt controller.
 - interrupts: List of Interrupt numbers.
 - reg: Base address and size of the IP core instance.
 - clock-names: List of input clocks.
   Required elements: "s_axi_lite_aclk", "aud_mclk"
 - clocks: Input clock specifier. Refer to common clock bindings.

Example:
	audio_ss_0_audio_formatter_0: audio_formatter@80010000 {
		compatible = "xlnx,audio-formatter-1.0";
		interrupt-names = "irq_mm2s", "irq_s2mm";
		interrupt-parent = <&gic>;
		interrupts = <0 104 4>, <0 105 4>;
		reg = <0x0 0x80010000 0x0 0x1000>;
		clock-names = "s_axi_lite_aclk", "aud_mclk";
		clocks = <&clk 71>, <&clk_wiz_1 0>;
	};
```

## Documentation/devicetree/bindings/sound/xlnx,audio-formatter.yaml
```yaml
# SPDX-License-Identifier: (GPL-2.0-only OR BSD-2-Clause)
%YAML 1.2
---
$id: http://devicetree.org/schemas/sound/xlnx,audio-formatter.yaml#
$schema: http://devicetree.org/meta-schemas/core.yaml#

title: Xilinx PL audio formatter

description:
  The IP core supports DMA, data formatting(AES<->PCM conversion)
  of audio samples.

maintainers:
  - Vincenzo Frascino <vincenzo.frascino@arm.com>

allOf:
  - $ref: dai-common.yaml#

properties:
  compatible:
    enum:
      - xlnx,audio-formatter-1.0

  reg:
    maxItems: 1

  interrupt-names:
    minItems: 1
    items:
      - const: irq_mm2s
      - const: irq_s2mm

  interrupts:
    minItems: 1
    items:
      - description: interrupt from MM2S block
      - description: interrupt from S2MM block

  clock-names:
    minItems: 1
    items:
      - const: s_axi_lite_aclk
      - const: aud_mclk

  clocks:
    minItems: 1
    items:
      - description: clock for the axi data stream
      - description: clock for the MEMS microphone data stream

required:
  - compatible
  - reg
  - interrupt-names
  - interrupts
  - clock-names
  - clocks

additionalProperties: false

examples:
  - |
    audio_formatter@80010000 {
      compatible = "xlnx,audio-formatter-1.0";
      reg = <0x80010000 0x1000>;
      interrupt-names = "irq_mm2s", "irq_s2mm";
      interrupt-parent = <&gic>;
      interrupts = <0 104 4>, <0 105 4>;
      clock-names = "s_axi_lite_aclk", "aud_mclk";
      clocks = <&clk 71>, <&clk_wiz_1 0>;
    };
...
```

## Documentation/devicetree/bindings/sound/xlnx,i2s.txt
```
Device-Tree bindings for Xilinx I2S PL block

The IP supports I2S based playback/capture audio

Required property:
 - compatible: "xlnx,i2s-transmitter-1.0" for playback and
	       "xlnx,i2s-receiver-1.0" for capture

Required property common to both I2S playback and capture:
 - reg: Base address and size of the IP core instance.
 - xlnx,dwidth: sample data width. Can be any of 16, 24.
 - xlnx,num-channels: Number of I2S streams. Can be any of 1, 2, 3, 4.
		      supported channels = 2 * xlnx,num-channels

Example:

	i2s_receiver@a0080000 {
		compatible = "xlnx,i2s-receiver-1.0";
		reg = <0x0 0xa0080000 0x0 0x10000>;
		xlnx,dwidth = <0x18>;
		xlnx,num-channels = <1>;
	};
	i2s_transmitter@a0090000 {
		compatible = "xlnx,i2s-transmitter-1.0";
		reg = <0x0 0xa0090000 0x0 0x10000>;
		xlnx,dwidth = <0x18>;
		xlnx,num-channels = <1>;
	};
```

## Documentation/devicetree/bindings/sound/xlnx,i2s.yaml
```yaml
# SPDX-License-Identifier: (GPL-2.0-only OR BSD-2-Clause)
%YAML 1.2
---
$id: http://devicetree.org/schemas/sound/xlnx,i2s.yaml#
$schema: http://devicetree.org/meta-schemas/core.yaml#

title: Xilinx I2S PL block

description:
  The IP supports I2S based playback/capture audio.

maintainers:
  - Vincenzo Frascino <vincenzo.frascino@arm.com>

allOf:
  - $ref: dai-common.yaml#

properties:
  compatible:
    enum:
      - xlnx,i2s-receiver-1.0
      - xlnx,i2s-transmitter-1.0

  reg:
    maxItems: 1

  xlnx,dwidth:
    $ref: /schemas/types.yaml#/definitions/uint32
    enum:
      - 16
      - 24
    description: |
      Sample data width.

  xlnx,num-channels:
    $ref: /schemas/types.yaml#/definitions/uint32
    minimum: 1
    maximum: 4
    description: |
      Number of I2S streams.

required:
  - compatible
  - reg
  - xlnx,dwidth
  - xlnx,num-channels

additionalProperties: false

examples:
  - |
    i2s@a0080000 {
      compatible = "xlnx,i2s-receiver-1.0";
      reg = <0xa0080000 0x10000>;
      xlnx,dwidth = <0x18>;
      xlnx,num-channels = <1>;
    };
    i2s@a0090000 {
      compatible = "xlnx,i2s-transmitter-1.0";
      reg = <0xa0090000 0x10000>;
      xlnx,dwidth = <0x18>;
      xlnx,num-channels = <1>;
    };

...
```
