## Documentation/devicetree/bindings/sound/xlnx,spdif.txt
```
Device-Tree bindings for Xilinx SPDIF IP

The IP supports playback and capture of SPDIF audio

Required properties:
 - compatible: "xlnx,spdif-2.0"
 - clock-names: List of input clocks.
   Required elements: "s_axi_aclk", "aud_clk_i"
 - clocks: Input clock specifier. Refer to common clock bindings.
 - reg: Base address and address length of the IP core instance.
 - interrupts-parent: Phandle for interrupt controller.
 - interrupts: List of Interrupt numbers.
 - xlnx,spdif-mode: 0 :- receiver mode
		    1 :- transmitter mode
 - xlnx,aud_clk_i: input audio clock value.

Example:
	spdif_0: spdif@80010000 {
		clock-names = "aud_clk_i", "s_axi_aclk";
		clocks = <&misc_clk_0>, <&clk 71>;
		compatible = "xlnx,spdif-2.0";
		interrupt-names = "spdif_interrupt";
		interrupt-parent = <&gic>;
		interrupts = <0 91 4>;
		reg = <0x0 0x80010000 0x0 0x10000>;
		xlnx,spdif-mode = <1>;
		xlnx,aud_clk_i = <49152913>;
	};
```

## Documentation/devicetree/bindings/sound/xlnx,spdif.yaml
```yaml
# SPDX-License-Identifier: (GPL-2.0-only OR BSD-2-Clause)
%YAML 1.2
---
$id: http://devicetree.org/schemas/sound/xlnx,spdif.yaml#
$schema: http://devicetree.org/meta-schemas/core.yaml#

title: Xilinx SPDIF IP

description:
  The IP supports playback and capture of SPDIF audio.

maintainers:
  - Vincenzo Frascino <vincenzo.frascino@arm.com>

allOf:
  - $ref: dai-common.yaml#

properties:
  compatible:
    enum:
      - xlnx,spdif-2.0

  reg:
    maxItems: 1

  interrupts:
    items:
      - description: SPDIF audio interrupt

  clock-names:
    items:
      - const: aud_clk_i
      - const: s_axi_aclk

  clocks:
    minItems: 1
    items:
      - description: input audio clock
      - description: clock for the AXI data stream

  xlnx,spdif-mode:
    $ref: /schemas/types.yaml#/definitions/uint32
    enum:
      - 0
      - 1
    description: |
      0 - receiver
      1 - transmitter

  xlnx,aud_clk_i:
    $ref: /schemas/types.yaml#/definitions/uint32
    description:
      Input audio clock frequency. It affects the sampling rate.

required:
  - compatible
  - reg
  - interrupts
  - clock-names
  - clocks

additionalProperties: false

examples:
  - |
    spdif@80010000 {
      compatible = "xlnx,spdif-2.0";
      reg = <0x80010000 0x10000>;
      clock-names = "aud_clk_i", "s_axi_aclk";
      clocks = <&misc_clk_0>, <&clk 71>;
      interrupt-parent = <&gic>;
      interrupts = <0 91 4>;
      xlnx,spdif-mode = <1>;
      xlnx,aud_clk_i = <49152913>;
    };

...
```

## Documentation/devicetree/bindings/sound/xmos,xvf3500.yaml
```yaml
# SPDX-License-Identifier: (GPL-2.0 OR BSD-2-Clause)
%YAML 1.2
---
$id: http://devicetree.org/schemas/sound/xmos,xvf3500.yaml#
$schema: http://devicetree.org/meta-schemas/core.yaml#

title: XMOS XVF3500 VocalFusion Voice Processor

maintainers:
  - Javier Carrasco <javier.carrasco@wolfvision.net>

description:
  The XMOS XVF3500 VocalFusion Voice Processor is a low-latency, 32-bit
  multicore controller for voice processing.
  https://www.xmos.com/xvf3500/

allOf:
  - $ref: /schemas/usb/usb-device.yaml#

properties:
  compatible:
    const: usb20b1,0013

  reg: true

  reset-gpios:
    maxItems: 1

  vdd-supply:
    description:
      Regulator for the 1V0 supply.

  vddio-supply:
    description:
      Regulator for the 3V3 supply.

required:
  - compatible
  - reg
  - reset-gpios
  - vdd-supply
  - vddio-supply

additionalProperties: false

examples:
  - |
    #include <dt-bindings/gpio/gpio.h>

    usb {
        #address-cells = <1>;
        #size-cells = <0>;

        voice_processor: voice-processor@1 {
            compatible = "usb20b1,0013";
            reg = <1>;
            reset-gpios = <&gpio 5 GPIO_ACTIVE_LOW>;
            vdd-supply = <&vcc1v0>;
            vddio-supply = <&vcc3v3>;
        };
    };

...
```

## Documentation/devicetree/bindings/sound/zl38060.yaml
```yaml
# SPDX-License-Identifier: (GPL-2.0 OR BSD-2-Clause)
%YAML 1.2
---
$id: http://devicetree.org/schemas/sound/zl38060.yaml#
$schema: http://devicetree.org/meta-schemas/core.yaml#

title: ZL38060 Connected Home Audio Processor from Microsemi.

description: |
  The ZL38060 is a "Connected Home Audio Processor" from Microsemi,
  which consists of a Digital Signal Processor (DSP), several Digital
  Audio Interfaces (DAIs), analog outputs, and a block of 14 GPIOs.

maintainers:
  - Jaroslav Kysela <perex@perex.cz>
  - Takashi Iwai <tiwai@suse.com>

allOf:
  - $ref: dai-common.yaml#

properties:
  compatible:
    const: mscc,zl38060

  reg:
    description:
      SPI device address.
    maxItems: 1

  spi-max-frequency:
    maximum: 24000000

  reset-gpios:
    description:
      A GPIO line handling reset of the chip. As the line is active low,
      it should be marked GPIO_ACTIVE_LOW (see ../gpio/gpio.txt)
    maxItems: 1

  '#gpio-cells':
    const: 2

  gpio-controller: true

  '#sound-dai-cells':
    const: 0

required:
  - compatible
  - reg
  - '#gpio-cells'
  - gpio-controller
  - '#sound-dai-cells'

unevaluatedProperties: false

examples:
  - |
    #include <dt-bindings/gpio/gpio.h>
    spi {
        #address-cells = <1>;
        #size-cells = <0>;

        codec: zl38060@0 {
            gpio-controller;
            #gpio-cells = <2>;
            #sound-dai-cells = <0>;
            compatible = "mscc,zl38060";
            reg = <0>;
            spi-max-frequency = <12000000>;
            reset-gpios = <&gpio1 0 GPIO_ACTIVE_LOW>;
        };
    };
```

## Documentation/devicetree/bindings/sound/zte,tdm.txt
```
ZTE TDM DAI driver

Required properties:

- compatible : should be one of the following.
       * zte,zx296718-tdm
- reg : physical base address of the controller and length of memory mapped
    region.
- clocks : Pairs of phandle and specifier referencing the controller's clocks.
- clock-names: "wclk" for the wclk.
               "pclk" for the pclk.
-#clock-cells: should be 1.
- zte,tdm-dma-sysctrl : Reference to the sysctrl controller controlling
    the dma. includes:
	phandle of sysctrl.
	register offset in sysctrl for control dma.
	mask of the register that be written to sysctrl.

Example:

	tdm: tdm@1487000 {
		compatible = "zte,zx296718-tdm";
		reg = <0x01487000 0x1000>;
		clocks = <&audiocrm AUDIO_TDM_WCLK>, <&audiocrm AUDIO_TDM_PCLK>;
		clock-names = "wclk", "pclk";
		#clock-cells = <1>;
		pinctrl-names = "default";
		pinctrl-0 = <&tdm_global_pin>;
		zte,tdm-dma-sysctrl = <&sysctrl 0x10c 4>;
	};
```

## Documentation/devicetree/bindings/sound/zte,zx-aud96p22.txt
```
ZTE ZX AUD96P22 Audio Codec

Required properties:
 - compatible: Must be "zte,zx-aud96p22"
 - #sound-dai-cells: Should be 0
 - reg: I2C bus slave address of AUD96P22

Example:

	i2c0: i2c@1486000 {
		compatible = "zte,zx296718-i2c";
		reg = <0x01486000 0x1000>;
		interrupts = <GIC_SPI 35 IRQ_TYPE_LEVEL_HIGH>;
		#address-cells = <1>;
		#size-cells = <0>;
		clocks = <&audiocrm AUDIO_I2C0_WCLK>;
		clock-frequency = <1600000>;

		aud96p22: codec@22 {
			compatible = "zte,zx-aud96p22";
			#sound-dai-cells = <0>;
			reg = <0x22>;
		};
	};
```

## Documentation/devicetree/bindings/sound/zte,zx-i2s.txt
```
ZTE ZX296702 I2S controller

Required properties:
 - compatible : Must be "zte,zx296702-i2s"
 - reg : Must contain I2S core's registers location and length
 - clocks : Pairs of phandle and specifier referencing the controller's clocks.
 - clock-names: "tx" for the clock to the I2S interface.
 - dmas: Pairs of phandle and specifier for the DMA channel that is used by
   the core. The core expects two dma channels for transmit.
 - dma-names : Must be "tx" and "rx"

For more details on the 'dma', 'dma-names', 'clock' and 'clock-names' properties
please check:
	* resource-names.txt
	* clock/clock-bindings.txt
	* dma/dma.txt

Example:
	i2s0: i2s0@0b005000 {
		#sound-dai-cells = <0>;
		compatible = "zte,zx296702-i2s";
		reg = <0x0b005000 0x1000>;
		clocks = <&lsp0clk ZX296702_I2S0_DIV>;
		clock-names = "tx";
		interrupts = <GIC_SPI 22 IRQ_TYPE_LEVEL_HIGH>;
		dmas = <&dma 5>, <&dma 6>;
		dma-names = "tx", "rx";
		status = "okay";
	};

	sound {
		compatible = "simple-audio-card";
		simple-audio-card,name = "zx296702_snd";
		simple-audio-card,format = "left_j";
		simple-audio-card,bitclock-master = <&sndcodec>;
		simple-audio-card,frame-master = <&sndcodec>;
		sndcpu: simple-audio-card,cpu {
			sound-dai = <&i2s0>;
		};

		sndcodec: simple-audio-card,codec {
			sound-dai = <&acodec>;
		};
	};
```

## Documentation/devicetree/bindings/sound/zte,zx-spdif.txt
```
ZTE ZX296702 SPDIF controller

Required properties:
 - compatible : Must be "zte,zx296702-spdif"
 - reg : Must contain SPDIF core's registers location and length
 - clocks : Pairs of phandle and specifier referencing the controller's clocks.
 - clock-names: "tx" for the clock to the SPDIF interface.
 - dmas: Pairs of phandle and specifier for the DMA channel that is used by
   the core. The core expects one dma channel for transmit.
 - dma-names : Must be "tx"

For more details on the 'dma', 'dma-names', 'clock' and 'clock-names' properties
please check:
	* resource-names.txt
	* clock/clock-bindings.txt
	* dma/dma.txt

Example:
	spdif0: spdif0@0b004000 {
		compatible = "zte,zx296702-spdif";
		reg = <0x0b004000 0x1000>;
		clocks = <&lsp0clk ZX296702_SPDIF0_DIV>;
		clock-names = "tx";
		interrupts = <GIC_SPI 21 IRQ_TYPE_LEVEL_HIGH>;
		dmas = <&dma 4>;
		dma-names = "tx";
	};
```

## Documentation/devicetree/bindings/soundwire/qcom,sdw.txt
```
Qualcomm SoundWire Controller Bindings


This binding describes the Qualcomm SoundWire Controller along with its
board specific bus parameters.

- compatible:
	Usage: required
	Value type: <stringlist>
	Definition: must be "qcom,soundwire-v<MAJOR>.<MINOR>.<STEP>",
		    Example:
			"qcom,soundwire-v1.3.0"
			"qcom,soundwire-v1.5.0"
			"qcom,soundwire-v1.6.0"
- reg:
	Usage: required
	Value type: <prop-encoded-array>
	Definition: the base address and size of SoundWire controller
		    address space.

- interrupts:
	Usage: required
	Value type: <prop-encoded-array>
	Definition: should specify the SoundWire Controller IRQ

- clock-names:
	Usage: required
	Value type: <stringlist>
	Definition: should be "iface" for SoundWire Controller interface clock

- clocks:
	Usage: required
	Value type: <prop-encoded-array>
	Definition: should specify the SoundWire Controller interface clock

- #sound-dai-cells:
	Usage: required
	Value type: <u32>
	Definition: must be 1 for digital audio interfaces on the controller.

- qcom,dout-ports:
	Usage: required
	Value type: <u32>
	Definition: must be count of data out ports

- qcom,din-ports:
	Usage: required
	Value type: <u32>
	Definition: must be count of data in ports

- qcom,ports-offset1:
	Usage: required
	Value type: <prop-encoded-array>
	Definition: should specify payload transport window offset1 of each
		    data port. Out ports followed by In ports.
		    More info in MIPI Alliance SoundWire 1.0 Specifications.

- qcom,ports-offset2:
	Usage: required
	Value type: <prop-encoded-array>
	Definition: should specify payload transport window offset2 of each
		    data port. Out ports followed by In ports.
		    More info in MIPI Alliance SoundWire 1.0 Specifications.

- qcom,ports-sinterval-low:
	Usage: required
	Value type: <prop-encoded-array>
	Definition: should be sample interval low of each data port.
		    Out ports followed by In ports. Used for Sample Interval
		    calculation.
		    More info in MIPI Alliance SoundWire 1.0 Specifications.

- qcom,ports-word-length:
	Usage: optional
	Value type: <prop-encoded-array>
	Definition: should be size of payload channel sample.
		    More info in MIPI Alliance SoundWire 1.0 Specifications.

- qcom,ports-block-pack-mode:
	Usage: optional
	Value type: <prop-encoded-array>
	Definition: should be 0 or 1 to indicate the block packing mode.
		    0 to indicate Blocks are per Channel
		    1 to indicate Blocks are per Port.
		    Out ports followed by In ports.
		    More info in MIPI Alliance SoundWire 1.0 Specifications.

- qcom,ports-block-group-count:
	Usage: optional
	Value type: <prop-encoded-array>
	Definition: should be in range 1 to 4 to indicate how many sample
		    intervals are combined into a payload.
		    Out ports followed by In ports.
		    More info in MIPI Alliance SoundWire 1.0 Specifications.

- qcom,ports-lane-control:
	Usage: optional
	Value type: <prop-encoded-array>
	Definition: should be in range 0 to 7 to identify which	data lane
		    the data port uses.
		    Out ports followed by In ports.
		    More info in MIPI Alliance SoundWire 1.0 Specifications.

- qcom,ports-hstart:
	Usage: optional
	Value type: <prop-encoded-array>
	Definition: should be number identifying lowerst numbered coloum in
		    SoundWire Frame, i.e. left edge of the Transport sub-frame
		    for each port. Values between 0 and 15 are valid.
		    Out ports followed by In ports.
		    More info in MIPI Alliance SoundWire 1.0 Specifications.

- qcom,ports-hstop:
	Usage: optional
	Value type: <prop-encoded-array>
	Definition: should be number identifying highest numbered coloum in
		    SoundWire Frame, i.e. the right edge of the Transport
		    sub-frame for each port. Values between 0 and 15 are valid.
		    Out ports followed by In ports.
		    More info in MIPI Alliance SoundWire 1.0 Specifications.

- qcom,dports-type:
	Usage: optional
	Value type: <prop-encoded-array>
	Definition: should be one of the following types
		    0 for reduced port
		    1 for simple ports
		    2 for full port
		    Out ports followed by In ports.
		    More info in MIPI Alliance SoundWire 1.0 Specifications.

Note:
	More Information on detail of encoding of these fields can be
found in MIPI Alliance SoundWire 1.0 Specifications.

= SoundWire devices
Each subnode of the bus represents SoundWire device attached to it.
The properties of these nodes are defined by the individual bindings.

= EXAMPLE
The following example represents a SoundWire controller on DB845c board
which has controller integrated inside WCD934x codec on SDM845 SoC.

soundwire: soundwire@c85 {
	compatible = "qcom,soundwire-v1.3.0";
	reg = <0xc85 0x20>;
	interrupts = <20 IRQ_TYPE_EDGE_RISING>;
	clocks = <&wcc>;
	clock-names = "iface";
	#sound-dai-cells = <1>;
	qcom,dports-type = <0>;
	qcom,dout-ports	= <6>;
	qcom,din-ports	= <2>;
	qcom,ports-sinterval-low = /bits/ 8  <0x07 0x1F 0x3F 0x7 0x1F 0x3F 0x0F 0x0F>;
	qcom,ports-offset1 = /bits/ 8 <0x01 0x02 0x0C 0x6 0x12 0x0D 0x07 0x0A >;
	qcom,ports-offset2 = /bits/ 8 <0x00 0x00 0x1F 0x00 0x00 0x1F 0x00 0x00>;

	/* Left Speaker */
	left{
		....
	};

	/* Right Speaker */
	right{
		....
	};
};
```
