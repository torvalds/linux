## Documentation/devicetree/bindings/sound/davinci-mcasp-audio.yaml
```yaml
# SPDX-License-Identifier: (GPL-2.0-only OR BSD-2-Clause)
%YAML 1.2
---
$id: http://devicetree.org/schemas/sound/davinci-mcasp-audio.yaml#
$schema: http://devicetree.org/meta-schemas/core.yaml#

title: McASP Controller for TI SoCs

maintainers:
  - Jayesh Choudhary <j-choudhary@ti.com>

properties:
  compatible:
    enum:
      - ti,dm646x-mcasp-audio
      - ti,da830-mcasp-audio
      - ti,am33xx-mcasp-audio
      - ti,dra7-mcasp-audio
      - ti,omap4-mcasp-audio

  reg:
    minItems: 1
    items:
      - description: CFG registers
      - description: data registers

  reg-names:
    minItems: 1
    items:
      - const: mpu
      - const: dat

  op-mode:
    $ref: /schemas/types.yaml#/definitions/uint32
    description: 0 - I2S or 1 - DIT operation mode
    enum:
      - 0
      - 1

  tdm-slots:
    $ref: /schemas/types.yaml#/definitions/uint32
    description:
      number of channels over one serializer
      the property is ignored in DIT mode
    minimum: 2
    maximum: 32

  serial-dir:
    description:
      A list of serializer configuration
      Entry is indication for serializer pin direction
      0 - Inactive, 1 - TX, 2 - RX
      All AXR pins should be present in the array even if inactive
    $ref: /schemas/types.yaml#/definitions/uint32-array
    minItems: 1
    maxItems: 25
    items:
      minimum: 0
      maximum: 2

  dmas:
    minItems: 1
    items:
      - description: transmission DMA channel
      - description: reception DMA channel

  dma-names:
    minItems: 1
    items:
      - const: tx
      - const: rx

  ti,hwmods:
    $ref: /schemas/types.yaml#/definitions/string
    description: Name of hwmod associated with McASP
    maxItems: 1
    deprecated: true

  tx-num-evt:
    $ref: /schemas/types.yaml#/definitions/uint32
    description:
      configures WFIFO threshold
      0 disables the FIFO use
      if property is missing, then also FIFO use is disabled

  rx-num-evt:
    $ref: /schemas/types.yaml#/definitions/uint32
    description:
      configures RFIFO threshold
      0 disables the FIFO use
      if property is missing, then also FIFO use is disabled

  dismod:
    $ref: /schemas/types.yaml#/definitions/uint32
    description:
      specify the drive on TX pin during inactive time slots
      0 - 3-state, 2 - logic low, 3 - logic high
    enum:
      - 0
      - 2
      - 3
    default: 2

  interrupts:
    minItems: 1
    maxItems: 2

  interrupt-names:
    oneOf:
      - description: TX interrupt
        const: tx
      - description: RX interrupt
        const: rx
      - description: TX and RX interrupts
        items:
          - const: tx
          - const: rx
      - description: Common/combined interrupt
        const: common

  fck_parent:
    $ref: /schemas/types.yaml#/definitions/string
    description: parent clock name for McASP fck
    maxItems: 1

  auxclk-fs-ratio:
    $ref: /schemas/types.yaml#/definitions/uint32
    description: ratio of AUCLK and FS rate if applicable

  gpio-controller: true

  "#gpio-cells":
    const: 2

  clocks:
    minItems: 1
    items:
      - description: functional clock
      - description: module specific optional ahclkx clock
      - description: module specific optional ahclkr clock

  clock-names:
    minItems: 1
    items:
      - const: fck
      - const: ahclkx
      - const: ahclkr

  power-domains:
    description: phandle to the corresponding power-domain
    maxItems: 1

  "#sound-dai-cells":
    const: 0

  port:
    description: connection for when McASP is used via graph card
    type: object

required:
  - compatible
  - reg
  - reg-names
  - dmas
  - dma-names
  - interrupts
  - interrupt-names

allOf:
  - $ref: dai-common.yaml#
  - if:
      properties:
        opmode:
          enum:
            - 0

    then:
      required:
        - tdm-slots

unevaluatedProperties: false

examples:
  - |
    mcasp0: mcasp0@1d00000 {
      compatible = "ti,da830-mcasp-audio";
      reg = <0x100000 0x3000>;
      reg-names = "mpu";
      interrupts = <82>, <83>;
      interrupt-names = "tx", "rx";
      op-mode = <0>;		/* MCASP_IIS_MODE */
      tdm-slots = <2>;
      dmas = <&main_udmap 0xc400>, <&main_udmap 0x4400>;
      dma-names = "tx", "rx";
      serial-dir = <
          0 0 0 0	/* 0: INACTIVE, 1: TX, 2: RX */
          0 0 0 0
          0 0 0 1
          2 0 0 0 >;
      tx-num-evt = <1>;
      rx-num-evt = <1>;
    };
```

## Documentation/devicetree/bindings/sound/davinci-mcbsp.txt
```
Texas Instruments DaVinci McBSP module
~~~~~~~~~~~~~~~~~~~~~~~~~~~~~~~~~~~~~~

This binding describes the "Multi-channel Buffered Serial Port" (McBSP)
audio interface found in some TI DaVinci processors like the OMAP-L138 or AM180x.


Required properties:
~~~~~~~~~~~~~~~~~~~~
- compatible :
        "ti,da850-mcbsp" : for DA850, AM180x and OPAM-L138 platforms

- reg : physical base address and length of the controller memory mapped
        region(s).
- reg-names : Should contain:
        * "mpu" for the main registers (required).
        * "dat" for the data FIFO (optional).

- dmas: three element list of DMA controller phandles, DMA request line and
	TC channel ordered triplets.
- dma-names: identifier string for each DMA request line in the dmas property.
	These strings correspond 1:1 with the ordered pairs in dmas. The dma
	identifiers must be "rx" and "tx".

Optional properties:
~~~~~~~~~~~~~~~~~~~~
- interrupts : Interrupt numbers for McBSP
- interrupt-names : Known interrupt names are "rx" and "tx"

- pinctrl-0: Should specify pin control group used for this controller.
- pinctrl-names: Should contain only one value - "default", for more details
        please refer to pinctrl-bindings.txt

Example (AM1808):
~~~~~~~~~~~~~~~~~

mcbsp0: mcbsp@1d10000 {
	compatible = "ti,da850-mcbsp";
	pinctrl-names = "default";
	pinctrl-0 = <&mcbsp0_pins>;

	reg = 	<0x00110000 0x1000>,
		<0x00310000 0x1000>;
	reg-names = "mpu", "dat";
	interrupts = <97 98>;
	interrupts-names = "rx", "tx";
	dmas = <&edma0 3 1
		&edma0 2 1>;
	dma-names = "tx", "rx";
	status = "okay";
};
```

## Documentation/devicetree/bindings/sound/davinci-mcbsp.yaml
```yaml
# SPDX-License-Identifier: (GPL-2.0-only OR BSD-2-Clause)
%YAML 1.2
---
$id: http://devicetree.org/schemas/sound/davinci-mcbsp.yaml#
$schema: http://devicetree.org/meta-schemas/core.yaml#

title: McBSP Controller for TI SoCs

maintainers:
  - Bastien Curutchet <bastien.curutchet@bootlin.com>

allOf:
  - $ref: dai-common.yaml#

properties:
  compatible:
    enum:
      - ti,da850-mcbsp

  reg:
    minItems: 1
    items:
      - description: CFG registers
      - description: data registers

  reg-names:
    minItems: 1
    items:
      - const: mpu
      - const: dat

  dmas:
    items:
      - description: transmission DMA channel
      - description: reception DMA channel

  dma-names:
    items:
      - const: tx
      - const: rx

  interrupts:
    items:
      - description: RX interrupt
      - description: TX interrupt

  interrupt-names:
    items:
      - const: rx
      - const: tx

  clocks:
    minItems: 1
    items:
      - description: functional clock
      - description: external input clock for sample rate generator.

  clock-names:
    minItems: 1
    items:
      - const: fck
      - const: clks

  power-domains:
    maxItems: 1

  "#sound-dai-cells":
    const: 0

  ti,T1-framing-tx:
    $ref: /schemas/types.yaml#/definitions/flag
    description:
      If the property is present, tx data delay is set to 2 bit clock periods.
      McBSP will insert a blank period (high-impedance period) before the first
      data bit. This can be used to interface to T1-framing devices.

  ti,T1-framing-rx:
    $ref: /schemas/types.yaml#/definitions/flag
    description:
      If the property is present, rx data delay is set to 2 bit clock periods.
      McBSP will discard the bit preceding the data stream (called framing bit).
      This can be used to interface to T1-framing devices.

required:
  - "#sound-dai-cells"
  - compatible
  - reg
  - reg-names
  - dmas
  - dma-names
  - clocks

unevaluatedProperties: false

examples:
  - |
    mcbsp0@1d10000 {
      #sound-dai-cells = <0>;
      compatible = "ti,da850-mcbsp";
      pinctrl-names = "default";
      pinctrl-0 = <&mcbsp0_pins>;

      reg = <0x111000 0x1000>,
            <0x311000 0x1000>;
      reg-names = "mpu", "dat";
      interrupts = <97>, <98>;
      interrupt-names = "rx", "tx";
      dmas = <&edma0 3 1>,
             <&edma0 2 1>;
      dma-names = "tx", "rx";

      clocks = <&psc1 14>;
    };
```

## Documentation/devicetree/bindings/sound/designware-i2s.txt
```
DesignWare I2S controller

Required properties:
 - compatible : Must be "snps,designware-i2s"
 - reg : Must contain the I2S core's registers location and length
 - clocks : Pairs of phandle and specifier referencing the controller's
   clocks. The controller expects one clock: the clock used as the sampling
   rate reference clock sample.
 - clock-names : "i2sclk" for the sample rate reference clock.
 - dmas: Pairs of phandle and specifier for the DMA channels that are used by
   the core. The core expects one or two dma channels: one for transmit and
   one for receive.
 - dma-names : "tx" for the transmit channel, "rx" for the receive channel.

Optional properties:
 - interrupts: The interrupt line number for the I2S controller. Add this
   parameter if the I2S controller that you are using does not support DMA.

For more details on the 'dma', 'dma-names', 'clock' and 'clock-names'
properties please check:
	* resource-names.txt
	* clock/clock-bindings.txt
	* dma/dma.txt

Example:

	soc_i2s: i2s@7ff90000 {
		compatible = "snps,designware-i2s";
		reg = <0x0 0x7ff90000 0x0 0x1000>;
		clocks = <&scpi_i2sclk 0>;
		clock-names = "i2sclk";
		#sound-dai-cells = <0>;
		dmas = <&dma0 5>;
		dma-names = "tx";
	};
```
