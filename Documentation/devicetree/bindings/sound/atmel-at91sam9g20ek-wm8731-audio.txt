## Documentation/devicetree/bindings/sound/atmel-at91sam9g20ek-wm8731-audio.txt
```
* Atmel at91sam9g20ek wm8731 audio complex

Required properties:
  - compatible: "atmel,at91sam9g20ek-wm8731-audio"
  - atmel,model: The user-visible name of this sound complex.
  - atmel,audio-routing: A list of the connections between audio components.
  - atmel,ssc-controller: The phandle of the SSC controller
  - atmel,audio-codec: The phandle of the WM8731 audio codec
Optional properties:
  - pinctrl-names, pinctrl-0: Please refer to pinctrl-bindings.txt

Example:
sound {
	compatible = "atmel,at91sam9g20ek-wm8731-audio";
	pinctrl-names = "default";
	pinctrl-0 = <&pinctrl_pck0_as_mck>;

	atmel,model = "wm8731 @ AT91SAMG20EK";

	atmel,audio-routing =
		"Ext Spk", "LHPOUT",
		"Int MIC", "MICIN";

	atmel,ssc-controller = <&ssc0>;
	atmel,audio-codec = <&wm8731>;
};
```

## Documentation/devicetree/bindings/sound/atmel-classd.txt
```
* Atmel ClassD driver under ALSA SoC architecture

Required properties:
- compatible
	Should be "atmel,sama5d2-classd".
- reg
	Should contain ClassD registers location and length.
- interrupts
	Should contain the IRQ line for the ClassD.
- dmas
	One DMA specifiers as described in atmel-dma.txt and dma.txt files.
- dma-names
	Must be "tx".
- clock-names
	Tuple listing input clock names.
	Required elements: "pclk", "gclk" and "aclk".
- clocks
	Please refer to clock-bindings.txt.

Optional properties:
- pinctrl-names, pinctrl-0
	Please refer to pinctrl-bindings.txt.
- atmel,model
	The user-visible name of this sound complex.
	The default value is "CLASSD".
- atmel,pwm-type
	PWM modulation type, "single" or "diff".
	The default value is "single".
- atmel,non-overlap-time
	Set non-overlapping time, the unit is nanosecond(ns).
	There are four values,
	<5>, <10>, <15>, <20>, the default value is <10>.
	Non-overlapping will be disabled if not specified.

Example:
classd: classd@fc048000 {
		compatible = "atmel,sama5d2-classd";
		reg = <0xfc048000 0x100>;
		interrupts = <59 IRQ_TYPE_LEVEL_HIGH 7>;
		dmas = <&dma0
			(AT91_XDMAC_DT_MEM_IF(0) | AT91_XDMAC_DT_PER_IF(1)
			| AT91_XDMAC_DT_PERID(47))>;
		dma-names = "tx";
		clocks = <&classd_clk>, <&classd_gclk>, <&audio_pll_pmc>;
		clock-names = "pclk", "gclk", "aclk";

		pinctrl-names = "default";
		pinctrl-0 = <&pinctrl_classd_default>;
		atmel,model = "classd @ SAMA5D2-Xplained";
		atmel,pwm-type = "diff";
		atmel,non-overlap-time = <10>;
};
```

## Documentation/devicetree/bindings/sound/atmel-i2s.txt
```
* Atmel I2S controller

Required properties:
- compatible:     Should be "atmel,sama5d2-i2s".
- reg:            Should be the physical base address of the controller and the
                  length of memory mapped region.
- interrupts:     Should contain the interrupt for the controller.
- dmas:           Should be one per channel name listed in the dma-names property,
                  as described in atmel-dma.txt and dma.txt files.
- dma-names:      Two dmas have to be defined, "tx" and "rx".
                  This IP also supports one shared channel for both rx and tx;
                  if this mode is used, one "rx-tx" name must be used.
- clocks:         Must contain an entry for each entry in clock-names.
                  Please refer to clock-bindings.txt.
- clock-names:    Should be one of each entry matching the clocks phandles list:
                  - "pclk" (peripheral clock) Required.
                  - "gclk" (generated clock) Optional (1).
                  - "muxclk" (I2S mux clock) Optional (1).

Optional properties:
- pinctrl-0:      Should specify pin control groups used for this controller.
- princtrl-names: Should contain only one value - "default".


(1) : Only the peripheral clock is required. The generated clock and the I2S
      mux clock are optional and should only be set together, when Master Mode
      is required.

Example:

	i2s@f8050000 {
		compatible = "atmel,sama5d2-i2s";
		reg = <0xf8050000 0x300>;
		interrupts = <54 IRQ_TYPE_LEVEL_HIGH 7>;
		dmas = <&dma0
			(AT91_XDMAC_DT_MEM_IF(0) | AT91_XDMAC_DT_PER_IF(1) |
			 AT91_XDMAC_DT_PERID(31))>,
		       <&dma0
			(AT91_XDMAC_DT_MEM_IF(0) | AT91_XDMAC_DT_PER_IF(1) |
			 AT91_XDMAC_DT_PERID(32))>;
		dma-names = "tx", "rx";
		clocks = <&i2s0_clk>, <&i2s0_gclk>, <&i2s0muxck>;
		clock-names = "pclk", "gclk", "muxclk";
		pinctrl-names = "default";
		pinctrl-0 = <&pinctrl_i2s0_default>;
	};
```

## Documentation/devicetree/bindings/sound/atmel-pdmic.txt
```
* Atmel PDMIC driver under ALSA SoC architecture

Required properties:
- compatible
	Should be "atmel,sama5d2-pdmic".
- reg
	Should contain PDMIC registers location and length.
- interrupts
	Should contain the IRQ line for the PDMIC.
- dmas
	One DMA specifiers as described in atmel-dma.txt and dma.txt files.
- dma-names
	Must be "rx".
- clock-names
	Required elements:
	- "pclk"	peripheral clock
	- "gclk"	generated clock
- clocks
	Must contain an entry for each required entry in clock-names.
	Please refer to clock-bindings.txt.
- atmel,mic-min-freq
	The minimal frequency that the micphone supports.
- atmel,mic-max-freq
	The maximal frequency that the micphone supports.

Optional properties:
- pinctrl-names, pinctrl-0
	Please refer to pinctrl-bindings.txt.
- atmel,model
	The user-visible name of this sound card.
	The default value is "PDMIC".
- atmel,mic-offset
	The offset that should be added.
	The range is from -32768 to 32767.
	The default value is 0.

Example:
	pdmic@f8018000 {
				compatible = "atmel,sama5d2-pdmic";
				reg = <0xf8018000 0x124>;
				interrupts = <48 IRQ_TYPE_LEVEL_HIGH 7>;
				dmas = <&dma0
					(AT91_XDMAC_DT_MEM_IF(0) | AT91_XDMAC_DT_PER_IF(1)
					| AT91_XDMAC_DT_PERID(50))>;
				dma-names = "rx";
				clocks = <&pdmic_clk>, <&pdmic_gclk>;
				clock-names = "pclk", "gclk";

				pinctrl-names = "default";
				pinctrl-0 = <&pinctrl_pdmic_default>;
				atmel,model = "PDMIC @ sama5d2_xplained";
				atmel,mic-min-freq = <1000000>;
				atmel,mic-max-freq = <3246000>;
				atmel,mic-offset = <0x0>;
	};
```

## Documentation/devicetree/bindings/sound/atmel-sam9x5-wm8731-audio.txt
```
* Atmel at91sam9x5ek wm8731 audio complex

Required properties:
  - compatible: "atmel,sam9x5-wm8731-audio"
  - atmel,model: The user-visible name of this sound complex.
  - atmel,ssc-controller: The phandle of the SSC controller
  - atmel,audio-codec: The phandle of the WM8731 audio codec
  - atmel,audio-routing: A list of the connections between audio components.
    Each entry is a pair of strings, the first being the connection's sink,
    the second being the connection's source.

Available audio endpoints for the audio-routing table:

Board connectors:
 * Headphone Jack
 * Line In Jack

wm8731 pins:
cf Documentation/devicetree/bindings/sound/wlf,wm8731.yaml

Example:
sound {
	compatible = "atmel,sam9x5-wm8731-audio";

	atmel,model = "wm8731 @ AT91SAM9X5EK";

	atmel,audio-routing =
		"Headphone Jack", "RHPOUT",
		"Headphone Jack", "LHPOUT",
		"LLINEIN", "Line In Jack",
		"RLINEIN", "Line In Jack";

	atmel,ssc-controller = <&ssc0>;
	atmel,audio-codec = <&wm8731>;
};
```

## Documentation/devicetree/bindings/sound/atmel-wm8904.txt
```
Atmel ASoC driver with wm8904 audio codec complex

Required properties:
  - compatible: "atmel,asoc-wm8904"
  - atmel,model: The user-visible name of this sound complex.
  - atmel,audio-routing: A list of the connections between audio components.
    Each entry is a pair of strings, the first being the connection's sink,
    the second being the connection's source. Valid names for sources and
    sinks are the WM8904's pins, and the jacks on the board:

    WM8904 pins:

    * IN1L
    * IN1R
    * IN2L
    * IN2R
    * IN3L
    * IN3R
    * HPOUTL
    * HPOUTR
    * LINEOUTL
    * LINEOUTR
    * MICBIAS

    Board connectors:

    * Headphone Jack
    * Line In Jack
    * Mic

  - atmel,ssc-controller: The phandle of the SSC controller
  - atmel,audio-codec: The phandle of the WM8904 audio codec

Optional properties:
  - pinctrl-names, pinctrl-0: Please refer to pinctrl-bindings.txt

Example:
sound {
	compatible = "atmel,asoc-wm8904";
	pinctrl-names = "default";
	pinctrl-0 = <&pinctrl_pck0_as_mck>;

	atmel,model = "wm8904 @ AT91SAM9N12EK";

	atmel,audio-routing =
		"Headphone Jack", "HPOUTL",
		"Headphone Jack", "HPOUTR",
		"IN2L", "Line In Jack",
		"IN2R", "Line In Jack",
		"Mic", "MICBIAS",
		"IN1L", "Mic";

	atmel,ssc-controller = <&ssc0>;
	atmel,audio-codec = <&wm8904>;
};
```

## Documentation/devicetree/bindings/sound/atmel_ac97c.txt
```
* Atmel AC97 controller

Required properties:
  - compatible: "atmel,at91sam9263-ac97c"
  - reg: Address and length of the register set for the device
  - interrupts: Should contain AC97 interrupt
  - ac97-gpios: Please refer to soc-ac97link.txt, only ac97-reset is used
Optional properties:
  - pinctrl-names, pinctrl-0: Please refer to pinctrl-bindings.txt

Example:
sound@fffa0000 {
       compatible = "atmel,at91sam9263-ac97c";
       pinctrl-names = "default";
       pinctrl-0 = <&pinctrl_ac97>;
       reg = <0xfffa0000 0x4000>;
       interrupts = <18 IRQ_TYPE_LEVEL_HIGH 5>;

       ac97-gpios = <&pioB 0 0 &pioB 2 0 &pioC 29 GPIO_ACTIVE_LOW>;
};
```

## Documentation/devicetree/bindings/sound/audio-graph-card.txt
```
Audio Graph Card:

Audio Graph Card specifies audio DAI connections of SoC <-> codec.
It is based on common bindings for device graphs.
see ${LINUX}/Documentation/devicetree/bindings/graph.txt

Basically, Audio Graph Card property is same as Simple Card.
see ${LINUX}/Documentation/devicetree/bindings/sound/simple-card.yaml

Below are same as Simple-Card.

- label
- widgets
- routing
- dai-format
- frame-master
- bitclock-master
- bitclock-inversion
- frame-inversion
- mclk-fs
- hp-det-gpio
- mic-det-gpio
- dai-tdm-slot-num
- dai-tdm-slot-width
- clocks / system-clock-frequency

Required properties:

- compatible				: "audio-graph-card";
- dais					: list of CPU DAI port{s}

Optional properties:
- pa-gpios: GPIO used to control external amplifier.

-----------------------
Example: Single DAI case
-----------------------

	sound_card {
		compatible = "audio-graph-card";

		dais = <&cpu_port>;
	};

	dai-controller {
		...
		cpu_port: port {
			cpu_endpoint: endpoint {
				remote-endpoint = <&codec_endpoint>;

				dai-format = "left_j";
				...
			};
		};
	};

	audio-codec {
		...
		port {
			codec_endpoint: endpoint {
				remote-endpoint = <&cpu_endpoint>;
			};
		};
	};

-----------------------
Example: Multi DAI case
-----------------------

	sound-card {
		compatible = "audio-graph-card";

		label = "sound-card";

		dais = <&cpu_port0
			&cpu_port1
			&cpu_port2>;
	};

	audio-codec@0 {
		...
		port {
			codec0_endpoint: endpoint {
				remote-endpoint = <&cpu_endpoint0>;
			};
		};
	};

	audio-codec@1 {
		...
		port {
			codec1_endpoint: endpoint {
				remote-endpoint = <&cpu_endpoint1>;
			};
		};
	};

	audio-codec@2 {
		...
		port {
			codec2_endpoint: endpoint {
				remote-endpoint = <&cpu_endpoint2>;
			};
		};
	};

	dai-controller {
		...
		ports {
			cpu_port0: port@0 {
				cpu_endpoint0: endpoint {
					remote-endpoint = <&codec0_endpoint>;

					dai-format = "left_j";
					...
				};
			};
			cpu_port1: port@1 {
				cpu_endpoint1: endpoint {
					remote-endpoint = <&codec1_endpoint>;

					dai-format = "i2s";
					...
				};
			};
			cpu_port2: port@2 {
				cpu_endpoint2: endpoint {
					remote-endpoint = <&codec2_endpoint>;

					dai-format = "i2s";
					...
				};
			};
		};
	};


-----------------------
Example: Sampling Rate Conversion
-----------------------

	sound_card {
		compatible = "audio-graph-card";

		label = "sound-card";
		prefix = "codec";
		routing = "codec Playback", "DAI0 Playback",
			  "DAI0 Capture",   "codec Capture";
		convert-rate = <48000>;

		dais = <&cpu_port>;
	};

	audio-codec {
		...
		port {
			codec_endpoint: endpoint {
				remote-endpoint = <&cpu_endpoint>;
			};
		};
	};

	dai-controller {
		...
		cpu_port: port {
			cpu_endpoint: endpoint {
				remote-endpoint = <&codec_endpoint>;

				dai-format = "left_j";
				...
			};
		};
	};

-----------------------
Example: 2 CPU 1 Codec (Mixing)
-----------------------

	sound_card {
		compatible = "audio-graph-card";

		label = "sound-card";
		routing = "codec Playback", "DAI0 Playback",
			  "codec Playback", "DAI1 Playback",
			  "DAI0 Capture",   "codec Capture";

		dais = <&cpu_port>;
	};

	audio-codec {
		...

		audio-graph-card,prefix = "codec";
		audio-graph-card,convert-rate = <48000>;
		port {
			reg = <0>;
			codec_endpoint0: endpoint@0 {
				remote-endpoint = <&cpu_endpoint0>;
			};
			codec_endpoint1: endpoint@1 {
				remote-endpoint = <&cpu_endpoint1>;
			};
		};
	};

	dai-controller {
		...
		cpu_port: port {
			cpu_endpoint0: endpoint@0 {
				remote-endpoint = <&codec_endpoint0>;

				dai-format = "left_j";
				...
			};
			cpu_endpoint1: endpoint@1 {
				remote-endpoint = <&codec_endpoint1>;

				dai-format = "left_j";
				...
			};
		};
	};

-----------------------
Example: Multi DAI with DPCM
-----------------------

	CPU0 ------ ak4613
	CPU1 ------ HDMI
	CPU2 ------ PCM3168A-p	/* DPCM 1ch/2ch */
	CPU3 --/		/* DPCM 3ch/4ch */
	CPU4 --/		/* DPCM 5ch/6ch */
	CPU5 --/		/* DPCM 7ch/8ch */
	CPU6 ------ PCM3168A-c

	sound_card: sound {
		compatible = "audio-graph-card";

		label = "sound-card";

		routing =	"pcm3168a Playback", "DAI2 Playback",
				"pcm3168a Playback", "DAI3 Playback",
				"pcm3168a Playback", "DAI4 Playback",
				"pcm3168a Playback", "DAI5 Playback";

		dais = <&snd_port0	/* ak4613 */
			&snd_port1	/* HDMI0  */
			&snd_port2	/* pcm3168a playback */
			&snd_port3	/* pcm3168a capture  */
			>;
	};

	ak4613: codec@10 {
		...
		port {
			ak4613_endpoint: endpoint {
				remote-endpoint = <&rsnd_endpoint0>;
			};
		};
	};

	pcm3168a: audio-codec@44 {
		...
		audio-graph-card,prefix = "pcm3168a";
		audio-graph-card,convert-channels = <8>; /* TDM Split */
		ports {
			port@0 {
				reg = <0>;
				pcm3168a_endpoint_p1: endpoint@1 {
					remote-endpoint = <&rsnd_endpoint2>;
					...
				};
				pcm3168a_endpoint_p2: endpoint@2 {
					remote-endpoint = <&rsnd_endpoint3>;
					...
				};
				pcm3168a_endpoint_p3: endpoint@3 {
					remote-endpoint = <&rsnd_endpoint4>;
					...
				};
				pcm3168a_endpoint_p4: endpoint@4 {
					remote-endpoint = <&rsnd_endpoint5>;
					...
				};
			};
			port@1 {
				reg = <1>;
				pcm3168a_endpoint_c: endpoint {
					remote-endpoint = <&rsnd_endpoint6>;
					...
				};
			};
		};
	};

	&sound {
		ports {
			snd_port0: port@0 {
				rsnd_endpoint0: endpoint {
					remote-endpoint = <&ak4613_endpoint>;
					...
				};
			};
			snd_port1: port@1 {
				rsnd_endpoint1: endpoint {
					remote-endpoint = <&dw_hdmi0_snd_in>;
					...
				};
			};
			snd_port2: port@2 {
				#address-cells = <1>;
				#size-cells = <0>;
				rsnd_endpoint2: endpoint@2 {
					remote-endpoint = <&pcm3168a_endpoint_p1>;
					...
				};
				rsnd_endpoint3: endpoint@3 {
					remote-endpoint = <&pcm3168a_endpoint_p2>;
					...
				};
				rsnd_endpoint4: endpoint@4 {
					remote-endpoint = <&pcm3168a_endpoint_p3>;
					...
				};
				rsnd_endpoint5: endpoint@5 {
					remote-endpoint = <&pcm3168a_endpoint_p4>;
					...
				};
			};
			snd_port3: port@6 {
				rsnd_endpoint6: endpoint {
					remote-endpoint = <&pcm3168a_endpoint_c>;
					...
				};
			};
		};
	};
```
