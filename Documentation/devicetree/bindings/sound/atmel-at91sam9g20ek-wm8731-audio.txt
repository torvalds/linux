## Documentation/devicetree/bindings/sound/awinic,aw88395.yaml
```yaml
# SPDX-License-Identifier: (GPL-2.0-only OR BSD-2-Clause)
%YAML 1.2
---
$id: http://devicetree.org/schemas/sound/awinic,aw88395.yaml#
$schema: http://devicetree.org/meta-schemas/core.yaml#

title: Awinic AW88395 Smart Audio Amplifier

maintainers:
  - Weidong Wang <wangweidong.a@awinic.com>

description:
  The Awinic AW88395 is an I2S/TDM input, high efficiency
  digital Smart K audio amplifier with an integrated 10.25V
  smart boost convert.

properties:
  compatible:
    enum:
      - awinic,aw88081
      - awinic,aw88083
      - awinic,aw88261
      - awinic,aw88395
      - awinic,aw88399

  reg:
    maxItems: 1

  '#sound-dai-cells':
    const: 0

  reset-gpios:
    maxItems: 1

  awinic,audio-channel:
    description:
      It is used to distinguish multiple PA devices, so that different
      configurations can be loaded to different PA devices
    $ref: /schemas/types.yaml#/definitions/uint32
    minimum: 0
    maximum: 7

  awinic,sync-flag:
    description:
      Flag bit used to keep the phase synchronized in the case of multiple PA
    $ref: /schemas/types.yaml#/definitions/flag

required:
  - compatible
  - reg
  - '#sound-dai-cells'
  - awinic,audio-channel

allOf:
  - $ref: dai-common.yaml#
  - if:
      properties:
        compatible:
          contains:
            enum:
              - awinic,aw88081
              - awinic,aw88083
              - awinic,aw88261
    then:
      properties:
        reset-gpios: false

unevaluatedProperties: false

examples:
  - |
    #include <dt-bindings/gpio/gpio.h>
    i2c {
        #address-cells = <1>;
        #size-cells = <0>;
        audio-codec@34 {
            compatible = "awinic,aw88395";
            reg = <0x34>;
            #sound-dai-cells = <0>;
            reset-gpios = <&gpio 10 GPIO_ACTIVE_LOW>;
            awinic,audio-channel = <0>;
            awinic,sync-flag;
        };
    };
```

## Documentation/devicetree/bindings/sound/awinic,aw8898.yaml
```yaml
# SPDX-License-Identifier: (GPL-2.0-only OR BSD-2-Clause)
%YAML 1.2
---
$id: http://devicetree.org/schemas/sound/awinic,aw8898.yaml#
$schema: http://devicetree.org/meta-schemas/core.yaml#

title: Awinic AW8898 Audio Amplifier

maintainers:
  - Luca Weiss <luca@lucaweiss.eu>

description:
  The AW8898 is an I2S/TDM input, high efficiency digital Smart K audio
  amplifier with an integrated 9.5V smart boost converter, sound quality
  enhancement algorithms and speaker protection.

allOf:
  - $ref: dai-common.yaml#

properties:
  compatible:
    const: awinic,aw8898

  reg:
    maxItems: 1

  reset-gpios:
    maxItems: 1

  interrupts:
    maxItems: 1

  dvdd-supply:
    description:
      Digital power supply

  vddio-supply:
    description:
      Digital IO power supply

  vdd-supply:
    description:
      Battery power supply

  "#sound-dai-cells":
    const: 0

required:
  - compatible
  - reg
  - reset-gpios
  - dvdd-supply
  - vddio-supply
  - vdd-supply
  - "#sound-dai-cells"

unevaluatedProperties: false

examples:
  - |
    #include <dt-bindings/gpio/gpio.h>
    #include <dt-bindings/interrupt-controller/irq.h>

    i2c {
        #address-cells = <1>;
        #size-cells = <0>;

        audio-codec@34 {
            compatible = "awinic,aw8898";
            reg = <0x34>;
            reset-gpios = <&tlmm 21 GPIO_ACTIVE_LOW>;
            interrupts-extended = <&tlmm 20 IRQ_TYPE_LEVEL_HIGH>;
            dvdd-supply = <&pm8953_l5>;
            vddio-supply = <&pm8953_l5>;
            vdd-supply = <&vph_pwr>;
            #sound-dai-cells = <0>;
        };
    };
```

## Documentation/devicetree/bindings/sound/axentia,tse850-pcm5142.txt
```
Devicetree bindings for the Axentia TSE-850 audio complex

Required properties:
  - compatible: "axentia,tse850-pcm5142"
  - axentia,cpu-dai: The phandle of the cpu dai.
  - axentia,audio-codec: The phandle of the PCM5142 codec.
  - axentia,add-gpios: gpio specifier that controls the mixer.
  - axentia,loop1-gpios: gpio specifier that controls loop relays on channel 1.
  - axentia,loop2-gpios: gpio specifier that controls loop relays on channel 2.
  - axentia,ana-supply: Regulator that supplies the output amplifier. Must
    support voltages in the 2V - 20V range, in 1V steps.

The schematics explaining the gpios are as follows:

               loop1 relays
   IN1 +---o  +------------+  o---+ OUT1
            \                /
             +              +
             |   /          |
             +--o  +--.     |
             |  add   |     |
             |        V     |
             |      .---.   |
   DAC +----------->|Sum|---+
             |      '---'   |
             |              |
             +              +

   IN2 +---o--+------------+--o---+ OUT2
               loop2 relays

The 'loop1' gpio pin controlls two relays, which are either in loop position,
meaning that input and output are directly connected, or they are in mixer
position, meaning that the signal is passed through the 'Sum' mixer. Similarly
for 'loop2'.

In the above, the 'loop1' relays are inactive, thus feeding IN1 to the mixer
(if 'add' is active) and feeding the mixer output to OUT1. The 'loop2' relays
are active, short-cutting the TSE-850 from channel 2. IN1, IN2, OUT1 and OUT2
are TSE-850 connectors and DAC is the PCB name of the (filtered) output from
the PCM5142 codec.

Example:

	&ssc0 {
		#sound-dai-cells = <0>;

	};

	&i2c {
		codec: pcm5142@4c {
			compatible = "ti,pcm5142";

			reg = <0x4c>;

			AVDD-supply = <&reg_3v3>;
			DVDD-supply = <&reg_3v3>;
			CPVDD-supply = <&reg_3v3>;

			clocks = <&sck>;

			pll-in = <3>;
			pll-out = <6>;
		};
	};

	ana: ana-reg {
		compatible = "pwm-regulator";

		regulator-name = "ANA";

		pwms = <&pwm0 2 1000 PWM_POLARITY_INVERTED>;
		pwm-dutycycle-unit = <1000>;
		pwm-dutycycle-range = <100 1000>;

		regulator-min-microvolt = <2000000>;
		regulator-max-microvolt = <20000000>;
		regulator-ramp-delay = <1000>;
	};

	sound {
		compatible = "axentia,tse850-pcm5142";

		axentia,cpu-dai = <&ssc0>;
		axentia,audio-codec = <&codec>;

		axentia,add-gpios = <&pioA 8 GPIO_ACTIVE_LOW>;
		axentia,loop1-gpios = <&pioA 10 GPIO_ACTIVE_LOW>;
		axentia,loop2-gpios = <&pioA 11 GPIO_ACTIVE_LOW>;

		axentia,ana-supply = <&ana>;
	};
```

## Documentation/devicetree/bindings/sound/brcm,bcm2835-i2s.txt
```
* Broadcom BCM2835 SoC I2S/PCM module

Required properties:
- compatible: "brcm,bcm2835-i2s"
- reg: Should contain PCM registers location and length.
- clocks: the (PCM) clock to use
- dmas: List of DMA controller phandle and DMA request line ordered pairs.
- dma-names: Identifier string for each DMA request line in the dmas property.
  These strings correspond 1:1 with the ordered pairs in dmas.

  One of the DMA channels will be responsible for transmission (should be
  named "tx") and one for reception (should be named "rx").

Example:

bcm2835_i2s: i2s@7e203000 {
	compatible = "brcm,bcm2835-i2s";
	reg = <0x7e203000 0x24>;
	clocks = <&clocks BCM2835_CLOCK_PCM>;

	dmas = <&dma 2>,
	       <&dma 3>;
	dma-names = "tx", "rx";
};
```

## Documentation/devicetree/bindings/sound/brcm,bcm2835-i2s.yaml
```yaml
# SPDX-License-Identifier: (GPL-2.0-only OR BSD-2-Clause)
%YAML 1.2
---
$id: http://devicetree.org/schemas/sound/brcm,bcm2835-i2s.yaml#
$schema: http://devicetree.org/meta-schemas/core.yaml#

title: Broadcom BCM2835 SoC I2S/PCM module

maintainers:
  - Florian Fainelli <florian.fainelli@broadcom.com>

properties:
  compatible:
    const: brcm,bcm2835-i2s

  reg:
    maxItems: 1

  clocks:
    maxItems: 1

  dmas:
    items:
      - description: Transmission DMA controller phandle and request line.
      - description: Reception DMA controller phandle and request line.

  dma-names:
    items:
      - const: tx
      - const: rx

required:
  - compatible
  - reg
  - clocks
  - dmas
  - dma-names

additionalProperties: false

examples:
  - |
    #include <dt-bindings/clock/bcm2835.h>

    i2s@7e203000 {
        compatible = "brcm,bcm2835-i2s";
        reg = <0x7e203000 0x24>;
        clocks = <&clocks BCM2835_CLOCK_PCM>;
        dmas = <&dma 2>, <&dma 3>;
        dma-names = "tx", "rx";
    };
```

## Documentation/devicetree/bindings/sound/brcm,bcm63xx-audio.txt
```
Broadcom DSL/PON BCM63xx Audio I2S controller

Required properties:
- compatible:     Should be "brcm,bcm63xx-i2s".
- #address-cells: 32bit valued, 1 cell.
- #size-cells:    32bit valued, 0 cell.
- reg:            Should contain audio registers location and length
- interrupts:     Should contain the interrupt for the controller.
- clocks:         Must contain an entry for each entry in clock-names.
                  Please refer to clock-bindings.txt.
- clock-names:    One of each entry matching the clocks phandles list:
                  - "i2sclk" (generated clock) Required.
                  - "i2sosc" (fixed 200MHz clock) Required.

(1) : The generated clock is required only when any of TX and RX
      works on Master Mode.
(2) : The fixed 200MHz clock is from internal chip and always on

Example:

		i2s: bcm63xx-i2s {
			#address-cells = <1>;
			#size-cells = <0>;
			compatible = "brcm,bcm63xx-i2s";
			reg = <0xFF802080 0xFF>;
			interrupts = <GIC_SPI 84 IRQ_TYPE_LEVEL_HIGH>;
			clocks = <&i2sclk>, <&osc>;
			clock-names = "i2sclk","i2sosc";
		};
```

## Documentation/devicetree/bindings/sound/brcm,cygnus-audio.txt
```
BROADCOM Cygnus Audio I2S/TDM/SPDIF controller

Required properties:
	- compatible : "brcm,cygnus-audio"
	- #address-cells: 32bit valued, 1 cell.
	- #size-cells:  32bit valued, 0 cell.
	- reg : Should contain audio registers location and length
	- reg-names: names of the registers listed in "reg" property
		Valid names are "aud" and "i2s_in". "aud" contains a
		set of DMA, I2S_OUT and SPDIF registers. "i2s_in" contains
		a set of I2S_IN registers.
	- clocks: PLL and leaf clocks used by audio ports
	- assigned-clocks: PLL and leaf clocks
	- assigned-clock-parents: parent clocks of the assigned clocks
		(usually the PLL)
	- assigned-clock-rates: List of clock frequencies of the
		assigned clocks
	- clock-names: names of 3 leaf clocks used by audio ports
		Valid names are "ch0_audio", "ch1_audio", "ch2_audio"
	- interrupts: audio DMA interrupt number

SSP Subnode properties:
- reg: The index of ssp port interface to use
	Valid value are 0, 1, 2, or 3 (for spdif)

Example:
	cygnus_audio: audio@180ae000 {
		compatible = "brcm,cygnus-audio";
		#address-cells = <1>;
		#size-cells = <0>;
		reg = <0x180ae000 0xafd>, <0x180aec00 0x1f8>;
		reg-names = "aud", "i2s_in";
		clocks = <&audiopll BCM_CYGNUS_AUDIOPLL_CH0>,
				<&audiopll BCM_CYGNUS_AUDIOPLL_CH1>,
				<&audiopll BCM_CYGNUS_AUDIOPLL_CH2>;
		assigned-clocks = <&audiopll BCM_CYGNUS_AUDIOPLL>,
							<&audiopll BCM_CYGNUS_AUDIOPLL_CH0>,
							<&audiopll BCM_CYGNUS_AUDIOPLL_CH1>,
							<&audiopll BCM_CYGNUS_AUDIOPLL_CH2>;
		assigned-clock-parents = <&audiopll BCM_CYGNUS_AUDIOPLL>;
		assigned-clock-rates = <1769470191>,
								<0>,
								<0>,
								<0>;
		clock-names = "ch0_audio", "ch1_audio", "ch2_audio";
		interrupts = <GIC_SPI 143 IRQ_TYPE_LEVEL_HIGH>;

		ssp0: ssp_port@0 {
			reg = <0>;
			status = "okay";
		};

		ssp1: ssp_port@1 {
			reg = <1>;
			status = "disabled";
		};

		ssp2: ssp_port@2 {
			reg = <2>;
			status = "disabled";
		};

		spdif: spdif_port@3 {
			reg = <3>;
			status = "disabled";
		};
	};
```

## Documentation/devicetree/bindings/sound/bt-sco.txt
```
Bluetooth-SCO audio CODEC

This device support generic Bluetooth SCO link.

Required properties:

  - compatible : "delta,dfbmcs320" or "linux,bt-sco"

Example:

codec: bt_sco {
	compatible = "delta,dfbmcs320";
};
```

## Documentation/devicetree/bindings/sound/cdns,xtfpga-i2s.txt
```
Bindings for I2S controller built into xtfpga Xtensa bitstreams.

Required properties:
- compatible: shall be "cdns,xtfpga-i2s".
- reg: memory region (address and length) with device registers.
- interrupts: interrupt for the device.
- clocks: phandle to the clk used as master clock. I2S bus clock
  is derived from it.

Examples:

	i2s0: xtfpga-i2s@0d080000 {
		#sound-dai-cells = <0>;
		compatible = "cdns,xtfpga-i2s";
		reg = <0x0d080000 0x40>;
		interrupts = <2 1>;
		clocks = <&cdce706 4>;
	};
```
