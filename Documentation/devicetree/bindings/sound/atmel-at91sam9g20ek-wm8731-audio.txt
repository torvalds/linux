## Documentation/devicetree/bindings/sound/audio-graph-card.yaml
```yaml
# SPDX-License-Identifier: (GPL-2.0-only OR BSD-2-Clause)
%YAML 1.2
---
$id: http://devicetree.org/schemas/sound/audio-graph-card.yaml#
$schema: http://devicetree.org/meta-schemas/core.yaml#

title: Audio Graph Card

maintainers:
  - Kuninori Morimoto <kuninori.morimoto.gx@renesas.com>

allOf:
  - $ref: /schemas/sound/audio-graph.yaml#

properties:
  compatible:
    enum:
      - audio-graph-card
      - audio-graph-scu-card

required:
  - compatible

unevaluatedProperties: false

examples:
  - |
    sound {
        compatible = "audio-graph-card";

        dais = <&cpu_port_a>;
    };

    cpu {
        /*
         * dai-controller own settings
         */

        port {
            cpu_endpoint: endpoint {
                remote-endpoint = <&codec_endpoint>;
                dai-format = "left_j";
            };
        };
    };

    codec {
        /*
         * codec own settings
         */

        port {
            codec_endpoint: endpoint {
                remote-endpoint = <&cpu_endpoint>;
            };
        };
    };
```

## Documentation/devicetree/bindings/sound/audio-graph-card2.yaml
```yaml
# SPDX-License-Identifier: (GPL-2.0-only OR BSD-2-Clause)
%YAML 1.2
---
$id: http://devicetree.org/schemas/sound/audio-graph-card2.yaml#
$schema: http://devicetree.org/meta-schemas/core.yaml#

title: Audio Graph Card2

maintainers:
  - Kuninori Morimoto <kuninori.morimoto.gx@renesas.com>

properties:
  compatible:
    enum:
      - audio-graph-card2
  links:
    $ref: /schemas/types.yaml#/definitions/phandle-array
  label:
    maxItems: 1
  routing:
    $ref: audio-graph.yaml#/properties/routing
  aux-devs:
    description: |
      List of phandles pointing to auxiliary devices, such
      as amplifiers, to be added to the sound card.
    $ref: /schemas/types.yaml#/definitions/phandle-array
  multi:
    type: object
    description: Multi-CPU/Codec node
  dpcm:
    type: object
    description: DPCM node
  codec2codec:
    type: object
    description: Codec to Codec node
  hp-det-gpios:
    $ref: audio-graph.yaml#/properties/hp-det-gpios
  mic-det-gpios:
    $ref: audio-graph.yaml#/properties/mic-det-gpios
  widgets:
    $ref: audio-graph.yaml#/properties/widgets

required:
  - compatible
  - links

additionalProperties: false

...
```

## Documentation/devicetree/bindings/sound/audio-graph-port.yaml
```yaml
# SPDX-License-Identifier: (GPL-2.0-only OR BSD-2-Clause)
%YAML 1.2
---
$id: http://devicetree.org/schemas/sound/audio-graph-port.yaml#
$schema: http://devicetree.org/meta-schemas/core.yaml#

title: Audio Graph Card 'port' Node Bindings

maintainers:
  - Kuninori Morimoto <kuninori.morimoto.gx@renesas.com>

select: false

allOf:
  - $ref: /schemas/graph.yaml#/$defs/port-base

properties:
  prefix:
    description: "device name prefix"
    $ref: /schemas/types.yaml#/definitions/string
  convert-rate:
    $ref: "/schemas/sound/dai-params.yaml#/$defs/dai-sample-rate"
  convert-channels:
    $ref: "/schemas/sound/dai-params.yaml#/$defs/dai-channels"
  convert-sample-format:
    $ref: "/schemas/sound/dai-params.yaml#/$defs/dai-sample-format"

patternProperties:
  "^endpoint(@[0-9a-f]+)?":
    $ref: /schemas/graph.yaml#/$defs/endpoint-base
    unevaluatedProperties: false

    properties:
      mclk-fs:
        description: |
          Multiplication factor between stream rate and codec mclk.
          When defined, mclk-fs property defined in dai-link sub nodes are
          ignored.
        $ref: /schemas/types.yaml#/definitions/uint32
      frame-inversion:
        description: dai-link uses frame clock inversion
        $ref: /schemas/types.yaml#/definitions/flag
      bitclock-inversion:
        description: dai-link uses bit clock inversion
        $ref: /schemas/types.yaml#/definitions/flag
      frame-master:
        description: Indicates dai-link frame master.
        oneOf:
          - $ref: /schemas/types.yaml#/definitions/flag
          - $ref: /schemas/types.yaml#/definitions/phandle
      bitclock-master:
        description: Indicates dai-link bit clock master
        oneOf:
          - $ref: /schemas/types.yaml#/definitions/flag
          - $ref: /schemas/types.yaml#/definitions/phandle

      dai-format:
        description: audio format.
        items:
          enum:
            - i2s
            - right_j
            - left_j
            - dsp_a
            - dsp_b
            - ac97
            - pdm
            - msb
            - lsb
      convert-rate:
        $ref: "/schemas/sound/dai-params.yaml#/$defs/dai-sample-rate"
      convert-channels:
        $ref: "/schemas/sound/dai-params.yaml#/$defs/dai-channels"
      convert-sample-format:
        $ref: "/schemas/sound/dai-params.yaml#/$defs/dai-sample-format"

      dai-tdm-slot-num:
        description: Number of slots in use.
        $ref: /schemas/types.yaml#/definitions/uint32
      dai-tdm-slot-width:
        description: Width in bits for each slot.
        $ref: /schemas/types.yaml#/definitions/uint32
      dai-tdm-slot-width-map:
        description: Mapping of sample widths to slot widths. For hardware
          that cannot support a fixed slot width or a slot width always
          equal to sample width. A matrix of one or more 3-tuples.
        $ref: /schemas/types.yaml#/definitions/uint32-matrix
        items:
          items:
            -
              description: Sample width in bits
              minimum: 8
              maximum: 64
            -
              description: Slot width in bits
              minimum: 8
              maximum: 256
            -
              description: Slot count
              minimum: 1
              maximum: 64

additionalProperties: true
```

## Documentation/devicetree/bindings/sound/audio-graph-scu-card.txt
```
Audio-Graph-SCU-Card:

Audio-Graph-SCU-Card is "Audio-Graph-Card" + "ALSA DPCM".

It is based on common bindings for device graphs.
see ${LINUX}/Documentation/devicetree/bindings/graph.txt

Basically, Audio-Graph-SCU-Card property is same as
Simple-Card / Simple-SCU-Card / Audio-Graph-Card.
see ${LINUX}/Documentation/devicetree/bindings/sound/simple-card.txt
    ${LINUX}/Documentation/devicetree/bindings/sound/simple-scu-card.txt
    ${LINUX}/Documentation/devicetree/bindings/sound/audio-graph-card.txt

Below are same as Simple-Card / Audio-Graph-Card.

- label
- dai-format
- frame-master
- bitclock-master
- bitclock-inversion
- frame-inversion
- dai-tdm-slot-num
- dai-tdm-slot-width
- clocks / system-clock-frequency

Below are same as Simple-SCU-Card.

- convert-rate
- convert-channels
- prefix
- routing

Required properties:

- compatible				: "audio-graph-scu-card";
- dais					: list of CPU DAI port{s}

Example 1. Sampling Rate Conversion

	sound_card {
		compatible = "audio-graph-scu-card";

		label = "sound-card";
		prefix = "codec";
		routing = "codec Playback", "DAI0 Playback",
			"codec Playback", "DAI1 Playback";
		convert-rate = <48000>;

		dais = <&cpu_port>;
	};

	audio-codec {
		...

		port {
			codec_endpoint: endpoint {
				remote-endpoint = <&cpu_endpoint>;
			};
		};
	};

	dai-controller {
		...
		cpu_port: port {
			cpu_endpoint: endpoint {
				remote-endpoint = <&codec_endpoint>;

				dai-format = "left_j";
				...
			};
		};
	};

Example 2. 2 CPU 1 Codec (Mixing)

	sound_card {
		compatible = "audio-graph-scu-card";

		label = "sound-card";
		prefix = "codec";
		routing = "codec Playback", "DAI0 Playback",
			"codec Playback", "DAI1 Playback";
		convert-rate = <48000>;

		dais = <&cpu_port0
			&cpu_port1>;
	};

	audio-codec {
		...

		port {
			codec_endpoint: endpoint {
				remote-endpoint = <&cpu_endpoint0>;
			};
		};
	};

	dai-controller {
		...
		ports {
			cpu_port0: port {
				cpu_endpoint0: endpoint {
					remote-endpoint = <&codec_endpoint>;

					dai-format = "left_j";
					...
				};
			};
			cpu_port1: port {
				cpu_endpoint1: endpoint {
					dai-format = "left_j";
					...
				};
			};
		};
	};
```

## Documentation/devicetree/bindings/sound/audio-graph.yaml
```yaml
# SPDX-License-Identifier: (GPL-2.0-only OR BSD-2-Clause)
%YAML 1.2
---
$id: http://devicetree.org/schemas/sound/audio-graph.yaml#
$schema: http://devicetree.org/meta-schemas/core.yaml#

title: Audio Graph

maintainers:
  - Kuninori Morimoto <kuninori.morimoto.gx@renesas.com>

allOf:
  - $ref: /schemas/sound/dai-params.yaml#

properties:
  dais:
    $ref: /schemas/types.yaml#/definitions/phandle-array
  label:
    maxItems: 1
  prefix:
    description: device name prefix
    $ref: /schemas/types.yaml#/definitions/string
  routing:
    description: |
      A list of the connections between audio components.
      Each entry is a pair of strings, the first being the
      connection's sink, the second being the connection's source.
    $ref: /schemas/types.yaml#/definitions/non-unique-string-array
  widgets:
    description: |
      User specified audio sound widgets.
      Each entry is a pair of strings, the first being the type of
      widget ("Microphone", "Line", "Headphone", "Speaker"), the
      second being the machine specific name for the widget.
    $ref: /schemas/types.yaml#/definitions/non-unique-string-array

  pa-gpios:
    maxItems: 1
  hp-det-gpio:
    maxItems: 1
  mic-det-gpio:
    maxItems: 1

required:
  - dais

additionalProperties: true
```

## Documentation/devicetree/bindings/sound/audio-iio-aux.yaml
```yaml
# SPDX-License-Identifier: (GPL-2.0-only OR BSD-2-Clause)
%YAML 1.2
---
$id: http://devicetree.org/schemas/sound/audio-iio-aux.yaml#
$schema: http://devicetree.org/meta-schemas/core.yaml#

title: Audio IIO auxiliary

maintainers:
  - Herve Codina <herve.codina@bootlin.com>

description:
  Auxiliary device based on Industrial I/O device channels

allOf:
  - $ref: dai-common.yaml#

properties:
  compatible:
    const: audio-iio-aux

  io-channels:
    description:
      Industrial I/O device channels used

  io-channel-names:
    description:
      Industrial I/O channel names related to io-channels.
      These names are used to provides sound controls, widgets and routes names.

  snd-control-invert-range:
    $ref: /schemas/types.yaml#/definitions/uint32-array
    description: |
      A list of 0/1 flags defining whether or not the related channel is
      inverted
    items:
      enum: [0, 1]
      default: 0
      description: |
        Invert the sound control value compared to the IIO channel raw value.
          - 1: The related sound control value is inverted meaning that the
               minimum sound control value correspond to the maximum IIO channel
               raw value and the maximum sound control value correspond to the
               minimum IIO channel raw value.
          - 0: The related sound control value is not inverted meaning that the
               minimum (resp maximum) sound control value correspond to the
               minimum (resp maximum) IIO channel raw value.

required:
  - compatible
  - io-channels
  - io-channel-names

unevaluatedProperties: false

examples:
  - |
    iio-aux {
        compatible = "audio-iio-aux";
        io-channels = <&iio 0>, <&iio 1>, <&iio 2>, <&iio 3>;
        io-channel-names = "CH0", "CH1", "CH2", "CH3";
        /* Invert CH1 and CH2 */
        snd-control-invert-range = <0 1 1 0>;
    };
```

## Documentation/devicetree/bindings/sound/awinic,aw8738.yaml
```yaml
# SPDX-License-Identifier: (GPL-2.0-only OR BSD-2-Clause)
%YAML 1.2
---
$id: http://devicetree.org/schemas/sound/awinic,aw8738.yaml#
$schema: http://devicetree.org/meta-schemas/core.yaml#

title: Awinic AW8738 Audio Amplifier

maintainers:
  - Stephan Gerhold <stephan@gerhold.net>

description:
  The Awinic AW8738 is a simple audio amplifier with different operation modes
  (set using one-wire pulse control). The mode configures the speaker-guard
  function (primarily the power limit for the amplifier).

allOf:
  - $ref: name-prefix.yaml#

properties:
  compatible:
    const: awinic,aw8738

  mode-gpios:
    description:
      GPIO used for one-wire pulse control. The pin is typically called SHDN
      (active-low), but this is misleading since it is actually more than
      just a simple shutdown/enable control.
    maxItems: 1

  awinic,mode:
    description: Operation mode (number of pulses for one-wire pulse control)
    $ref: /schemas/types.yaml#/definitions/uint32
    minimum: 1
    maximum: 7

  sound-name-prefix: true

required:
  - compatible
  - mode-gpios
  - awinic,mode

additionalProperties: false

examples:
  - |
    #include <dt-bindings/gpio/gpio.h>
    audio-amplifier {
        compatible = "awinic,aw8738";
        mode-gpios = <&msmgpio 114 GPIO_ACTIVE_HIGH>;
        awinic,mode = <5>;
        sound-name-prefix = "Speaker Amp";
    };
```

## Documentation/devicetree/bindings/sound/awinic,aw87390.yaml
```yaml
# SPDX-License-Identifier: (GPL-2.0-only OR BSD-2-Clause)
%YAML 1.2
---
$id: http://devicetree.org/schemas/sound/awinic,aw87390.yaml#
$schema: http://devicetree.org/meta-schemas/core.yaml#

title: Awinic Aw87390 Audio Amplifier

maintainers:
  - Weidong Wang <wangweidong.a@awinic.com>

description:
  The awinic aw87390 is specifically designed to improve
  the musical output dynamic range, enhance the overall
  sound quallity, which is a new high efficiency, low
  noise, constant large volume, 6th Smart K audio amplifier.

properties:
  compatible:
    oneOf:
      - enum:
          - awinic,aw87390
      - items:
          - enum:
              - anbernic,rgds-amp
          - const: awinic,aw87391

  reg:
    maxItems: 1

  "#sound-dai-cells":
    const: 0

  awinic,audio-channel:
    description:
      It is used to distinguish multiple PA devices, so that different
      configurations can be loaded to different PA devices
    $ref: /schemas/types.yaml#/definitions/uint32
    minimum: 0
    maximum: 7

required:
  - compatible
  - reg
  - "#sound-dai-cells"

unevaluatedProperties: false

allOf:
  - $ref: dai-common.yaml#
  - if:
      properties:
        compatible:
          contains:
            enum:
              - awinic,aw87390
    then:
      required:
        - awinic,audio-channel

  - if:
      properties:
        compatible:
          contains:
            enum:
              - anbernic,rgds-amp
    then:
      properties:
        vdd-supply: true

examples:
  - |
    i2c {
        #address-cells = <1>;
        #size-cells = <0>;
        audio-codec@58 {
            compatible = "awinic,aw87390";
            reg = <0x58>;
            #sound-dai-cells = <0>;
            awinic,audio-channel = <0>;
        };
    };
```
