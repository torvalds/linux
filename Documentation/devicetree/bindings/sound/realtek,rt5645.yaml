## Documentation/devicetree/bindings/sound/renesas,fsi.txt
```
Renesas FSI

Required properties:
- compatible			: "renesas,fsi2-<soctype>",
				  "renesas,sh_fsi2" or "renesas,sh_fsi" as
				  fallback.
				  Examples with soctypes are:
				    - "renesas,fsi2-r8a7740" (R-Mobile A1)
				    - "renesas,fsi2-sh73a0" (SH-Mobile AG5)
- reg				: Should contain the register physical address and length
- interrupts			: Should contain FSI interrupt

- fsia,spdif-connection		: FSI is connected by S/PDIF
- fsia,stream-mode-support	: FSI supports 16bit stream mode.
- fsia,use-internal-clock	: FSI uses internal clock when master mode.

- fsib,spdif-connection		: same as fsia
- fsib,stream-mode-support	: same as fsia
- fsib,use-internal-clock	: same as fsia

Example:

sh_fsi2: sh_fsi2@ec230000 {
	compatible = "renesas,sh_fsi2";
	reg = <0xec230000 0x400>;
	interrupts = <0 146 0x4>;

	fsia,spdif-connection;
	fsia,stream-mode-support;
	fsia,use-internal-clock;
};
```

## Documentation/devicetree/bindings/sound/renesas,fsi.yaml
```yaml
# SPDX-License-Identifier: GPL-2.0
%YAML 1.2
---
$id: http://devicetree.org/schemas/sound/renesas,fsi.yaml#
$schema: http://devicetree.org/meta-schemas/core.yaml#

title: Renesas FIFO-buffered Serial Interface (FSI)

maintainers:
  - Kuninori Morimoto <kuninori.morimoto.gx@renesas.com>

properties:
  $nodename:
    pattern: "^sound@.*"

  compatible:
    oneOf:
      # for FSI2 SoC
      - items:
          - enum:
              - renesas,fsi2-sh73a0  # SH-Mobile AG5
              - renesas,fsi2-r8a7740 # R-Mobile A1
          - enum:
              - renesas,sh_fsi2
      # for Generic
      - items:
          - enum:
              - renesas,sh_fsi
              - renesas,sh_fsi2

  reg:
    maxItems: 1

  interrupts:
    maxItems: 1

  clocks:
    minItems: 1
    items:
      - description: Main FSI module clock
      - description: |
          SPU bus/bridge clock. On R8A7740, this clock must be enabled to allow
          register access as the FSI block is connected behind the SPU bus.
      - description: CPG DIV6 functional clocks for FSI port A
      - description: CPG DIV6 functional clocks for FSI port B
      - description: FSI dividers for port A used for audio clock generation
      - description: FSI dividers for port B used for audio clock generation
      - description: External clock inputs for FSI port A provided by the board
      - description: External clock inputs for FSI port B provided by the board

  clock-names:
    minItems: 1
    maxItems: 8
    items:
      enum:
        - fck  # Main FSI module clock
        - spu  # optional SPU bus/bridge clock
        - icka # optional CPG DIV6 functional clocks for FSI port A
        - ickb # optional CPG DIV6 functional clocks for FSI port B
        - diva # optional FSI dividers for port A used for audio clock generation
        - divb # optional FSI dividers for port B used for audio clock generation
        - xcka # optional External clock inputs for FSI port A provided by the board
        - xckb # optional External clock inputs for FSI port B provided by the board

  power-domains:
    maxItems: 1

  '#sound-dai-cells':
    const: 1

patternProperties:
  "^fsi(a|b),spdif-connection$":
    $ref: /schemas/types.yaml#/definitions/flag
    description: FSI is connected by S/PDIF

  "^fsi(a|b),stream-mode-support$":
    $ref: /schemas/types.yaml#/definitions/flag
    description: FSI supports 16bit stream mode

  "^fsi(a|b),use-internal-clock$":
    $ref: /schemas/types.yaml#/definitions/flag
    description: FSI uses internal clock when master mode

required:
  - compatible
  - reg
  - interrupts
  - clocks
  - power-domains
  - '#sound-dai-cells'

unevaluatedProperties: false

allOf:
  - $ref: dai-common.yaml#
  - if:
      properties:
        compatible:
          contains:
            const: renesas,fsi2-r8a7740
    then:
      required:
        - clock-names

      properties:
        clock-names:
          minItems: 2
          items:
            - const: fck
            - const: spu
            - enum: [icka, ickb, diva, divb, xcka, xckb]
            - enum: [icka, ickb, diva, divb, xcka, xckb]
            - enum: [icka, ickb, diva, divb, xcka, xckb]
            - enum: [icka, ickb, diva, divb, xcka, xckb]
            - enum: [icka, ickb, diva, divb, xcka, xckb]
            - enum: [icka, ickb, diva, divb, xcka, xckb]

examples:
  - |
    #include <dt-bindings/clock/r8a7740-clock.h>
    #include <dt-bindings/interrupt-controller/arm-gic.h>
    sh_fsi2: sound@fe1f0000 {
            compatible = "renesas,fsi2-r8a7740", "renesas,sh_fsi2";
            reg = <0xfe1f0000 0x400>;
            interrupts = <GIC_SPI 9 0x4>;
            clocks = <&mstp3_clks R8A7740_CLK_FSI>, <&spu_clk>,
                    <&fsia_clk>, <&fsiack_clk>, <&fsidiva_clk>,
                    <&fsib_clk>, <&fsibck_clk>, <&fsidivb_clk>;
            clock-names = "fck", "spu", "icka", "xcka", "diva",
                         "ickb", "xckb", "divb";
            power-domains = <&pd_a4mp>;

            #sound-dai-cells = <1>;
            fsia,spdif-connection;
            fsia,stream-mode-support;
            fsia,use-internal-clock;
    };
```

## Documentation/devicetree/bindings/sound/renesas,idt821034.yaml
```yaml
# SPDX-License-Identifier: (GPL-2.0-only OR BSD-2-Clause)
%YAML 1.2
---
$id: http://devicetree.org/schemas/sound/renesas,idt821034.yaml#
$schema: http://devicetree.org/meta-schemas/core.yaml#

title: Renesas IDT821034 codec device

maintainers:
  - Herve Codina <herve.codina@bootlin.com>

description: |
  The IDT821034 codec is a four channel PCM codec with onchip filters and
  programmable gain setting.

  The time-slots used by the codec must be set and so, the properties
  'dai-tdm-slot-num', 'dai-tdm-slot-width', 'dai-tdm-slot-tx-mask' and
  'dai-tdm-slot-rx-mask' must be present in the ALSA sound card node for
  sub-nodes that involve the codec. The codec uses one 8bit time-slot per
  channel.
  'dai-tdm-tdm-slot-with' must be set to 8.

  The IDT821034 codec also supports 5 gpios (SLIC signals) per channel.

allOf:
  - $ref: /schemas/spi/spi-peripheral-props.yaml#
  - $ref: dai-common.yaml#

properties:
  compatible:
    const: renesas,idt821034

  reg:
    description:
      SPI device address.
    maxItems: 1

  spi-max-frequency:
    maximum: 8192000

  spi-cpha: true

  '#sound-dai-cells':
    const: 0

  '#gpio-cells':
    const: 2

  gpio-controller: true

required:
  - compatible
  - reg
  - spi-cpha
  - '#sound-dai-cells'
  - gpio-controller
  - '#gpio-cells'

unevaluatedProperties: false

examples:
  - |
    spi {
        #address-cells = <1>;
        #size-cells = <0>;
        audio-codec@0 {
            compatible = "renesas,idt821034";
            reg = <0>;
            spi-max-frequency = <8192000>;
            spi-cpha;
            #sound-dai-cells = <0>;
            gpio-controller;
            #gpio-cells = <2>;
        };
    };
```
