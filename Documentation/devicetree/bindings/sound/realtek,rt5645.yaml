## Documentation/devicetree/bindings/sound/rockchip,i2s-tdm.txt
```
* Rockchip I2S/TDM controller

Required properties:

- compatible: should be one of the following
   - "rockchip,px30-i2s-tdm": for px30
   - "rockchip,rk1808-i2s-tdm": for rk1808
   - "rockchip,rk3308-i2s-tdm": for rk3308
   - "rockchip,rk3568-i2s-tdm": for rk3568
   - "rockchip,rv1126-i2s-tdm": for rv1126
- reg: physical base address of the controller and length of memory mapped
  region.
- interrupts: should contain the I2S interrupt.
- dmas: DMA specifiers for tx and rx dma. See the DMA client binding,
	Documentation/devicetree/bindings/dma/dma.txt
- dma-names: should include "tx" and "rx".
- clocks: a list of phandle + clock-specifer pairs, one for each entry in clock-names.
- clock-names: clock names.
- rockchip,bclk-fs: configure the bclk fs.
- resets: a list of phandle + reset-specifer paris, one for each entry in reset-names.
- reset-names: reset names, should include "tx-m", "rx-m".
- rockchip,cru: cru phandle.
- rockchip,grf: the phandle of the syscon node for GRF register.
- rockchip,mclk-calibrate: enable mclk source calibration.
- rockchip,clk-trcm: tx and rx lrck/bclk common use.
   - 0: both tx_lrck/bclk and rx_lrck/bclk are used
   - 1: only tx_lrck/bclk is used
   - 2: only rx_lrck/bclk is used
- rockchip,no-dmaengine: This is a boolean property. If present, driver will do not
  register pcm dmaengine, only just register dai. if the dai is part of multi-dais,
  the property should be present. Please refer to rockchip,multidais.txt about
  multi-dais usage.
- rockchip,playback-only: Specify that the controller only has playback capability.
- rockchip,capture-only: Specify that the controller only has capture capability.

Optional properties:
- rockchip,i2s-rx-route: This is a variable length array, that shows the mapping
  route of i2s rx sdis to I2S data bus. By default, they are one-to-one mapping:
  * sdi_0 <-- data_0
  * sdi_1 <-- data_1
  * sdi_2 <-- data_2
  * sdi_3 <-- data_3
  If you would like to change the order of I2S RX data, the route mapping may
  like this:
  * sdi_3 <-- data_0
  * sdi_1 <-- data_1
  * sdi_2 <-- data_2
  * sdi_0 <-- data_3
  You need to add the property for i2s node on dts:
  - rockchip,i2s-rx-route = <3 1 2 0>;

- rockchip,i2s-tx-route: This is a variable length array, that shows the mapping
  route of i2s tx sdos to I2S data bus. By default, they are one-to-one mapping:
  * sdo_0 --> data_0
  * sdo_1 --> data_1
  * sdo_2 --> data_2
  * sdo_3 --> data_3
  If you would like to change the order of I2S TX data, the route mapping may
  like this:
  * sdo_2 --> data_0
  * sdo_1 --> data_1
  * sdo_0 --> data_2
  * sdo_3 --> data_3
  You need to add the property for i2s node on dts:
  - rockchip,i2s-tx-route = <2 1 0 3>;

- rockchip,tdm-fsync-half-frame: This is a boolean value, if present, use half
  frame fsync.

Example for rk3308 I2S/TDM controller:

i2s_8ch_0: i2s@ff300000 {
	compatible = "rockchip,rk3308-i2s-tdm";
	reg = <0x0 0xff300000 0x0 0x1000>;
	interrupts = <GIC_SPI 48 IRQ_TYPE_LEVEL_HIGH>;
	clocks = <&cru SCLK_I2S0_8CH_TX>, <&cru SCLK_I2S0_8CH_RX>, <&cru HCLK_I2S0_8CH>;
	clock-names = "mclk_tx", "mclk_rx", "hclk";
	dmas = <&dmac1 0>, <&dmac1 1>;
	dma-names = "tx", "rx";
	resets = <&cru SRST_I2S0_8CH_TX_M>, <&cru SRST_I2S0_8CH_RX_M>;
	reset-names = "tx-m", "rx-m";
	rockchip,cru = <&cru>;
	rockchip,clk-trcm = <1>;
	pinctrl-names = "default";
	pinctrl-0 = <&i2s_8ch_0_sclktx
		     &i2s_8ch_0_sclkrx
		     &i2s_8ch_0_lrcktx
		     &i2s_8ch_0_lrckrx
		     &i2s_8ch_0_sdi0
		     &i2s_8ch_0_sdi1
		     &i2s_8ch_0_sdi2
		     &i2s_8ch_0_sdi3
		     &i2s_8ch_0_sdo0
		     &i2s_8ch_0_sdo1
		     &i2s_8ch_0_sdo2
		     &i2s_8ch_0_sdo3
		     &i2s_8ch_0_mclk>;
	status = "disabled";
};
```

## Documentation/devicetree/bindings/sound/rockchip,i2s-tdm.yaml
```yaml
# SPDX-License-Identifier: (GPL-2.0-only OR BSD-2-Clause)
%YAML 1.2
---
$id: http://devicetree.org/schemas/sound/rockchip,i2s-tdm.yaml#
$schema: http://devicetree.org/meta-schemas/core.yaml#

title: Rockchip I2S/TDM Controller

description:
  The Rockchip I2S/TDM Controller is a Time Division Multiplexed
  audio interface found in various Rockchip SoCs, allowing up
  to 8 channels of audio over a serial interface.

maintainers:
  - Nicolas Frattaroli <frattaroli.nicolas@gmail.com>

allOf:
  - $ref: dai-common.yaml#

properties:
  compatible:
    enum:
      - rockchip,px30-i2s-tdm
      - rockchip,rk1808-i2s-tdm
      - rockchip,rk3308-i2s-tdm
      - rockchip,rk3568-i2s-tdm
      - rockchip,rk3588-i2s-tdm
      - rockchip,rv1126-i2s-tdm

  reg:
    maxItems: 1

  interrupts:
    maxItems: 1

  dmas:
    minItems: 1
    maxItems: 2

  dma-names:
    minItems: 1
    maxItems: 2
    items:
      enum:
        - rx
        - tx

  clocks:
    minItems: 3
    items:
      - description: clock for TX
      - description: clock for RX
      - description: AHB clock driving the interface
      - description:
          Parent clock for mclk_tx (only required when using mclk-calibrate)
      - description:
          Parent clock for mclk_rx (only required when using mclk-calibrate)
      - description:
          Clock for sample rates that are an integer multiple of 8000
          (only required when using mclk-calibrate)
      - description:
          Clock for sample rates that are an integer multiple of 11025
          (only required when using mclk-calibrate)

  clock-names:
    minItems: 3
    items:
      - const: mclk_tx
      - const: mclk_rx
      - const: hclk
      - const: mclk_tx_src
      - const: mclk_rx_src
      - const: mclk_root0
      - const: mclk_root1

  resets:
    minItems: 1
    maxItems: 2
    description: resets for the tx and rx directions

  reset-names:
    minItems: 1
    maxItems: 2
    items:
      enum:
        - tx-m
        - rx-m

  rockchip,grf:
    $ref: /schemas/types.yaml#/definitions/phandle
    description:
      The phandle of the syscon node for the GRF register.

  rockchip,trcm-sync-tx-only:
    type: boolean
    description: Use TX BCLK/LRCK for both TX and RX.

  rockchip,trcm-sync-rx-only:
    type: boolean
    description: Use RX BCLK/LRCK for both TX and RX.

  "#sound-dai-cells":
    const: 0

  rockchip,i2s-rx-route:
    $ref: /schemas/types.yaml#/definitions/uint32-array
    description:
      Defines the mapping of I2S RX sdis to I2S data bus lines.
      By default, they are mapped one-to-one.
      rockchip,i2s-rx-route = <3> would mean sdi3 is receiving from data0.
    maxItems: 4
    items:
      enum: [0, 1, 2, 3]

  rockchip,i2s-tx-route:
    $ref: /schemas/types.yaml#/definitions/uint32-array
    description:
      Defines the mapping of I2S TX sdos to I2S data bus lines.
      By default, they are mapped one-to-one.
      rockchip,i2s-tx-route = <3> would mean sdo3 is sending to data0.
    maxItems: 4
    items:
      enum: [0, 1, 2, 3]

  rockchip,io-multiplex:
    description:
      Specify that the GPIO lines on the I2S bus are multiplexed such that
      the direction (input/output) needs to be dynamically adjusted.
    type: boolean


required:
  - compatible
  - reg
  - interrupts
  - dmas
  - dma-names
  - clocks
  - clock-names
  - resets
  - reset-names
  - "#sound-dai-cells"

unevaluatedProperties: false

examples:
  - |
    #include <dt-bindings/clock/rk3568-cru.h>
    #include <dt-bindings/interrupt-controller/arm-gic.h>
    #include <dt-bindings/interrupt-controller/irq.h>
    #include <dt-bindings/pinctrl/rockchip.h>

    bus {
        #address-cells = <2>;
        #size-cells = <2>;
        i2s@fe410000 {
            compatible = "rockchip,rk3568-i2s-tdm";
            reg = <0x0 0xfe410000 0x0 0x1000>;
            interrupts = <GIC_SPI 53 IRQ_TYPE_LEVEL_HIGH>;
            clocks = <&cru MCLK_I2S1_8CH_TX>, <&cru MCLK_I2S1_8CH_RX>,
                     <&cru HCLK_I2S1_8CH>;
            clock-names = "mclk_tx", "mclk_rx", "hclk";
            dmas = <&dmac1 3>, <&dmac1 2>;
            dma-names = "rx", "tx";
            resets = <&cru SRST_M_I2S1_8CH_TX>, <&cru SRST_M_I2S1_8CH_RX>;
            reset-names = "tx-m", "rx-m";
            rockchip,trcm-sync-tx-only;
            rockchip,grf = <&grf>;
            #sound-dai-cells = <0>;
            pinctrl-names = "default";
            pinctrl-0 =
                <&i2s1m0_sclktx
                &i2s1m0_sclkrx
                &i2s1m0_lrcktx
                &i2s1m0_lrckrx
                &i2s1m0_sdi0
                &i2s1m0_sdi1
                &i2s1m0_sdi2
                &i2s1m0_sdi3
                &i2s1m0_sdo0
                &i2s1m0_sdo1
                &i2s1m0_sdo2
                &i2s1m0_sdo3>;
        };
    };
```

## Documentation/devicetree/bindings/sound/rockchip,multicodecs.txt
```
ROCKCHIP multicodecs audio

Required properties:
- compatible: "rockchip,multicodecs-card"
- rockchip,cpu: The phandle of the Rockchip I2S/PDM controller that's
  connected to the CODEC
- rockchip,codec: The phandle of audio codecs

Optional properties:
- rockchip,card-name: User specified audio sound card name, one string property.
- rockchip,codec-hp-det : Detect the headphone via internal codec.
- rockchip,wait-card-locked : This is a variable length array, user specified
			      these sound cards need to be prepared and locked,
			      otherwise the local slave card can be probed.
- rockchip,audio-routing : sound card dapm routing.
- hp-det-gpio : headphone detect gpio.
- io-channels : headset mic/key detect adc channel.
- io-channel-names : headset mic/key adc channel name.
- spk-con-gpio : speaker enable/disabled gpio.
- hp-con-gpio : headphone enable/disabled gpio.
- keyup-threshold-microvolt: keyup-threshold-microvolt uV.
- poll-interval : headset adc key poller internal ms.
- play-pause-key : PLAYPAUSE key, can define the other key like vol+/vol- and so on.


Optional dai-link subnode properties:
- rockchip,format			: CPU/CODEC common audio format.
					  "i2s", "right_j", "left_j" , "dsp_a"
					  "dsp_b", "ac97", "pdm", "msb", "lsb".
- rockchip,frame-master			: Indicates dai-link frame master.
					  phandle to a cpu or codec subnode.
- rockchip,bitclock-master		: Indicates dai-link bit clock master.
					  phandle to a cpu or codec subnode.
- rockchip,bitclock-inversion		: bool property. Add this if the
					  dai-link uses bit clock inversion.
- rockchip,frame-inversion		: bool property. Add this if the
					  dai-link uses frame clock inversion.
- rockchip,mclk-fs     			: Multiplication factor between stream
					  rate and codec mclk, applied only for
					  the dai-link.

Example:

sound {
	compatible = "rockchip,multicodecs-card";
	rockchip,mclk-fs = <256>;
	rockchip,cpu = <&i2s0_8ch>;
	rockchip,codec = <&codec>, <&vad>;
};

Example 2 :

es8388_sound: es8388-sound {
	status = "okay";
	compatible = "rockchip,multicodecs-card";
	rockchip,card-name = "rockchip-es8388";
	hp-det-gpio = <&gpio1 RK_PD5 GPIO_ACTIVE_LOW>;
	io-channels = <&saradc 3>;
	io-channel-names = "adc-detect";
	spk-con-gpio = <&gpio1 RK_PD3 GPIO_ACTIVE_HIGH>;
	hp-con-gpio = <&gpio1 RK_PD2 GPIO_ACTIVE_HIGH>;
	rockchip,format = "i2s";
	rockchip,mclk-fs = <256>;
	rockchip,cpu = <&i2s0_8ch>;
	rockchip,codec = <&es8388>;
	rockchip,audio-routing =
                        "Headphone", "LOUT1",
                        "Headphone", "ROUT1",
                        "Speaker", "LOUT2",
                        "Speaker", "ROUT2",
                        "Headphone", "Headphone Power",
                        "Headphone", "Headphone Power",
                        "Speaker", "Speaker Power",
                        "Speaker", "Speaker Power",
                        "LINPUT1", "Main Mic",
                        "LINPUT2", "Main Mic",
                        "RINPUT1", "Headset Mic",
                        "RINPUT2", "Headset Mic";
        pinctrl-names = "default";
        pinctrl-0 = <&hp_det>;
        keyup-threshold-microvolt = <1800000>;
        poll-interval = <100>;
        play-pause-key{
                label = "playpause";
                linux,code = <KEY_PLAYPAUSE>;
                press-threshold-microvolt = <2000>;
	};
};
```
