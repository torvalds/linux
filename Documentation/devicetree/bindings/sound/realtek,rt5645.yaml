## Documentation/devicetree/bindings/sound/realtek,rt5645.yaml
```yaml
# SPDX-License-Identifier: GPL-2.0-only OR BSD-2-Clause
%YAML 1.2
---
$id: http://devicetree.org/schemas/sound/realtek,rt5645.yaml#
$schema: http://devicetree.org/meta-schemas/core.yaml#

title: RT5650/RT5645 audio CODEC

maintainers:
  - Animesh Agarwal <animeshagarwal28@gmail.com>

description: |
  This device supports I2C only.

  Pins on the device (for linking into audio routes) for RT5645/RT5650:
    * DMIC L1
    * DMIC R1
    * DMIC L2
    * DMIC R2
    * IN1P
    * IN1N
    * IN2P
    * IN2N
    * Haptic Generator
    * HPOL
    * HPOR
    * LOUTL
    * LOUTR
    * PDM1L
    * PDM1R
    * SPOL
    * SPOR

allOf:
  - $ref: dai-common.yaml#

properties:
  compatible:
    enum:
      - realtek,rt5645
      - realtek,rt5650

  reg:
    maxItems: 1

  interrupts:
    maxItems: 1
    description: The CODEC's interrupt output.

  avdd-supply:
    description: Power supply for AVDD, providing 1.8V.

  cpvdd-supply:
    description: Power supply for CPVDD, providing 3.5V.

  hp-detect-gpios:
    description: 
      A GPIO spec for the external headphone detect pin. If jd-mode = 0, we
      will get the JD status by getting the value of hp-detect-gpios.
    maxItems: 1

  cbj-sleeve-gpios:
    description:
      A GPIO spec to control the external combo jack circuit to tie the
      sleeve/ring2 contacts to the ground or floating. It could avoid some
      electric noise from the active speaker jacks.
    maxItems: 1

  realtek,in2-differential:
    description:
      Indicate MIC2 input are differential, rather than single-ended.
    type: boolean

  realtek,dmic1-data-pin:
    description: Specify which pin to be used as DMIC1 data pin.
    $ref: /schemas/types.yaml#/definitions/uint32
    enum:
      - 0 # dmic1 is not used
      - 1 # using IN2P pin as dmic1 data pin
      - 2 # using GPIO6 pin as dmic1 data pin
      - 3 # using GPIO10 pin as dmic1 data pin
      - 4 # using GPIO12 pin as dmic1 data pin

  realtek,dmic2-data-pin:
    description: Specify which pin to be used as DMIC2 data pin.
    $ref: /schemas/types.yaml#/definitions/uint32
    enum:
      - 0 # dmic2 is not used
      - 1 # using IN2N pin as dmic2 data pin
      - 2 # using GPIO5 pin as dmic2 data pin
      - 3 # using GPIO11 pin as dmic2 data pin

  realtek,jd-mode:
    description: The JD mode of rt5645/rt5650.
    $ref: /schemas/types.yaml#/definitions/uint32
    enum:
      - 0 # rt5645/rt5650 JD function is not used
      - 1 # Mode-0 (VDD=3.3V), two port jack detection
      - 2 # Mode-1 (VDD=3.3V), one port jack detection
      - 3 # Mode-2 (VDD=1.8V), one port jack detection

required:
  - compatible
  - reg
  - interrupts
  - avdd-supply
  - cpvdd-supply

unevaluatedProperties: false

examples:
  - |
    #include <dt-bindings/gpio/gpio.h>
    #include <dt-bindings/interrupt-controller/irq.h>

    i2c {
        #address-cells = <1>;
        #size-cells = <0>;

        codec@1a {
            compatible = "realtek,rt5650";
            reg = <0x1a>;
            hp-detect-gpios = <&gpio 19 0>;
            cbj-sleeve-gpios = <&gpio 20 0>;
            interrupt-parent = <&gpio>;
            interrupts = <7 IRQ_TYPE_EDGE_FALLING>;
            avdd-supply = <&avdd_reg>;
            cpvdd-supply = <&cpvdd_supply>;
            realtek,jd-mode = <3>;
        };
    };
```

## Documentation/devicetree/bindings/sound/realtek,rt5651.yaml
```yaml
# SPDX-License-Identifier: (GPL-2.0-only OR BSD-2-Clause)
%YAML 1.2
---
$id: http://devicetree.org/schemas/sound/realtek,rt5651.yaml#
$schema: http://devicetree.org/meta-schemas/core.yaml#

title: Realtek RT5651 audio CODEC

maintainers:
  - Bard Liao <bardliao@realtek.com>

description: >
  This device supports I2C only.

  Pins on the device (for linking into audio routes) for RT5651:

    * DMIC L1
    * DMIC R1
    * IN1P
    * IN2P
    * IN2N
    * IN3P
    * HPOL
    * HPOR
    * LOUTL
    * LOUTR
    * PDML
    * PDMR

allOf:
  - $ref: /schemas/sound/dai-common.yaml#

properties:
  compatible:
    const: realtek,rt5651

  reg:
    maxItems: 1

  clocks:
    maxItems: 1

  clock-names:
    const: mclk

  '#sound-dai-cells':
    const: 0

  realtek,in2-differential:
    type: boolean
    description: Indicate MIC2 input are differential, rather than single-ended.

  realtek,dmic-en:
    type: boolean
    description: Indicates DMIC is used.

  realtek,jack-detect-source:
    $ref: /schemas/types.yaml#/definitions/uint32
    description: Select jack-detect input pin.
    enum: [1, 2, 3]

  realtek,jack-detect-not-inverted:
    type: boolean
    description:
      Normal jack-detect switches give an inverted (active-low) signal. Set this
      bool in the rare case you've a jack-detect switch which is not inverted.

  realtek,over-current-threshold-microamp:
    description: Micbias over-current detection threshold in µA.
    enum: [600, 1500, 2000]

  realtek,over-current-scale-factor:
    $ref: /schemas/types.yaml#/definitions/uint32
    description: >
      Micbias over-current detection scale factor:

        0: scale current by 0.5
        1: scale current by 0.75
        2: scale current by 1.0
        3: scale current by 1.5
    enum: [0, 1, 2, 3]

required:
  - compatible
  - reg

additionalProperties: false

examples:
  - |
    i2c {
        #address-cells = <1>;
        #size-cells = <0>;
        codec@1a {
            compatible = "realtek,rt5651";
            reg = <0x1a>;
            realtek,dmic-en;
            realtek,in2-differential;
        };
    };
```

## Documentation/devicetree/bindings/sound/realtek,rt5659.yaml
```yaml
# SPDX-License-Identifier: (GPL-2.0-only OR BSD-2-Clause)
%YAML 1.2
---
$id: http://devicetree.org/schemas/sound/realtek,rt5659.yaml#
$schema: http://devicetree.org/meta-schemas/core.yaml#

title: RT5659/RT5658 audio CODEC

maintainers:
  - Animesh Agarwal <animeshagarwal28@gmail.com>

description: |
  This device supports I2C only.

  Pins on the device (for linking into audio routes) for RT5659/RT5658:
    * DMIC L1
    * DMIC R1
    * DMIC L2
    * DMIC R2
    * IN1P
    * IN1N
    * IN2P
    * IN2N
    * IN3P
    * IN3N
    * IN4P
    * IN4N
    * HPOL
    * HPOR
    * SPOL
    * SPOR
    * LOUTL
    * LOUTR
    * MONOOUT
    * PDML
    * PDMR
    * SPDIF

allOf:
  - $ref: dai-common.yaml#

properties:
  compatible:
    enum:
      - realtek,rt5659
      - realtek,rt5658

  reg:
    maxItems: 1

  interrupts:
    maxItems: 1

  clocks:
    maxItems: 1

  clock-names:
    const: mclk

  realtek,dmic1-data-pin:
    $ref: /schemas/types.yaml#/definitions/uint32
    enum:
      - 0 # dmic1 is not used
      - 1 # using IN2N pin as dmic1 data pin
      - 2 # using GPIO5 pin as dmic1 data pin
      - 3 # using GPIO9 pin as dmic1 data pin
      - 4 # using GPIO11 pin as dmic1 data pin
    description: Specify which pin to be used as DMIC1 data pin.
    default: 0

  realtek,dmic2-data-pin:
    $ref: /schemas/types.yaml#/definitions/uint32
    enum:
      - 0 # dmic2 is not used
      - 1 # using IN2P pin as dmic2 data pin
      - 2 # using GPIO6 pin as dmic2 data pin
      - 3 # using GPIO10 pin as dmic2 data pin
      - 4 # using GPIO12 pin as dmic2 data pin
    description: Specify which pin to be used as DMIC2 data pin.
    default: 0

  realtek,jd-src:
    $ref: /schemas/types.yaml#/definitions/uint32
    enum:
      - 0 # No JD is used
      - 1 # using JD3 as JD source
      - 2 # JD source for Intel HDA header
    description: Specify which JD source be used.
    default: 0

  realtek,ldo1-en-gpios:
    maxItems: 1
    description: CODEC's LDO1_EN pin.

  realtek,reset-gpios:
    maxItems: 1
    description: CODEC's RESET pin.

  ports:
    $ref: /schemas/graph.yaml#/properties/ports

  port:
    $ref: audio-graph-port.yaml#
    unevaluatedProperties: false

required:
  - compatible
  - reg
  - interrupts

unevaluatedProperties: false

examples:
  - |
    #include <dt-bindings/gpio/gpio.h>
    #include <dt-bindings/interrupt-controller/irq.h>

    i2c {
        #address-cells = <1>;
        #size-cells = <0>;

        codec@1b {
            compatible = "realtek,rt5659";
            reg = <0x1b>;
            interrupt-parent = <&gpio>;
            interrupts = <3 IRQ_TYPE_LEVEL_HIGH>;
            realtek,ldo1-en-gpios = <&gpio 3 GPIO_ACTIVE_HIGH>;
        };
    };
```

## Documentation/devicetree/bindings/sound/realtek,rt5677.yaml
```yaml
# SPDX-License-Identifier: (GPL-2.0-only OR BSD-2-Clause)
%YAML 1.2
---
$id: http://devicetree.org/schemas/sound/realtek,rt5677.yaml#
$schema: http://devicetree.org/meta-schemas/core.yaml#

title: RT5677 audio CODEC

maintainers:
  - Animesh Agarwal <animeshagarwal28@gmail.com>

description: |
  This device supports I2C only.

  Pins on the device (for linking into audio routes):
    * IN1P
    * IN1N
    * IN2P
    * IN2N
    * MICBIAS1
    * DMIC1
    * DMIC2
    * DMIC3
    * DMIC4
    * LOUT1
    * LOUT2
    * LOUT3

allOf:
  - $ref: dai-common.yaml#

properties:
  compatible:
    const: realtek,rt5677

  reg:
    maxItems: 1

  interrupts:
    maxItems: 1

  gpio-controller: true

  '#gpio-cells':
    const: 2

  realtek,pow-ldo2-gpio:
    maxItems: 1
    description: CODEC's POW_LDO2 pin.

  realtek,reset-gpio:
    maxItems: 1
    description: CODEC's RESET pin. Active low.

  realtek,gpio-config:
    description: |
      Array of six 8bit elements that configures GPIO.
      0 - floating (reset value)
      1 - pull down
      2 - pull up
    $ref: /schemas/types.yaml#/definitions/uint32-array
    minItems: 6
    maxItems: 6
    items:
      maximum: 2

  realtek,jd1-gpio:
    $ref: /schemas/types.yaml#/definitions/uint32
    enum:
      - 0 # OFF
      - 1 # GPIO1 for jd1.
      - 2 # GPIO2 for jd1.
      - 3 # GPIO3 for jd1.
    description: Configures GPIO Mic Jack detection 1.

  realtek,jd2-gpio:
    $ref: /schemas/types.yaml#/definitions/uint32
    enum:
      - 0 # OFF
      - 1 # GPIO4 for jd2.
      - 2 # GPIO5 for jd2.
      - 3 # GPIO6 for jd2.
    description: Configures GPIO Mic Jack detection 2.

  realtek,jd3-gpio:
    $ref: /schemas/types.yaml#/definitions/uint32
    enum:
      - 0 # OFF
      - 1 # GPIO4 for jd3.
      - 2 # GPIO5 for jd3.
      - 3 # GPIO6 for jd3.
    description: Configures GPIO Mic Jack detection 3.

patternProperties:
  '^realtek,in[1-2]-differential$':
    type: boolean
    description: Indicate MIC1/2 input are differential, rather than
      single-ended.

  '^realtek,lout[1-3]-differential$':
    type: boolean
    description: Indicate LOUT1/2/3 outputs are differential, rather than
      single-ended.

required:
  - compatible
  - reg
  - interrupts
  - gpio-controller
  - '#gpio-cells'

unevaluatedProperties: false

examples:
  - |
    #include <dt-bindings/gpio/gpio.h>
    #include <dt-bindings/interrupt-controller/irq.h>

    i2c {
        #address-cells = <1>;
        #size-cells = <0>;

        codec@2c {
            compatible = "realtek,rt5677";
            reg = <0x2c>;
            interrupt-parent = <&gpio>;
            interrupts = <3 IRQ_TYPE_LEVEL_HIGH>;
            gpio-controller;
            #gpio-cells = <2>;
            realtek,pow-ldo2-gpio = <&gpio 3 GPIO_ACTIVE_HIGH>;
            realtek,reset-gpio = <&gpio 3 GPIO_ACTIVE_LOW>;
            realtek,in1-differential;
            realtek,gpio-config = <0 0 0 0 0 2>;
        };
    };
```

## Documentation/devicetree/bindings/sound/realtek,rt5682s.yaml
```yaml
# SPDX-License-Identifier: (GPL-2.0-only OR BSD-2-Clause)
%YAML 1.2
---
$id: http://devicetree.org/schemas/sound/realtek,rt5682s.yaml#
$schema: http://devicetree.org/meta-schemas/core.yaml#

title: Realtek rt5682s codec

maintainers:
  - Derek Fang <derek.fang@realtek.com>

description: |
  Rt5682s(ALC5682I-VS) is a rt5682i variant which supports I2C only.

allOf:
  - $ref: dai-common.yaml#

properties:
  compatible:
    const: realtek,rt5682s

  reg:
    maxItems: 1
    description: I2C address of the device.

  interrupts:
    maxItems: 1
    description: The CODEC's interrupt output.

  realtek,dmic1-data-pin:
    $ref: /schemas/types.yaml#/definitions/uint32
    enum:
      - 0 # dmic1 data is not used
      - 1 # using GPIO2 pin as dmic1 data pin
      - 2 # using GPIO5 pin as dmic1 data pin
    description: |
      Specify which GPIO pin be used as DMIC1 data pin.

  realtek,dmic1-clk-pin:
    $ref: /schemas/types.yaml#/definitions/uint32
    enum:
      - 0 # dmic1 clk is not used
      - 1 # using GPIO1 pin as dmic1 clock pin
      - 2 # using GPIO3 pin as dmic1 clock pin
    description: |
      Specify which GPIO pin be used as DMIC1 clk pin.

  realtek,jd-src:
    $ref: /schemas/types.yaml#/definitions/uint32
    enum:
      - 0 # No JD is used
      - 1 # using JD1 as JD source
    description: |
      Specify which JD source be used.

  realtek,ldo1-en-gpios:
    description: |
      The GPIO that controls the CODEC's LDO1_EN pin.

  realtek,dmic-clk-rate-hz:
    description: |
      Set the clock rate (hz) for the requirement of the particular DMIC.

  realtek,dmic-delay-ms:
    description: |
      Set the delay time (ms) for the requirement of the particular DMIC.

  realtek,amic-delay-ms:
    description: |
      Set the delay time (ms) for the requirement of the particular platform or AMIC.

  realtek,dmic-clk-driving-high:
    type: boolean
    description: |
      Set the high driving of the DMIC clock out.

  clocks:
    items:
      - description: phandle and clock specifier for codec MCLK.

  clock-names:
    items:
      - const: mclk

  "#clock-cells":
    const: 1

  clock-output-names:
    minItems: 2
    maxItems: 2
    description: Name given for DAI word clock and bit clock outputs.

  "#sound-dai-cells":
    const: 1

  AVDD-supply:
    description: Regulator supplying analog power through the AVDD pin.

  MICVDD-supply:
    description: Regulator supplying power for the microphone bias through the
      MICVDD pin.

  DBVDD-supply:
    description: Regulator supplying I/O power through the DBVDD pin.

  LDO1-IN-supply:
    description: Regulator supplying power to the digital core and charge pump
      through the LDO1_IN pin.

unevaluatedProperties: false

required:
  - compatible
  - reg
  - AVDD-supply
  - MICVDD-supply
  - DBVDD-supply
  - LDO1-IN-supply

examples:
  - |
    #include <dt-bindings/gpio/gpio.h>
    #include <dt-bindings/interrupt-controller/irq.h>

    i2c {
        #address-cells = <1>;
        #size-cells = <0>;

        codec@1a {
            compatible = "realtek,rt5682s";
            reg = <0x1a>;
            interrupts = <6 IRQ_TYPE_LEVEL_HIGH>;
            realtek,ldo1-en-gpios =
                <&gpio 2 GPIO_ACTIVE_HIGH>;
            realtek,dmic1-data-pin = <1>;
            realtek,dmic1-clk-pin = <1>;
            realtek,jd-src = <1>;

            #clock-cells = <1>;
            clock-output-names = "rt5682-dai-wclk", "rt5682-dai-bclk";

            clocks = <&osc>;
            clock-names = "mclk";

            AVDD-supply = <&avdd_reg>;
            MICVDD-supply = <&micvdd_reg>;
            DBVDD-supply = <&dbvdd_reg>;
            LDO1-IN-supply = <&ldo1_in_reg>;
        };
    };
```
