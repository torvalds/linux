## Documentation/devicetree/bindings/sound/renesas,rz-ssi.yaml
```yaml
# SPDX-License-Identifier: (GPL-2.0-only OR BSD-2-Clause)
%YAML 1.2
---
$id: http://devicetree.org/schemas/sound/renesas,rz-ssi.yaml#
$schema: http://devicetree.org/meta-schemas/core.yaml#

title: Renesas RZ/{G2L,V2L} ASoC Sound Serial Interface (SSIF-2)

maintainers:
  - Biju Das <biju.das.jz@bp.renesas.com>

allOf:
  - $ref: dai-common.yaml#

properties:
  compatible:
    items:
      - enum:
          - renesas,r9a07g043-ssi  # RZ/G2UL and RZ/Five
          - renesas,r9a07g044-ssi  # RZ/G2{L,LC}
          - renesas,r9a07g054-ssi  # RZ/V2L
          - renesas,r9a08g045-ssi  # RZ/G3S
      - const: renesas,rz-ssi

  reg:
    maxItems: 1

  interrupts:
    minItems: 2
    maxItems: 3

  interrupt-names:
    oneOf:
      - items:
          - const: int_req
          - const: dma_rx
          - const: dma_tx
      - items:
          - const: int_req
          - const: dma_rt

  clocks:
    maxItems: 4

  clock-names:
    items:
      - const: ssi
      - const: ssi_sfr
      - const: audio_clk1
      - const: audio_clk2

  power-domains:
    maxItems: 1

  resets:
    maxItems: 1

  dmas:
    minItems: 1
    maxItems: 2

  dma-names:
    oneOf:
      - items:
          - const: tx
          - const: rx
      - items:
          - const: rt

  '#sound-dai-cells':
    const: 0

  port:
    $ref: audio-graph-port.yaml#/definitions/port-base
    description: Connection to controller providing I2S signals

required:
  - compatible
  - reg
  - interrupts
  - interrupt-names
  - clocks
  - clock-names
  - resets
  - '#sound-dai-cells'

unevaluatedProperties: false

examples:
  - |
    #include <dt-bindings/interrupt-controller/arm-gic.h>
    #include <dt-bindings/clock/r9a07g044-cpg.h>

    ssi0: ssi@10049c00 {
        compatible = "renesas,r9a07g044-ssi",
                     "renesas,rz-ssi";
            reg = <0x10049c00 0x400>;
            interrupts = <GIC_SPI 326 IRQ_TYPE_LEVEL_HIGH>,
                         <GIC_SPI 327 IRQ_TYPE_EDGE_RISING>,
                         <GIC_SPI 328 IRQ_TYPE_EDGE_RISING>;
            interrupt-names = "int_req", "dma_rx", "dma_tx";
            clocks = <&cpg CPG_MOD R9A07G044_SSI0_PCLK2>,
                     <&cpg CPG_MOD R9A07G044_SSI0_PCLK_SFR>,
                     <&audio_clk1>,
                     <&audio_clk2>;
            clock-names = "ssi", "ssi_sfr", "audio_clk1", "audio_clk2";
            power-domains = <&cpg>;
            resets = <&cpg R9A07G044_SSI0_RST_M2_REG>;
            dmas = <&dmac 0x2655>,
                   <&dmac 0x2656>;
            dma-names = "tx", "rx";
            #sound-dai-cells = <0>;
    };
```

## Documentation/devicetree/bindings/sound/richtek,rt9120.yaml
```yaml
# SPDX-License-Identifier: GPL-2.0
%YAML 1.2
---
$id: http://devicetree.org/schemas/sound/richtek,rt9120.yaml#
$schema: http://devicetree.org/meta-schemas/core.yaml#

title: Richtek RT9120 Class-D audio amplifier

maintainers:
  - ChiYuan Huang <cy_huang@richtek.com>

description: |
  The RT9120 is a high efficiency, I2S-input, stereo audio power amplifier
  delivering 2*20W into 8 Ohm BTL speaker loads. It supports the wide input
  voltage  range from 4.5V to 26.4V to meet the need on most common
  applications like as TV, monitors. home entertainment, electronic music
  equipment.

allOf:
  - $ref: dai-common.yaml#

properties:
  compatible:
    enum:
      - richtek,rt9120

  reg:
    description: I2C device address
    maxItems: 1

  pwdnn-gpios:
    description: GPIO used for power down, low active
    maxItems: 1

  dvdd-supply:
    description: |
      Supply for the default on DVDD power, voltage domain must be 3P3V or 1P8V

  '#sound-dai-cells':
    const: 0

required:
  - compatible
  - reg
  - dvdd-supply
  - '#sound-dai-cells'

unevaluatedProperties: false

examples:
  - |
    i2c {
      #address-cells = <1>;
      #size-cells = <0>;
      rt9120@1a {
        compatible = "richtek,rt9120";
        reg = <0x1a>;
        pwdnn-gpios = <&gpio26 2 0>;
        dvdd-supply = <&vdd_io_reg>;
        #sound-dai-cells = <0>;
      };
    };
```

## Documentation/devicetree/bindings/sound/richtek,rt9123.yaml
```yaml
# SPDX-License-Identifier: GPL-2.0-only OR BSD-2-Clause
%YAML 1.2
---
$id: http://devicetree.org/schemas/sound/richtek,rt9123.yaml#
$schema: http://devicetree.org/meta-schemas/core.yaml#

title: Richtek RT9123/RTQ9124 Audio Amplifier

maintainers:
  - ChiYuan Huang <cy_huang@richtek.com>

description:
  RT9123 is a 3.2W mono Class-D audio amplifier that features high efficiency
  and performance with ultra-low quiescent current. The digital audio interface
  support various formats, including I2S, left-justified, right-justified, and
  TDM formats.

  RTQ9124 is an ultra-low output noise, digital input, mono-channel Class-D
  power amplifier that supports a 2.1MHz switching frequency. It integrates
  both DC and AC load diagnostics, as well as real-time load monitoring to
  assess speaker condition. The device operates from 4.5V to 18V and delivers
  up to 30W output power.

allOf:
  - $ref: dai-common.yaml#

properties:
  compatible:
    enum:
      - richtek,rt9123
      - richtek,rtq9124

  reg:
    maxItems: 1

  '#sound-dai-cells':
    const: 0

  enable-gpios:
    maxItems: 1

required:
  - compatible
  - reg
  - '#sound-dai-cells'

unevaluatedProperties: false

examples:
  - |
    #include <dt-bindings/gpio/gpio.h>

    i2c {
        #address-cells = <1>;
        #size-cells = <0>;

        amplifier@5e {
            compatible = "richtek,rt9123";
            reg = <0x5e>;
            enable-gpios = <&gpio 26 GPIO_ACTIVE_HIGH>;
            #sound-dai-cells = <0>;
        };
    };
```

## Documentation/devicetree/bindings/sound/richtek,rt9123p.yaml
```yaml
# SPDX-License-Identifier: GPL-2.0-only OR BSD-2-Clause
%YAML 1.2
---
$id: http://devicetree.org/schemas/sound/richtek,rt9123p.yaml#
$schema: http://devicetree.org/meta-schemas/core.yaml#

title: Richtek RT9123P Audio Amplifier

maintainers:
  - ChiYuan Huang <cy_huang@richtek.com>

description:
  RT9123P is a RT9123 variant which does not support I2C control.

allOf:
  - $ref: dai-common.yaml#

properties:
  compatible:
    enum:
      - richtek,rt9123p

  '#sound-dai-cells':
    const: 0

  enable-gpios:
    maxItems: 1

  enable-delay-ms:
    description:
      Delay time for 'ENABLE' pin changes intended to make I2S clocks ready to
      prevent speaker pop noise. The unit is in millisecond.

required:
  - compatible
  - '#sound-dai-cells'

unevaluatedProperties: false

examples:
  - |
    #include <dt-bindings/gpio/gpio.h>

    amplifier {
        compatible = "richtek,rt9123p";
        enable-gpios = <&gpio 26 GPIO_ACTIVE_HIGH>;
        #sound-dai-cells = <0>;
    };
```

## Documentation/devicetree/bindings/sound/richtek,rtq9128.yaml
```yaml
# SPDX-License-Identifier: (GPL-2.0 OR BSD-2-Clause)
%YAML 1.2
---
$id: http://devicetree.org/schemas/sound/richtek,rtq9128.yaml#
$schema: http://devicetree.org/meta-schemas/core.yaml#

title: Richtek RTQ9128 Automative Audio Power Amplifier

maintainers:
  - ChiYuan Huang <cy_huang@richtek.com>

description:
  The RTQ9128 is a ultra-low output noise, high-efficiency, four-channel
  class-D audio power amplifier and delivering 4x75W into 4OHm at 10%
  THD+N from a 25V supply in automotive applications.

  The RTQ9154 is the family series of RTQ9128. The major change is to modify
  the package size. Beside this, whole functions are almost all the same.

allOf:
  - $ref: dai-common.yaml#

properties:
  compatible:
    oneOf:
      - enum:
          - richtek,rtq9128
      - items:
          - enum:
              - richtek,rtq9154
          - const: richtek,rtq9128

  reg:
    maxItems: 1

  enable-gpios:
    maxItems: 1

  richtek,tdm-input-data2-select:
    type: boolean
    description:
      By default, if TDM mode is used, TDM data input will select 'DATA1' pin
      as the data source. This option will configure TDM data input source from
      'DATA1' to 'DATA2' pin.

  '#sound-dai-cells':
    const: 0

required:
  - compatible
  - reg
  - '#sound-dai-cells'

unevaluatedProperties: false

examples:
  - |
    #include <dt-bindings/gpio/gpio.h>
    i2c {
      #address-cells = <1>;
      #size-cells = <0>;

      speaker@1a {
        compatible = "richtek,rtq9128";
        reg = <0x1a>;
        enable-gpios = <&gpio 26 GPIO_ACTIVE_HIGH>;
        #sound-dai-cells = <0>;
      };
    };
```

## Documentation/devicetree/bindings/sound/rockchip,audio-pwm.txt
```
* Rockchip Audio PWM controller

Required properties:

- compatible: "rockchip,audio-pwm-v1"
- reg: physical base address of the controller and length of memory mapped
  region.
- dmas: DMA specifiers for tx dma. See the DMA client binding,
	Documentation/devicetree/bindings/dma/dma.txt
- dma-names: should include "tx".
- clocks: a list of phandle + clock-specifer pairs, one for each entry in clock-names.
- clock-names: should contain following:
   - "clk" : clock for Audio PWM controller
   - "hclk": clock for AHB BUS
- pinctrl-names: Must contain a "default" entry.
- pinctrl-N: One property must exist for each entry in
	     pinctrl-names. See ../pinctrl/pinctrl-bindings.txt
	     for details of the property values.

Optional properties:

- rockchip,sample-width-bits: Output sampling data width,the value ranges from 8 to 11 bits.
- rockchip,interpolat-points-cfg: Interpolation rate,the value must be 1/3/7/15 points,
  if this is set,the linear interpolation mode will be turned on.
- spk-ctl-gpios: The gpio of speak controller.

Example for Audio PWM controller:

audpwm: audpwm@ff840000 {
	compatible = "rockchip,audio-pwm-v1";
	reg = <0xff840000 0x1000>;
	clocks = <&cru SCLK_AUDPWM>, <&cru HCLK_AUDPWM>;
	clock-names = "clk", "hclk";
	dmas = <&dmac 26>;
	dma-names = "tx";
	pinctrl-names = "default";
	pinctrl-0 = <&audpwmm0_pins>;
	rockchip,sample-width-bits = <11>;
	rockchip,interpolat-points = <1>;
	spk-ctl-gpios = <&gpio0 RK_PC0 GPIO_ACTIVE_HIGH>;
	status = "disabled";
};
```

## Documentation/devicetree/bindings/sound/rockchip,codec-digital.txt
```
* Rockchip Codec Digital Interface

Required properties:

- compatible: should be one of the following
   - "rockchip,codec-digital-v1"
   - "rockchip,rk3568-codec-digital"
   - "rockchip,rk3588-codec-digital"
   - "rockchip,rv1106-codec-digital"
   - "rockchip,rv1126-codec-digital"
- reg: physical base address of the controller and length of memory mapped
  region.
- clocks: a list of phandle + clock-specifer pairs, one for each entry in clock-names.
- clock-names: clock names.
- rockchip,bclk-fs: configure the bclk fs.
- resets: a list of phandle + reset-specifer paris, one for each entry in reset-names.
- reset-names: reset names, should include "reset".
- rockchip,grf: the phandle of the syscon node for GRF register.

Optional properties:
- rockchip,clk-sync-mode: This is a boolean property, if present, using clk
  sync mode.
- rockchip,pwm-output-mode: This is a boolean property, if present, output pwm
  to drive spk.

Example:

rkacdc_dig: codec-digital@ff850000 {
	compatible = "rockchip,codec-digital-v1";
	reg = <0xff850000 0x1000>;
	clocks = <&cru CLK_ACDCDIG_ADC>, <&cru CLK_ACDCDIG_DAC>,
		 <&cru PCLK_ACDCDIG>;
	clock-names = "adc", "dac", "pclk";
	pinctrl-names = "default";
	pinctrl-0 = <&acodec_pins>;
	resets = <&cru SRST_ACDCDIG>;
	reset-names = "reset" ;
	rockchip,grf = <&grf>;
	status = "disabled";
};
```

## Documentation/devicetree/bindings/sound/rockchip,dummy-codec.txt
```
* Rockchip Dummy Codec

Required properties:

- compatible: "rockchip,dummy-codec"

Example for rk3308 dummy codec:

dummy_codec: dummy-codec {
	compatible = "rockchip,dummy-codec";
};
```

## Documentation/devicetree/bindings/sound/rockchip,hdmi-analog.txt
```
ROCKCHIP Built-in HDMI and external audio codec which use the same
I2S interface(such as RK3368)
Use simple-audio-card can be if only HDMI or codec ic

Required properties:
- compatible: "rockchip,rk3368-hdmi-analog"
- rockchip,cpu: The phandle of the Rockchip I2S controller that's
  connected to the CODEC
- rockchip,codec: The phandle of audio codecs, should contain both
  codec ic and HDMI

Example:

sound {
	compatible = "rockchip,rk3368-hdmi-analog";
	rockchip,cpu = <&i2s_8ch>;
	rockchip,codec = <&es8316>, <&hdmi>;
	rockchip,widgets = "Microphone", "Mic Jack",
			   "Headphone", "Headphone Jack";
	rockchip,routing = "Mic Jack", "micbias",
			   "Headphone Jack", "HPOL",
			   "Headphone Jack", "HPOR";
};
```

## Documentation/devicetree/bindings/sound/rockchip,hdmi-dp.txt
```
ROCKCHIP Built-in HDMI and DP audio

Required properties:
- compatible: "rockchip,rk3399-hdmi-dp"
- rockchip,cpu: The phandle of the Rockchip I2S controller that's
  connected to the CODEC
- rockchip,codec: The phandle of audio codecs, should contain HDMI
  or DP, or both.

Example:

sound {
	compatible = "rockchip,rk3399-hdmi-dp";
	rockchip,cpu = <&i2s2>;
	rockchip,codec = <&hdmi>, <&cdn_dp>;
};
```
