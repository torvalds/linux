## Documentation/devicetree/bindings/sound/madera.txt
```
Cirrus Logic Madera class audio codecs

This describes audio configuration bindings for these codecs.

See also the core bindings for the parent MFD driver:
See Documentation/devicetree/bindings/mfd/madera.txt

and defines for values used in these bindings:
include/dt-bindings/sound/madera.h

These properties are all contained in the parent MFD node.

Optional properties:
  - cirrus,dmic-ref : Indicates how the MICBIAS pins have been externally
    connected to DMICs on each input, one cell per input.
    <IN1 IN2 IN3 ...>
    A value of 0 indicates MICVDD and is the default, other values depend on the
    codec:
    For CS47L35 one of the CS47L35_DMIC_REF_xxx values
    For all other codecs one of the MADERA_DMIC_REF_xxx values
    Also see the datasheet for a description of the INn_DMIC_SUP field.

  - cirrus,inmode : A list of input mode settings for each input. A maximum of
    16 cells, with four cells per input in the order INnAL, INnAR INnBL INnBR.
    For non-muxed inputs the first two cells for that input set the mode for
    the left and right channel and the second two cells must be 0.
    For muxed inputs the first two cells for that input set the mode of the
    left and right A inputs and the second two cells set the mode of the left
    and right B inputs.
    Valid mode values are one of the MADERA_INMODE_xxx. If the array is shorter
    than the number of inputs the unspecified inputs default to
    MADERA_INMODE_DIFF.

  - cirrus,out-mono : Mono bit for each output, maximum of six cells if the
    array is shorter outputs will be set to stereo.

  - cirrus,max-channels-clocked : Maximum number of channels that I2S clocks
    will be generated for. Useful when clock master for systems where the I2S
    bus has multiple data lines.
    One cell for each AIF, use a value of zero for AIFs that should be handled
    normally.

  - cirrus,pdm-fmt : PDM speaker data format, must contain 2 cells
    (OUT5 and OUT6). See the PDM_SPKn_FMT field in the datasheet for a
    description of this value.
    The second cell is ignored for codecs that do not have OUT6.

  - cirrus,pdm-mute : PDM mute format, must contain 2 cells
    (OUT5 and OUT6). See the PDM_SPKn_CTRL_1 register in the datasheet for a
    description of this value.
    The second cell is ignored for codecs that do not have OUT6.

Example:

cs47l35@0 {
	compatible = "cirrus,cs47l35";

	cirrus,dmic-ref = <0 0 CS47L35_DMIC_REF_MICBIAS1B 0>;
	cirrus,inmode = <
		MADERA_INMODE_DMIC MADERA_INMODE_DMIC /* IN1A digital */
		MADERA_INMODE_SE   MADERA_INMODE_SE   /* IN1B single-ended */
		MADERA_INMODE_DIFF MADERA_INMODE_DIFF /* IN2 differential */
		0 0 	/* not used on this codec */
	>;
	cirrus,out-mono = <0 0 0 0 0 0>;
	cirrus,max-channels-clocked = <2 0 0>;
};
```

## Documentation/devicetree/bindings/sound/marvell,mmp-sspa.yaml
```yaml
# SPDX-License-Identifier: (GPL-2.0+ OR BSD-2-Clause)
%YAML 1.2
---
$id: http://devicetree.org/schemas/sound/marvell,mmp-sspa.yaml#
$schema: http://devicetree.org/meta-schemas/core.yaml#

title: Marvel SSPA Digital Audio Interface

maintainers:
  - Lubomir Rintel <lkundrak@v3.sk>

allOf:
  - $ref: dai-common.yaml#

properties:
  $nodename:
    pattern: "^audio-controller(@.*)?$"

  compatible:
    const: marvell,mmp-sspa

  reg:
    items:
      - description: RX block
      - description: TX block

  interrupts:
    maxItems: 1

  clocks:
    items:
      - description: Clock for the Audio block
      - description: I2S bit clock

  clock-names:
    items:
      - const: audio
      - const: bitclk

  power-domains:
    maxItems: 1

  '#sound-dai-cells':
    const: 0

  dmas:
    items:
      - description: TX DMA Channel
      - description: RX DMA Channel

  dma-names:
    items:
      - const: tx
      - const: rx

  port:
    $ref: audio-graph-port.yaml#
    unevaluatedProperties: false

    properties:
      endpoint:
        type: object

        properties:
          dai-format:
            const: i2s

required:
  - "#sound-dai-cells"
  - compatible
  - reg
  - interrupts
  - clocks
  - clock-names
  - dmas
  - dma-names
  - port

unevaluatedProperties: false

examples:
  - |
    #include <dt-bindings/clock/marvell,mmp2.h>

    audio-controller@d42a0c00 {
      compatible = "marvell,mmp-sspa";
      reg = <0xd42a0c00 0x30>,
            <0xd42a0c80 0x30>;
      interrupts = <2>;
      clock-names = "audio", "bitclk";
      clocks = <&soc_clocks 127>,
               <&audio_clk 1>;
      #sound-dai-cells = <0>;
      dmas = <&adma0 0>, <&adma0 1>;
      dma-names = "tx", "rx";
      port {
        endpoint {
          remote-endpoint = <&rt5631_0>;
          dai-format = "i2s";
        };
      };
    };

...
```

## Documentation/devicetree/bindings/sound/marvell,pxa2xx-ac97.txt
```
Marvell PXA2xx audio complex

This descriptions matches the AC97 controller found in pxa2xx and pxa3xx series.

Required properties:
  - compatible: should be one of the following:
    "marvell,pxa250-ac97"
    "marvell,pxa270-ac97"
    "marvell,pxa300-ac97"
  - reg: device MMIO address space
  - interrupts: single interrupt generated by AC97 IP
  - clocks: input clock of the AC97 IP, refer to clock-bindings.txt

Optional properties:
  - pinctrl-names, pinctrl-0: refer to pinctrl-bindings.txt
  - reset-gpios: gpio used for AC97 reset, refer to gpio.txt

Example:
	ac97: sound@40500000 {
		compatible = "marvell,pxa250-ac97";
		reg = < 0x40500000 0x1000 >;
		interrupts = <14>;
		reset-gpios = <&gpio 113 GPIO_ACTIVE_HIGH>;
		#sound-dai-cells = <1>;
		pinctrl-names = "default";
		pinctrl-0 = < &pmux_ac97_default >;
	};
```
