## Documentation/devicetree/bindings/sound/imx-audio-si476x.txt
```
Freescale i.MX audio complex with si476x codec

Required properties:
- compatible : "fsl,imx-audio-si476x"
- model : The user-visible name of this sound complex
- ssi-controller : The phandle of the i.MX SSI controller

- mux-int-port : The internal port of the i.MX audio muxer (AUDMUX)
- mux-ext-port : The external port of the i.MX audio muxer

Note: The AUDMUX port numbering should start at 1, which is consistent with
hardware manual.

Example:

sound {
	compatible = "fsl,imx-audio-si476x",
		     "fsl,imx-tuner-si476x";
	model = "imx-radio-si476x";

	ssi-controller = <&ssi1>;
	mux-int-port = <2>;
	mux-ext-port = <5>;
};
```

## Documentation/devicetree/bindings/sound/imx-audio-spdif.txt
```
Freescale i.MX audio complex with S/PDIF transceiver

Required properties:

  - compatible		: "fsl,imx-audio-spdif"

  - model		: The user-visible name of this sound complex

  - spdif-controller	: The phandle of the i.MX S/PDIF controller


Optional properties:

  - spdif-out		: This is a boolean property. If present, the
			  transmitting function of S/PDIF will be enabled,
			  indicating there's a physical S/PDIF out connector
			  or jack on the board or it's connecting to some
			  other IP block, such as an HDMI encoder or
			  display-controller.

  - spdif-in		: This is a boolean property. If present, the receiving
			  function of S/PDIF will be enabled, indicating there
			  is a physical S/PDIF in connector/jack on the board.

* Note: At least one of these two properties should be set in the DT binding.


Example:

sound-spdif {
	compatible = "fsl,imx-audio-spdif";
	model = "imx-spdif";
	spdif-controller = <&spdif>;
	spdif-out;
	spdif-in;
};
```

## Documentation/devicetree/bindings/sound/imx-audio-wm8962.txt
```
Freescale i.MX audio complex with WM8962 codec

Required properties:

  - compatible		: "fsl,imx-audio-wm8962"

  - model		: The user-visible name of this sound complex

  - cpu-dai		: The phandle of CPU DAI

  - audio-codec		: The phandle of the WM8962 audio codec

  - audio-routing	: A list of the connections between audio components.
			  Each entry is a pair of strings, the first being the
			  connection's sink, the second being the connection's
			  source. Valid names could be power supplies, WM8962
			  pins, and the jacks on the board:

			  Power supplies:
			   * Mic Bias

			  Board connectors:
			   * Mic Jack
			   * Headphone Jack
			   * Ext Spk

  - mux-int-port	: The internal port of the i.MX audio muxer (AUDMUX)

  - mux-ext-port	: The external port of the i.MX audio muxer

Note: The AUDMUX port numbering should start at 1, which is consistent with
hardware manual.

Optional properties:
- hp-det-gpios : The gpio pin to detect plug in/out event that happens to
  Headphone jack.
- mic-det-gpios: The gpio pin to detect plug in/out event that happens to
  Microphone jack.

Example:

sound {
	compatible = "fsl,imx6q-sabresd-wm8962",
		     "fsl,imx-audio-wm8962";
	model = "wm8962-audio";
	cpu-dai = <&ssi2>;
	audio-codec = <&codec>;
		audio-routing =
		"Headphone Jack", "HPOUTL",
		"Headphone Jack", "HPOUTR",
		"Ext Spk", "SPKOUTL",
		"Ext Spk", "SPKOUTR",
		"MICBIAS", "AMIC",
		"IN3R", "MICBIAS",
		"DMIC", "MICBIAS",
		"DMICDAT", "DMIC";
	mux-int-port = <2>;
	mux-ext-port = <3>;
	hp-det-gpios = <&gpio7 8 1>;
	mic-det-gpios = <&gpio1 9 1>;
};
```

## Documentation/devicetree/bindings/sound/imx-audmux.txt
```
Freescale Digital Audio Mux (AUDMUX) device

Required properties:

  - compatible		: "fsl,imx21-audmux" for AUDMUX version firstly used
			  on i.MX21, or "fsl,imx31-audmux" for the version
			  firstly used on i.MX31.

  - reg			: Should contain AUDMUX registers location and length.

An initial configuration can be setup using child nodes.

Required properties of optional child nodes:

  - fsl,audmux-port	: Integer of the audmux port that is configured by this
			  child node.

  - fsl,port-config	: List of configuration options for the specific port.
			  For imx31-audmux and above, it is a list of tuples
			  <ptcr pdcr>. For imx21-audmux it is a list of pcr
			  values.

Example:

audmux@021d8000 {
	compatible = "fsl,imx6q-audmux", "fsl,imx31-audmux";
	reg = <0x021d8000 0x4000>;
};
```

## Documentation/devicetree/bindings/sound/imx-audmux.yaml
```yaml
# SPDX-License-Identifier: (GPL-2.0-only OR BSD-2-Clause)
%YAML 1.2
---
$id: http://devicetree.org/schemas/sound/imx-audmux.yaml#
$schema: http://devicetree.org/meta-schemas/core.yaml#

title: Freescale Digital Audio Mux device

maintainers:
  - Oleksij Rempel <o.rempel@pengutronix.de>

properties:
  compatible:
    oneOf:
      - items:
          - enum:
              - fsl,imx27-audmux
          - const: fsl,imx21-audmux
      - items:
          - enum:
              - fsl,imx25-audmux
              - fsl,imx35-audmux
              - fsl,imx50-audmux
              - fsl,imx51-audmux
              - fsl,imx53-audmux
              - fsl,imx6q-audmux
              - fsl,imx6sl-audmux
              - fsl,imx6sll-audmux
              - fsl,imx6sx-audmux
          - const: fsl,imx31-audmux

  reg:
    maxItems: 1

  clocks:
    maxItems: 1

  clock-names:
    items:
      - const: audmux

patternProperties:
  "^mux-[0-9a-z]*$":
    type: object
    properties:
      fsl,audmux-port:
        $ref: /schemas/types.yaml#/definitions/uint32
        description: |
          Integer of the audmux port that is configured by this child node

      fsl,port-config:
        $ref: /schemas/types.yaml#/definitions/uint32-array
        description: |
          List of configuration options for the specific port.
          For imx31-audmux and above, it is a list of tuples ptcr pdcr.
          For imx21-audmux it is a list of pcr values.

    required:
      - fsl,audmux-port
      - fsl,port-config

    additionalProperties: false

required:
  - compatible
  - reg

additionalProperties: false

examples:
  - |
    audmux@21d8000 {
        compatible = "fsl,imx6q-audmux", "fsl,imx31-audmux";
        reg = <0x021d8000 0x4000>;
    };
  - |
    audmux@10016000 {
        compatible = "fsl,imx27-audmux", "fsl,imx21-audmux";
        reg = <0x10016000 0x1000>;
        clocks = <&clks 1>;
        clock-names = "audmux";

        mux-ssi0 {
            fsl,audmux-port = <0>;
            fsl,port-config = <0xcb205000>;
        };

        mux-pins4 {
            fsl,audmux-port = <2>;
            fsl,port-config = <0x00001000>;
        };
    };
  - |
    #include <dt-bindings/sound/fsl-imx-audmux.h>
    audmux@21d8000 {
        compatible = "fsl,imx6q-audmux", "fsl,imx31-audmux";
        reg = <0x021d8000 0x4000>;
        pinctrl-names = "default";
        pinctrl-0 = <&pinctrl_audmux>;

        mux-ssi1 {
            fsl,audmux-port = <0>;
            fsl,port-config = <
                IMX_AUDMUX_V2_PTCR_SYN		0
                IMX_AUDMUX_V2_PTCR_TFSEL(2)	0
                IMX_AUDMUX_V2_PTCR_TCSEL(2)	0
                IMX_AUDMUX_V2_PTCR_TFSDIR	0
                IMX_AUDMUX_V2_PTCR_TCLKDIR      IMX_AUDMUX_V2_PDCR_RXDSEL(2)
              >;
        };

        mux-pins3 {
            fsl,audmux-port = <2>;
            fsl,port-config = <
                IMX_AUDMUX_V2_PTCR_SYN          IMX_AUDMUX_V2_PDCR_RXDSEL(0)
                0                               IMX_AUDMUX_V2_PDCR_TXRXEN
              >;
        };
    };
```

## Documentation/devicetree/bindings/sound/infineon,peb2466.yaml
```yaml
# SPDX-License-Identifier: (GPL-2.0-only OR BSD-2-Clause)
%YAML 1.2
---
$id: http://devicetree.org/schemas/sound/infineon,peb2466.yaml#
$schema: http://devicetree.org/meta-schemas/core.yaml#

title: Infineon PEB2466 codec

maintainers:
  - Herve Codina <herve.codina@bootlin.com>

description: |
  The Infineon PEB2466 codec is a programmable DSP-based four channels codec
  with filters capabilities.

  The time-slots used by the codec must be set and so, the properties
  'dai-tdm-slot-num', 'dai-tdm-slot-width', 'dai-tdm-slot-tx-mask' and
  'dai-tdm-slot-rx-mask' must be present in the sound card node for sub-nodes
  that involve the codec. The codec uses one 8bit time-slot per channel.
  'dai-tdm-tdm-slot-with' must be set to 8.

  The PEB2466 codec also supports 28 gpios (signaling pins).

allOf:
  - $ref: /schemas/spi/spi-peripheral-props.yaml
  - $ref: dai-common.yaml#

properties:
  compatible:
    const: infineon,peb2466

  reg:
    description:
      SPI device address.
    maxItems: 1

  clocks:
    items:
      - description: Master clock

  clock-names:
    items:
      - const: mclk

  spi-max-frequency:
    maximum: 8192000

  reset-gpios:
    description:
      GPIO used to reset the device.
    maxItems: 1

  firmware-name:
    $ref: /schemas/types.yaml#/definitions/string
    description:
      Filters coefficients file to load. If this property is omitted, internal
      filters are disabled.

  '#sound-dai-cells':
    const: 0

  '#gpio-cells':
    const: 2

  gpio-controller: true

required:
  - compatible
  - reg
  - '#sound-dai-cells'
  - gpio-controller
  - '#gpio-cells'

unevaluatedProperties: false

examples:
  - |
    #include <dt-bindings/gpio/gpio.h>
    spi {
        #address-cells = <1>;
        #size-cells = <0>;
        audio-codec@0 {
            compatible = "infineon,peb2466";
            reg = <0>;
            spi-max-frequency = <8192000>;
            reset-gpios = <&gpio 10 GPIO_ACTIVE_LOW>;
            #sound-dai-cells = <0>;
            gpio-controller;
            #gpio-cells = <2>;
        };
    };
```

## Documentation/devicetree/bindings/sound/ingenic,aic.yaml
```yaml
# SPDX-License-Identifier: (GPL-2.0-only OR BSD-2-Clause)
%YAML 1.2
---
$id: http://devicetree.org/schemas/sound/ingenic,aic.yaml#
$schema: http://devicetree.org/meta-schemas/core.yaml#

title: Ingenic SoCs AC97 / I2S Controller (AIC) DT bindings

maintainers:
  - Paul Cercueil <paul@crapouillou.net>

properties:
  $nodename:
    pattern: '^audio-controller@'

  compatible:
    oneOf:
      - enum:
          - ingenic,jz4740-i2s
          - ingenic,jz4760-i2s
          - ingenic,jz4770-i2s
          - ingenic,jz4780-i2s
      - items:
          - const: ingenic,jz4725b-i2s
          - const: ingenic,jz4740-i2s

  '#sound-dai-cells':
    const: 0

  reg:
    maxItems: 1

  interrupts:
    maxItems: 1

  clocks:
    items:
      - description: AIC clock
      - description: I2S clock
      - description: EXT clock
      - description: PLL/2 clock

  clock-names:
    items:
      - const: aic
      - const: i2s
      - const: ext
      - const: pll half

  dmas:
    items:
      - description: DMA controller phandle and request line for I2S RX
      - description: DMA controller phandle and request line for I2S TX

  dma-names:
    items:
      - const: rx
      - const: tx

additionalProperties: false

required:
  - compatible
  - reg
  - interrupts
  - clocks
  - clock-names
  - dmas
  - dma-names
  - '#sound-dai-cells'

examples:
  - |
    #include <dt-bindings/clock/ingenic,jz4740-cgu.h>
    aic: audio-controller@10020000 {
      compatible = "ingenic,jz4740-i2s";
      reg = <0x10020000 0x38>;

      #sound-dai-cells = <0>;

      interrupt-parent = <&intc>;
      interrupts = <18>;

      clocks = <&cgu JZ4740_CLK_AIC>,
               <&cgu JZ4740_CLK_I2S>,
               <&cgu JZ4740_CLK_EXT>,
               <&cgu JZ4740_CLK_PLL_HALF>;
      clock-names = "aic", "i2s", "ext", "pll half";

      dmas = <&dmac 25 0xffffffff>, <&dmac 24 0xffffffff>;
      dma-names = "rx", "tx";
    };
```

## Documentation/devicetree/bindings/sound/ingenic,codec.yaml
```yaml
# SPDX-License-Identifier: (GPL-2.0-only OR BSD-2-Clause)
%YAML 1.2
---
$id: http://devicetree.org/schemas/sound/ingenic,codec.yaml#
$schema: http://devicetree.org/meta-schemas/core.yaml#

title: Ingenic JZ47xx internal codec DT bindings

maintainers:
  - Paul Cercueil <paul@crapouillou.net>

properties:
  $nodename:
    pattern: '^audio-codec@.*'

  compatible:
    oneOf:
      - const: ingenic,jz4770-codec
      - const: ingenic,jz4725b-codec
      - const: ingenic,jz4740-codec

  reg:
    maxItems: 1

  clocks:
    maxItems: 1

  clock-names:
    items:
      - const: aic

  '#sound-dai-cells':
    const: 0

additionalProperties: false

required:
  - compatible
  - reg
  - clocks
  - clock-names
  - '#sound-dai-cells'

examples:
  - |
    #include <dt-bindings/clock/jz4740-cgu.h>
    codec: audio-codec@10020080 {
      compatible = "ingenic,jz4740-codec";
      reg = <0x10020080 0x8>;
      #sound-dai-cells = <0>;
      clocks = <&cgu JZ4740_CLK_AIC>;
      clock-names = "aic";
    };

...
```

## Documentation/devicetree/bindings/sound/ingenic,jz4725b-codec.txt
```
Ingenic JZ4725B codec controller

Required properties:
- compatible : "ingenic,jz4725b-codec"
- reg : codec registers location and length
- clocks : phandle to the AIC clock.
- clock-names: must be set to "aic".
- #sound-dai-cells: Must be set to 0.

Example:

codec: audio-codec@100200a4 {
	compatible = "ingenic,jz4725b-codec";
	reg = <0x100200a4 0x8>;

	#sound-dai-cells = <0>;

	clocks = <&cgu JZ4725B_CLK_AIC>;
	clock-names = "aic";
};
```

## Documentation/devicetree/bindings/sound/ingenic,jz4740-codec.txt
```
Ingenic JZ4740 codec controller

Required properties:
- compatible : "ingenic,jz4740-codec"
- reg : codec registers location and length
- clocks : phandle to the AIC clock.
- clock-names: must be set to "aic".
- #sound-dai-cells: Must be set to 0.

Example:

codec: audio-codec@10020080 {
	compatible = "ingenic,jz4740-codec";
	reg = <0x10020080 0x8>;

	#sound-dai-cells = <0>;

	clocks = <&cgu JZ4740_CLK_AIC>;
	clock-names = "aic";
};
```

## Documentation/devicetree/bindings/sound/ingenic,jz4740-i2s.txt
```
Ingenic JZ4740 I2S controller

Required properties:
- compatible : "ingenic,jz4740-i2s" or "ingenic,jz4780-i2s"
- reg : I2S registers location and length
- clocks : AIC and I2S PLL clock specifiers.
- clock-names: "aic" and "i2s"
- dmas: DMA controller phandle and DMA request line for I2S Tx and Rx channels
- dma-names: Must be "tx" and "rx"

Example:

i2s: i2s@10020000 {
	compatible = "ingenic,jz4740-i2s";
	reg = <0x10020000 0x94>;

	clocks = <&cgu JZ4740_CLK_AIC>, <&cgu JZ4740_CLK_I2SPLL>;
	clock-names = "aic", "i2s";

	dmas = <&dma 2>, <&dma 3>;
	dma-names = "tx", "rx";

};
```

## Documentation/devicetree/bindings/sound/inno-rk3036.txt
```
Inno audio codec for RK3036

Inno audio codec is integrated inside RK3036 SoC.

Required properties:
- compatible : Should be "rockchip,rk3036-codec".
- reg : The registers of codec.
- clock-names : Should be "acodec_pclk".
- clocks : The clock of codec.
- rockchip,grf : The phandle of grf device node.

Example:

	acodec: acodec-ana@20030000 {
		compatible = "rk3036-codec";
		reg = <0x20030000 0x4000>;
		rockchip,grf = <&grf>;
		clock-names = "acodec_pclk";
		clocks = <&cru ACLK_VCODEC>;
	};
```
