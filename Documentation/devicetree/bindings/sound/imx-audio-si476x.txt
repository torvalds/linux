## Documentation/devicetree/bindings/sound/intel,keembay-i2s.yaml
```yaml
# SPDX-License-Identifier: (GPL-2.0 OR BSD-2-Clause)
# Copyright 2020 Intel Corporation
%YAML 1.2
---
$id: http://devicetree.org/schemas/sound/intel,keembay-i2s.yaml#
$schema: http://devicetree.org/meta-schemas/core.yaml#

title: Intel KeemBay I2S

maintainers:
  - Daniele Alessandrelli <daniele.alessandrelli@intel.com>
  - Paul J. Murphy <paul.j.murphy@intel.com>

description: |
 Intel KeemBay I2S

allOf:
  - $ref: dai-common.yaml#

properties:
  compatible:
    enum:
      - intel,keembay-i2s
      - intel,keembay-tdm
      - intel,keembay-hdmi-i2s

  "#sound-dai-cells":
    const: 0

  reg:
    items:
      - description: I2S registers
      - description: I2S gen configuration

  reg-names:
    items:
      - const: i2s-regs
      - const: i2s_gen_cfg

  interrupts:
    maxItems: 1

  clocks:
    items:
      - description: Bus Clock
      - description: Module Clock

  clock-names:
    items:
      - const: osc
      - const: apb_clk

  dmas:
    items:
      - description: DMA TX channel
      - description: DMA RX channel

  dma-names:
    items:
      - const: tx
      - const: rx

required:
  - compatible
  - "#sound-dai-cells"
  - reg
  - clocks
  - clock-names
  - interrupts

unevaluatedProperties: false

examples:
  - |
    #include <dt-bindings/interrupt-controller/arm-gic.h>
    #include <dt-bindings/interrupt-controller/irq.h>
    #define KEEM_BAY_PSS_AUX_I2S3
    #define KEEM_BAY_PSS_I2S3
    i2s@20140000 {
        compatible = "intel,keembay-i2s";
        #sound-dai-cells = <0>;
        reg = <0x20140000 0x200>, /* I2S registers */
              <0x202a00a4 0x4>; /* I2S gen configuration */
        reg-names = "i2s-regs", "i2s_gen_cfg";
        interrupts = <GIC_SPI 120 IRQ_TYPE_LEVEL_HIGH>;
        clock-names = "osc", "apb_clk";
        clocks = <&scmi_clk KEEM_BAY_PSS_AUX_I2S3>, <&scmi_clk KEEM_BAY_PSS_I2S3>;
        dmas = <&axi_dma0 29>, <&axi_dma0 33>;
        dma-names = "tx", "rx";
    };
```

## Documentation/devicetree/bindings/sound/invensense,ics43432.yaml
```yaml
# SPDX-License-Identifier: GPL-2.0-only OR BSD-2-Clause
%YAML 1.2
---
$id: http://devicetree.org/schemas/sound/invensense,ics43432.yaml#
$schema: http://devicetree.org/meta-schemas/core.yaml#

title: Invensense ICS-43432-compatible MEMS Microphone with I2S Output

maintainers:
  - Oleksij Rempel <o.rempel@pengutronix.de>

description:
  The ICS-43432 and compatible MEMS microphones output audio over an I2S
  interface and require no software configuration. The only host connection
  is the I2S bus. The microphone requires an I2S clock frequency between
  460 kHz and 3.379 MHz and 64 clock cycles per stereo frame. Each frame
  contains 32-bit slots per channel, with 24 bits carrying audio data.
  A hardware pin determines whether the microphone outputs audio on the
  left or right channel of the I2S frame.

allOf:
  - $ref: dai-common.yaml#

properties:
  compatible:
    enum:
      - invensense,ics43432
      - cui,cmm-4030d-261

  port:
    $ref: audio-graph-port.yaml#
    unevaluatedProperties: false

required:
  - compatible

unevaluatedProperties: false

examples:
  - |
    ics43432: ics43432 {
        compatible = "invensense,ics43432";

        port {
          endpoint {
            remote-endpoint = <&i2s1_endpoint>;
            dai-format = "i2s";
          };
        };

    };
```

## Documentation/devicetree/bindings/sound/irondevice,sma1303.yaml
```yaml
# SPDX-License-Identifier: (GPL-2.0-only OR BSD-2-Clause)
%YAML 1.2
---
$id: http://devicetree.org/schemas/sound/irondevice,sma1303.yaml#
$schema: http://devicetree.org/meta-schemas/core.yaml#

title: Iron Device SMA1303 Audio Amplifier

maintainers:
  - Kiseok Jo <kiseok.jo@irondevice.com>

description:
  SMA1303 digital class-D audio amplifier
  with an integrated boost converter.

allOf:
  - $ref: dai-common.yaml#

properties:
  compatible:
    enum:
      - irondevice,sma1303

  reg:
    maxItems: 1

  '#sound-dai-cells':
    const: 1

required:
  - compatible
  - reg
  - '#sound-dai-cells'

additionalProperties: false

examples:
  - |
    i2c {
        #address-cells = <1>;
        #size-cells = <0>;

        amplifier@1e {
            compatible = "irondevice,sma1303";
            reg = <0x1e>;
            #sound-dai-cells = <1>;
        };
    };
```

## Documentation/devicetree/bindings/sound/irondevice,sma1307.yaml
```yaml
# SPDX-License-Identifier: (GPL-2.0-only OR BSD-2-Clause)
%YAML 1.2
---
$id: http://devicetree.org/schemas/sound/irondevice,sma1307.yaml#
$schema: http://devicetree.org/meta-schemas/core.yaml#

title: Iron Device SMA1307 Audio Amplifier

maintainers:
  - Kiseok Jo <kiseok.jo@irondevice.com>

description:
  SMA1307 boosted digital speaker amplifier with feedback-loop.

allOf:
  - $ref: dai-common.yaml#

properties:
  compatible:
    enum:
      - irondevice,sma1307a
      - irondevice,sma1307aq
    description:
      If a 'q' is added, it indicated the product is AEC-Q100
      qualified for automotive applications. SMA1307A supports
      both WLCSP and QFN packages. However, SMA1307AQ only
      supports the QFN package.

  reg:
    maxItems: 1

  '#sound-dai-cells':
    const: 1

required:
  - compatible
  - reg
  - '#sound-dai-cells'

additionalProperties: false

examples:
  - |
    i2c {
        #address-cells = <1>;
        #size-cells = <0>;

        amplifier@1e {
            compatible = "irondevice,sma1307a";
            reg = <0x1e>;
            #sound-dai-cells = <1>;
        };
    };
```

## Documentation/devicetree/bindings/sound/linux,bt-sco.yaml
```yaml
# SPDX-License-Identifier: GPL-2.0
%YAML 1.2
---
$id: http://devicetree.org/schemas/sound/linux,bt-sco.yaml#
$schema: http://devicetree.org/meta-schemas/core.yaml#

title: Bluetooth SCO Audio Codec

maintainers:
  - Mark Brown <broonie@kernel.org>

properties:
  '#sound-dai-cells':
    enum:
      - 0

      # For Wideband PCM
      - 1

  compatible:
    enum:
      - delta,dfbmcs320
      - linux,bt-sco

required:
  - '#sound-dai-cells'
  - compatible

additionalProperties: false

examples:
  - |
    codec {
        #sound-dai-cells = <0>;
        compatible = "linux,bt-sco";
    };

...
```

## Documentation/devicetree/bindings/sound/linux,spdif-dit.yaml
```yaml
# SPDX-License-Identifier: GPL-2.0
%YAML 1.2
---
$id: http://devicetree.org/schemas/sound/linux,spdif-dit.yaml#
$schema: http://devicetree.org/meta-schemas/core.yaml#

title: Dummy SPDIF Transmitter

maintainers:
  - Mark Brown <broonie@kernel.org>

allOf:
  - $ref: name-prefix.yaml#

properties:
  compatible:
    const: linux,spdif-dit

  "#sound-dai-cells":
    const: 0

  sound-name-prefix: true

required:
  - "#sound-dai-cells"
  - compatible

additionalProperties: false

examples:
  - |
    spdif-out {
        #sound-dai-cells = <0>;
        compatible = "linux,spdif-dit";
    };

...
```

## Documentation/devicetree/bindings/sound/linux,spdif.yaml
```yaml
# SPDX-License-Identifier: GPL-2.0
%YAML 1.2
---
$id: http://devicetree.org/schemas/sound/linux,spdif.yaml#
$schema: http://devicetree.org/meta-schemas/core.yaml#

title: Dummy SPDIF Transmitter/Receiver

maintainers:
  - Mark Brown <broonie@kernel.org>

allOf:
  - $ref: dai-common.yaml#

properties:
  compatible:
    enum:
      - linux,spdif-dit
      - linux,spdif-dir

  "#sound-dai-cells":
    const: 0

  sound-name-prefix: true

  port:
    $ref: /schemas/graph.yaml#/properties/port

required:
  - "#sound-dai-cells"
  - compatible

additionalProperties: false

examples:
  - |
    spdif-out {
        #sound-dai-cells = <0>;
        compatible = "linux,spdif-dit";
    };

...
```

## Documentation/devicetree/bindings/sound/loongson,ls-audio-card.yaml
```yaml
# SPDX-License-Identifier: (GPL-2.0-only OR BSD-2-Clause)
%YAML 1.2
---
$id: http://devicetree.org/schemas/sound/loongson,ls-audio-card.yaml#
$schema: http://devicetree.org/meta-schemas/core.yaml#

title: Loongson 7axxx/2kxxx ASoC audio sound card driver

maintainers:
  - Yingkun Meng <mengyingkun@loongson.cn>
  - Binbin Zhou <zhoubinbin@loongson.cn>

description:
  The binding describes the sound card present in loongson
  7axxx/2kxxx platform. The sound card is an ASoC component
  which uses Loongson I2S controller to transfer the audio data.

allOf:
  - $ref: sound-card-common.yaml#

properties:
  compatible:
    enum:
      - loongson,ls-audio-card  # Loongson-2K1000/Loongson-2K2000/LS7A
      - loongson,ls2k0300-forever-pi-audio-card # CTCISZ Forever Pi
      - loongson,ls2k0300-dl2k0300b-audio-card # ATK-DL2K0300B

  mclk-fs:
    $ref: simple-card.yaml#/definitions/mclk-fs

  cpu:
    description: Holds subnode which indicates cpu dai.
    type: object
    additionalProperties: false
    properties:
      sound-dai:
        maxItems: 1
    required:
      - sound-dai

  codec:
    description: Holds subnode which indicates codec dai.
    type: object
    additionalProperties: false
    properties:
      sound-dai:
        maxItems: 1
    required:
      - sound-dai

  spkr-en-gpios:
    maxItems: 1
    description: The GPIO that enables the speakers

  hp-ctl-gpios:
    maxItems: 1
    description: The GPIO that control the headphones

  hp-det-gpios:
    maxItems: 1
    description: The GPIO that detect headphones are plugged in

required:
  - compatible
  - mclk-fs
  - cpu
  - codec

unevaluatedProperties: false

examples:
  - |
    sound {
        compatible = "loongson,ls-audio-card";
        model = "loongson-audio";
        mclk-fs = <512>;

        cpu {
            sound-dai = <&i2s>;
        };
        codec {
             sound-dai = <&es8323>;
        };
    };

  - |
    #include <dt-bindings/gpio/gpio.h>

    sound {
        compatible = "loongson,ls2k0300-dl2k0300b-audio-card";
        model = "loongson-audio";
        mclk-fs = <512>;
        hp-det-gpios = <&gpio 81 GPIO_ACTIVE_HIGH>;
        spkr-en-gpios = <&gpio 86 GPIO_ACTIVE_HIGH>;
        hp-ctl-gpios = <&gpio 87 GPIO_ACTIVE_HIGH>;
        audio-routing =
                      "Headphone", "LOUT1",
                      "Headphone", "ROUT1",
                      "Speaker", "LOUT2",
                      "Speaker", "ROUT2";

        cpu {
            sound-dai = <&i2s>;
        };

        codec {
             sound-dai = <&es8388>;
        };
    };
```

## Documentation/devicetree/bindings/sound/loongson,ls1b-ac97.yaml
```yaml
# SPDX-License-Identifier: (GPL-2.0-only OR BSD-2-Clause)
%YAML 1.2
---
$id: http://devicetree.org/schemas/sound/loongson,ls1b-ac97.yaml#
$schema: http://devicetree.org/meta-schemas/core.yaml#

title: Loongson-1 AC97 Controller

maintainers:
  - Keguang Zhang <keguang.zhang@gmail.com>

description:
  The Loongson-1 AC97 controller supports 2-channel stereo output and input.
  It is paired with the DMA engine to handle playback and capture functions.

allOf:
  - $ref: dai-common.yaml#

properties:
  compatible:
    oneOf:
      - const: loongson,ls1b-ac97
      - items:
          - enum:
              - loongson,ls1a-ac97
              - loongson,ls1c-ac97
          - const: loongson,ls1b-ac97

  reg:
    maxItems: 3

  reg-names:
    items:
      - const: ac97
      - const: audio-tx
      - const: audio-rx

  dmas:
    maxItems: 2

  dma-names:
    items:
      - const: tx
      - const: rx

  '#sound-dai-cells':
    const: 0

required:
  - compatible
  - reg
  - reg-names
  - dmas
  - dma-names
  - '#sound-dai-cells'

unevaluatedProperties: false

examples:
  - |
    audio-controller@1fe74000 {
        compatible = "loongson,ls1b-ac97";
        reg = <0x1fe74000 0x60>, <0x1fe72420 0x4>, <0x1fe74c4c 0x4>;
        reg-names = "ac97", "audio-tx", "audio-rx";
        dmas = <&dma 1>, <&dma 2>;
        dma-names = "tx", "rx";
        #sound-dai-cells = <0>;
    };
```

## Documentation/devicetree/bindings/sound/loongson,ls2k1000-i2s.yaml
```yaml
# SPDX-License-Identifier: (GPL-2.0-only OR BSD-2-Clause)
%YAML 1.2
---
$id: http://devicetree.org/schemas/sound/loongson,ls2k1000-i2s.yaml#
$schema: http://devicetree.org/meta-schemas/core.yaml#

title: Loongson-2K1000 I2S controller

maintainers:
  - Binbin Zhou <zhoubinbin@loongson.cn>

allOf:
  - $ref: dai-common.yaml#

properties:
  compatible:
    const: loongson,ls2k1000-i2s

  reg:
    items:
      - description: Loongson I2S controller Registers.
      - description: APB DMA config register for Loongson I2S controller.

  interrupts:
    maxItems: 1

  clocks:
    maxItems: 1

  dmas:
    maxItems: 2

  dma-names:
    items:
      - const: tx
      - const: rx

  '#sound-dai-cells':
    const: 0

required:
  - compatible
  - reg
  - interrupts
  - clocks
  - dmas
  - dma-names
  - '#sound-dai-cells'

unevaluatedProperties: false

examples:
  - |
    #include <dt-bindings/clock/loongson,ls2k-clk.h>
    #include <dt-bindings/interrupt-controller/irq.h>

    i2s@1fe2d000 {
        compatible = "loongson,ls2k1000-i2s";
        reg = <0x1fe2d000 0x14>,
              <0x1fe00438 0x8>;
        interrupt-parent = <&liointc0>;
        interrupts = <5 IRQ_TYPE_LEVEL_HIGH>;
        clocks = <&clk LOONGSON2_APB_CLK>;
        dmas = <&apbdma2 0>, <&apbdma3 0>;
        dma-names = "tx", "rx";
        #sound-dai-cells = <0>;
    };
...
```
