## Documentation/devicetree/bindings/sound/nau8821.txt
```
Nuvoton NAU88L21 audio codec

This device supports I2C only.

Required properties:
  - compatible : Must be "nuvoton,nau8821"

  - reg : the I2C address of the device. This is either 0x1B (CSB=0) or 0x54 (CSB=1).

Optional properties:
  - nuvoton,jkdet-enable: Enable jack detection via JKDET pin.
  - nuvoton,jkdet-pull-enable: Enable JKDET pin pull. If set - pin pull enabled,
      otherwise pin in high impedance state.
  - nuvoton,jkdet-pull-up: Pull-up JKDET pin. If set then JKDET pin is pull up, otherwise pull down.
  - nuvoton,jkdet-polarity: JKDET pin polarity. 0 - active high, 1 - active low.

  - nuvoton,vref-impedance: VREF Impedance selection
      0 - Open
      1 - 25 kOhm
      2 - 125 kOhm
      3 - 2.5 kOhm

  - nuvoton,micbias-voltage: Micbias voltage level.
      0 - VDDA
      1 - VDDA
      2 - VDDA * 1.1
      3 - VDDA * 1.2
      4 - VDDA * 1.3
      5 - VDDA * 1.4
      6 - VDDA * 1.53
      7 - VDDA * 1.53

  - nuvoton,jack-insert-debounce: number from 0 to 7 that sets debounce time to 2^(n+2) ms
  - nuvoton,jack-eject-debounce: number from 0 to 7 that sets debounce time to 2^(n+2) ms

  - nuvoton,dmic-clk-threshold: the ADC threshold of DMIC clock.


Example:

  headset: nau8821@1b {
      compatible = "nuvoton,nau8821";
      reg = <0x1b>;
      interrupt-parent = <&gpio>;
      interrupts = <23 IRQ_TYPE_LEVEL_LOW>;
      nuvoton,jkdet-enable;
      nuvoton,jkdet-pull-enable;
      nuvoton,jkdet-pull-up;
      nuvoton,jkdet-polarity = <GPIO_ACTIVE_LOW>;
      nuvoton,vref-impedance = <2>;
      nuvoton,micbias-voltage = <6>;
      nuvoton,jack-insert-debounce = <7>;
      nuvoton,jack-eject-debounce = <7>;
      nuvoton,dmic-clk-threshold = 3072000;
  };
```

## Documentation/devicetree/bindings/sound/nau8822.txt
```
NAU8822 audio CODEC

This device supports I2C only.

Required properties:

  - compatible : "nuvoton,nau8822"

  - reg : the I2C address of the device.

Example:

codec: nau8822@1a {
	compatible = "nuvoton,nau8822";
	reg = <0x1a>;
};
```

## Documentation/devicetree/bindings/sound/nau8824.txt
```
Nuvoton NAU8824 audio codec

This device supports I2C only.

Required properties:
  - compatible : Must be "nuvoton,nau8824"

  - reg : the I2C address of the device. This is either 0x1a (CSB=0) or 0x1b (CSB=1).

Optional properties:
  - nuvoton,jkdet-polarity: JKDET pin polarity. 0 - active high, 1 - active low.

  - nuvoton,vref-impedance: VREF Impedance selection
      0 - Open
      1 - 25 kOhm
      2 - 125 kOhm
      3 - 2.5 kOhm

  - nuvoton,micbias-voltage: Micbias voltage level.
      0 - VDDA
      1 - VDDA
      2 - VDDA * 1.1
      3 - VDDA * 1.2
      4 - VDDA * 1.3
      5 - VDDA * 1.4
      6 - VDDA * 1.53
      7 - VDDA * 1.53

  - nuvoton,sar-threshold-num: Number of buttons supported
  - nuvoton,sar-threshold: Impedance threshold for each button. Array that contains up to 8 buttons configuration. SAR value is calculated as
    SAR = 255 * MICBIAS / SAR_VOLTAGE * R / (2000 + R)
    where MICBIAS is configured by 'nuvoton,micbias-voltage', SAR_VOLTAGE is configured by 'nuvoton,sar-voltage', R - button impedance.
    Refer datasheet section 10.2 for more information about threshold calculation.

  - nuvoton,sar-hysteresis: Button impedance measurement hysteresis.

  - nuvoton,sar-voltage: Reference voltage for button impedance measurement.
      0 - VDDA
      1 - VDDA
      2 - VDDA * 1.1
      3 - VDDA * 1.2
      4 - VDDA * 1.3
      5 - VDDA * 1.4
      6 - VDDA * 1.53
      7 - VDDA * 1.53

  - nuvoton,sar-compare-time: SAR compare time
      0 - 500 ns
      1 - 1 us
      2 - 2 us
      3 - 4 us

  - nuvoton,sar-sampling-time: SAR sampling time
      0 - 2 us
      1 - 4 us
      2 - 8 us
      3 - 16 us

  - nuvoton,short-key-debounce: Button short key press debounce time.
      0 - 30 ms
      1 - 50 ms
      2 - 100 ms

  - nuvoton,jack-eject-debounce: Jack ejection debounce time.
      0 - 0 ms
      1 - 1 ms
      2 - 10 ms


Example:

  headset: nau8824@1a {
      compatible = "nuvoton,nau8824";
      reg = <0x1a>;
      interrupt-parent = <&gpio>;
      interrupts = <TEGRA_GPIO(E, 6) IRQ_TYPE_LEVEL_LOW>;
      nuvoton,vref-impedance = <2>;
      nuvoton,micbias-voltage = <6>;
      // Setup 4 buttons impedance according to Android specification
      nuvoton,sar-threshold-num = <4>;
      nuvoton,sar-threshold = <0xc 0x1e 0x38 0x60>;
      nuvoton,sar-hysteresis = <0>;
      nuvoton,sar-voltage = <6>;
      nuvoton,sar-compare-time = <1>;
      nuvoton,sar-sampling-time = <1>;
      nuvoton,short-key-debounce = <0>;
      nuvoton,jack-eject-debounce = <1>;
  };
```

## Documentation/devicetree/bindings/sound/nau8825.txt
```
Nuvoton NAU8825 audio codec

This device supports I2C only.

Required properties:
  - compatible : Must be "nuvoton,nau8825"

  - reg : the I2C address of the device. This is either 0x1a (CSB=0) or 0x1b (CSB=1).

Optional properties:
  - nuvoton,jkdet-enable: Enable jack detection via JKDET pin.
  - nuvoton,jkdet-pull-enable: Enable JKDET pin pull. If set - pin pull enabled,
      otherwise pin in high impedance state.
  - nuvoton,jkdet-pull-up: Pull-up JKDET pin. If set then JKDET pin is pull up, otherwise pull down.
  - nuvoton,jkdet-polarity: JKDET pin polarity. 0 - active high, 1 - active low.

  - nuvoton,vref-impedance: VREF Impedance selection
      0 - Open
      1 - 25 kOhm
      2 - 125 kOhm
      3 - 2.5 kOhm

  - nuvoton,micbias-voltage: Micbias voltage level.
      0 - VDDA
      1 - VDDA
      2 - VDDA * 1.1
      3 - VDDA * 1.2
      4 - VDDA * 1.3
      5 - VDDA * 1.4
      6 - VDDA * 1.53
      7 - VDDA * 1.53

  - nuvoton,sar-threshold-num: Number of buttons supported
  - nuvoton,sar-threshold: Impedance threshold for each button. Array that contains up to 8 buttons configuration. SAR value is calculated as
    SAR = 255 * MICBIAS / SAR_VOLTAGE * R / (2000 + R)
    where MICBIAS is configured by 'nuvoton,micbias-voltage', SAR_VOLTAGE is configured by 'nuvoton,sar-voltage', R - button impedance.
    Refer datasheet section 10.2 for more information about threshold calculation.

  - nuvoton,sar-hysteresis: Button impedance measurement hysteresis.

  - nuvoton,sar-voltage: Reference voltage for button impedance measurement.
      0 - VDDA
      1 - VDDA
      2 - VDDA * 1.1
      3 - VDDA * 1.2
      4 - VDDA * 1.3
      5 - VDDA * 1.4
      6 - VDDA * 1.53
      7 - VDDA * 1.53

  - nuvoton,sar-compare-time: SAR compare time
      0 - 500 ns
      1 - 1 us
      2 - 2 us
      3 - 4 us

  - nuvoton,sar-sampling-time: SAR sampling time
      0 - 2 us
      1 - 4 us
      2 - 8 us
      3 - 16 us

  - nuvoton,short-key-debounce: Button short key press debounce time.
      0 - 30 ms
      1 - 50 ms
      2 - 100 ms
      3 - 30 ms

  - nuvoton,jack-insert-debounce: number from 0 to 7 that sets debounce time to 2^(n+2) ms
  - nuvoton,jack-eject-debounce: number from 0 to 7 that sets debounce time to 2^(n+2) ms

  - nuvoton,crosstalk-enable: make crosstalk function enable if set.

  - clocks: list of phandle and clock specifier pairs according to common clock bindings for the
      clocks described in clock-names
  - clock-names: should include "mclk" for the MCLK master clock

Example:

  headset: nau8825@1a {
      compatible = "nuvoton,nau8825";
      reg = <0x1a>;
      interrupt-parent = <&gpio>;
      interrupts = <TEGRA_GPIO(E, 6) IRQ_TYPE_LEVEL_LOW>;
      nuvoton,jkdet-enable;
      nuvoton,jkdet-pull-enable;
      nuvoton,jkdet-pull-up;
      nuvoton,jkdet-polarity = <GPIO_ACTIVE_LOW>;
      nuvoton,vref-impedance = <2>;
      nuvoton,micbias-voltage = <6>;
      // Setup 4 buttons impedance according to Android specification
      nuvoton,sar-threshold-num = <4>;
      nuvoton,sar-threshold = <0xc 0x1e 0x38 0x60>;
      nuvoton,sar-hysteresis = <1>;
      nuvoton,sar-voltage = <0>;
      nuvoton,sar-compare-time = <0>;
      nuvoton,sar-sampling-time = <0>;
      nuvoton,short-key-debounce = <2>;
      nuvoton,jack-insert-debounce = <7>;
      nuvoton,jack-eject-debounce = <7>;
      nuvoton,crosstalk-enable;

      clock-names = "mclk";
      clocks = <&tegra_pmc TEGRA_PMC_CLK_OUT_2>;
  };
```

## Documentation/devicetree/bindings/sound/neofidelity,ntp8835.yaml
```yaml
# SPDX-License-Identifier: (GPL-2.0-only OR BSD-2-Clause)
%YAML 1.2
---
$id: http://devicetree.org/schemas/sound/neofidelity,ntp8835.yaml#
$schema: http://devicetree.org/meta-schemas/core.yaml#

title: NeoFidelity NTP8835/NTP8835C Amplifiers

maintainers:
  - Igor Prusov <ivprusov@salutedevices.com>

description: |
  The NTP8835 is a single chip full digital audio amplifier
  including power stages for stereo amplifier systems.
  NTP8835 is integrated with versatile digital audio signal
  processing functions, high-performance, high-fidelity fully
  digital PWM modulator and two high-power full-bridge MOSFET
  power stages. NTP8835C has identical programming interface,
  but has different output signal characteristics.

allOf:
  - $ref: dai-common.yaml#

properties:
  compatible:
    enum:
      - neofidelity,ntp8835
      - neofidelity,ntp8835c

  reg:
    enum:
      - 0x2a
      - 0x2b
      - 0x2c
      - 0x2d

  reset-gpios:
    maxItems: 1

  '#sound-dai-cells':
    const: 0

  clocks:
    maxItems: 4

  clock-names:
    items:
      - const: wck
      - const: bck
      - const: scl
      - const: mclk

required:
  - compatible
  - reg

unevaluatedProperties: false

examples:
  - |
   #include <dt-bindings/gpio/gpio.h>
    i2c {
      #address-cells = <1>;
      #size-cells = <0>;
      audio-codec@2b {
        compatible = "neofidelity,ntp8835";
        #sound-dai-cells = <0>;
        reg = <0x2b>;
        reset-gpios = <&gpio 5 GPIO_ACTIVE_LOW>;
        clocks = <&clkc 551>, <&clkc 552>, <&clkc 553>, <&clkc 554>;
        clock-names = "wck", "bck", "scl", "mclk";
      };
    };
```

## Documentation/devicetree/bindings/sound/neofidelity,ntp8918.yaml
```yaml
# SPDX-License-Identifier: (GPL-2.0-only OR BSD-2-Clause)
%YAML 1.2
---
$id: http://devicetree.org/schemas/sound/neofidelity,ntp8918.yaml#
$schema: http://devicetree.org/meta-schemas/core.yaml#

title: NeoFidelity NTP8918 Amplifier

maintainers:
  - Igor Prusov <ivprusov@salutedevices.com>

description:
  The NTP8918 is a single chip full digital audio amplifier
  including power stage for stereo amplifier system.
  The NTP8918 is integrated with versatile digital audio signal
  processing functions, high-performance, high-fidelity fully
  digital PWM modulator and two high-power full-bridge MOSFET
  power stages.

allOf:
  - $ref: dai-common.yaml#

properties:
  compatible:
    enum:
      - neofidelity,ntp8918

  reg:
    enum:
      - 0x2a
      - 0x2b
      - 0x2c
      - 0x2d

  reset-gpios:
    maxItems: 1

  '#sound-dai-cells':
    const: 0

  clocks:
    maxItems: 3

  clock-names:
    items:
      - const: wck
      - const: scl
      - const: bck

required:
  - compatible
  - reg

unevaluatedProperties: false

examples:
  - |
    #include <dt-bindings/gpio/gpio.h>

    i2c {
        #address-cells = <1>;
        #size-cells = <0>;

        audio-codec@2a {
            compatible = "neofidelity,ntp8918";
            #sound-dai-cells = <0>;
            reg = <0x2a>;
            clocks = <&clkc 150>, <&clkc 151>, <&clkc 152>;
            clock-names =  "wck", "scl", "bck";
            reset-gpios = <&gpio 5 GPIO_ACTIVE_LOW>;
        };
    };
```

## Documentation/devicetree/bindings/sound/nokia,rx51.txt
```
* Analkia N900 audio setup

Required properties:
- compatible: Should contain "analkia,n900-audio"
- analkia,cpu-dai: phandle for the McBSP analde
- analkia,audio-codec: phandles for the main TLV320AIC3X analde and the
                     auxiliary TLV320AIC3X analde (in this order)
- analkia,headphone-amplifier: phandle for the TPA6130A2 analde
- tvout-selection-gpios: GPIO for tvout selection
- jack-detection-gpios: GPIO for jack detection
- eci-switch-gpios: GPIO for ECI (Enhancement Control Interface) switch
- speaker-amplifier-gpios: GPIO for speaker amplifier

Example:

sound {
	compatible = "analkia,n900-audio";

	analkia,cpu-dai = <&mcbsp2>;
	analkia,audio-codec = <&tlv320aic3x>, <&tlv320aic3x_aux>;
	analkia,headphone-amplifier = <&tpa6130a2>;

	tvout-selection-gpios = <&gpio2 8 GPIO_ACTIVE_HIGH>; /* 40 */
	jack-detection-gpios = <&gpio6 17 GPIO_ACTIVE_HIGH>; /* 177 */
	eci-switch-gpios = <&gpio6 22 GPIO_ACTIVE_HIGH>; /* 182 */
	speaker-amplifier-gpios = <&twl_gpio 7 GPIO_ACTIVE_HIGH>;
};
```

## Documentation/devicetree/bindings/sound/nuvoton,nau8315.yaml
```yaml
# SPDX-License-Identifier: GPL-2.0-only OR BSD-2-Clause
%YAML 1.2
---
$id: http://devicetree.org/schemas/sound/nuvoton,nau8315.yaml#
$schema: http://devicetree.org/meta-schemas/core.yaml#

title: NAU8315/NAU8318 Mono Class-D Amplifier

maintainers:
  - David Lin <CTLIN0@nuvoton.com>

allOf:
  - $ref: dai-common.yaml#

properties:
  compatible:
    enum:
      - nuvoton,nau8315
      - nuvoton,nau8318

  '#sound-dai-cells':
    const: 0

  enable-gpios:
    maxItems: 1
    description:
      GPIO specifier for the chip's device enable input(EN) pin.
      If this option is not specified then driver does not manage
      the pin state (e.g. chip is always on).

required:
  - compatible

unevaluatedProperties: false

examples:
  - |
    #include <dt-bindings/gpio/gpio.h>

    codec {
        compatible = "nuvoton,nau8315";
        #sound-dai-cells = <0>;
        enable-gpios = <&gpio1 5 GPIO_ACTIVE_HIGH>;
    };
```

## Documentation/devicetree/bindings/sound/nuvoton,nau8325.yaml
```yaml
# SPDX-License-Identifier: (GPL-2.0-only OR BSD-2-Clause)
%YAML 1.2
---
$id: http://devicetree.org/schemas/sound/nuvoton,nau8325.yaml#
$schema: http://devicetree.org/meta-schemas/core.yaml#

title: NAU8325 audio Amplifier

maintainers:
  - Seven Lee <WTLI@nuvoton.com>

allOf:
  - $ref: dai-common.yaml#

properties:
  compatible:
    const: nuvoton,nau8325

  reg:
    maxItems: 1

  nuvoton,vref-impedance-ohms:
    description:
      The vref impedance to be used in ohms. Middle of voltage enables
      Tie-Off selection options. Due to the high impedance of the VREF
      pin, it is important to use a low-leakage capacitor.

    enum: [0, 25000, 125000, 2500]

  nuvoton,dac-vref-microvolt:
    description:
      The DAC vref to be used in voltage. DAC reference voltage setting. Can
      be used for minor tuning of the output level. Since the VDDA is range
      between 1.62 to 1.98 voltage, the typical value for design is 1.8V. After
      the minor tuning, the final microvolt are as the below.

    enum: [1800000, 2700000, 2880000, 3060000]

  nuvoton,alc-enable:
    description:
      Enable digital automatic level control (ALC) function.
    type: boolean

  nuvoton,clock-detection-disable:
    description:
      When clock detection is enabled, it will detect whether MCLK
      and FS are within the range. MCLK range is from 2.048MHz to 24.576MHz.
      FS range is from 8kHz to 96kHz. And also needs to detect the ratio
      MCLK_SRC/LRCK of 256, 400 or 500, and needs to detect the BCLK
      to make sure data is present. There needs to be at least 8 BCLK
      cycles per Frame Sync.
    type: boolean

  nuvoton,clock-det-data:
    description:
      Request clock detection to require 2048 non-zero samples before enabling
      the audio paths. If set then non-zero samples is required, otherwise it
      doesn't matter.
    type: boolean

required:
  - compatible
  - reg

unevaluatedProperties: false

examples:
  - |
    i2c {
        #address-cells = <1>;
        #size-cells = <0>;
        codec@21 {
            compatible = "nuvoton,nau8325";
            reg = <0x21>;
            nuvoton,vref-impedance-ohms = <125000>;
            nuvoton,dac-vref-microvolt = <2880000>;
            nuvoton,alc-enable;
            nuvoton,clock-det-data;
        };
    };
```
