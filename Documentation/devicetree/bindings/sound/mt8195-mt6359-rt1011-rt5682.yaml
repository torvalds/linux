## Documentation/devicetree/bindings/sound/mt8195-mt6359-rt1011-rt5682.yaml
```yaml
# SPDX-License-Identifier: (GPL-2.0-only OR BSD-2-Clause)
%YAML 1.2
---
$id: http://devicetree.org/schemas/sound/mt8195-mt6359-rt1011-rt5682.yaml#
$schema: http://devicetree.org/meta-schemas/core.yaml#

title: Mediatek MT8195 with MT6359, RT1011 and RT5682 ASoC sound card driver

maintainers:
  - Trevor Wu <trevor.wu@mediatek.com>

description:
  This binding describes the MT8195 sound card with RT1011 and RT5682.

properties:
  compatible:
    const: mediatek,mt8195_mt6359_rt1011_rt5682

  mediatek,platform:
    $ref: "/schemas/types.yaml#/definitions/phandle"
    description: The phandle of MT8195 ASoC platform.

  mediatek,dptx-codec:
    $ref: "/schemas/types.yaml#/definitions/phandle"
    description: The phandle of MT8195 Display Port Tx codec node.

  mediatek,hdmi-codec:
    $ref: "/schemas/types.yaml#/definitions/phandle"
    description: The phandle of MT8195 HDMI codec node.

additionalProperties: false

required:
  - compatible
  - mediatek,platform

examples:
  - |

    sound: mt8195-sound {
        compatible = "mediatek,mt8195_mt6359_rt1011_rt5682";
        mediatek,platform = <&afe>;
        pinctrl-names = "default";
        pinctrl-0 = <&aud_pins_default>;
    };

...
```

## Documentation/devicetree/bindings/sound/mt8195-mt6359.yaml
```yaml
# SPDX-License-Identifier: (GPL-2.0-only OR BSD-2-Clause)
%YAML 1.2
---
$id: http://devicetree.org/schemas/sound/mt8195-mt6359.yaml#
$schema: http://devicetree.org/meta-schemas/core.yaml#

title: MediaTek MT8195 ASoC sound card driver

maintainers:
  - Trevor Wu <trevor.wu@mediatek.com>

description:
  This binding describes the MT8195 sound card.

allOf:
  - $ref: sound-card-common.yaml#

properties:
  compatible:
    enum:
      - mediatek,mt8195_mt6359_rt1019_rt5682
      - mediatek,mt8195_mt6359_rt1011_rt5682
      - mediatek,mt8195_mt6359_max98390_rt5682
      - mediatek,mt8195_mt6359

  model:
    $ref: /schemas/types.yaml#/definitions/string
    description: User specified audio sound card name

  audio-routing:
    description:
      A list of the connections between audio components. Each entry is a
      pair of strings, the first being the connection's sink, the second
      being the connection's source.
      Valid names could be the input or output widgets of audio components,
      power supplies, MicBias of codec and the software switch.
    minItems: 2
    items:
      enum:
        # Sinks
        - Ext Spk
        - Headphone
        - IN1P
        - Left Spk
        - Right Spk

        # Sources
        - Headphone L
        - Headphone R
        - Headset Mic
        - HPOL
        - HPOR
        - Left BE_OUT
        - Left SPO
        - Right BE_OUT
        - Right SPO
        - Speaker

  mediatek,platform:
    $ref: /schemas/types.yaml#/definitions/phandle
    description: The phandle of MT8195 ASoC platform.

  mediatek,dptx-codec:
    $ref: /schemas/types.yaml#/definitions/phandle
    description: The phandle of MT8195 Display Port Tx codec node.
    deprecated: true

  mediatek,hdmi-codec:
    $ref: /schemas/types.yaml#/definitions/phandle
    description: The phandle of MT8195 HDMI codec node.
    deprecated: true

  mediatek,adsp:
    $ref: /schemas/types.yaml#/definitions/phandle
    description: The phandle of MT8195 ADSP platform.

  mediatek,dai-link:
    $ref: /schemas/types.yaml#/definitions/string-array
    description:
      A list of the desired dai-links in the sound card. Each entry is a
      name defined in the machine driver.

patternProperties:
  ".*-dai-link$":
    type: object
    additionalProperties: false
    description:
      Container for dai-link level properties and CODEC sub-nodes.

    properties:
      link-name:
        description: Indicates dai-link name and PCM stream name
        enum:
          - DL_SRC_BE
          - DPTX_BE
          - ETDM1_IN_BE
          - ETDM2_IN_BE
          - ETDM1_OUT_BE
          - ETDM2_OUT_BE
          - ETDM3_OUT_BE
          - PCM1_BE

      codec:
        description: Holds subnode which indicates codec dai.
        type: object
        additionalProperties: false
        properties:
          sound-dai:
            minItems: 1
            maxItems: 2
        required:
          - sound-dai

      dai-format:
        description: audio format
        enum: [ i2s, right_j, left_j, dsp_a, dsp_b ]

      mediatek,clk-provider:
        $ref: /schemas/types.yaml#/definitions/string
        description: Indicates dai-link clock master.
        enum: [ cpu, codec ]

    required:
      - link-name

additionalProperties: false

required:
  - compatible
  - mediatek,platform

# Disallow legacy properties if xxx-dai-link nodes are specified
if:
  not:
    patternProperties:
      ".*-dai-link$": false
then:
  properties:
    mediatek,dptx-codec: false
    mediatek,hdmi-codec: false

examples:
  - |

    sound: mt8195-sound {
        compatible = "mediatek,mt8195_mt6359_rt1019_rt5682";
        model = "mt8195_r1019_5682";
        mediatek,platform = <&afe>;
        pinctrl-names = "default";
        pinctrl-0 = <&aud_pins_default>;

        audio-routing =
                "Headphone", "HPOL",
                "Headphone", "HPOR",
                "IN1P", "Headset Mic",
                "Ext Spk", "Speaker";

        mm-dai-link {
                link-name = "ETDM1_IN_BE";
                mediatek,clk-provider = "cpu";
        };

        hs-playback-dai-link {
                link-name = "ETDM1_OUT_BE";
                mediatek,clk-provider = "cpu";
                codec {
                        sound-dai = <&headset_codec>;
                };
        };

        hs-capture-dai-link {
                link-name = "ETDM2_IN_BE";
                mediatek,clk-provider = "cpu";
                codec {
                        sound-dai = <&headset_codec>;
                };
        };

        spk-playback-dai-link {
                link-name = "ETDM2_OUT_BE";
                mediatek,clk-provider = "cpu";
                codec {
                        sound-dai = <&spk_amplifier>;
                };
        };

        hdmi-dai-link {
                link-name = "ETDM3_OUT_BE";
                codec {
                        sound-dai = <&hdmi_tx>;
                };
        };

        displayport-dai-link {
                link-name = "DPTX_BE";
                codec {
                        sound-dai = <&dp_tx>;
                };
        };
    };

...
```

## Documentation/devicetree/bindings/sound/mtk-afe-pcm.txt
```
Mediatek AFE PCM controller

Required properties:
- compatible = "mediatek,mt8173-afe-pcm";
- reg: register location and size
- interrupts: Should contain AFE interrupt
- clock-names: should have these clock names:
		"infra_sys_audio_clk",
		"top_pdn_audio",
		"top_pdn_aud_intbus",
		"bck0",
		"bck1",
		"i2s0_m",
		"i2s1_m",
		"i2s2_m",
		"i2s3_m",
		"i2s3_b";

Example:

	afe: mt8173-afe-pcm@11220000  {
		compatible = "mediatek,mt8173-afe-pcm";
		reg = <0 0x11220000 0 0x1000>;
		interrupts = <GIC_SPI 134 IRQ_TYPE_EDGE_FALLING>;
		clocks = <&infracfg INFRA_AUDIO>,
			<&topckgen TOP_AUDIO_SEL>,
			<&topckgen TOP_AUD_INTBUS_SEL>,
			<&topckgen TOP_APLL1_DIV0>,
			<&topckgen TOP_APLL2_DIV0>,
			<&topckgen TOP_I2S0_M_CK_SEL>,
			<&topckgen TOP_I2S1_M_CK_SEL>,
			<&topckgen TOP_I2S2_M_CK_SEL>,
			<&topckgen TOP_I2S3_M_CK_SEL>,
			<&topckgen TOP_I2S3_B_CK_SEL>;
		clock-names = "infra_sys_audio_clk",
				"top_pdn_audio",
				"top_pdn_aud_intbus",
				"bck0",
				"bck1",
				"i2s0_m",
				"i2s1_m",
				"i2s2_m",
				"i2s3_m",
				"i2s3_b";
	};
```

## Documentation/devicetree/bindings/sound/mtk-btcvsd-snd.txt
```
Mediatek ALSA BT SCO CVSD/MSBC Driver

Required properties:
- compatible = "mediatek,mtk-btcvsd-snd";
- reg: register location and size of PKV and SRAM_BANK2
- interrupts: should contain BTSCO interrupt
- mediatek,infracfg: the phandles of INFRASYS
- mediatek,offset: Array contains of register offset and mask
    infra_misc_offset,
    infra_conn_bt_cvsd_mask,
    cvsd_mcu_read_offset,
    cvsd_mcu_write_offset,
    cvsd_packet_indicator_offset

Example:

	mtk-btcvsd-snd@18000000 {
		compatible = "mediatek,mtk-btcvsd-snd";
		reg=<0 0x18000000 0 0x1000>,
		    <0 0x18080000 0 0x8000>;
		interrupts = <GIC_SPI 286 IRQ_TYPE_LEVEL_LOW>;
		mediatek,infracfg = <&infrasys>;
		mediatek,offset = <0xf00 0x800 0xfd0 0xfd4 0xfd8>;
	};
```

## Documentation/devicetree/bindings/sound/mvebu-audio.txt
```
* mvebu (Kirkwood, Dove, Armada 370) audio controller

Required properties:

- compatible:
  "marvell,kirkwood-audio" for Kirkwood platforms
  "marvell,dove-audio" for Dove platforms
  "marvell,armada370-audio" for Armada 370 platforms
  "marvell,armada-380-audio" for Armada 38x platforms

- reg: physical base address of the controller and length of memory mapped
  region (named "i2s_regs").
  With "marvell,armada-380-audio" two other regions are required:
  first of those is dedicated for Audio PLL Configuration registers
  (named "pll_regs") and the second one ("soc_ctrl") - for register
  where one of exceptive I/O types (I2S or S/PDIF) is set.

- interrupts:
  with "marvell,kirkwood-audio", the audio interrupt
  with "marvell,dove-audio", a list of two interrupts, the first for
  the data flow, and the second for errors.

- clocks: one or two phandles.
  The first one is mandatory and defines the internal clock.
  The second one is optional and defines an external clock.

- clock-names: names associated to the clocks:
	"internal" for the internal clock
	"extclk" for the external clock

Optional properties:

- spdif-mode:
  Enable S/PDIF mode on Armada 38x SoC. Using this property
  disables standard I2S I/O. Valid only with "marvell,armada-380-audio"
  compatible string.

Example:

i2s1: audio-controller@b4000 {
	compatible = "marvell,dove-audio";
	reg = <0xb4000 0x2210>;
	interrupts = <21>, <22>;
	clocks = <&gate_clk 13>;
	clock-names = "internal";
};
```

## Documentation/devicetree/bindings/sound/mxs-audio-sgtl5000.txt
```
* Freescale MXS audio complex with SGTL5000 codec

Required properties:
- compatible		: "fsl,mxs-audio-sgtl5000"
- model			: The user-visible name of this sound complex
- saif-controllers	: The phandle list of the MXS SAIF controller
- audio-codec		: The phandle of the SGTL5000 audio codec
- audio-routing		: A list of the connections between audio components.
			  Each entry is a pair of strings, the first being the
			  connection's sink, the second being the connection's
			  source. Valid names could be power supplies, SGTL5000
			  pins, and the jacks on the board:

			  Power supplies:
			   * Mic Bias

			  SGTL5000 pins:
			   * MIC_IN
			   * LINE_IN
			   * HP_OUT
			   * LINE_OUT

			  Board connectors:
			   * Mic Jack
			   * Line In Jack
			   * Headphone Jack
			   * Line Out Jack
			   * Ext Spk

Example:

sound {
	compatible = "fsl,imx28-evk-sgtl5000",
		     "fsl,mxs-audio-sgtl5000";
	model = "imx28-evk-sgtl5000";
	saif-controllers = <&saif0 &saif1>;
	audio-codec = <&sgtl5000>;
	audio-routing =
		"MIC_IN", "Mic Jack",
		"Mic Jack", "Mic Bias",
		"Headphone Jack", "HP_OUT";
};
```

## Documentation/devicetree/bindings/sound/mxs-saif.txt
```
* Freescale MXS Serial Audio Interface (SAIF)

Required properties:
- compatible: Should be "fsl,<chip>-saif"
- reg: Should contain registers location and length
- interrupts: Should contain ERROR interrupt number
- dmas: DMA specifier, consisting of a phandle to DMA controller node
  and SAIF DMA channel ID.
  Refer to dma.txt and fsl-mxs-dma.txt for details.
- dma-names: Must be "rx-tx".

Optional properties:
- fsl,saif-master: phandle to the master SAIF.  It's only required for
  the slave SAIF.

Note: Each SAIF controller should have an alias correctly numbered
in "aliases" node.

Example:

aliases {
	saif0 = &saif0;
	saif1 = &saif1;
};

saif0: saif@80042000 {
	compatible = "fsl,imx28-saif";
	reg = <0x80042000 2000>;
	interrupts = <59>;
	dmas = <&dma_apbx 4>;
	dma-names = "rx-tx";
};

saif1: saif@80046000 {
	compatible = "fsl,imx28-saif";
	reg = <0x80046000 2000>;
	interrupts = <58>;
	dmas = <&dma_apbx 5>;
	dma-names = "rx-tx";
	fsl,saif-master = <&saif0>;
};
```

## Documentation/devicetree/bindings/sound/name-prefix.txt
```
Name prefix:

Card implementing the routing property define the connection between
audio components as list of string pair. Component using the same
sink/source names may use the name prefix property to prepend the
name of their sinks/sources with the provided string.

Optional name prefix property:
- sound-name-prefix : string using as prefix for the sink/source names of
		      the component.

Example: Two instances of the same component.

amp0: analog-amplifier@0 {
	compatible = "simple-audio-amplifier";
	enable-gpios = <&gpio GPIOH_3 0>;
	sound-name-prefix = "FRONT";
};

amp1: analog-amplifier@1 {
	compatible = "simple-audio-amplifier";
	enable-gpios = <&gpio GPIOH_4 0>;
	sound-name-prefix = "BACK";
};
```

## Documentation/devicetree/bindings/sound/name-prefix.yaml
```yaml
# SPDX-License-Identifier: (GPL-2.0-only OR BSD-2-Clause)
%YAML 1.2
---
$id: http://devicetree.org/schemas/sound/name-prefix.yaml#
$schema: http://devicetree.org/meta-schemas/core.yaml#

title: Component sound name prefix

maintainers:
  - Jerome Brunet <jbrunet@baylibre.com>

properties:
  sound-name-prefix:
    $ref: /schemas/types.yaml#/definitions/string
    description: |
      Card implementing the routing property define the connection between
      audio components as list of string pair. Component using the same
      sink/source names may use this property to prepend the name of their
      sinks/sources with the provided string.

additionalProperties: true
```

## Documentation/devicetree/bindings/sound/nau8315.txt
```
Nuvoton NAU8315 Mono Class-D Amplifier

Required properties:
- compatible   : "nuvoton,nau8315"
                 "nuvoton,nau8318"

Optional properties:
- enable-gpios : GPIO specifier for the chip's device enable input(EN) pin.
        If this option is not specified then driver does not manage
        the pin state (e.g. chip is always on).

Example:

#include <dt-bindings/gpio/gpio.h>

nau8315 {
	compatible = "nuvoton,nau8315";
	enable-gpios = <&gpio1 5 GPIO_ACTIVE_HIGH>;
};

nau8318 {
	compatible = "nuvoton,nau8318";
	enable-gpios = <&gpio1 5 GPIO_ACTIVE_HIGH>;
};
```

## Documentation/devicetree/bindings/sound/nau8540.txt
```
NAU85L40 audio CODEC

This device supports I2C only.

Required properties:

  - compatible : "nuvoton,nau8540"

  - reg : the I2C address of the device.

Example:

codec: nau8540@1c {
       compatible = "nuvoton,nau8540";
       reg = <0x1c>;
};
```

## Documentation/devicetree/bindings/sound/nau8810.txt
```
NAU8810/NAU8812/NAU8814 audio CODEC

This device supports I2C only.

Required properties:

  - compatible : One of "nuvoton,nau8810" or "nuvoton,nau8812" or
	"nuvoton,nau8814"

  - reg : the I2C address of the device.

Example:

codec: nau8810@1a {
	compatible = "nuvoton,nau8810";
	reg = <0x1a>;
};
```
