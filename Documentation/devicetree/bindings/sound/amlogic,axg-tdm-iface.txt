## Documentation/devicetree/bindings/sound/asahi-kasei,ak4104.yaml
```yaml
# SPDX-License-Identifier: GPL-2.0-only OR BSD-2-Clause
%YAML 1.2
---
$id: http://devicetree.org/schemas/sound/asahi-kasei,ak4104.yaml#
$schema: http://devicetree.org/meta-schemas/core.yaml#

title: AK4104 S/PDIF transmitter

allOf:
  - $ref: dai-common.yaml#

maintainers:
  - Daniel Mack <github@zonque.org>
  - Xiaxi Shen <shenxiaxi26@gmail.com>

properties:
  compatible:
    const: asahi-kasei,ak4104

  reg:
    description: Chip select number on the SPI bus 
    maxItems: 1

  vdd-supply:
    description: A regulator node providing between 2.7V and 3.6V.

  reset-gpios:
    maxItems: 1
    description: Optional GPIO spec for the reset pin, deasserted 
                  before communication starts.
    
required:
  - compatible
  - reg
  - vdd-supply

unevaluatedProperties: false

examples:
  - |
    i2c {
        #address-cells = <1>;
        #size-cells = <0>;
        codec@0 {
            compatible = "asahi-kasei,ak4104";
            reg = <0>;
            vdd-supply = <&vdd_3v3_reg>;
        };
    };
```

## Documentation/devicetree/bindings/sound/asahi-kasei,ak4375.yaml
```yaml
# SPDX-License-Identifier: (GPL-2.0-only OR BSD-2-Clause)
%YAML 1.2
---
$id: http://devicetree.org/schemas/sound/asahi-kasei,ak4375.yaml#
$schema: http://devicetree.org/meta-schemas/core.yaml#

title: AK4375 DAC and headphones amplifier

maintainers:
  - Vincent Knecht <vincent.knecht@mailoo.org>

allOf:
  - $ref: dai-common.yaml#

properties:
  compatible:
    const: asahi-kasei,ak4375

  reg:
    maxItems: 1

  '#sound-dai-cells':
    const: 0

  avdd-supply:
    description: regulator phandle for the AVDD power supply.

  tvdd-supply:
    description: regulator phandle for the TVDD power supply.

  pdn-gpios:
    description: optional GPIO to set the PDN pin.

required:
  - compatible
  - reg
  - '#sound-dai-cells'
  - avdd-supply
  - tvdd-supply

unevaluatedProperties: false

examples:
  - |
    #include <dt-bindings/gpio/gpio.h>
    i2c {
      #address-cells = <1>;
      #size-cells = <0>;

      headphones: audio-codec@10 {
        compatible = "asahi-kasei,ak4375";
        reg = <0x10>;
        avdd-supply = <&reg_headphones_avdd>;
        tvdd-supply = <&pm8916_l6>;
        pdn-gpios = <&msmgpio 114 GPIO_ACTIVE_HIGH>;
        pinctrl-names = "default";
        pinctrl-0 = <&headphones_pdn_default>;
        #sound-dai-cells = <0>;
      };
    };
```

## Documentation/devicetree/bindings/sound/asahi-kasei,ak4458.yaml
```yaml
# SPDX-License-Identifier: GPL-2.0-only OR BSD-2-Clause
%YAML 1.2
---
$id: http://devicetree.org/schemas/sound/asahi-kasei,ak4458.yaml#
$schema: http://devicetree.org/meta-schemas/core.yaml#

title: AK4458 audio DAC

maintainers:
  - Shengjiu Wang <shengjiu.wang@nxp.com>

properties:
  compatible:
    enum:
      - asahi-kasei,ak4458
      - asahi-kasei,ak4497

  reg:
    maxItems: 1

  avdd-supply:
    description: Analog power supply

  dvdd-supply:
    description: Digital power supply

  reset-gpios:
    maxItems: 1

  mute-gpios:
    maxItems: 1
    description:
      GPIO used to mute all the outputs

  dsd-path:
    description: Select DSD input pins for ak4497
    $ref: /schemas/types.yaml#/definitions/uint32
    oneOf:
      - const: 0
        description: "select #16, #17, #19 pins"
      - const: 1
        description: "select #3, #4, #5 pins"

required:
  - compatible
  - reg

allOf:
  - if:
      properties:
        compatible:
          contains:
            const: asahi-kasei,ak4458

    then:
      properties:
        dsd-path: false

additionalProperties: false

examples:
  - |
    #include <dt-bindings/gpio/gpio.h>
    i2c {
        #address-cells = <1>;
        #size-cells = <0>;
        codec@10 {
            compatible = "asahi-kasei,ak4458";
            reg = <0x10>;
            reset-gpios = <&gpio1 10 GPIO_ACTIVE_LOW>;
            mute-gpios = <&gpio1 11 GPIO_ACTIVE_HIGH>;
        };
    };
```

## Documentation/devicetree/bindings/sound/asahi-kasei,ak4554.yaml
```yaml
# SPDX-License-Identifier: GPL-2.0-only OR BSD-2-Clause
%YAML 1.2
---
$id: http://devicetree.org/schemas/sound/asahi-kasei,ak4554.yaml#
$schema: http://devicetree.org/meta-schemas/core.yaml#

title: AK4554 sound codec

maintainers:
  - Kuninori Morimoto <kuninori.morimoto.gx@renesas.com>
  - Liam Girdwood <lgirdwood@gmail.com>
  - Mark Brown <broonie@kernel.org>

properties:
  compatible:
    const: asahi-kasei,ak4554

required:
  - compatible

additionalProperties: false

examples:
  - |
    codec {
        compatible = "asahi-kasei,ak4554";
    };
```

## Documentation/devicetree/bindings/sound/asahi-kasei,ak4613.yaml
```yaml
# SPDX-License-Identifier: (GPL-2.0-only OR BSD-2-Clause)
%YAML 1.2
---
$id: http://devicetree.org/schemas/sound/asahi-kasei,ak4613.yaml#
$schema: http://devicetree.org/meta-schemas/core.yaml#

title: AK4613 I2C transmitter

maintainers:
  - Kuninori Morimoto <kuninori.morimoto.gx@renesas.com>

allOf:
  - $ref: dai-common.yaml#

properties:
  compatible:
    const: asahi-kasei,ak4613

  reg:
    maxItems: 1

  clocks:
    maxItems: 1

  "#sound-dai-cells":
    const: 0

  ports:
    $ref: audio-graph-port.yaml#/definitions/ports

  port:
    $ref: audio-graph-port.yaml#
    unevaluatedProperties: false

patternProperties:
  "^asahi-kasei,in[1-2]-single-end$":
    description: Input Pin 1 - 2.
    $ref: /schemas/types.yaml#/definitions/flag

  "^asahi-kasei,out[1-6]-single-end$":
    description: Output Pin 1 - 6.
    $ref: /schemas/types.yaml#/definitions/flag

required:
  - compatible
  - reg

unevaluatedProperties: false

examples:
  - |
    i2c {
        #address-cells = <1>;
        #size-cells = <0>;
        ak4613: codec@10 {
            compatible = "asahi-kasei,ak4613";
            reg = <0x10>;
        };
    };
```

## Documentation/devicetree/bindings/sound/asahi-kasei,ak4619.yaml
```yaml
# SPDX-License-Identifier: (GPL-2.0-only OR BSD-2-Clause)
%YAML 1.2
---
$id: http://devicetree.org/schemas/sound/asahi-kasei,ak4619.yaml#
$schema: http://devicetree.org/meta-schemas/core.yaml#

title: AK4619 I2C transmitter

maintainers:
  - Kuninori Morimoto <kuninori.morimoto.gx@renesas.com>
  - Khanh Le <khanh.le.xr@renesas.com>

allOf:
  - $ref: dai-common.yaml#

properties:
  compatible:
    const: asahi-kasei,ak4619

  reg:
    maxItems: 1

  clocks:
    maxItems: 1

  clock-names:
    items:
      - const: mclk

  "#sound-dai-cells":
    const: 0

  port:
    $ref: audio-graph-port.yaml#
    unevaluatedProperties: false

required:
  - compatible
  - reg

unevaluatedProperties: false

examples:
  - |
    i2c {
        #address-cells = <1>;
        #size-cells = <0>;
        codec@10 {
            compatible = "asahi-kasei,ak4619";
            reg = <0x10>;

            clocks = <&rcar_sound>;
            clock-names = "mclk";

            #sound-dai-cells = <0>;
            port {
                 ak4619_endpoint: endpoint {
                       remote-endpoint = <&rsnd_endpoint>;
                  };
            };
        };
    };
```

## Documentation/devicetree/bindings/sound/asahi-kasei,ak5558.yaml
```yaml
# SPDX-License-Identifier: GPL-2.0-only OR BSD-2-Clause
%YAML 1.2
---
$id: http://devicetree.org/schemas/sound/asahi-kasei,ak5558.yaml#
$schema: http://devicetree.org/meta-schemas/core.yaml#

title: AK5558 8 channel differential 32-bit delta-sigma ADC

maintainers:
  - Junichi Wakasugi <wakasugi.jb@om.asahi-kasei.co.jp>
  - Mihai Serban <mihai.serban@nxp.com>

properties:
  compatible:
    enum:
      - asahi-kasei,ak5552
      - asahi-kasei,ak5558

  reg:
    maxItems: 1

  avdd-supply:
    description: A 1.8V supply that powers up the AVDD pin.

  dvdd-supply:
    description: A 1.2V supply that powers up the DVDD pin.

  reset-gpios:
    maxItems: 1

required:
  - compatible
  - reg

additionalProperties: false

examples:
  - |
    #include <dt-bindings/gpio/gpio.h>
    i2c {
        #address-cells = <1>;
        #size-cells = <0>;
        ak5558: codec@10 {
            compatible = "asahi-kasei,ak5558";
            reg = <0x10>;
            reset-gpios = <&gpio1 10 GPIO_ACTIVE_LOW>;
        };
    };
```

## Documentation/devicetree/bindings/sound/atmel,asoc-wm8904.yaml
```yaml
# SPDX-License-Identifier: (GPL-2.0 OR BSD-2-Clause)
%YAML 1.2
---
$id: http://devicetree.org/schemas/sound/atmel,asoc-wm8904.yaml#
$schema: http://devicetree.org/meta-schemas/core.yaml#

title: Atmel wm8904 audio codec complex

maintainers:
  - Dharma Balasubiramani <dharma.b@microchip.com>

description:
  The ASoC audio complex configuration for Atmel with WM8904 audio codec.

properties:
  compatible:
    const: atmel,asoc-wm8904

  atmel,model:
    $ref: /schemas/types.yaml#/definitions/string
    description: The user-visible name of this sound complex.

  atmel,ssc-controller:
    $ref: /schemas/types.yaml#/definitions/phandle
    description: The phandle of the SSC controller.

  atmel,audio-codec:
    $ref: /schemas/types.yaml#/definitions/phandle
    description: The phandle of the WM8731 audio codec.

  atmel,audio-routing:
    description:
      A list of the connections between audio components. Each entry is a pair
      of strings, the first being the connection's sink, the second being the
      connection's source.
    $ref: /schemas/types.yaml#/definitions/non-unique-string-array
    items:
      enum:
        # Board Connectors
        - Headphone Jack
        - Line In Jack
        - Mic
        # WM8904 CODEC Pins
        - IN1L
        - IN1R
        - IN2L
        - IN2R
        - IN3L
        - IN3R
        - HPOUTL
        - HPOUTR
        - LINEOUTL
        - LINEOUTR
        - MICBIAS

required:
  - compatible
  - atmel,model
  - atmel,audio-routing
  - atmel,ssc-controller
  - atmel,audio-codec

additionalProperties: false

examples:
  - |
    sound {
        compatible = "atmel,asoc-wm8904";
        pinctrl-names = "default";
        pinctrl-0 = <&pinctrl_pck0_as_mck>;

        atmel,model = "wm8904 @ AT91SAM9N12EK";

        atmel,audio-routing =
                "Headphone Jack", "HPOUTL",
                "Headphone Jack", "HPOUTR",
                "IN2L", "Line In Jack",
                "IN2R", "Line In Jack",
                "Mic", "MICBIAS",
                "IN1L", "Mic";

        atmel,ssc-controller = <&ssc0>;
        atmel,audio-codec = <&wm8904>;
    };
```

## Documentation/devicetree/bindings/sound/atmel,at91-ssc.yaml
```yaml
# SPDX-License-Identifier: (GPL-2.0-only OR BSD-2-Clause)
%YAML 1.2
---
$id: http://devicetree.org/schemas/sound/atmel,at91-ssc.yaml#
$schema: http://devicetree.org/meta-schemas/core.yaml#

title: Atmel Serial Synchronous Serial (SSC)

maintainers:
  - Andrei Simion <andrei.simion@microchip.com>

description:
  The Atmel Synchronous Serial Controller (SSC) provides a versatile
  synchronous communication link for audio and telecom applications,
  supporting protocols like I2S, Short Frame Sync, and Long Frame Sync.

properties:
  compatible:
    enum:
      - atmel,at91rm9200-ssc
      - atmel,at91sam9g45-ssc

  reg:
    maxItems: 1

  interrupts:
    maxItems: 1

  clocks:
    maxItems: 1

  clock-names:
    items:
      - const: pclk

  dmas:
    items:
      - description: TX DMA Channel
      - description: RX DMA Channel

  dma-names:
    items:
      - const: tx
      - const: rx

  atmel,clk-from-rk-pin:
    description:
      Specify the clock source for the SSC (Synchronous Serial Controller)
      when operating in slave mode. By default, the clock is sourced from
      the TK pin.
    type: boolean

  "#sound-dai-cells":
    const: 0

required:
  - compatible
  - reg
  - interrupts
  - clocks
  - clock-names

allOf:
  - $ref: dai-common.yaml#
  - if:
      properties:
        compatible:
          contains:
            enum:
              - atmel,at91sam9g45-ssc
    then:
      required:
        - dmas
        - dma-names

unevaluatedProperties: false

examples:
  - |
    #include <dt-bindings/clock/at91.h>
    #include <dt-bindings/dma/at91.h>
    #include <dt-bindings/interrupt-controller/irq.h>

    ssc@100000 {
       compatible = "atmel,at91sam9g45-ssc";
       reg = <0x100000 0x4000>;
       interrupts = <28 IRQ_TYPE_LEVEL_HIGH 5>;
       dmas = <&dma0 (AT91_XDMAC_DT_MEM_IF(0) | AT91_XDMAC_DT_PER_IF(1) |
                     AT91_XDMAC_DT_PERID(38))>,
              <&dma0 (AT91_XDMAC_DT_MEM_IF(0) | AT91_XDMAC_DT_PER_IF(1) |
                     AT91_XDMAC_DT_PERID(39))>;
       dma-names = "tx", "rx";
       clocks = <&pmc PMC_TYPE_PERIPHERAL 28>;
       clock-names = "pclk";
       #sound-dai-cells = <0>;
    };

    ssc@c00000 {
      compatible = "atmel,at91rm9200-ssc";
      reg = <0xc00000 0x4000>;
      interrupts = <14 IRQ_TYPE_LEVEL_HIGH 5>;
      clocks = <&pmc PMC_TYPE_PERIPHERAL 14>;
      clock-names = "pclk";
    };
```

## Documentation/devicetree/bindings/sound/atmel,at91sam9g20ek-wm8731.yaml
```yaml
# SPDX-License-Identifier: (GPL-2.0-only OR BSD-2-Clause)
%YAML 1.2
---
$id: http://devicetree.org/schemas/sound/atmel,at91sam9g20ek-wm8731.yaml#
$schema: http://devicetree.org/meta-schemas/core.yaml#

title: Atmel at91sam9g20ek wm8731 audio complex

maintainers:
  - Balakrishnan Sambath <balakrishnan.s@microchip.com>

description:
  The audio complex configuration for Atmel at91sam9g20ek with WM8731 audio codec.

properties:
  compatible:
    const: atmel,at91sam9g20ek-wm8731-audio

  atmel,model:
    $ref: /schemas/types.yaml#/definitions/string
    description: The user-visible name of this sound complex.

  atmel,audio-routing:
    $ref: /schemas/types.yaml#/definitions/non-unique-string-array
    description: A list of the connections between audio components.
    minItems: 2
    maxItems: 4
    items:
      enum:
        # Board Connectors
        - Ext Spk
        - Int Mic

        # CODEC Pins
        - LOUT
        - ROUT
        - LHPOUT
        - RHPOUT
        - LLINEIN
        - RLINEIN
        - MICIN

  atmel,ssc-controller:
    $ref: /schemas/types.yaml#/definitions/phandle
    description: The phandle of the SSC controller.

  atmel,audio-codec:
    $ref: /schemas/types.yaml#/definitions/phandle
    description: The phandle of WM8731 audio codec.

required:
  - compatible
  - atmel,model
  - atmel,audio-routing
  - atmel,ssc-controller
  - atmel,audio-codec

additionalProperties: false

examples:
  - |
    sound {
        compatible = "atmel,at91sam9g20ek-wm8731-audio";
        pinctrl-names = "default";
        pinctrl-0 = <&pinctrl_pck0_as_mck>;
        atmel,model = "wm8731 @ AT91SAMG20EK";
        atmel,audio-routing =
            "Ext Spk", "LHPOUT",
            "Int Mic", "MICIN";
        atmel,ssc-controller = <&ssc0>;
        atmel,audio-codec = <&wm8731>;
    };
```
