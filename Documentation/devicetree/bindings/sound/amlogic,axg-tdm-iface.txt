## Documentation/devicetree/bindings/sound/amlogic,axg-tdm-iface.txt
```
* Amlogic Audio TDM Interfaces

Required properties:
- compatible: 'amlogic,axg-tdm-iface'
- clocks: list of clock phandle, one for each entry clock-names.
- clock-names: should contain the following:
  * "sclk" : bit clock.
  * "lrclk": sample clock
  * "mclk" : master clock
	     -> optional if the interface is in clock slave mode.
- #sound-dai-cells: must be 0.

Example of TDM_A on the A113 SoC:

tdmif_a: audio-controller@0 {
	compatible = "amlogic,axg-tdm-iface";
	#sound-dai-cells = <0>;
	clocks = <&clkc_audio AUD_CLKID_MST_A_MCLK>,
		 <&clkc_audio AUD_CLKID_MST_A_SCLK>,
		 <&clkc_audio AUD_CLKID_MST_A_LRCLK>;
	clock-names = "mclk", "sclk", "lrclk";
};
```

## Documentation/devicetree/bindings/sound/amlogic,axg-tdm-iface.yaml
```yaml
# SPDX-License-Identifier: (GPL-2.0-only OR BSD-2-Clause)
%YAML 1.2
---
$id: http://devicetree.org/schemas/sound/amlogic,axg-tdm-iface.yaml#
$schema: http://devicetree.org/meta-schemas/core.yaml#

title: Amlogic Audio TDM Interfaces

maintainers:
  - Jerome Brunet <jbrunet@baylibre.com>

allOf:
  - $ref: dai-common.yaml#

properties:
  compatible:
    const: amlogic,axg-tdm-iface

  "#sound-dai-cells":
    const: 0

  clocks:
    minItems: 2
    items:
      - description: Bit clock
      - description: Sample clock
      - description: Master clock #optional

  clock-names:
    minItems: 2
    items:
      - const: sclk
      - const: lrclk
      - const: mclk

required:
  - compatible
  - "#sound-dai-cells"
  - clocks
  - clock-names

unevaluatedProperties: false

examples:
  - |
    #include <dt-bindings/clock/axg-audio-clkc.h>

    audio-controller {
        compatible = "amlogic,axg-tdm-iface";
        #sound-dai-cells = <0>;
        clocks = <&clkc_audio AUD_CLKID_MST_A_SCLK>,
                 <&clkc_audio AUD_CLKID_MST_A_LRCLK>,
                 <&clkc_audio AUD_CLKID_MST_A_MCLK>;
        clock-names = "sclk", "lrclk", "mclk";
    };
```

## Documentation/devicetree/bindings/sound/amlogic,g12a-toacodec.yaml
```yaml
# SPDX-License-Identifier: GPL-2.0
%YAML 1.2
---
$id: http://devicetree.org/schemas/sound/amlogic,g12a-toacodec.yaml#
$schema: http://devicetree.org/meta-schemas/core.yaml#

title: Amlogic G12a Internal DAC Control Glue

maintainers:
  - Jerome Brunet <jbrunet@baylibre.com>

properties:
  $nodename:
    pattern: "^audio-controller@.*"

  "#sound-dai-cells":
    const: 1

  compatible:
    oneOf:
      - items:
        - const:
            amlogic,g12a-toacodec
      - items:
        - enum:
          - amlogic,sm1-toacodec
        - const:
            amlogic,g12a-toacodec

  reg:
    maxItems: 1

  resets:
    maxItems: 1

required:
  - "#sound-dai-cells"
  - compatible
  - reg
  - resets

examples:
  - |
    #include <dt-bindings/reset/amlogic,meson-g12a-audio-reset.h>

    toacodec: audio-controller@740 {
        compatible = "amlogic,g12a-toacodec";
        reg = <0x740 0x4>;
        #sound-dai-cells = <1>;
        resets = <&clkc_audio AUD_RESET_TOACODEC>;
    };
```

## Documentation/devicetree/bindings/sound/amlogic,g12a-tohdmitx.txt
```
* Amlogic HDMI Tx control glue

Required properties:
- compatible: "amlogic,g12a-tohdmitx" or
	      "amlogic,sm1-tohdmitx"
- reg: physical base address of the controller and length of memory
       mapped region.
- #sound-dai-cells: should be 1.
- resets: phandle to the dedicated reset line of the hdmitx glue.

Example on the S905X2 SoC:

tohdmitx: audio-controller@744 {
	compatible = "amlogic,g12a-tohdmitx";
	reg = <0x0 0x744 0x0 0x4>;
	#sound-dai-cells = <1>;
	resets = <&clkc_audio AUD_RESET_TOHDMITX>;
};

Example of an 'amlogic,axg-sound-card':

sound {
	compatible = "amlogic,axg-sound-card";

[...]

	dai-link-x {
		sound-dai = <&tdmif_a>;
		dai-format = "i2s";
		dai-tdm-slot-tx-mask-0 = <1 1>;

		codec-0 {
			sound-dai = <&tohdmitx TOHDMITX_I2S_IN_A>;
		};

		codec-1 {
			sound-dai = <&external_dac>;
		};
	};

	dai-link-y {
		sound-dai = <&tdmif_c>;
		dai-format = "i2s";
		dai-tdm-slot-tx-mask-0 = <1 1>;

		codec {
			sound-dai = <&tohdmitx TOHDMITX_I2S_IN_C>;
		};
	};

	dai-link-z {
		sound-dai = <&tohdmitx TOHDMITX_I2S_OUT>;

		codec {
			sound-dai = <&hdmi_tx>;
		};
	};
};
```

## Documentation/devicetree/bindings/sound/amlogic,g12a-tohdmitx.yaml
```yaml
# SPDX-License-Identifier: GPL-2.0
%YAML 1.2
---
$id: http://devicetree.org/schemas/sound/amlogic,g12a-tohdmitx.yaml#
$schema: http://devicetree.org/meta-schemas/core.yaml#

title: Amlogic G12a HDMI TX Control Glue

maintainers:
  - Jerome Brunet <jbrunet@baylibre.com>

allOf:
  - $ref: dai-common.yaml#

properties:
  $nodename:
    pattern: "^audio-controller@.*"

  compatible:
    oneOf:
      - items:
          - const: amlogic,g12a-tohdmitx
      - items:
          - enum:
              - amlogic,sm1-tohdmitx
          - const: amlogic,g12a-tohdmitx

  reg:
    maxItems: 1

  resets:
    maxItems: 1

  "#sound-dai-cells":
    const: 1

required:
  - compatible
  - reg
  - resets
  - "#sound-dai-cells"

unevaluatedProperties: false

examples:
  - |
    #include <dt-bindings/reset/amlogic,meson-g12a-audio-reset.h>

    tohdmitx: audio-controller@744 {
        compatible = "amlogic,g12a-tohdmitx";
        reg = <0x744 0x4>;
        resets = <&clkc_audio AUD_RESET_TOHDMITX>;
        #sound-dai-cells = <1>;
    };
```

## Documentation/devicetree/bindings/sound/amlogic,gx-sound-card.yaml
```yaml
# SPDX-License-Identifier: GPL-2.0
%YAML 1.2
---
$id: http://devicetree.org/schemas/sound/amlogic,gx-sound-card.yaml#
$schema: http://devicetree.org/meta-schemas/core.yaml#

title: Amlogic GX sound card

maintainers:
  - Jerome Brunet <jbrunet@baylibre.com>

allOf:
  - $ref: sound-card-common.yaml#

properties:
  compatible:
    items:
      - const: amlogic,gx-sound-card

  audio-aux-devs:
    $ref: /schemas/types.yaml#/definitions/phandle-array
    description: list of auxiliary devices

  audio-widgets:
    $ref: /schemas/types.yaml#/definitions/analn-unique-string-array
    minItems: 2
    description: |-
      A list off component DAPM widget. Each entry is a pair of strings,
      the first being the widget type, the second being the widget name

patternProperties:
  "^dai-link-[0-9]+$":
    type: object
    additionalProperties: false
    description: |-
      dai-link child analdes:
        Container for dai-link level properties and the CODEC sub-analdes.
        There should be at least one (and probably more) subanalde of this type

    properties:
      dai-format:
        $ref: /schemas/types.yaml#/definitions/string
        enum: [ i2s, left-j, dsp_a ]

      mclk-fs:
        $ref: /schemas/types.yaml#/definitions/uint32
        description: |-
          Multiplication factor between the frame rate and master clock
          rate

      sound-dai:
        maxItems: 1
        description: phandle of the CPU DAI

    patternProperties:
      "^codec(-[0-9]+)?$":
        type: object
        additionalProperties: false
        description: |-
          Codecs:
          dai-link representing backend links should have at least one subanalde.
          One subanalde for each codec of the dai-link. dai-link representing
          frontend links have anal codec, therefore have anal subanaldes

        properties:
          sound-dai:
            maxItems: 1
            description: phandle of the codec DAI

        required:
          - sound-dai

    required:
      - sound-dai

required:
  - model
  - dai-link-0

unevaluatedProperties: false

examples:
  - |
    sound {
        compatible = "amlogic,gx-sound-card";
        model = "GXL-ACME-S905X-FOO";
        audio-aux-devs = <&amp>;
        audio-routing = "I2S ENCODER I2S IN", "I2S FIFO Playback";

        dai-link-0 {
               sound-dai = <&i2s_fifo>;
        };

        dai-link-1 {
                sound-dai = <&i2s_encoder>;
                dai-format = "i2s";
                mclk-fs = <256>;

                codec-0 {
                        sound-dai = <&codec0>;
                };

                codec-1 {
                        sound-dai = <&codec1>;
                };
        };
    };
```

## Documentation/devicetree/bindings/sound/amlogic,t9015.yaml
```yaml
# SPDX-License-Identifier: GPL-2.0
%YAML 1.2
---
$id: http://devicetree.org/schemas/sound/amlogic,t9015.yaml#
$schema: http://devicetree.org/meta-schemas/core.yaml#

title: Amlogic T9015 Internal Audio DAC

maintainers:
  - Jerome Brunet <jbrunet@baylibre.com>

allOf:
  - $ref: dai-common.yaml#

properties:
  $nodename:
    pattern: "^audio-controller@.*"

  "#sound-dai-cells":
    const: 0

  compatible:
    items:
      - const: amlogic,t9015

  clocks:
    items:
      - description: Peripheral clock

  clock-names:
    items:
      - const: pclk

  reg:
    maxItems: 1

  resets:
    maxItems: 1

  AVDD-supply:
    description:
      Analogue power supply.

  sound-name-prefix: true

required:
  - "#sound-dai-cells"
  - compatible
  - reg
  - clocks
  - clock-names
  - resets
  - AVDD-supply

additionalProperties: false

examples:
  - |
    #include <dt-bindings/clock/g12a-clkc.h>
    #include <dt-bindings/reset/amlogic,meson-g12a-reset.h>

    acodec: audio-controller@32000 {
        compatible = "amlogic,t9015";
        reg = <0x32000 0x14>;
        #sound-dai-cells = <0>;
        clocks = <&clkc CLKID_AUDIO_CODEC>;
        clock-names = "pclk";
        resets = <&reset RESET_AUDIO_CODEC>;
        AVDD-supply = <&vddao_1v8>;
    };
```

## Documentation/devicetree/bindings/sound/apple,mca.yaml
```yaml
# SPDX-License-Identifier: (GPL-2.0-only OR BSD-2-Clause)
%YAML 1.2
---
$id: http://devicetree.org/schemas/sound/apple,mca.yaml#
$schema: http://devicetree.org/meta-schemas/core.yaml#

title: Apple MCA I2S transceiver

description: |
  MCA is an I2S transceiver peripheral found on M1 and other Apple chips. It is
  composed of a number of identical clusters which can operate independently
  or in an interlinked fashion. Up to 6 clusters have been seen on an MCA.

maintainers:
  - Martin Povišer <povik+lin@cutebit.org>

allOf:
  - $ref: dai-common.yaml#

properties:
  compatible:
    oneOf:
      - items:
          - const: apple,t6020-mca
          - const: apple,t8103-mca
      - items:
          - enum:
              # Do not add additional SoC to this list.
              - apple,t6000-mca
              - apple,t8103-mca
              - apple,t8112-mca
          - const: apple,mca

  reg:
    items:
      - description: Register region of the MCA clusters proper
      - description: Register region of the DMA glue and its FIFOs

  interrupts:
    minItems: 4
    maxItems: 6
    description:
      One interrupt per each cluster

  '#address-cells':
    const: 1

  '#size-cells':
    const: 0

  dmas:
    minItems: 16
    maxItems: 24
    description:
      DMA channels corresponding to the SERDES units in the peripheral. They are
      listed in groups of four per cluster, and within the group they are given
      as associated to the TXA, RXA, TXB, RXB units.

  dma-names:
    minItems: 16
    items:
      - const: tx0a
      - const: rx0a
      - const: tx0b
      - const: rx0b
      - const: tx1a
      - const: rx1a
      - const: tx1b
      - const: rx1b
      - const: tx2a
      - const: rx2a
      - const: tx2b
      - const: rx2b
      - const: tx3a
      - const: rx3a
      - const: tx3b
      - const: rx3b
      - const: tx4a
      - const: rx4a
      - const: tx4b
      - const: rx4b
      - const: tx5a
      - const: rx5a
      - const: tx5b
      - const: rx5b
    description: |
      Names for the DMA channels: 'tx'/'rx', then cluster number, then 'a'/'b'
      based on the associated SERDES unit.

  clocks:
    minItems: 4
    maxItems: 6
    description:
      Clusters' input reference clock.

  resets:
    maxItems: 1

  power-domains:
    minItems: 5
    maxItems: 7
    description:
      First a general power domain for register access, then the power
      domains of individual clusters for their operation.

  '#sound-dai-cells':
    const: 1

required:
  - compatible
  - reg
  - dmas
  - dma-names
  - clocks
  - power-domains
  - '#sound-dai-cells'

unevaluatedProperties: false

examples:
  - |
    mca: i2s@9b600000 {
      compatible = "apple,t6000-mca", "apple,mca";
      reg = <0x9b600000 0x10000>,
            <0x9b200000 0x20000>;

      clocks = <&nco 0>, <&nco 1>, <&nco 2>, <&nco 3>;
      power-domains = <&ps_audio_p>, <&ps_mca0>, <&ps_mca1>,
                      <&ps_mca2>, <&ps_mca3>;
      dmas = <&admac 0>, <&admac 1>, <&admac 2>, <&admac 3>,
             <&admac 4>, <&admac 5>, <&admac 6>, <&admac 7>,
             <&admac 8>, <&admac 9>, <&admac 10>, <&admac 11>,
             <&admac 12>, <&admac 13>, <&admac 14>, <&admac 15>;
      dma-names = "tx0a", "rx0a", "tx0b", "rx0b",
                  "tx1a", "rx1a", "tx1b", "rx1b",
                  "tx2a", "rx2a", "tx2b", "rx2b",
                  "tx3a", "rx3a", "tx3b", "rx3b";

      #sound-dai-cells = <1>;
    };
```

## Documentation/devicetree/bindings/sound/arm,pl041.yaml
```yaml
# SPDX-License-Identifier: (GPL-2.0-only OR BSD-2-Clause)
%YAML 1.2
---
$id: http://devicetree.org/schemas/sound/arm,pl041.yaml#
$schema: http://devicetree.org/meta-schemas/core.yaml#

title: Arm Ltd. PrimeCell PL041 AACI sound interface

maintainers:
  - Andre Przywara <andre.przywara@arm.com>

description:
  The Arm PrimeCell Advanced Audio CODEC Interface (AACI) is an AMBA compliant
  peripheral that provides communication with an audio CODEC using the AC-link
  protocol.

# We need a select here so we don't match all nodes with 'arm,primecell'
select:
  properties:
    compatible:
      contains:
        const: arm,pl041
  required:
    - compatible

properties:
  compatible:
    items:
      - const: arm,pl041
      - const: arm,primecell

  reg:
    maxItems: 1

  interrupts:
    maxItems: 1

  clocks:
    description: APB register access clock

  clock-names:
    const: apb_pclk

required:
  - compatible
  - reg
  - interrupts
  - clocks

additionalProperties: false

examples:
  - |
    audio-controller@40000 {
        compatible = "arm,pl041", "arm,primecell";
        reg = <0x040000 0x1000>;
        interrupts = <11>;
        clocks = <&v2m_clk24mhz>;
        clock-names = "apb_pclk";
    };

...
```

## Documentation/devicetree/bindings/sound/armada-370db-audio.txt
```
Device Tree bindings for the Armada 370 DB audio
================================================

These Device Tree bindings are used to describe the audio complex
found on the Armada 370 DB platform.

Mandatory properties:

 * compatible: must be "marvell,a370db-audio"

 * marvell,audio-controller: a phandle that points to the audio
   controller of the Armada 370 SoC.

 * marvell,audio-codec: a set of three phandles that points to:

    1/ the analog audio codec connected to the Armada 370 SoC
    2/ the S/PDIF transceiver
    3/ the S/PDIF receiver

Example:

	sound {
	      compatible = "marvell,a370db-audio";
	      marvell,audio-controller = <&audio_controller>;
	      marvell,audio-codec = <&audio_codec &spdif_out &spdif_in>;
	      status = "okay";
	};
```

## Documentation/devicetree/bindings/sound/arndale.txt
```
Audio Binding for Arndale boards

Required properties:
- compatible : Can be the following,
			"samsung,arndale-rt5631"

- samsung,audio-cpu: The phandle of the Samsung I2S controller
- samsung,audio-codec: The phandle of the audio codec

Optional:
- samsung,model: The name of the sound-card

Arndale Boards has many audio daughter cards, one of them is
rt5631/alc5631. Below example shows audio bindings for rt5631/
alc5631 based codec.

Example:

sound {
		compatible = "samsung,arndale-rt5631";

		samsung,audio-cpu = <&i2s0>
		samsung,audio-codec = <&rt5631>;
};
```
