## Documentation/devicetree/bindings/sound/atmel,sam9x5-wm8731-audio.yaml
```yaml
# SPDX-License-Identifier: (GPL-2.0 OR BSD-2-Clause)
%YAML 1.2
---
$id: http://devicetree.org/schemas/sound/atmel,sam9x5-wm8731-audio.yaml#
$schema: http://devicetree.org/meta-schemas/core.yaml#

title: Atmel at91sam9x5ek wm8731 audio complex

maintainers:
  - Dharma Balasubiramani <dharma.b@microchip.com>

description:
  The audio complex configuration for Atmel at91sam9x5ek with WM8731 audio codec.

properties:
  compatible:
    const: atmel,sam9x5-wm8731-audio

  atmel,model:
    $ref: /schemas/types.yaml#/definitions/string
    description: The user-visible name of this sound complex.

  atmel,ssc-controller:
    $ref: /schemas/types.yaml#/definitions/phandle
    description: The phandle of the SSC controller.

  atmel,audio-codec:
    $ref: /schemas/types.yaml#/definitions/phandle
    description: The phandle of the WM8731 audio codec.

  atmel,audio-routing:
    description:
      A list of the connections between audio components. Each entry is a pair
      of strings, the first being the connection's sink, the second being the
      connection's source.
    $ref: /schemas/types.yaml#/definitions/non-unique-string-array
    items:
      enum:
        # Board Connectors
        - Headphone Jack
        - Line In Jack

        # CODEC Pins
        - LOUT
        - ROUT
        - LHPOUT
        - RHPOUT
        - LLINEIN
        - RLINEIN
        - MICIN

required:
  - compatible
  - atmel,model
  - atmel,ssc-controller
  - atmel,audio-codec
  - atmel,audio-routing

additionalProperties: false

examples:
  - |
    sound {
        compatible = "atmel,sam9x5-wm8731-audio";

        atmel,model = "wm8731 @ AT91SAM9X5EK";

        atmel,audio-routing =
                "Headphone Jack", "RHPOUT",
                "Headphone Jack", "LHPOUT",
                "LLINEIN", "Line In Jack",
                "RLINEIN", "Line In Jack";

        atmel,ssc-controller = <&ssc0>;
        atmel,audio-codec = <&wm8731>;
    };
```

## Documentation/devicetree/bindings/sound/atmel,sama5d2-classd.yaml
```yaml
# SPDX-License-Identifier: (GPL-2.0 OR BSD-2-Clause)
# Copyright (C) 2022 Microchip Technology, Inc. and its subsidiaries
%YAML 1.2
---
$id: http://devicetree.org/schemas/sound/atmel,sama5d2-classd.yaml#
$schema: http://devicetree.org/meta-schemas/core.yaml#

title: Atmel ClassD Amplifier

maintainers:
  - Nicolas Ferre <nicolas.ferre@microchip.com>
  - Alexandre Belloni <alexandre.belloni@bootlin.com>
  - Claudiu Beznea <claudiu.beznea@microchip.com>

description:
  The Audio Class D Amplifier (CLASSD) is a digital input, Pulse Width
  Modulated (PWM) output stereo Class D amplifier.

properties:
  compatible:
    oneOf:
      - items:
          - const: atmel,sama5d2-classd
      - items:
          - const: microchip,sam9x7-classd
          - const: atmel,sama5d2-classd

  reg:
    maxItems: 1

  interrupts:
    maxItems: 1

  dmas:
    maxItems: 1

  dma-names:
    const: tx

  clocks:
    maxItems: 2

  clock-names:
    items:
      - const: pclk
      - const: gclk

  atmel,model:
    $ref: /schemas/types.yaml#/definitions/string
    default: CLASSD
    description: The user-visible name of this sound complex.

  atmel,pwm-type:
    $ref: /schemas/types.yaml#/definitions/string
    enum:
      - single
      - diff
    default: single
    description: PWM modulation type.

  atmel,non-overlap-time:
    $ref: /schemas/types.yaml#/definitions/uint32
    enum:
      - 5
      - 10
      - 15
      - 20
    default: 10
    description:
      Set non-overlapping time, the unit is nanosecond(ns).
      Non-overlapping will be disabled if not specified.

required:
  - compatible
  - reg
  - interrupts
  - dmas
  - dma-names
  - clock-names
  - clocks

additionalProperties: false

examples:
  - |
    #include <dt-bindings/dma/at91.h>
    #include <dt-bindings/interrupt-controller/arm-gic.h>

    classd: sound@fc048000 {
        compatible = "atmel,sama5d2-classd";
        reg = <0xfc048000 0x100>;
        interrupts = <59 IRQ_TYPE_LEVEL_HIGH 7>;
        dmas = <&dma0
            (AT91_XDMAC_DT_MEM_IF(0) | AT91_XDMAC_DT_PER_IF(1)
            | AT91_XDMAC_DT_PERID(47))>;
        dma-names = "tx";
        clocks = <&classd_clk>, <&classd_gclk>;
        clock-names = "pclk", "gclk";
        assigned-clocks = <&classd_gclk>;
        pinctrl-names = "default";
        pinctrl-0 = <&pinctrl_classd_default>;
        atmel,model = "classd @ SAMA5D2-Xplained";
        atmel,pwm-type = "diff";
        atmel,non-overlap-time = <10>;
    };
```

## Documentation/devicetree/bindings/sound/atmel,sama5d2-i2s.yaml
```yaml
# SPDX-License-Identifier: (GPL-2.0 OR BSD-2-Clause)
# Copyright (C) 2022 Microchip Technology, Inc. and its subsidiaries
%YAML 1.2
---
$id: http://devicetree.org/schemas/sound/atmel,sama5d2-i2s.yaml#
$schema: http://devicetree.org/meta-schemas/core.yaml#

title: Atmel I2S controller

maintainers:
  - Nicolas Ferre <nicolas.ferre@microchip.com>
  - Alexandre Belloni <alexandre.belloni@bootlin.com>
  - Claudiu Beznea <claudiu.beznea@microchip.com>

description:
  Atmel I2S (Inter-IC Sound Controller) bus is the standard
  interface for connecting audio devices, such as audio codecs.

properties:
  compatible:
    const: atmel,sama5d2-i2s

  reg:
    maxItems: 1

  interrupts:
    maxItems: 1

  clocks:
    items:
      - description: Peripheral clock
      - description: Generated clock (Optional)
      - description: I2S mux clock (Optional). Set
          with gclk when Master Mode is required.
    minItems: 1

  clock-names:
    items:
      - const: pclk
      - const: gclk
      - const: muxclk
    minItems: 1

  dmas:
    items:
      - description: TX DMA Channel
      - description: RX DMA Channel

  dma-names:
    items:
      - const: tx
      - const: rx

required:
  - compatible
  - reg
  - interrupts
  - dmas
  - dma-names
  - clocks
  - clock-names

additionalProperties: false

examples:
  - |
    #include <dt-bindings/dma/at91.h>
    #include <dt-bindings/interrupt-controller/arm-gic.h>

    i2s@f8050000 {
        compatible = "atmel,sama5d2-i2s";
        reg = <0xf8050000 0x300>;
        interrupts = <54 IRQ_TYPE_LEVEL_HIGH 7>;
        dmas = <&dma0
                (AT91_XDMAC_DT_MEM_IF(0) | AT91_XDMAC_DT_PER_IF(1) |
                AT91_XDMAC_DT_PERID(31))>,
               <&dma0
                (AT91_XDMAC_DT_MEM_IF(0) | AT91_XDMAC_DT_PER_IF(1) |
                AT91_XDMAC_DT_PERID(32))>;
        dma-names = "tx", "rx";
        clocks = <&i2s0_clk>, <&i2s0_gclk>, <&i2s0muxck>;
        clock-names = "pclk", "gclk", "muxclk";
        pinctrl-names = "default";
        pinctrl-0 = <&pinctrl_i2s0_default>;
    };
```

## Documentation/devicetree/bindings/sound/atmel,sama5d2-pdmic.yaml
```yaml
# SPDX-License-Identifier: (GPL-2.0 OR BSD-2-Clause)
# Copyright (C) 2022 Microchip Technology, Inc. and its subsidiaries
%YAML 1.2
---
$id: http://devicetree.org/schemas/sound/atmel,sama5d2-pdmic.yaml#
$schema: http://devicetree.org/meta-schemas/core.yaml#

title: Atmel PDMIC decoder

maintainers:
  - Claudiu Beznea <claudiu.beznea@microchip.com>

description:
  Atmel Pulse Density Modulation Interface Controller
  (PDMIC) peripheral is a mono PDM decoder module
  that decodes an incoming PDM sample stream.

properties:
  compatible:
    const: atmel,sama5d2-pdmic

  reg:
    maxItems: 1

  interrupts:
    maxItems: 1

  clocks:
    items:
      - description: peripheral clock
      - description: generated clock

  clock-names:
    items:
      - const: pclk
      - const: gclk

  dmas:
    maxItems: 1

  dma-names:
    const: rx

  atmel,mic-min-freq:
    $ref: /schemas/types.yaml#/definitions/uint32
    description:
      The minimal frequency that the microphone supports.

  atmel,mic-max-freq:
    $ref: /schemas/types.yaml#/definitions/uint32
    description:
      The maximal frequency that the microphone supports.

  atmel,model:
    $ref: /schemas/types.yaml#/definitions/string
    default: PDMIC
    description: The user-visible name of this sound card.

  atmel,mic-offset:
    $ref: /schemas/types.yaml#/definitions/int32
    default: 0
    description: The offset that should be added.

required:
  - compatible
  - reg
  - interrupts
  - dmas
  - dma-names
  - clock-names
  - clocks
  - atmel,mic-min-freq
  - atmel,mic-max-freq

additionalProperties: false

examples:
  - |
    #include <dt-bindings/dma/at91.h>
    #include <dt-bindings/interrupt-controller/arm-gic.h>

    pdmic: sound@f8018000 {
        compatible = "atmel,sama5d2-pdmic";
        reg = <0xf8018000 0x124>;
        interrupts = <48 IRQ_TYPE_LEVEL_HIGH 7>;
        dmas = <&dma0
                (AT91_XDMAC_DT_MEM_IF(0) | AT91_XDMAC_DT_PER_IF(1)
                | AT91_XDMAC_DT_PERID(50))>;
        dma-names = "rx";
        clocks = <&pdmic_clk>, <&pdmic_gclk>;
        clock-names = "pclk", "gclk";
        pinctrl-names = "default";
        pinctrl-0 = <&pinctrl_pdmic_default>;
        atmel,model = "PDMIC@sama5d2_xplained";
        atmel,mic-min-freq = <1000000>;
        atmel,mic-max-freq = <3246000>;
        atmel,mic-offset = <0x0>;
    };
```
