## Documentation/devicetree/bindings/sound/st,stm32-sai.txt
```
STMicroelectronics STM32 Serial Audio Interface (SAI).

The SAI interface (Serial Audio Interface) offers a wide set of audio protocols
as I2S standards, LSB or MSB-justified, PCM/DSP, TDM, and AC'97.
The SAI contains two independent audio sub-blocks. Each sub-block has
its own clock generator and I/O lines controller.

Required properties:
  - compatible: Should be "st,stm32f4-sai" or "st,stm32h7-sai"
  - reg: Base address and size of SAI common register set.
  - clocks: Must contain phandle and clock specifier pairs for each entry
	in clock-names.
  - clock-names: Must contain "pclk" "x8k" and "x11k"
	"pclk": Clock which feeds the peripheral bus interface.
	        Mandatory for "st,stm32h7-sai" compatible.
	        Not used for "st,stm32f4-sai" compatible.
	"x8k": SAI parent clock for sampling rates multiple of 8kHz.
	"x11k": SAI parent clock for sampling rates multiple of 11.025kHz.
  - interrupts: cpu DAI interrupt line shared by SAI sub-blocks

Optional properties:
  - resets: Reference to a reset controller asserting the SAI

SAI subnodes:
Two subnodes corresponding to SAI sub-block instances A et B can be defined.
Subnode can be omitted for unsused sub-block.

SAI subnodes required properties:
  - compatible: Should be "st,stm32-sai-sub-a" or "st,stm32-sai-sub-b"
	for SAI sub-block A or B respectively.
  - reg: Base address and size of SAI sub-block register set.
  - clocks: Must contain one phandle and clock specifier pair
	for sai_ck which feeds the internal clock generator.
	If the SAI shares a master clock, with another SAI set as MCLK
	clock provider, SAI provider phandle must be specified here.
  - clock-names: Must contain "sai_ck".
	Must also contain "MCLK", if SAI shares a master clock,
	with a SAI set as MCLK clock provider.
  - dmas: see Documentation/devicetree/bindings/dma/stm32-dma.txt
  - dma-names: identifier string for each DMA request line
	"tx": if sai sub-block is configured as playback DAI
	"rx": if sai sub-block is configured as capture DAI
  - pinctrl-names: should contain only value "default"
  - pinctrl-0: see Documentation/devicetree/bindings/pinctrl/st,stm32-pinctrl.yaml

SAI subnodes Optional properties:
  - st,sync: specify synchronization mode.
	By default SAI sub-block is in asynchronous mode.
	This property sets SAI sub-block as slave of another SAI sub-block.
	Must contain the phandle and index of the sai sub-block providing
	the synchronization.
  - st,iec60958: support S/PDIF IEC6958 protocol for playback
	IEC60958 protocol is not available for capture.
	By default, custom protocol is assumed, meaning that protocol is
	configured according to protocol defined in related DAI link node,
	such as i2s, left justified, right justified, dsp and pdm protocols.
	Note: ac97 protocol is not supported by SAI driver
   - #clock-cells: should be 0. This property must be present if the SAI device
	is a master clock provider, according to clocks bindings, described in
	Documentation/devicetree/bindings/clock/clock-bindings.txt.

The device node should contain one 'port' child node with one child 'endpoint'
node, according to the bindings defined in Documentation/devicetree/bindings/
graph.txt.

Example:
sound_card {
	compatible = "audio-graph-card";
	dais = <&sai1b_port>;
};

sai1: sai1@40015800 {
	compatible = "st,stm32h7-sai";
	#address-cells = <1>;
	#size-cells = <1>;
	ranges = <0 0x40015800 0x400>;
	reg = <0x40015800 0x4>;
	clocks = <&rcc SAI1_CK>, <&rcc PLL1_Q>, <&rcc PLL2_P>;
	clock-names = "pclk", "x8k", "x11k";
	interrupts = <87>;

	sai1a: audio-controller@40015804 {
		compatible = "st,stm32-sai-sub-a";
		reg = <0x4 0x1C>;
		clocks = <&rcc SAI1_CK>;
		clock-names = "sai_ck";
		dmas = <&dmamux1 1 87 0x400 0x0>;
		dma-names = "tx";
		pinctrl-names = "default";
		pinctrl-0 = <&pinctrl_sai1a>;

		sai1b_port: port {
			cpu_endpoint: endpoint {
				remote-endpoint = <&codec_endpoint>;
				format = "i2s";
			};
		};
	};
};

audio-codec {
	codec_port: port {
		codec_endpoint: endpoint {
			remote-endpoint = <&cpu_endpoint>;
		};
	};
};
```

## Documentation/devicetree/bindings/sound/st,stm32-sai.yaml
```yaml
# SPDX-License-Identifier: (GPL-2.0-only OR BSD-2-Clause)
%YAML 1.2
---
$id: http://devicetree.org/schemas/sound/st,stm32-sai.yaml#
$schema: http://devicetree.org/meta-schemas/core.yaml#

title: STMicroelectronics STM32 Serial Audio Interface (SAI)

maintainers:
  - Olivier Moysan <olivier.moysan@foss.st.com>

description:
  The SAI interface (Serial Audio Interface) offers a wide set of audio
  protocols as I2S standards, LSB or MSB-justified, PCM/DSP, TDM, and AC'97.
  The SAI contains two independent audio sub-blocks. Each sub-block has
  its own clock generator and I/O lines controller.

properties:
  compatible:
    enum:
      - st,stm32f4-sai
      - st,stm32h7-sai

  reg:
    items:
      - description: Base address and size of SAI common register set.
      - description: Base address and size of SAI identification register set.
    minItems: 1

  ranges:
    maxItems: 1

  interrupts:
    maxItems: 1

  resets:
    maxItems: 1

  "#address-cells":
    const: 1

  "#size-cells":
    const: 1

  clocks:
    maxItems: 3

  clock-names:
    maxItems: 3

  access-controllers:
    minItems: 1
    maxItems: 2

required:
  - compatible
  - reg
  - ranges
  - "#address-cells"
  - "#size-cells"
  - clocks
  - clock-names

patternProperties:
  "^audio-controller@[0-9a-f]+$":
    type: object
    additionalProperties: false
    description:
      Two subnodes corresponding to SAI sub-block instances A et B
      can be defined. Subnode can be omitted for unused sub-block.

    properties:
      compatible:
        description: Compatible for SAI sub-block A or B.
        pattern: "st,stm32-sai-sub-[ab]"

      "#sound-dai-cells":
        const: 0

      reg:
        maxItems: 1

      clocks:
        items:
          - description: sai_ck clock feeding the internal clock generator.
          - description: MCLK clock from a SAI set as master clock provider.
        minItems: 1

      clock-names:
        items:
          - const: sai_ck
          - const: MCLK
        minItems: 1

      dmas:
        maxItems: 1

      dma-names:
        description: |
          rx: SAI sub-block is configured as a capture DAI.
          tx: SAI sub-block is configured as a playback DAI.
        enum: [ rx, tx ]

      st,sync:
        description:
          Configure the SAI sub-block as slave of another SAI sub-block.
          By default SAI sub-block is in asynchronous mode.
          Must contain the phandle and index of the SAI sub-block providing
          the synchronization.
        $ref: /schemas/types.yaml#/definitions/phandle-array
        items:
          - items:
              - description: phandle of the SAI sub-block
              - description: index of the SAI sub-block

      st,iec60958:
        description:
          If set, support S/PDIF IEC6958 protocol for playback.
          IEC60958 protocol is not available for capture.
          By default, custom protocol is assumed, meaning that protocol is
          configured according to protocol defined in related DAI link node,
          such as i2s, left justified, right justified, dsp and pdm protocols.
        $ref: /schemas/types.yaml#/definitions/flag

      "#clock-cells":
        description: Configure the SAI device as master clock provider.
        const: 0

      port:
        $ref: audio-graph-port.yaml#
        unevaluatedProperties: false

    required:
      - compatible
      - "#sound-dai-cells"
      - reg
      - clocks
      - clock-names
      - dmas
      - dma-names

allOf:
  - if:
      properties:
        compatible:
          contains:
            const: st,stm32f4-sai
    then:
      properties:
        clocks:
          items:
            - description: x8k, SAI parent clock for sampling rates multiple of 8kHz.
            - description: x11k, SAI parent clock for sampling rates multiple of 11.025kHz.

        clock-names:
          items:
            - const: x8k
            - const: x11k
    else:
      properties:
        clocks:
          items:
            - description: pclk feeds the peripheral bus interface.
            - description: x8k, SAI parent clock for sampling rates multiple of 8kHz.
            - description: x11k, SAI parent clock for sampling rates multiple of 11.025kHz.

        clock-names:
          items:
            - const: pclk
            - const: x8k
            - const: x11k

additionalProperties: false

examples:
  - |
    #include <dt-bindings/interrupt-controller/arm-gic.h>
    #include <dt-bindings/clock/stm32mp1-clks.h>
    #include <dt-bindings/reset/stm32mp1-resets.h>
    sai2: sai@4400b000 {
      compatible = "st,stm32h7-sai";
      #address-cells = <1>;
      #size-cells = <1>;
      ranges = <0 0x4400b000 0x400>;
      reg = <0x4400b000 0x4>, <0x4400b3f0 0x10>;
      clocks = <&rcc SAI2>, <&rcc PLL3_Q>, <&rcc PLL3_R>;
      clock-names = "pclk", "x8k", "x11k";
      pinctrl-names = "default", "sleep";
      pinctrl-0 = <&sai2a_pins_a>, <&sai2b_pins_b>;
      pinctrl-1 = <&sai2a_sleep_pins_a>, <&sai2b_sleep_pins_b>;

      sai2a: audio-controller@4400b004 {
        #sound-dai-cells = <0>;
        compatible = "st,stm32-sai-sub-a";
        reg = <0x4 0x1c>;
        dmas = <&dmamux1 89 0x400 0x01>;
        dma-names = "tx";
        clocks = <&rcc SAI2_K>;
        clock-names = "sai_ck";
      };
    };

...
```

## Documentation/devicetree/bindings/sound/st,stm32-spdifrx.txt
```
STMicroelectronics STM32 S/PDIF receiver (SPDIFRX).

The SPDIFRX peripheral, is designed to receive an S/PDIF flow compliant with
IEC-60958 and IEC-61937.

Required properties:
  - compatible: should be "st,stm32h7-spdifrx"
  - reg: cpu DAI IP base address and size
  - clocks: must contain an entry for kclk (used as S/PDIF signal reference)
  - clock-names: must contain "kclk"
  - interrupts: cpu DAI interrupt line
  - dmas: DMA specifiers for audio data DMA and iec control flow DMA
    See STM32 DMA bindings, Documentation/devicetree/bindings/dma/st,stm32-dma.yaml
  - dma-names: two dmas have to be defined, "rx" and "rx-ctrl"

Optional properties:
  - resets: Reference to a reset controller asserting the SPDIFRX

The device node should contain one 'port' child node with one child 'endpoint'
node, according to the bindings defined in Documentation/devicetree/bindings/
graph.txt.

Example:
spdifrx: spdifrx@40004000 {
	compatible = "st,stm32h7-spdifrx";
	reg = <0x40004000 0x400>;
	clocks = <&rcc SPDIFRX_CK>;
	clock-names = "kclk";
	interrupts = <97>;
	dmas = <&dmamux1 2 93 0x400 0x0>,
	       <&dmamux1 3 94 0x400 0x0>;
	dma-names = "rx", "rx-ctrl";
	pinctrl-0 = <&spdifrx_pins>;
	pinctrl-names = "default";

	spdifrx_port: port {
		cpu_endpoint: endpoint {
			remote-endpoint = <&codec_endpoint>;
		};
	};
};

spdif_in: spdif-in {
	compatible = "linux,spdif-dir";

	codec_port: port {
		codec_endpoint: endpoint {
			remote-endpoint = <&cpu_endpoint>;
		};
	};
};

soundcard {
	compatible = "audio-graph-card";
	dais = <&spdifrx_port>;
};
```

## Documentation/devicetree/bindings/sound/st,stm32-spdifrx.yaml
```yaml
# SPDX-License-Identifier: (GPL-2.0-only OR BSD-2-Clause)
%YAML 1.2
---
$id: http://devicetree.org/schemas/sound/st,stm32-spdifrx.yaml#
$schema: http://devicetree.org/meta-schemas/core.yaml#

title: STMicroelectronics STM32 S/PDIF receiver (SPDIFRX)

maintainers:
  - Olivier Moysan <olivier.moysan@foss.st.com>

description: |
  The SPDIFRX peripheral, is designed to receive an S/PDIF flow compliant with
  IEC-60958 and IEC-61937.

properties:
  compatible:
    enum:
      - st,stm32h7-spdifrx

  "#sound-dai-cells":
    const: 0

  reg:
    maxItems: 1

  clocks:
    maxItems: 1

  clock-names:
    items:
      - const: kclk

  interrupts:
    maxItems: 1

  dmas:
    items:
      - description: audio data capture DMA
      - description: IEC status bits capture DMA

  dma-names:
    items:
      - const: rx
      - const: rx-ctrl

  resets:
    maxItems: 1

required:
  - compatible
  - "#sound-dai-cells"
  - reg
  - clocks
  - clock-names
  - interrupts
  - dmas
  - dma-names

additionalProperties: false

examples:
  - |
    #include <dt-bindings/interrupt-controller/arm-gic.h>
    #include <dt-bindings/clock/stm32mp1-clks.h>
    spdifrx: spdifrx@40004000 {
        compatible = "st,stm32h7-spdifrx";
        #sound-dai-cells = <0>;
        reg = <0x40004000 0x400>;
        clocks = <&rcc SPDIF_K>;
        clock-names = "kclk";
        interrupts = <GIC_SPI 97 IRQ_TYPE_LEVEL_HIGH>;
        dmas = <&dmamux1 2 93 0x400 0x0>,
               <&dmamux1 3 94 0x400 0x0>;
        dma-names = "rx", "rx-ctrl";
        pinctrl-0 = <&spdifrx_pins>;
        pinctrl-names = "default";
    };

...
```

## Documentation/devicetree/bindings/sound/starfive,jh7110-pwmdac.yaml
```yaml
# SPDX-License-Identifier: (GPL-2.0-only OR BSD-2-Clause)
%YAML 1.2
---
$id: http://devicetree.org/schemas/sound/starfive,jh7110-pwmdac.yaml#
$schema: http://devicetree.org/meta-schemas/core.yaml#

title: StarFive JH7110 PWM-DAC Controller

description:
  The PWM-DAC Controller uses PWM square wave generators plus RC filters to
  form a DAC for audio play in StarFive JH7110 SoC. This audio play controller
  supports 16 bit audio format, up to 48K sampling frequency, up to left and
  right dual channels.

maintainers:
  - Hal Feng <hal.feng@starfivetech.com>

allOf:
  - $ref: dai-common.yaml#

properties:
  compatible:
    const: starfive,jh7110-pwmdac

  reg:
    maxItems: 1

  clocks:
    items:
      - description: PWMDAC APB
      - description: PWMDAC CORE

  clock-names:
    items:
      - const: apb
      - const: core

  resets:
    maxItems: 1
    description: PWMDAC APB

  dmas:
    maxItems: 1
    description: TX DMA Channel

  dma-names:
    const: tx

  "#sound-dai-cells":
    const: 0

required:
  - compatible
  - reg
  - clocks
  - clock-names
  - resets
  - dmas
  - dma-names
  - "#sound-dai-cells"

additionalProperties: false

examples:
  - |
    pwmdac@100b0000 {
        compatible = "starfive,jh7110-pwmdac";
        reg = <0x100b0000 0x1000>;
        clocks = <&syscrg 157>,
                 <&syscrg 158>;
        clock-names = "apb", "core";
        resets = <&syscrg 96>;
        dmas = <&dma 22>;
        dma-names = "tx";
        #sound-dai-cells = <0>;
    };
```
