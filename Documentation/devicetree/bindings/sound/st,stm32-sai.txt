## Documentation/devicetree/bindings/sound/starfive,jh7110-tdm.yaml
```yaml
# SPDX-License-Identifier: (GPL-2.0-only OR BSD-2-Clause)
%YAML 1.2
---
$id: http://devicetree.org/schemas/sound/starfive,jh7110-tdm.yaml#
$schema: http://devicetree.org/meta-schemas/core.yaml#

title: StarFive JH7110 TDM Controller

description: |
  The TDM Controller is a Time Division Multiplexed audio interface
  integrated in StarFive JH7110 SoC, allowing up to 8 channels of
  audio over a serial interface. The TDM controller can operate both
  in master and slave mode.

maintainers:
  - Walker Chen <walker.chen@starfivetech.com>

allOf:
  - $ref: dai-common.yaml#

properties:
  compatible:
    enum:
      - starfive,jh7110-tdm

  reg:
    maxItems: 1

  clocks:
    items:
      - description: TDM AHB Clock
      - description: TDM APB Clock
      - description: TDM Internal Clock
      - description: TDM Clock
      - description: Inner MCLK
      - description: TDM External Clock

  clock-names:
    items:
      - const: tdm_ahb
      - const: tdm_apb
      - const: tdm_internal
      - const: tdm
      - const: mclk_inner
      - const: tdm_ext

  resets:
    items:
      - description: tdm ahb reset line
      - description: tdm apb reset line
      - description: tdm core reset line

  dmas:
    items:
      - description: RX DMA Channel
      - description: TX DMA Channel

  dma-names:
    items:
      - const: rx
      - const: tx

  "#sound-dai-cells":
    const: 0

required:
  - compatible
  - reg
  - clocks
  - clock-names
  - resets
  - dmas
  - dma-names
  - "#sound-dai-cells"

additionalProperties: false

examples:
  - |
    tdm@10090000 {
        compatible = "starfive,jh7110-tdm";
        reg = <0x10090000 0x1000>;
        clocks = <&syscrg 184>,
                 <&syscrg 185>,
                 <&syscrg 186>,
                 <&syscrg 187>,
                 <&syscrg 17>,
                 <&tdm_ext>;
        clock-names = "tdm_ahb", "tdm_apb",
                      "tdm_internal", "tdm",
                      "mclk_inner", "tdm_ext";
        resets = <&syscrg 105>,
                 <&syscrg 107>,
                 <&syscrg 106>;
        dmas = <&dma 20>, <&dma 21>;
        dma-names = "rx","tx";
        #sound-dai-cells = <0>;
    };
```

## Documentation/devicetree/bindings/sound/storm.txt
```
* Sound complex for Storm boards

Models a soundcard for Storm boards with the Qualcomm Technologies IPQ806x SOC
connected to a MAX98357A DAC via I2S.

Required properties:

- compatible	: "google,storm-audio"
- cpu		: Phandle of the CPU DAI
- codec		: Phandle of the codec DAI

Optional properties:

- qcom,model	: The user-visible name of this sound card.

Example:

sound {
	compatible = "google,storm-audio";
	qcom,model = "ipq806x-storm";
	cpu = <&lpass_cpu>;
	codec = <&max98357a>;
};
```

## Documentation/devicetree/bindings/sound/sun4i-codec.txt
```
* Allwinner A10 Codec

Required properties:
- compatible: must be one of the following compatibles:
		- "allwinner,sun4i-a10-codec"
		- "allwinner,sun6i-a31-codec"
		- "allwinner,sun7i-a20-codec"
		- "allwinner,sun8i-a23-codec"
		- "allwinner,sun8i-h3-codec"
- reg: must contain the registers location and length
- interrupts: must contain the codec interrupt
- dmas: DMA channels for tx and rx dma. See the DMA client binding,
	Documentation/devicetree/bindings/dma/dma.txt
- dma-names: should include "tx" and "rx".
- clocks: a list of phandle + clock-specifer pairs, one for each entry
  in clock-names.
- clock-names: should contain followings:
   - "apb": the parent APB clock for this controller
   - "codec": the parent module clock

Optional properties:
- allwinner,pa-gpios: gpio to enable external amplifier

Required properties for the following compatibles:
		- "allwinner,sun6i-a31-codec"
		- "allwinner,sun8i-a23-codec"
		- "allwinner,sun8i-h3-codec"
- resets: phandle to the reset control for this device
- allwinner,audio-routing: A list of the connections between audio components.
			   Each entry is a pair of strings, the first being the
			   connection's sink, the second being the connection's
			   source. Valid names include:

			   Audio pins on the SoC:
			   "HP"
			   "HPCOM"
			   "LINEIN"
			   "LINEOUT"	(not on sun8i-a23)
			   "MIC1"
			   "MIC2"
			   "MIC3"	(sun6i-a31 only)

			   Microphone biases from the SoC:
			   "HBIAS"
			   "MBIAS"

			   Board connectors:
			   "Headphone"
			   "Headset Mic"
			   "Line In"
			   "Line Out"
			   "Mic"
			   "Speaker"

Required properties for the following compatibles:
		- "allwinner,sun8i-a23-codec"
		- "allwinner,sun8i-h3-codec"
- allwinner,codec-analog-controls: A phandle to the codec analog controls
				   block in the PRCM.

Example:
codec: codec@01c22c00 {
	#sound-dai-cells = <0>;
	compatible = "allwinner,sun7i-a20-codec";
	reg = <0x01c22c00 0x40>;
	interrupts = <0 30 4>;
	clocks = <&apb0_gates 0>, <&codec_clk>;
	clock-names = "apb", "codec";
	dmas = <&dma 0 19>, <&dma 0 19>;
	dma-names = "rx", "tx";
};

codec: codec@01c22c00 {
	#sound-dai-cells = <0>;
	compatible = "allwinner,sun6i-a31-codec";
	reg = <0x01c22c00 0x98>;
	interrupts = <GIC_SPI 29 IRQ_TYPE_LEVEL_HIGH>;
	clocks = <&ccu CLK_APB1_CODEC>, <&ccu CLK_CODEC>;
	clock-names = "apb", "codec";
	resets = <&ccu RST_APB1_CODEC>;
	dmas = <&dma 15>, <&dma 15>;
	dma-names = "rx", "tx";
	allwinner,audio-routing =
		"Headphone", "HP",
		"Speaker", "LINEOUT",
		"LINEIN", "Line In",
		"MIC1",	"MBIAS",
		"MIC1", "Mic",
		"MIC2", "HBIAS",
		"MIC2", "Headset Mic";
};
```

## Documentation/devicetree/bindings/sound/sun4i-i2s.txt
```
* Allwinner A10 I2S controller

The I2S bus (Inter-IC sound bus) is a serial link for digital
audio data transfer between devices in the system.

Required properties:

- compatible: should be one of the following:
   - "allwinner,sun4i-a10-i2s"
   - "allwinner,sun6i-a31-i2s"
   - "allwinner,sun8i-h3-i2s"
- reg: physical base address of the controller and length of memory mapped
  region.
- interrupts: should contain the I2S interrupt.
- dmas: DMA specifiers for tx and rx dma. See the DMA client binding,
	Documentation/devicetree/bindings/dma/dma.txt
- dma-names: should include "tx" and "rx".
- clocks: a list of phandle + clock-specifer pairs, one for each entry in clock-names.
- clock-names: should contain the following:
   - "apb" : clock for the I2S bus interface
   - "mod" : module clock for the I2S controller
- #sound-dai-cells : Must be equal to 0

Required properties for the following compatibles:
	- "allwinner,sun6i-a31-i2s"
	- "allwinner,sun8i-h3-i2s"
- resets: phandle to the reset line for this codec

Example:

i2s0: i2s@01c22400 {
	#sound-dai-cells = <0>;
	compatible = "allwinner,sun4i-a10-i2s";
	reg = <0x01c22400 0x400>;
	interrupts = <GIC_SPI 16 IRQ_TYPE_LEVEL_HIGH>;
	clocks = <&apb0_gates 3>, <&i2s0_clk>;
	clock-names = "apb", "mod";
	dmas = <&dma SUN4I_DMA_NORMAL 3>,
	       <&dma SUN4I_DMA_NORMAL 3>;
	dma-names = "rx", "tx";
};
```

## Documentation/devicetree/bindings/sound/sun50i-codec-analog.txt
```
* Allwinner A64 Codec Analog Controls

Required properties:
- compatible: must be one of the following compatibles:
		- "allwinner,sun50i-a64-codec-analog"
- reg: must contain the registers location and length
- cpvdd-supply: Regulator supply for the headphone amplifier

Example:
	codec_analog: codec-analog@1f015c0 {
		compatible = "allwinner,sun50i-a64-codec-analog";
		reg = <0x01f015c0 0x4>;
		cpvdd-supply = <&reg_eldo1>;
	};
```

## Documentation/devicetree/bindings/sound/sun8i-a33-codec.txt
```
Allwinner SUN8I audio codec
------------------------------------

On Sun8i-A33 SoCs, the audio is separated in different parts:
	  - A DAI driver. It uses the "sun4i-i2s" driver which is
	  documented here:
	  Documentation/devicetree/bindings/sound/sun4i-i2s.txt
	  - An analog part of the codec which is handled as PRCM registers.
	  See Documentation/devicetree/bindings/sound/sun8i-codec-analog.txt
	  - An digital part of the codec which is documented in this current
	  binding documentation.
	  - And finally, an audio card which links all the above components.
	  The simple-audio card will be used.
	  See Documentation/devicetree/bindings/sound/simple-card.txt

This bindings documentation exposes Sun8i codec (digital part).

Required properties:
- compatible: must be "allwinner,sun8i-a33-codec"
- reg: must contain the registers location and length
- interrupts: must contain the codec interrupt
- clocks: a list of phandle + clock-specifer pairs, one for each entry
  in clock-names.
- clock-names: should contain followings:
   - "bus": the parent APB clock for this controller
   - "mod": the parent module clock

Here is an example to add a sound card and the codec binding on sun8i SoCs that
are similar to A33 using simple-card:

	sound {
		compatible = "simple-audio-card";
		simple-audio-card,name = "sun8i-a33-audio";
		simple-audio-card,format = "i2s";
		simple-audio-card,frame-master = <&link_codec>;
		simple-audio-card,bitclock-master = <&link_codec>;
		simple-audio-card,mclk-fs = <512>;
		simple-audio-card,aux-devs = <&codec_analog>;
		simple-audio-card,routing =
				"Left DAC", "Digital Left DAC",
				"Right DAC", "Digital Right DAC";

		simple-audio-card,cpu {
			sound-dai = <&dai>;
		};

		link_codec: simple-audio-card,codec {
			sound-dai = <&codec>;
		};

	soc@1c00000 {
		[...]

		audio-codec@1c22e00 {
			#sound-dai-cells = <0>;
			compatible = "allwinner,sun8i-a33-codec";
			reg = <0x01c22e00 0x400>;
			interrupts = <GIC_SPI 29 IRQ_TYPE_LEVEL_HIGH>;
			clocks = <&ccu CLK_BUS_CODEC>, <&ccu CLK_AC_DIG>;
			clock-names = "bus", "mod";
		};
	};
```

## Documentation/devicetree/bindings/sound/sun8i-codec-analog.txt
```
* Allwinner Codec Analog Controls

Required properties:
- compatible: must be one of the following compatibles:
		- "allwinner,sun8i-a23-codec-analog"
		- "allwinner,sun8i-h3-codec-analog"
		- "allwinner,sun8i-v3s-codec-analog"

Required properties if not a sub-node of the PRCM node:
- reg: must contain the registers location and length

Example:
prcm: prcm@1f01400 {
	codec_analog: codec-analog {
		compatible = "allwinner,sun8i-a23-codec-analog";
	};
};
```

## Documentation/devicetree/bindings/sound/sunxi,sun4i-spdif.txt
```
Allwinner Sony/Philips Digital Interface Format (S/PDIF) Controller

The Allwinner S/PDIF audio block is a transceiver that allows the
processor to receive and transmit digital audio via an coaxial cable or
a fibre cable.
For now only playback is supported.

Required properties:

  - compatible		: should be one of the following:
    - "allwinner,sun4i-a10-spdif": for the Allwinner A10 SoC
    - "allwinner,sun6i-a31-spdif": for the Allwinner A31 SoC
    - "allwinner,sun8i-h3-spdif": for the Allwinner H3 SoC

  - reg			: Offset and length of the register set for the device.

  - interrupts		: Contains the spdif interrupt.

  - dmas		: Generic dma devicetree binding as described in
			  Documentation/devicetree/bindings/dma/dma.txt.

  - dma-names		: Two dmas have to be defined, "tx" and "rx".

  - clocks		: Contains an entry for each entry in clock-names.

  - clock-names		: Includes the following entries:
	"apb"		  clock for the spdif bus.
	"spdif"		  clock for spdif controller.

  - resets		: reset specifier for the ahb reset (A31 and newer only)

Example:

spdif: spdif@01c21000 {
	compatible = "allwinner,sun4i-a10-spdif";
	reg = <0x01c21000 0x40>;
	interrupts = <13>;
	clocks = <&apb0_gates 1>, <&spdif_clk>;
	clock-names = "apb", "spdif";
	dmas = <&dma 0 2>, <&dma 0 2>;
	dma-names = "rx", "tx";
};
```

## Documentation/devicetree/bindings/sound/tas2552.txt
```
Texas Instruments - tas2552 Codec module

The tas2552 serial control bus communicates through I2C protocols

Required properties:
	- compatible - One of:
		"ti,tas2552" - TAS2552
	- reg -  I2C slave address: it can be 0x40 if ADDR pin is 0
				    or 0x41 if ADDR pin is 1.
	- supply-*: Required supply regulators are:
		"vbat"		battery voltage
		"iovdd"		I/O Voltage
		"avdd"		Analog DAC Voltage

Optional properties:
	- enable-gpio - gpio pin to enable/disable the device

tas2552 can receive its reference clock via MCLK, BCLK, IVCLKIN pin or use the
internal 1.8MHz. This CLKIN is used by the PLL. In addition to PLL, the PDM
reference clock is also selectable: PLL, IVCLKIN, BCLK or MCLK.
For system integration the dt-bindings/sound/tas2552.h header file provides
defined values to select and configure the PLL and PDM reference clocks.

Example:

tas2552: tas2552@41 {
	compatible = "ti,tas2552";
	reg = <0x41>;
	vbat-supply = <&reg_vbat>;
	iovdd-supply = <&reg_iovdd>;
	avdd-supply = <&reg_avdd>;
	enable-gpio = <&gpio4 2 GPIO_ACTIVE_HIGH>;
};

For more product information please see the link below:
http://www.ti.com/product/TAS2552
```

## Documentation/devicetree/bindings/sound/tas2562.txt
```
Texas Instruments TAS2562 Smart PA

The TAS2562 is a mono, digital input Class-D audio amplifier optimized for
efficiently driving high peak power into small loudspeakers.
Integrated speaker voltage and current sense provides for
real time monitoring of loudspeaker behavior.

Required properties:
 - #address-cells  - Should be <1>.
 - #size-cells     - Should be <0>.
 - compatible:	   - Should contain "ti,tas2562", "ti,tas2563".
 - reg:		   - The i2c address. Should be 0x4c, 0x4d, 0x4e or 0x4f.
 - ti,imon-slot-no:- TDM TX current sense time slot.
 - ti,vmon-slot-no:- TDM TX voltage sense time slot. This slot must always be
		     greater then ti,imon-slot-no.

Optional properties:
- interrupt-parent: phandle to the interrupt controller which provides
                    the interrupt.
- interrupts: (GPIO) interrupt to which the chip is connected.
- shut-down-gpio: GPIO used to control the state of the device.

Examples:
tas2562@4c {
        #address-cells = <1>;
        #size-cells = <0>;
        compatible = "ti,tas2562";
        reg = <0x4c>;

        interrupt-parent = <&gpio1>;
        interrupts = <14>;

	shut-down-gpio = <&gpio1 15 0>;
        ti,imon-slot-no = <0>;
        ti,vmon-slot-no = <1>;
};
```

## Documentation/devicetree/bindings/sound/tas2562.yaml
```yaml
# SPDX-License-Identifier: (GPL-2.0-only OR BSD-2-Clause)
# Copyright (C) 2019 Texas Instruments Incorporated
%YAML 1.2
---
$id: "http://devicetree.org/schemas/sound/tas2562.yaml#"
$schema: "http://devicetree.org/meta-schemas/core.yaml#"

title: Texas Instruments TAS2562 Smart PA

maintainers:
  - Dan Murphy <dmurphy@ti.com>

description: |
  The TAS2562 is a mono, digital input Class-D audio amplifier optimized for
  efficiently driving high peak power into small loudspeakers.
  Integrated speaker voltage and current sense provides for
  real time monitoring of loudspeaker behavior.

  Specifications about the audio amplifier can be found at:
    https://www.ti.com/lit/gpn/tas2562
    https://www.ti.com/lit/gpn/tas2563
    https://www.ti.com/lit/gpn/tas2564
    https://www.ti.com/lit/gpn/tas2110

properties:
  compatible:
    enum:
      - ti,tas2562
      - ti,tas2563
      - ti,tas2564
      - ti,tas2110

  reg:
    maxItems: 1
    description: |
       I2C address of the device can be one of these 0x4c, 0x4d, 0x4e or 0x4f

  shut-down-gpios:
    description: GPIO used to control the state of the device.
    deprecated: true

  shutdown-gpios:
    description: GPIO used to control the state of the device.

  interrupts:
    maxItems: 1

  ti,imon-slot-no:
    $ref: /schemas/types.yaml#/definitions/uint32
    description: TDM TX current sense time slot.

  '#sound-dai-cells':
    const: 1

required:
  - compatible
  - reg

additionalProperties: false

examples:
  - |
   #include <dt-bindings/gpio/gpio.h>
   i2c0 {
     #address-cells = <1>;
     #size-cells = <0>;
     codec: codec@4c {
       compatible = "ti,tas2562";
       reg = <0x4c>;
       #sound-dai-cells = <1>;
       interrupt-parent = <&gpio1>;
       interrupts = <14>;
       shutdown-gpios = <&gpio1 15 0>;
       ti,imon-slot-no = <0>;
     };
   };
```
