## Documentation/devicetree/bindings/sound/tas2770.txt
```
Texas Instruments TAS2770 Smart PA

The TAS2770 is a mono, digital input Class-D audio amplifier optimized for
efficiently driving high peak power into small loudspeakers.
Integrated speaker voltage and current sense provides for
real time monitoring of loudspeaker behavior.

Required properties:

 - compatible:	   - Should contain "ti,tas2770".
 - reg:		       - The i2c address. Should contain <0x4c>, <0x4d>,<0x4e>, or <0x4f>.
 - #address-cells  - Should be <1>.
 - #size-cells     - Should be <0>.
 - ti,asi-format:  - Sets TDM RX capture edge. 0->Rising; 1->Falling.
 - ti,imon-slot-no:- TDM TX current sense time slot.
 - ti,vmon-slot-no:- TDM TX voltage sense time slot.

Optional properties:

- interrupt-parent: the phandle to the interrupt controller which provides
                     the interrupt.
- interrupts: interrupt specification for data-ready.

Examples:

    tas2770@4c {
                compatible = "ti,tas2770";
                reg = <0x4c>;
                #address-cells = <1>;
                #size-cells = <0>;
                interrupt-parent = <&msm_gpio>;
                interrupts = <97 0>;
                ti,asi-format = <0>;
                ti,imon-slot-no = <0>;
                ti,vmon-slot-no = <2>;
        };
```

## Documentation/devicetree/bindings/sound/tas2770.yaml
```yaml
# SPDX-License-Identifier: (GPL-2.0-only OR BSD-2-Clause)
# Copyright (C) 2019-20 Texas Instruments Incorporated
%YAML 1.2
---
$id: "http://devicetree.org/schemas/sound/tas2770.yaml#"
$schema: "http://devicetree.org/meta-schemas/core.yaml#"

title: Texas Instruments TAS2770 Smart PA

maintainers:
  - Shi Fu <shifu0704@thundersoft.com>

description: |
  The TAS2770 is a mono, digital input Class-D audio amplifier optimized for
  efficiently driving high peak power into small loudspeakers.
  Integrated speaker voltage and current sense provides for
  real time monitoring of loudspeaker behavior.

properties:
  compatible:
    enum:
      - ti,tas2770

  reg:
    maxItems: 1
    description: |
       I2C address of the device can be between 0x41 to 0x48.

  reset-gpio:
    description: GPIO used to reset the device.

  shutdown-gpios:
    description: GPIO used to control the state of the device.

  interrupts:
    maxItems: 1

  ti,imon-slot-no:
    $ref: /schemas/types.yaml#/definitions/uint32
    description: TDM TX current sense time slot.

  ti,vmon-slot-no:
    $ref: /schemas/types.yaml#/definitions/uint32
    description: TDM TX voltage sense time slot.

  ti,asi-format:
    deprecated: true
    $ref: /schemas/types.yaml#/definitions/uint32
    description: Sets TDM RX capture edge.
    enum:
      - 0 # Rising edge
      - 1 # Falling edge

  '#sound-dai-cells':
    const: 1

required:
  - compatible
  - reg

additionalProperties: false

examples:
  - |
   #include <dt-bindings/gpio/gpio.h>
   i2c0 {
     #address-cells = <1>;
     #size-cells = <0>;
     codec: codec@41 {
       compatible = "ti,tas2770";
       reg = <0x41>;
       #sound-dai-cells = <1>;
       interrupt-parent = <&gpio1>;
       interrupts = <14>;
       reset-gpio = <&gpio1 15 0>;
       shutdown-gpios = <&gpio1 14 0>;
       ti,imon-slot-no = <0>;
       ti,vmon-slot-no = <2>;
     };
   };
```

## Documentation/devicetree/bindings/sound/tas571x.txt
```
Texas Instruments TAS5711/TAS5717/TAS5719/TAS5721 stereo power amplifiers

The codec is controlled through an I2C interface.  It also has two other
signals that can be wired up to GPIOs: reset (strongly recommended), and
powerdown (optional).

Required properties:

- compatible: should be one of the following:
  - "ti,tas5707"
  - "ti,tas5711",
  - "ti,tas5717",
  - "ti,tas5719",
  - "ti,tas5721"
- reg: The I2C address of the device
- #sound-dai-cells: must be equal to 0

Optional properties:

- reset-gpios: GPIO specifier for the TAS571x's active low reset line
- pdn-gpios: GPIO specifier for the TAS571x's active low powerdown line
- clocks: clock phandle for the MCLK input
- clock-names: should be "mclk"
- AVDD-supply: regulator phandle for the AVDD supply (all chips)
- DVDD-supply: regulator phandle for the DVDD supply (all chips)
- HPVDD-supply: regulator phandle for the HPVDD supply (5717/5719)
- PVDD_AB-supply: regulator phandle for the PVDD_AB supply (5717/5719)
- PVDD_CD-supply: regulator phandle for the PVDD_CD supply (5717/5719)
- PVDD_A-supply: regulator phandle for the PVDD_A supply (5711)
- PVDD_B-supply: regulator phandle for the PVDD_B supply (5711)
- PVDD_C-supply: regulator phandle for the PVDD_C supply (5711)
- PVDD_D-supply: regulator phandle for the PVDD_D supply (5711)
- DRVDD-supply: regulator phandle for the DRVDD supply (5721)
- PVDD-supply: regulator phandle for the PVDD supply (5721)

Example:

	tas5717: audio-codec@2a {
		compatible = "ti,tas5717";
		reg = <0x2a>;
		#sound-dai-cells = <0>;

		reset-gpios = <&gpio5 1 GPIO_ACTIVE_LOW>;
		pdn-gpios = <&gpio5 2 GPIO_ACTIVE_LOW>;

		clocks = <&clk_core CLK_I2S>;
		clock-names = "mclk";
	};
```

## Documentation/devicetree/bindings/sound/tas5720.txt
```
Texas Instruments TAS5720 Mono Audio amplifier

The TAS5720 serial control bus communicates through the I2C protocol only. The
serial bus is also used for periodic codec fault checking/reporting during
audio playback. For more product information please see the links below:

https://www.ti.com/product/TAS5720L
https://www.ti.com/product/TAS5720M
https://www.ti.com/product/TAS5722L

Required properties:

- compatible : "ti,tas5720",
               "ti,tas5722"
- reg : I2C slave address
- dvdd-supply : phandle to a 3.3-V supply for the digital circuitry
- pvdd-supply : phandle to a supply used for the Class-D amp and the analog

Example:

tas5720: tas5720@6c {
	compatible = "ti,tas5720";
	reg = <0x6c>;
	dvdd-supply = <&vdd_3v3_reg>;
	pvdd-supply = <&amp_supply_reg>;
};
```

## Documentation/devicetree/bindings/sound/tas5805m.yaml
```yaml
# SPDX-License-Identifier: (GPL-2.0-only OR BSD-2-Clause)
%YAML 1.2
---
$id: http://devicetree.org/schemas/sound/tas5805m.yaml#
$schema: http://devicetree.org/meta-schemas/core.yaml#

title: TAS5805M audio amplifier

maintainers:
  - Daniel Beer <daniel.beer@igorinstitute.com>

description: |
  The TAS5805M is a class D audio amplifier with a built-in DSP.

properties:
  compatible:
    enum:
      - ti,tas5805m

  reg:
    maxItems: 1
    description: |
      I2C address of the amplifier. See the datasheet for possible values.

  pvdd-supply:
    description: |
      Regulator for audio power supply (PVDD in the datasheet).

  pdn-gpios:
    description: |
      Power-down control GPIO (PDN pin in the datasheet).

  ti,dsp-config-name:
    description: |
      The name of the DSP configuration that should be loaded for this
      instance. Configuration blobs are sequences of register writes
      generated from TI's PPC3 tool.
    $ref: /schemas/types.yaml#/definitions/string

examples:
  - |
    i2c0 {
        #address-cells = <1>;
        #size-cells = <0>;
        tas5805m: tas5805m@2c {
                reg = <0x2c>;
                compatible = "ti,tas5805m";

                pvdd-supply = <&audiopwr>;
                pdn-gpios = <&tlmm 160 0>;

                ti,dsp-config-name = "mono_pbtl_48khz";
        };
    };

additionalProperties: true
```

## Documentation/devicetree/bindings/sound/tc358749x.txt
```
Toshiba tc358749x audio CODEC

Required properties:

- compatible: "toshiba,tc358749x"
- reg: the I2C address of the device for I2C
- power-gpios: tc358749x 1.2v power control gpio
- power18-gpios: tc358749x 1.8v power control gpio
- power33-gpios: tc358749x 3.3v power control gpio
- csi-ctl-gpios: rk3399-sapphire hw csi select control
- stanby-gpios: tc358749x stanby pin control
- reset-gpios: tc358749x reset pin control
- int-gpios: tc358749x interrupt pin control gpio
- pinctrl-names: must contain a "default" entry.
- pinctrl-0: pin control group to be used for gpio.

Example:

tc358749x: tc358749x@0f {
	compatible = "toshiba,tc358749x";
	reg = <0x0f>;
	power-gpios = <&gpio2 6 GPIO_ACTIVE_HIGH>;
	power18-gpios = <&gpio2 9 GPIO_ACTIVE_HIGH>;
	power33-gpios = <&gpio2 5 GPIO_ACTIVE_HIGH>;
	csi-ctl-gpios = <&gpio2 10 GPIO_ACTIVE_HIGH>;
	stanby-gpios = <&gpio2 8 GPIO_ACTIVE_HIGH>;
	reset-gpios = <&gpio2 7 GPIO_ACTIVE_HIGH>;
	int-gpios = <&gpio2 12 GPIO_ACTIVE_HIGH>;
	pinctrl-names = "default";
	pinctrl-0 = <&hdmiin_gpios>;
	status = "okay";
};
```

## Documentation/devicetree/bindings/sound/tda7419.txt
```
TDA7419 audio processor

This device supports I2C only.

Required properties:

- compatible : "st,tda7419"
- reg : the I2C address of the device.
- vdd-supply : a regulator spec for the common power supply (8-10V)

Optional properties:

- st,mute-gpios : a GPIO spec for the MUTE pin.

Pins on the device (for linking into audio routes):

  * SE3L
  * SE3R
  * SE2L
  * SE2R
  * SE1L
  * SE1R
  * DIFFL
  * DIFFR
  * MIX
  * OUTLF
  * OUTRF
  * OUTLR
  * OUTRR
  * OUTSW

Example:

ap: tda7419@44 {
	compatible = "st,tda7419";
	reg = <0x44>;
	vdd-supply = <&vdd_9v0_reg>;
};
```

## Documentation/devicetree/bindings/sound/tdm-slot.txt
```
TDM slot:

This specifies audio DAI's TDM slot.

TDM slot properties:
dai-tdm-slot-num : Number of slots in use.
dai-tdm-slot-width : Width in bits for each slot.
dai-tdm-slot-tx-mask : Transmit direction slot mask, optional
dai-tdm-slot-rx-mask : Receive direction slot mask, optional

For instance:
	dai-tdm-slot-num = <2>;
	dai-tdm-slot-width = <8>;
	dai-tdm-slot-tx-mask = <0 1>;
	dai-tdm-slot-rx-mask = <1 0>;

And for each specified driver, there could be one .of_xlate_tdm_slot_mask()
to specify an explicit mapping of the channels and the slots. If it's absent
the default snd_soc_of_xlate_tdm_slot_mask() will be used to generating the
tx and rx masks.

For snd_soc_of_xlate_tdm_slot_mask(), the tx and rx masks will use a 1 bit
for an active slot as default, and the default active bits are at the LSB of
the masks.

The explicit masks are given as array of integers, where the first
number presents bit-0 (LSB), second presents bit-1, etc. Any non zero
number is considered 1 and 0 is 0. snd_soc_of_xlate_tdm_slot_mask()
does not do anything, if either mask is set non zero value.
```

## Documentation/devicetree/bindings/sound/tdm-slot.yaml
```yaml
# SPDX-License-Identifier: (GPL-2.0-only OR BSD-2-Clause)
%YAML 1.2
---
$id: http://devicetree.org/schemas/sound/tdm-slot.yaml#
$schema: http://devicetree.org/meta-schemas/core.yaml#

title: Time Division Multiplexing (TDM) Slot Parameters

maintainers:
  - Liam Girdwood <lgirdwood@gmail.com>

select: false

properties:
  dai-tdm-slot-num:
    $ref: /schemas/types.yaml#/definitions/uint32
    description: Number of slots in use

  dai-tdm-slot-width:
    $ref: /schemas/types.yaml#/definitions/uint32
    description: Width, in bits, of each slot

  dai-tdm-idle-mode:
    $ref: /schemas/types.yaml#/definitions/string
    enum:
      - none
      - off
      - zero
      - pulldown
      - hiz
      - pullup
      - drivehigh
    description: Drive mode for inactive/idle TDM slots. For hardware that
      implements .set_tdm_idle(). Optional. "None" represents undefined
      behaviour and is the same as not setting this property.

patternProperties:
  '^dai-tdm-slot-[rt]x-mask$':
    $ref: /schemas/types.yaml#/definitions/uint32-array
    description: Slot mask for active TDM slots. Optional. Drivers may
      specify .xlate_tdm_slot_mask() to generate a slot mask dynamically. If
      neither this property nor a driver-specific function are specified, the
      default snd_soc_xlate_tdm_slot_mask() function will be used to generate
      a mask. The first element of the array is slot 0 (LSB). Any nonzero
      value will be treated as 1.

  '^dai-tdm-slot-[rt]x-idle-mask$':
    $ref: /schemas/types.yaml#/definitions/uint32
    description: Idle slot mask. Optional. A bit being set to 1 indicates
      that the corresponding TDM slot is inactive/idle.

additionalProperties: true
```
