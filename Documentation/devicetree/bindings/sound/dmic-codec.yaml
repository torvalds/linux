## Documentation/devicetree/bindings/sound/fsl,audmix.yaml
```yaml
# SPDX-License-Identifier: (GPL-2.0-only OR BSD-2-Clause)
%YAML 1.2
---
$id: http://devicetree.org/schemas/sound/fsl,audmix.yaml#
$schema: http://devicetree.org/meta-schemas/core.yaml#

title: NXP Audio Mixer (AUDMIX).

maintainers:
  - Shengjiu Wang <shengjiu.wang@nxp.com>
  - Frank Li <Frank.Li@nxp.com>

description: |
  The Audio Mixer is a on-chip functional module that allows mixing of two
  audio streams into a single audio stream. Audio Mixer has two input serial
  audio interfaces. These are driven by two Synchronous Audio interface
  modules (SAI). Each input serial interface carries 8 audio channels in its
  frame in TDM manner. Mixer mixes audio samples of corresponding channels
  from two interfaces into a single sample. Before mixing, audio samples of
  two inputs can be attenuated based on configuration. The output of the
  Audio Mixer is also a serial audio interface. Like input interfaces it has
  the same TDM frame format. This output is used to drive the serial DAC TDM
  interface of audio codec and also sent to the external pins along with the
  receive path of normal audio SAI module for readback by the CPU.

  The output of Audio Mixer can be selected from any of the three streams
    - serial audio input 1
    - serial audio input 2
    - mixed audio

  Mixing operation is independent of audio sample rate but the two audio
  input streams must have same audio sample rate with same number of channels
  in TDM frame to be eligible for mixing.

properties:
  compatible:
    const: fsl,imx8qm-audmix

  reg:
    maxItems: 1

  clocks:
    maxItems: 1

  clock-names:
    items:
      - const: ipg

  power-domains:
    maxItems: 1

  dais:
    description: contain a list of phandles to AUDMIX connected DAIs.
    $ref: /schemas/types.yaml#/definitions/phandle-array
    minItems: 2
    items:
      - description: the AUDMIX output
        maxItems: 1
      - description: serial audio input 1
        maxItems: 1
      - description: serial audio input 2
        maxItems: 1

  ports:
    $ref: /schemas/graph.yaml#/properties/ports
    patternProperties:
      '^port@[0-1]':
        $ref: audio-graph-port.yaml#
        unevaluatedProperties: false
        description: Input port from SAI TX

    properties:
      port@2:
        $ref: audio-graph-port.yaml#
        unevaluatedProperties: false
        description: Output port to SAI RX

required:
  - compatible
  - reg
  - clocks
  - clock-names
  - power-domains

unevaluatedProperties: false

examples:
  - |
    audmix@59840000 {
      compatible = "fsl,imx8qm-audmix";
      reg = <0x59840000 0x10000>;
      clocks = <&amix_lpcg 0>;
      clock-names = "ipg";
      power-domains = <&pd_audmix>;
      dais = <&sai4>, <&sai5>;

      ports {
        #address-cells = <1>;
        #size-cells = <0>;

        port@0 {
          reg = <0>;
          playback-only;

          amix_endpoint0: endpoint {
            dai-tdm-slot-num = <8>;
            dai-tdm-slot-width = <32>;
            dai-tdm-slot-width-map = <32 8 32>;
            dai-format = "dsp_a";
            remote-endpoint = <&be00_ep>;
          };
        };

        port@1 {
          reg = <1>;
          playback-only;

          amix_endpoint1: endpoint {
            dai-tdm-slot-num = <8>;
            dai-tdm-slot-width = <32>;
            dai-tdm-slot-width-map = <32 8 32>;
            dai-format = "dsp_a";
            remote-endpoint = <&be01_ep>;
          };
        };

        port@2 {
          reg = <2>;
          capture-only;

          amix_endpoint2: endpoint {
            dai-tdm-slot-num = <8>;
            dai-tdm-slot-width = <32>;
            dai-tdm-slot-width-map = <32 8 32>;
            dai-format = "dsp_a";
            bitclock-master;
            frame-master;
            remote-endpoint = <&be02_ep>;
          };
        };
      };
    };
```

## Documentation/devicetree/bindings/sound/fsl,easrc.yaml
```yaml
# SPDX-License-Identifier: (GPL-2.0-only OR BSD-2-Clause)
%YAML 1.2
---
$id: http://devicetree.org/schemas/sound/fsl,easrc.yaml#
$schema: http://devicetree.org/meta-schemas/core.yaml#

title: NXP Asynchronous Sample Rate Converter (ASRC) Controller

maintainers:
  - Shengjiu Wang <shengjiu.wang@nxp.com>

properties:
  $nodename:
    pattern: "^easrc@.*"

  compatible:
    oneOf:
      - enum:
          - fsl,imx8mn-easrc
      - items:
          - enum:
              - fsl,imx8mp-easrc
          - const: fsl,imx8mn-easrc

  reg:
    maxItems: 1

  interrupts:
    maxItems: 1

  clocks:
    items:
      - description: Peripheral clock

  clock-names:
    items:
      - const: mem

  dmas:
    maxItems: 8

  dma-names:
    items:
      - const: ctx0_rx
      - const: ctx0_tx
      - const: ctx1_rx
      - const: ctx1_tx
      - const: ctx2_rx
      - const: ctx2_tx
      - const: ctx3_rx
      - const: ctx3_tx

  firmware-name:
    $ref: /schemas/types.yaml#/definitions/string
    const: imx/easrc/easrc-imx8mn.bin
    description: The coefficient table for the filters

  fsl,asrc-rate:
    $ref: /schemas/types.yaml#/definitions/uint32
    minimum: 8000
    maximum: 192000
    description: Defines a mutual sample rate used by DPCM Back Ends

  fsl,asrc-format:
    $ref: /schemas/types.yaml#/definitions/uint32
    enum: [2, 6, 10, 32, 36]
    default: 2
    description:
      Defines a mutual sample format used by DPCM Back Ends

required:
  - compatible
  - reg
  - interrupts
  - clocks
  - clock-names
  - dmas
  - dma-names
  - firmware-name
  - fsl,asrc-rate
  - fsl,asrc-format

additionalProperties: false

examples:
  - |
    #include <dt-bindings/clock/imx8mn-clock.h>

    easrc: easrc@300c0000 {
           compatible = "fsl,imx8mn-easrc";
           reg = <0x300c0000 0x10000>;
           interrupts = <0x0 122 0x4>;
           clocks = <&clk IMX8MN_CLK_ASRC_ROOT>;
           clock-names = "mem";
           dmas = <&sdma2 16 23 0> , <&sdma2 17 23 0>,
                  <&sdma2 18 23 0> , <&sdma2 19 23 0>,
                  <&sdma2 20 23 0> , <&sdma2 21 23 0>,
                  <&sdma2 22 23 0> , <&sdma2 23 23 0>;
           dma-names = "ctx0_rx", "ctx0_tx",
                       "ctx1_rx", "ctx1_tx",
                       "ctx2_rx", "ctx2_tx",
                       "ctx3_rx", "ctx3_tx";
           firmware-name = "imx/easrc/easrc-imx8mn.bin";
           fsl,asrc-rate  = <8000>;
           fsl,asrc-format = <2>;
    };
```

## Documentation/devicetree/bindings/sound/fsl,esai.txt
```
Freescale Enhanced Serial Audio Interface (ESAI) Controller

The Enhanced Serial Audio Interface (ESAI) provides a full-duplex serial port
for serial communication with a variety of serial devices, including industry
standard codecs, Sony/Phillips Digital Interface (S/PDIF) transceivers, and
other DSPs. It has up to six transmitters and four receivers.

Required properties:

  - compatible		: Compatible list, must contain "fsl,imx35-esai" or
			  "fsl,vf610-esai"

  - reg			: Offset and length of the register set for the device.

  - interrupts		: Contains the spdif interrupt.

  - dmas		: Generic dma devicetree binding as described in
			  Documentation/devicetree/bindings/dma/dma.txt.

  - dma-names		: Two dmas have to be defined, "tx" and "rx".

  - clocks		: Contains an entry for each entry in clock-names.

  - clock-names		: Includes the following entries:
	"core"		  The core clock used to access registers
	"extal"		  The esai baud clock for esai controller used to
			  derive HCK, SCK and FS.
	"fsys"		  The system clock derived from ahb clock used to
			  derive HCK, SCK and FS.
	"spba"		  The spba clock is required when ESAI is placed as a
			  bus slave of the Shared Peripheral Bus and when two
			  or more bus masters (CPU, DMA or DSP) try to access
			  it. This property is optional depending on the SoC
			  design.

  - fsl,fifo-depth	: The number of elements in the transmit and receive
			  FIFOs. This number is the maximum allowed value for
			  TFCR[TFWM] or RFCR[RFWM].

  - fsl,esai-synchronous: This is a boolean property. If present, indicating
			  that ESAI would work in the synchronous mode, which
			  means all the settings for Receiving would be
			  duplicated from Transmition related registers.

  - big-endian		: If this property is absent, the native endian mode
			  will be in use as default, or the big endian mode
			  will be in use for all the device registers.

Example:

esai: esai@2024000 {
	compatible = "fsl,imx35-esai";
	reg = <0x02024000 0x4000>;
	interrupts = <0 51 0x04>;
	clocks = <&clks 208>, <&clks 118>, <&clks 208>;
	clock-names = "core", "extal", "fsys";
	dmas = <&sdma 23 21 0>, <&sdma 24 21 0>;
	dma-names = "rx", "tx";
	fsl,fifo-depth = <128>;
	fsl,esai-synchronous;
	big-endian;
};
```
