## Documentation/devicetree/bindings/sound/everest,es8328.yaml
```yaml
# SPDX-License-Identifier: (GPL-2.0-only OR BSD-2-Clause)
%YAML 1.2
---
$id: http://devicetree.org/schemas/sound/everest,es8328.yaml#
$schema: http://devicetree.org/meta-schemas/core.yaml#

title: Everest ES8328 audio CODEC

description:
  Everest Audio Codec, which can be connected via I2C or SPI.
  Pins on the device (for linking into audio routes) are
  * LOUT1
  * LOUT2
  * ROUT1
  * ROUT2
  * LINPUT1
  * RINPUT1
  * LINPUT2
  * RINPUT2
  * Mic Bias

maintainers:
  - David Yang <yangxiaohua@everest-semi.com>

properties:
  compatible:
    oneOf:
      - enum:
          - everest,es8328
      - items:
          - enum:
              - everest,es8388
          - const: everest,es8328

  reg:
    maxItems: 1

  "#sound-dai-cells":
    const: 0

  clocks:
    items:
      - description: A 22.5792 or 11.2896 MHz clock

  DVDD-supply:
    description: Regulator providing digital core supply voltage 1.8 - 3.6V

  AVDD-supply:
    description: Regulator providing analog supply voltage 3.3V

  PVDD-supply:
    description: Regulator providing digital IO supply voltage 1.8 - 3.6V

  HPVDD-supply:
    description: Regulator providing analog output voltage 3.3V

  port:
    $ref: audio-graph-port.yaml#
    unevaluatedProperties: false

required:
  - compatible
  - reg
  - clocks
  - DVDD-supply
  - AVDD-supply
  - PVDD-supply
  - HPVDD-supply

additionalProperties: false

examples:
  - |
    i2c {
      #address-cells = <1>;
      #size-cells = <0>;
      es8328: codec@11 {
        compatible = "everest,es8328";
        reg = <0x11>;
        AVDD-supply = <&reg_3p3v>;
        DVDD-supply = <&reg_3p3v>;
        HPVDD-supply = <&reg_3p3v>;
        PVDD-supply = <&reg_3p3v>;
        clocks = <&clks 169>;
      };
    };
```

## Documentation/devicetree/bindings/sound/everest,es8375.yaml
```yaml
# SPDX-License-Identifier: (GPL-2.0-only OR BSD-2-Clause)
%YAML 1.2
---
$id: http://devicetree.org/schemas/sound/everest,es8375.yaml#
$schema: http://devicetree.org/meta-schemas/core.yaml#

title: Everest ES8375 audio CODEC

maintainers:
  - Michael Zhang <zhangyi@everest-semi.com>

allOf:
  - $ref: dai-common.yaml#

properties:
  compatible:
    const: everest,es8375

  reg:
    maxItems: 1

  clocks:
    items:
      - description: clock for master clock (MCLK)

  clock-names:
    items:
      - const: mclk

  vdda-supply:
    description:
      Analogue power supply.

  vddd-supply:
    description:
      Interface power supply.

  everest,mclk-src:
    $ref: /schemas/types.yaml#/definitions/uint8
    description: |
      Represents the MCLK/SCLK pair pins used as the internal clock.
      0 represents selecting MCLK.
      1 represents selecting SCLK.
    enum: [0, 1]
    default: 0

  "#sound-dai-cells":
    const: 0

required:
  - compatible
  - reg
  - "#sound-dai-cells"
  - vdda-supply
  - vddd-supply

additionalProperties: false

examples:
  - |
    i2c {
      #address-cells = <1>;
      #size-cells = <0>;
      es8375: codec@18 {
        compatible = "everest,es8375";
        reg = <0x18>;
        vdda-supply = <&vdd3v3>;
        vddd-supply = <&vdd3v3>;
        #sound-dai-cells = <0>;
      };
    };
```

## Documentation/devicetree/bindings/sound/everest,es8389.yaml
```yaml
# SPDX-License-Identifier: (GPL-2.0-only OR BSD-2-Clause)
%YAML 1.2
---
$id: http://devicetree.org/schemas/sound/everest,es8389.yaml#
$schema: http://devicetree.org/meta-schemas/core.yaml#

title: Everest ES8389 audio CODEC

maintainers:
  - Michael Zhang <zhangyi@everest-semi.com>

allOf:
  - $ref: dai-common.yaml#

properties:
  compatible:
    const: everest,es8389

  reg:
    maxItems: 1

  clocks:
    items:
      - description: clock for master clock (MCLK)

  clock-names:
    items:
      - const: mclk

  "#sound-dai-cells":
    const: 0

required:
  - compatible
  - reg
  - "#sound-dai-cells"

additionalProperties: false

examples:
  - |
    i2c {
      #address-cells = <1>;
      #size-cells = <0>;
      es8389: codec@10 {
        compatible = "everest,es8389";
        reg = <0x10>;
        #sound-dai-cells = <0>;
      };
    };
```

## Documentation/devicetree/bindings/sound/fm1288.txt
```
FM1288 Voice Processor Codec

Required properties:

  - compatible: "fm1288"
  - reg: the I2C address of the device for I2C
  - pwd-gpios: Power down control

Optional properties:

- bypass-gpios: Voice data by-pass control

Example:

fm1288: fm1288@60 {
	compatible = "fm1288";
	reg = <0x60>;
	pwd-gpios = <&gpio0 RK_PD1 GPIO_ACTIVE_HIGH>;
	bypass-gpios = <&gpio0 RK_PD4 GPIO_ACTIVE_HIGH>;
};
```

## Documentation/devicetree/bindings/sound/foursemi,fs2105s.yaml
```yaml
# SPDX-License-Identifier: (GPL-2.0-only OR BSD-2-Clause)
%YAML 1.2
---
$id: http://devicetree.org/schemas/sound/foursemi,fs2105s.yaml#
$schema: http://devicetree.org/meta-schemas/core.yaml#

title: FourSemi FS2104/5S Digital Audio Amplifier

maintainers:
  - Nick Li <nick.li@foursemi.com>

description:
  The FS2104 is a 15W Inductor-Less, Stereo, Closed-Loop,
  Digital Input Class-D Power Amplifier with Enhanced Signal Processing.
  The FS2105S is a 30W Inductor-Less, Stereo, Closed-Loop,
  Digital Input Class-D Power Amplifier with Enhanced Signal Processing.

properties:
  compatible:
    oneOf:
      - items:
          - enum:
              - foursemi,fs2104
          - const: foursemi,fs2105s
      - enum:
          - foursemi,fs2105s

  reg:
    maxItems: 1

  clocks:
    items:
      - description: The clock of I2S BCLK

  clock-names:
    items:
      - const: bclk

  interrupts:
    maxItems: 1

  '#sound-dai-cells':
    const: 0

  pvdd-supply:
    description:
      Regulator for power supply(PVDD in datasheet).

  dvdd-supply:
    description:
      Regulator for digital supply(DVDD in datasheet).

  reset-gpios:
    maxItems: 1
    description:
      It's the SDZ pin in datasheet, the pin is active low,
      it will power down and reset the chip to shut down state.

  firmware-name:
    maxItems: 1
    description: |
      The firmware(*.bin) contains:
      a. Register initialization settings
      b. DSP effect parameters
      c. Multi-scene sound effect configurations(optional)
      It's gernerated by FourSemi's tuning tool.

required:
  - compatible
  - reg
  - '#sound-dai-cells'
  - pvdd-supply
  - dvdd-supply
  - reset-gpios
  - firmware-name

allOf:
  - $ref: dai-common.yaml#

unevaluatedProperties: false

examples:
  - |
    #include <dt-bindings/gpio/gpio.h>
    i2c {
        #address-cells = <1>;
        #size-cells = <0>;
        audio-codec@68 {
            compatible = "foursemi,fs2105s";
            reg = <0x68>;
            clocks = <&clocks 18>;
            clock-names = "bclk";
            #sound-dai-cells = <0>;
            pvdd-supply = <&pvdd_supply>;
            dvdd-supply = <&dvdd_supply>;
            reset-gpios = <&gpio 18 GPIO_ACTIVE_LOW>;
            firmware-name = "fs2105s-btl-2p0-0s.bin";
            pinctrl-names = "default";
            pinctrl-0 = <&fs210x_pins_default>;
        };
    };
```

## Documentation/devicetree/bindings/sound/fsl,asrc.txt
```
Freescale Asynchronous Sample Rate Converter (ASRC) Controller

The Asynchronous Sample Rate Converter (ASRC) converts the sampling rate of a
signal associated with an input clock into a signal associated with a different
output clock. The driver currently works as a Front End of DPCM with other Back
Ends Audio controller such as ESAI, SSI and SAI. It has three pairs to support
three substreams within totally 10 channels.

Required properties:

  - compatible		: Compatible list, should contain one of the following
			  compatibles:
			  "fsl,imx35-asrc",
			  "fsl,imx53-asrc",
			  "fsl,imx8qm-asrc",
			  "fsl,imx8qxp-asrc",

  - reg			: Offset and length of the register set for the device.

  - interrupts		: Contains the spdif interrupt.

  - dmas		: Generic dma devicetree binding as described in
			  Documentation/devicetree/bindings/dma/dma.txt.

  - dma-names		: Contains "rxa", "rxb", "rxc", "txa", "txb" and "txc".

  - clocks		: Contains an entry for each entry in clock-names.

  - clock-names		: Contains the following entries
	"mem"		  Peripheral access clock to access registers.
	"ipg"		  Peripheral clock to driver module.
	"asrck_<0-f>"	  Clock sources for input and output clock.
	"spba"		  The spba clock is required when ASRC is placed as a
			  bus slave of the Shared Peripheral Bus and when two
			  or more bus masters (CPU, DMA or DSP) try to access
			  it. This property is optional depending on the SoC
			  design.

   - fsl,asrc-rate	: Defines a mutual sample rate used by DPCM Back Ends.

   - fsl,asrc-width	: Defines a mutual sample width used by DPCM Back Ends.

   - fsl,asrc-clk-map   : Defines clock map used in driver. which is required
			  by imx8qm/imx8qxp platform
			  <0> - select the map for asrc0 in imx8qm/imx8qxp
			  <1> - select the map for asrc1 in imx8qm/imx8qxp

Optional properties:

   - big-endian		: If this property is absent, the little endian mode
			  will be in use as default. Otherwise, the big endian
			  mode will be in use for all the device registers.

   - fsl,asrc-format	: Defines a mutual sample format used by DPCM Back
			  Ends, which can replace the fsl,asrc-width.
			  The value is 2 (S16_LE), or 6 (S24_LE).

Example:

asrc: asrc@2034000 {
	compatible = "fsl,imx53-asrc";
	reg = <0x02034000 0x4000>;
	interrupts = <0 50 IRQ_TYPE_LEVEL_HIGH>;
	clocks = <&clks 107>, <&clks 107>, <&clks 0>,
	       <&clks 0>, <&clks 0>, <&clks 0>, <&clks 0>,
	       <&clks 0>, <&clks 0>, <&clks 0>, <&clks 0>,
	       <&clks 0>, <&clks 0>, <&clks 0>, <&clks 0>,
	       <&clks 107>, <&clks 0>, <&clks 0>;
	clock-names = "mem", "ipg", "asrck0",
		"asrck_1", "asrck_2", "asrck_3", "asrck_4",
		"asrck_5", "asrck_6", "asrck_7", "asrck_8",
		"asrck_9", "asrck_a", "asrck_b", "asrck_c",
		"asrck_d", "asrck_e", "asrck_f";
	dmas = <&sdma 17 23 1>, <&sdma 18 23 1>, <&sdma 19 23 1>,
	     <&sdma 20 23 1>, <&sdma 21 23 1>, <&sdma 22 23 1>;
	dma-names = "rxa", "rxb", "rxc",
		"txa", "txb", "txc";
	fsl,asrc-rate  = <48000>;
	fsl,asrc-width = <16>;
};
```

## Documentation/devicetree/bindings/sound/fsl,aud2htx.yaml
```yaml
# SPDX-License-Identifier: (GPL-2.0-only OR BSD-2-Clause)
%YAML 1.2
---
$id: http://devicetree.org/schemas/sound/fsl,aud2htx.yaml#
$schema: http://devicetree.org/meta-schemas/core.yaml#

title: NXP Audio Subsystem to HDMI RTX Subsystem Controller

maintainers:
  - Shengjiu Wang <shengjiu.wang@nxp.com>

properties:
  compatible:
    const: fsl,imx8mp-aud2htx

  reg:
    maxItems: 1

  interrupts:
    maxItems: 1

  clocks:
    items:
      - description: Peripheral clock

  clock-names:
    items:
      - const: bus

  dmas:
    items:
      - description: DMA controller phandle and request line for TX

  dma-names:
    items:
      - const: tx

  power-domains:
    maxItems: 1

required:
  - compatible
  - reg
  - interrupts
  - clocks
  - clock-names
  - dmas
  - dma-names

additionalProperties: false

examples:
  - |
    #include <dt-bindings/interrupt-controller/arm-gic.h>
    #include <dt-bindings/clock/imx8mp-clock.h>

    aud2htx: aud2htx@30cb0000 {
        compatible = "fsl,imx8mp-aud2htx";
        reg = <0x30cb0000 0x10000>;
        interrupts = <GIC_SPI 130 IRQ_TYPE_LEVEL_HIGH>;
        clocks = <&audiomix_clk IMX8MP_CLK_AUDIOMIX_AUD2HTX_IPG>;
        clock-names = "bus";
        dmas = <&sdma2 26 2 0>;
        dma-names = "tx";
        power-domains = <&audiomix_pd>;
    };
```

## Documentation/devicetree/bindings/sound/fsl,audmix.txt
```
NXP Audio Mixer (AUDMIX).

The Audio Mixer is a on-chip functional module that allows mixing of two
audio streams into a single audio stream. Audio Mixer has two input serial
audio interfaces. These are driven by two Synchronous Audio interface
modules (SAI). Each input serial interface carries 8 audio channels in its
frame in TDM manner. Mixer mixes audio samples of corresponding channels
from two interfaces into a single sample. Before mixing, audio samples of
two inputs can be attenuated based on configuration. The output of the
Audio Mixer is also a serial audio interface. Like input interfaces it has
the same TDM frame format. This output is used to drive the serial DAC TDM
interface of audio codec and also sent to the external pins along with the
receive path of normal audio SAI module for readback by the CPU.

The output of Audio Mixer can be selected from any of the three streams
 - serial audio input 1
 - serial audio input 2
 - mixed audio

Mixing operation is independent of audio sample rate but the two audio
input streams must have same audio sample rate with same number of channels
in TDM frame to be eligible for mixing.

Device driver required properties:
=================================
  - compatible		: Compatible list, contains "fsl,imx8qm-audmix"

  - reg			: Offset and length of the register set for the device.

  - clocks		: Must contain an entry for each entry in clock-names.

  - clock-names		: Must include the "ipg" for register access.

  - power-domains	: Must contain the phandle to AUDMIX power domain node

  - dais		: Must contain a list of phandles to AUDMIX connected
			  DAIs. The current implementation requires two phandles
			  to SAI interfaces to be provided, the first SAI in the
			  list being used to route the AUDMIX output.

Device driver configuration example:
======================================
  audmix: audmix@59840000 {
    compatible = "fsl,imx8qm-audmix";
    reg = <0x0 0x59840000 0x0 0x10000>;
    clocks = <&clk IMX8QXP_AUD_AUDMIX_IPG>;
    clock-names = "ipg";
    power-domains = <&pd_audmix>;
    dais = <&sai4>, <&sai5>;
  };
```
