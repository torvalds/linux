## Documentation/devicetree/bindings/sound/dmic-codec.yaml
```yaml
# SPDX-License-Identifier: GPL-2.0
%YAML 1.2
---
$id: http://devicetree.org/schemas/sound/dmic-codec.yaml#
$schema: http://devicetree.org/meta-schemas/core.yaml#

title: Generic PDM Digital microphone (DMIC) codec

maintainers:
  - Arnaud Pouliquen <arnaud.pouliquen@foss.st.com>

allOf:
  - $ref: dai-common.yaml#

properties:
  compatible:
    const: dmic-codec

  '#sound-dai-cells':
    const: 0

  dmicen-gpios:
    description: GPIO specifier for DMIC to control start and stop
    maxItems: 1

  num-channels:
    description: Number of microphones on this DAI
    $ref: /schemas/types.yaml#/definitions/uint32
    minimum: 1
    maximum: 8
    default: 8

  modeswitch-delay-ms:
    description: Delay (in ms) to complete DMIC mode switch

  wakeup-delay-ms:
    description: Delay (in ms) after enabling the DMIC

required:
  - compatible

unevaluatedProperties: false

examples:
  - |
    #include <dt-bindings/gpio/gpio.h>

    dmic {
        compatible = "dmic-codec";
        dmicen-gpios = <&gpio4 3 GPIO_ACTIVE_HIGH>;
        num-channels = <1>;
        wakeup-delay-ms = <50>;
        modeswitch-delay-ms = <35>;
    };
...
```

## Documentation/devicetree/bindings/sound/dmic.txt
```
Device-Tree bindings for Digital microphone (DMIC) codec

This device support generic PDM digital microphone.

Required properties:
	- compatible: should be "dmic-codec".

Optional properties:
	- dmicen-gpios: GPIO specifier for dmic to control start and stop
	- num-channels: Number of microphones on this DAI

Example node:

	dmic_codec: dmic@0 {
		compatible = "dmic-codec";
		dmicen-gpios = <&gpio4 3 GPIO_ACTIVE_HIGH>;
		num-channels = <1>;
	};
```

## Documentation/devicetree/bindings/sound/dw-hdmi-audio.txt
```
dw hdmi audio interface

Required properties:

- compatible : Should be "dw-hdmi-audio".
```

## Documentation/devicetree/bindings/sound/es8311.txt
```
Everest ES8311 audio CODEC

Required properties:

  - compatible: "everest,es8311"
  - reg: the I2C address of the device for I2C
  - spk-ctl-gpios: control spk enable/disable
Optional properties:

- clocks: The phandle of the master clock to the CODEC
- clock-names: Should be "mclk"
- adc-pga-gain: The PGA Gain of ADC, the value range is: 0(0dB) ~ 10(30dB),
                the step is 3dB.
- adc-volume: The volume of ADC, range is: 0x00(-95dB) ~ 0xff(+32dB), 0dB is 0xbf.
- dac-volume: The volume of DAC, range is: 0x00(-95dB) ~ 0xff(+32dB), 0dB is 0xbf.
- aec-mode: The string of description AEC path between ADC and DAC, It should be:
		"adc left, adc right",
		"adc left, null right",
		"null left, adc right",
		"null left, null right",
		"dac left, adc right",
		"adc left, dac right",
		"dac left, dac right"
	    And aec-mode is "adc left, adc right" by default, if the property
	    is not specified.
Example:

es8311: es8311@18 {
	compatible = "everest,es8311";
	reg = <0x18>;
	clocks = <&cru MCLK_I2S0_TX_OUT2IO>;
	clock-names = "mclk";
	adc-pga-gain = <0>;  /* 0dB */
	adc-volume = <0xbf>;  /* 0dB */
	dac-volume = <0xbf>;  /* 0dB */
	aec-mode = "dac left, adc right";
	spk-ctl-gpios = <&gpio2 5 GPIO_ACTIVE_HIGH>;
};
```

## Documentation/devicetree/bindings/sound/es8316.txt
```
Everest ES8316 audio CODEC

Required properties:

  - compatible: "everest,es8316"
  - reg: the I2C address of the device for I2C
  - spk-con-gpio: spk mute enable/disable
  - hp-det-gpio: headphone detect gpio
Optional properties:

- clocks: The phandle of the master clock to the CODEC
- clock-names: Should be "mclk"

Example:

codec: es8316@10 {
	compatible = "everest,es8316";
	reg = <0x10>;
	clocks = <&cru SCLK_I2S_8CH_OUT>;
	clock-names = "mclk";
	spk-con-gpio = <&gpio0 11 GPIO_ACTIVE_HIGH>;
	hp-det-gpio = <&gpio4 28 GPIO_ACTIVE_HIGH>;
};
```

## Documentation/devicetree/bindings/sound/es8328.txt
```
Everest ES8328 audio CODEC

This device supports both I2C and SPI.

Required properties:

  - compatible  : Should be "everest,es8328" or "everest,es8388"
  - DVDD-supply : Regulator providing digital core supply voltage 1.8 - 3.6V
  - AVDD-supply : Regulator providing analog supply voltage 3.3V
  - PVDD-supply : Regulator providing digital IO supply voltage 1.8 - 3.6V
  - IPVDD-supply : Regulator providing analog output voltage 3.3V
  - clocks : A 22.5792 or 11.2896 MHz clock
  - reg : the I2C address of the device for I2C, the chip select number for SPI

Pins on the device (for linking into audio routes):

  * LOUT1
  * LOUT2
  * ROUT1
  * ROUT2
  * LINPUT1
  * RINPUT1
  * LINPUT2
  * RINPUT2
  * Mic Bias


Example:

codec: es8328@11 {
	compatible = "everest,es8328";
	DVDD-supply = <&reg_3p3v>;
	AVDD-supply = <&reg_3p3v>;
	PVDD-supply = <&reg_3p3v>;
	HPVDD-supply = <&reg_3p3v>;
	clocks = <&clks 169>;
	reg = <0x11>;
};
```

## Documentation/devicetree/bindings/sound/eukrea-tlv320.txt
```
Audio complex for Eukrea boards with tlv320aic23 codec.

Required properties:
- compatible : "eukrea,asoc-tlv320"
- eukrea,model : The user-visible name of this sound complex.
- ssi-controller : The phandle of the SSI controller.
- fsl,mux-int-port : The internal port of the i.MX audio muxer (AUDMUX).
- fsl,mux-ext-port : The external port of the i.MX audio muxer.

Note: The AUDMUX port numbering should start at 1, which is consistent with
hardware manual.

Example:

	sound {
		compatible = "eukrea,asoc-tlv320";
		eukrea,model = "imx51-eukrea-tlv320aic23";
		ssi-controller = <&ssi2>;
		fsl,mux-int-port = <2>;
		fsl,mux-ext-port = <3>;
	};
```

## Documentation/devicetree/bindings/sound/everest,es7134.txt
```
ES7134 i2s DA converter

Required properties:
- compatible : "everest,es7134" or
               "everest,es7144" or
	       "everest,es7154"
- VDD-supply : regulator phandle for the VDD supply
- PVDD-supply: regulator phandle for the PVDD supply for the es7154

Example:

i2s_codec: external-codec {
	compatible = "everest,es7134";
	VDD-supply = <&vcc_5v>;
};
```

## Documentation/devicetree/bindings/sound/everest,es71x4.yaml
```yaml
# SPDX-License-Identifier: (GPL-2.0-only OR BSD-2-Clause)
%YAML 1.2
---
$id: http://devicetree.org/schemas/sound/everest,es71x4.yaml#
$schema: http://devicetree.org/meta-schemas/core.yaml#

title: Everest ES7134/7144/7154 2 channels I2S analog to digital converter

maintainers:
  - Neil Armstrong <neil.armstrong@linaro.org>

properties:
  compatible:
    enum:
      - everest,es7134
      - everest,es7144
      - everest,es7154

  VDD-supply: true
  PVDD-supply: true

  '#sound-dai-cells':
    const: 0

required:
  - compatible
  - VDD-supply

allOf:
  - $ref: dai-common.yaml#
  - if:
      properties:
        compatible:
          contains:
            enum:
              - everest,es7134
              - everest,es7144
    then:
      properties:
        PVDD-supply: false

  - if:
      properties:
        compatible:
          contains:
            enum:
              - everest,es7154
    then:
      required:
        - PVDD-supply

unevaluatedProperties: false

examples:
  - |
   codec {
       compatible = "everest,es7134";
       #sound-dai-cells = <0>;
       VDD-supply = <&vdd_supply>;
   };

...
```

## Documentation/devicetree/bindings/sound/everest,es7241.txt
```
ES7241 i2s AD converter

Required properties:
- compatible : "everest,es7241"
- VDDP-supply: regulator phandle for the VDDA supply
- VDDA-supply: regulator phandle for the VDDP supply
- VDDD-supply: regulator phandle for the VDDD supply

Optional properties:
- reset-gpios: gpio connected to the reset pin
- m0-gpios   : gpio connected to the m0 pin
- m1-gpios   : gpio connected to the m1 pin
- everest,sdout-pull-down:
   Format used by the serial interface is controlled by pulling
   the sdout. If the sdout is pulled down, leftj format is used.
   If this property is not provided, sdout is assumed to pulled
   up and i2s format is used

Example:

linein: audio-codec@2 {
	#sound-dai-cells = <0>;
	compatible = "everest,es7241";
	VDDA-supply = <&vcc_3v3>;
	VDDP-supply = <&vcc_3v3>;
	VDDD-supply = <&vcc_3v3>;
	reset-gpios = <&gpio GPIOH_42>;
};
```

## Documentation/devicetree/bindings/sound/everest,es7241.yaml
```yaml
# SPDX-License-Identifier: (GPL-2.0-only OR BSD-2-Clause)
%YAML 1.2
---
$id: http://devicetree.org/schemas/sound/everest,es7241.yaml#
$schema: http://devicetree.org/meta-schemas/core.yaml#

title: Everest ES7241 2 channels I2S analog to digital converter

maintainers:
  - Neil Armstrong <neil.armstrong@linaro.org>

properties:
  compatible:
    enum:
      - everest,es7241

  reset-gpios:
    maxItems: 1
    description: GPIO connected to the reset pin

  m0-gpios:
    maxItems: 1
    description: GPIO connected to the m0 pin

  m1-gpios:
    maxItems: 1
    description: GPIO connected to the m0 pin

  everest,sdout-pull-down:
    type: boolean
    description:
      Format used by the serial interface is controlled by pulling
      the sdout. If the sdout is pulled down, leftj format is used.
      If this property is not provided, sdout is assumed to pulled
      up and i2s format is used

  VDDP-supply: true
  VDDA-supply: true
  VDDD-supply: true

  '#sound-dai-cells':
    const: 0

required:
  - compatible
  - VDDP-supply
  - VDDA-supply
  - VDDD-supply

allOf:
  - $ref: dai-common.yaml#

unevaluatedProperties: false

examples:
  - |
   #include <dt-bindings/gpio/gpio.h>
   codec {
       compatible = "everest,es7241";
       #sound-dai-cells = <0>;
       reset-gpios = <&gpio1 15 GPIO_ACTIVE_HIGH>;
       VDDP-supply = <&vddp_supply>;
       VDDA-supply = <&vdda_supply>;
       VDDD-supply = <&vddd_supply>;
   };

...
```

## Documentation/devicetree/bindings/sound/everest,es8316.txt
```
Everest ES8316 audio CODEC

This device supports both I2C and SPI.

Required properties:

  - compatible  : should be "everest,es8316"
  - reg : the I2C address of the device for I2C

Optional properties:

  - clocks : a list of phandle, should contain entries for clock-names
  - clock-names : should include as follows:
         "mclk" : master clock (MCLK) of the device

Example:

es8316: codec@11 {
	compatible = "everest,es8316";
	reg = <0x11>;
	clocks = <&clks 10>;
	clock-names = "mclk";
};
```

## Documentation/devicetree/bindings/sound/everest,es8316.yaml
```yaml
# SPDX-License-Identifier: (GPL-2.0-only OR BSD-2-Clause)
%YAML 1.2
---
$id: http://devicetree.org/schemas/sound/everest,es8316.yaml#
$schema: http://devicetree.org/meta-schemas/core.yaml#

title: Everest ES8311, ES8316 and ES8323 audio CODECs

maintainers:
  - Daniel Drake <drake@endlessm.com>
  - Katsuhiro Suzuki <katsuhiro@katsuster.net>
  - Matteo Martelli <matteomartelli3@gmail.com>
  - Binbin Zhou <zhoubinbin@loongson.cn>

description: |
  Everest ES8311, ES8316 and ES8323 audio CODECs

  Pins on the device (for linking into audio routes):

    Outputs:
      * LOUT:     Left Analog Output
      * ROUT:     Right Analog Output
      * MICBIAS:  Microphone Bias

    Inputs:
      * MIC1P:    Microphone 1 Positive Analog Input
      * MIC1N:    Microphone 1 Negative Analog Input
      * MIC2P:    Microphone 2 Positive Analog Input
      * MIC2N:    Microphone 2 Negative Analog Input

allOf:
  - $ref: dai-common.yaml#

properties:
  compatible:
    enum:
      - everest,es8311
      - everest,es8316
      - everest,es8323

  reg:
    maxItems: 1

  clocks:
    items:
      - description: clock for master clock (MCLK)

  clock-names:
    items:
      - const: mclk

  port:
    $ref: audio-graph-port.yaml#
    unevaluatedProperties: false

  "#sound-dai-cells":
    const: 0

required:
  - compatible
  - reg
  - "#sound-dai-cells"

unevaluatedProperties: false

examples:
  - |
    i2c {
      #address-cells = <1>;
      #size-cells = <0>;
      es8316: codec@11 {
        compatible = "everest,es8316";
        reg = <0x11>;
        clocks = <&clks 10>;
        clock-names = "mclk";
        #sound-dai-cells = <0>;
      };
    };
```

## Documentation/devicetree/bindings/sound/everest,es8326.yaml
```yaml
# SPDX-License-Identifier: (GPL-2.0-only OR BSD-2-Clause)
%YAML 1.2
---
$id: http://devicetree.org/schemas/sound/everest,es8326.yaml#
$schema: http://devicetree.org/meta-schemas/core.yaml#

title: Everest ES8326 audio CODEC

maintainers:
  - David Yang <yangxiaohua@everest-semi.com>

properties:
  compatible:
    const: everest,es8326

  reg:
    maxItems: 1

  clocks:
    items:
      - description: clock for master clock (MCLK)

  clock-names:
    items:
      - const: mclk

  interrupts:
    maxItems: 1
    description: interrupt output for headset detection

  "#sound-dai-cells":
    const: 0

  everest,jack-pol:
    $ref: /schemas/types.yaml#/definitions/uint8
    description: |
      just the value of reg 57. Bit(3) decides whether the jack polarity is inverted.
      Bit(2) decides whether the button on the headset is inverted.
      Bit(1)/(0) decides the mic property to be OMTP/CTIA or auto.
    minimum: 0x00
    maximum: 0x0f
    default: 0x0f

  everest,mic1-src:
    deprecated: true
    $ref: /schemas/types.yaml#/definitions/uint8
    description:
      the value of reg 2A when headset plugged.
    minimum: 0x00
    maximum: 0x77
    default: 0x22

  everest,mic2-src:
    deprecated: true
    $ref: /schemas/types.yaml#/definitions/uint8
    description:
      the value of reg 2A when headset unplugged.
    minimum: 0x00
    maximum: 0x77
    default: 0x44

  everest,jack-detect-inverted:
    $ref: /schemas/types.yaml#/definitions/flag
    description:
      Defined to invert the jack detection.

  everest,interrupt-src:
    $ref: /schemas/types.yaml#/definitions/uint8
    description: |
      value of reg 0x58, Defines the interrupt source.
      Bit(2) 1 means button press triggers irq, 0 means not.
      Bit(3) 1 means PIN9 is the irq source for jack detection. When set to 0,
      bias change on PIN9 do not triggers irq.
      Bit(4) 1 means PIN27 is the irq source for jack detection.
      Bit(5) 1 means PIN9 is the irq source after MIC detect.
      Bit(6) 1 means PIN27 is the irq source after MIC detect.
    minimum: 0
    maximum: 0x3c
    default: 0x08

  everest,interrupt-clk:
    $ref: /schemas/types.yaml#/definitions/uint8
    description: |
     value of reg 0x59, Defines the interrupt output behavior.
     Bit(0-3) 0 means irq pulse equals 512*internal clock
       1 means irq pulse equals 1024*internal clock
       2 means ...
       7 means irq pulse equals 65536*internal clock
       8 means irq mutes PA
       9 means irq mutes PA and DAC output
     Bit(4) 1 means we invert the interrupt output.
     Bit(6) 1 means the chip do not detect jack type after button released.
       0 means the chip detect jack type again after button released.
    minimum: 0
    maximum: 0x7f
    default: 0x00

required:
  - compatible
  - reg
  - "#sound-dai-cells"

additionalProperties: false

examples:
  - |
    i2c {
      #address-cells = <1>;
      #size-cells = <0>;
      es8326: codec@19 {
        compatible = "everest,es8326";
        reg = <0x19>;
        clocks = <&clks 10>;
        clock-names = "mclk";
        #sound-dai-cells = <0>;
        everest,jack-pol = [0e];
        everest,interrupt-src = [08];
        everest,interrupt-clk = [00];
      };
    };
```
