## Documentation/devicetree/bindings/sound/rockchip-spdif.txt
```
* Rockchip SPDIF transceiver

The S/PDIF audio block is a stereo transceiver that allows the
processor to receive and transmit digital audio via an coaxial cable or
a fibre cable.

Required properties:

- compatible: should be one of the following:
   - "rockchip,rk3066-spdif"
   - "rockchip,rk3188-spdif"
   - "rockchip,rk3228-spdif"
   - "rockchip,rk3288-spdif"
   - "rockchip,rk3328-spdif"
   - "rockchip,rk3366-spdif"
   - "rockchip,rk3368-spdif"
   - "rockchip,rk3399-spdif"
- reg: physical base address of the controller and length of memory mapped
  region.
- interrupts: should contain the SPDIF interrupt.
- dmas: DMA specifiers for tx dma. See the DMA client binding,
  Documentation/devicetree/bindings/dma/dma.txt
- dma-names: should be "tx"
- clocks: a list of phandle + clock-specifier pairs, one for each entry
  in clock-names.
- clock-names: should contain following:
   - "hclk": clock for SPDIF controller
   - "mclk" : clock for SPDIF bus

Required properties on RK3288:
  - rockchip,grf: the phandle of the syscon node for the general register
                   file (GRF)

Example for the rk3188 SPDIF controller:

spdif: spdif@1011e000 {
	compatible = "rockchip,rk3188-spdif", "rockchip,rk3066-spdif";
	reg = <0x1011e000 0x2000>;
	interrupts = <GIC_SPI 32 IRQ_TYPE_LEVEL_HIGH>;
	dmas = <&dmac1_s 8>;
	dma-names = "tx";
	clock-names = "hclk", "mclk";
	clocks = <&cru HCLK_SPDIF>, <&cru SCLK_SPDIF>;
	#sound-dai-cells = <0>;
};
```

## Documentation/devicetree/bindings/sound/rockchip-spdif.yaml
```yaml
# SPDX-License-Identifier: GPL-2.0
%YAML 1.2
---
$id: http://devicetree.org/schemas/sound/rockchip-spdif.yaml#
$schema: http://devicetree.org/meta-schemas/core.yaml#

title: Rockchip SPDIF transceiver

description:
  The S/PDIF audio block is a stereo transceiver that allows the
  processor to receive and transmit digital audio via a coaxial or
  fibre cable.

maintainers:
  - Heiko Stuebner <heiko@sntech.de>

properties:
  compatible:
    oneOf:
      - const: rockchip,rk3066-spdif
      - const: rockchip,rk3228-spdif
      - const: rockchip,rk3328-spdif
      - const: rockchip,rk3366-spdif
      - const: rockchip,rk3368-spdif
      - const: rockchip,rk3399-spdif
      - items:
          - enum:
            - rockchip,rk3188-spdif
            - rockchip,rk3288-spdif
          - const: rockchip,rk3066-spdif

  reg:
    maxItems: 1

  interrupts:
    maxItems: 1

  clocks:
    items:
      - description: clock for SPDIF bus
      - description: clock for SPDIF controller

  clock-names:
    items:
      - const: mclk
      - const: hclk

  dmas:
    maxItems: 1

  dma-names:
    const: tx

  power-domains:
    maxItems: 1

  rockchip,grf:
    $ref: /schemas/types.yaml#/definitions/phandle
    description:
      The phandle of the syscon node for the GRF register.
      Required property on RK3288.

  "#sound-dai-cells":
    const: 0

required:
  - compatible
  - reg
  - interrupts
  - clocks
  - clock-names
  - dmas
  - dma-names
  - "#sound-dai-cells"

if:
  properties:
    compatible:
      contains:
        const: rockchip,rk3288-spdif

then:
  required:
    - rockchip,grf

additionalProperties: false

examples:
  - |
    #include <dt-bindings/clock/rk3188-cru.h>
    #include <dt-bindings/interrupt-controller/arm-gic.h>
    spdif: spdif@1011e000 {
      compatible = "rockchip,rk3188-spdif", "rockchip,rk3066-spdif";
      reg = <0x1011e000 0x2000>;
      interrupts = <GIC_SPI 32 IRQ_TYPE_LEVEL_HIGH>;
      clocks = <&cru SCLK_SPDIF>, <&cru HCLK_SPDIF>;
      clock-names = "mclk", "hclk";
      dmas = <&dmac1_s 8>;
      dma-names = "tx";
      #sound-dai-cells = <0>;
    };
```

## Documentation/devicetree/bindings/sound/rohm,bd28623.txt
```
ROHM BD28623MUV Class D speaker amplifier for digital input

This codec does not have any control buses such as I2C, it detect format and
rate of I2S signal automatically. It has two signals that can be connected
to GPIOs: reset and mute.

Required properties:
- compatible      : should be "rohm,bd28623"
- #sound-dai-cells: should be 0.
- VCCA-supply     : regulator phandle for the VCCA supply
- VCCP1-supply    : regulator phandle for the VCCP1 supply
- VCCP2-supply    : regulator phandle for the VCCP2 supply

Optional properties:
- reset-gpios     : GPIO specifier for the active low reset line
- mute-gpios      : GPIO specifier for the active low mute line

Example:

	codec {
		compatible = "rohm,bd28623";
		#sound-dai-cells = <0>;

		VCCA-supply = <&vcc_reg>;
		VCCP1-supply = <&vcc_reg>;
		VCCP2-supply = <&vcc_reg>;
		reset-gpios = <&gpio 0 GPIO_ACTIVE_LOW>;
		mute-gpios = <&gpio 1 GPIO_ACTIVE_LOW>;
	};
```

## Documentation/devicetree/bindings/sound/rohm,bd28623.yaml
```yaml
# SPDX-License-Identifier: (GPL-2.0-only OR BSD-2-Clause)
%YAML 1.2
---
$id: http://devicetree.org/schemas/sound/rohm,bd28623.yaml#
$schema: http://devicetree.org/meta-schemas/core.yaml#

title: ROHM BD28623MUV Class D speaker amplifier for digital input

description:
  This codec does not have any control buses such as I2C, it detect
  format and rate of I2S signal automatically. It has two signals
  that can be connected to GPIOs reset and mute.

maintainers:
  - Katsuhiro Suzuki <katsuhiro@katsuster.net>

properties:
  compatible:
    const: rohm,bd28623

  "#sound-dai-cells":
    const: 0

  VCCA-supply:
    description:
      regulator phandle for the VCCA (for analog) power supply

  VCCP1-supply:
    description:
      regulator phandle for the VCCP1 (for ch1) power supply

  VCCP2-supply:
    description:
      regulator phandle for the VCCP2 (for ch2) power supply

  reset-gpios:
    maxItems: 1
    description:
      GPIO specifier for the active low reset line

  mute-gpios:
    maxItems: 1
    description:
      GPIO specifier for the active low mute line

required:
  - compatible
  - VCCA-supply
  - VCCP1-supply
  - VCCP2-supply
  - "#sound-dai-cells"

additionalProperties: false

examples:
  - |
    #include <dt-bindings/gpio/gpio.h>
    codec {
      compatible = "rohm,bd28623";
      #sound-dai-cells = <0>;

      VCCA-supply = <&vcc_reg>;
      VCCP1-supply = <&vcc_reg>;
      VCCP2-supply = <&vcc_reg>;
      reset-gpios = <&gpio 0 GPIO_ACTIVE_LOW>;
      mute-gpios = <&gpio 1 GPIO_ACTIVE_LOW>;
    };
```

## Documentation/devicetree/bindings/sound/rt1011.txt
```
RT1011 Mono Class D Audio Amplifier

This device supports I2C only.

Required properties:

- compatible : "realtek,rt1011".

- reg : The I2C address of the device. This I2C address decide by
        two input pins (ASEL1 and ASEL2).
        -------------------------------------
        |   ASEL2   |  ASEL1   |  Address   |
        -------------------------------------
        |     0     |    0     |   0x38     |
        -------------------------------------
        |     0     |    1     |   0x39     |
        -------------------------------------
        |     1     |    0     |   0x3a     |
        -------------------------------------
        |     1     |    1     |   0x3b     |
        -------------------------------------

Pins on the device (for linking into audio routes) for RT1011:

  * SPO

Example:

rt1011: codec@38 {
	compatible = "realtek,rt1011";
	reg = <0x38>;
};
```

## Documentation/devicetree/bindings/sound/rt1015.txt
```
RT1015 Mono Class D Audio Amplifier

This device supports I2C only.

Required properties:

- compatible : "realtek,rt1015".

- reg : The I2C address of the device.

Optional properties:

- realtek,power-up-delay-ms
  Set a delay time for flush work to be completed,
  this value is adjustable depending on platform.

Example:

rt1015: codec@28 {
	compatible = "realtek,rt1015";
	reg = <0x28>;
	realtek,power-up-delay-ms = <50>;
};
```

## Documentation/devicetree/bindings/sound/rt1016.txt
```
RT1016 Stereo Class D Audio Amplifier

This device supports I2C only.

Required properties:

- compatible : "realtek,rt1016".

- reg : The I2C address of the device.


Example:

rt1016: codec@1a {
	compatible = "realtek,rt1016";
	reg = <0x1a>;
};
```

## Documentation/devicetree/bindings/sound/rt1019.yaml
```yaml
# SPDX-License-Identifier: (GPL-2.0-only OR BSD-2-Clause)
%YAML 1.2
---
$id: http://devicetree.org/schemas/sound/rt1019.yaml#
$schema: http://devicetree.org/meta-schemas/core.yaml#

title: RT1019 Mono Class-D Audio Amplifier

maintainers:
  - jack.yu@realtek.com

properties:
  compatible:
    const: realtek,rt1019

  reg:
    maxItems: 1
    description: I2C address of the device.

required:
  - compatible
  - reg

additionalProperties: false

examples:
  - |
    i2c {
        #address-cells = <1>;
        #size-cells = <0>;
        rt1019: codec@28 {
            compatible = "realtek,rt1019";
            reg = <0x28>;
        };
    };
```

## Documentation/devicetree/bindings/sound/rt1308.txt
```
RT1308 audio Amplifier

This device supports I2C only.

Required properties:

- compatible : "realtek,rt1308".

- reg : The I2C address of the device.


Example:

rt1308: rt1308@10 {
	compatible = "realtek,rt1308";
	reg = <0x10>;
};
```

## Documentation/devicetree/bindings/sound/rt274.txt
```
RT274 audio CODEC

This device supports I2C only.

Required properties:

- compatible : "realtek,rt274".

- reg : The I2C address of the device.

Optional properties:

- interrupts : The CODEC's interrupt output.


Pins on the device (for linking into audio routes) for RT274:

  * DMIC1 Pin
  * DMIC2 Pin
  * MIC
  * LINE1
  * LINE2
  * HPO Pin
  * SPDIF
  * LINE3

Example:

codec: rt274@1c {
	compatible = "realtek,rt274";
	reg = <0x1c>;
	interrupts = <7 IRQ_TYPE_EDGE_FALLING>;
};
```

## Documentation/devicetree/bindings/sound/rt3261.txt
```
rt3261 audio CODEC

This device supports I2C only.

Required properties:

  - compatible : "rt3261"

  - reg : the I2C address of the device.

  - codec-en-gpio : the enable gpio of codec.

  - spk-num : the number of speaker.

  - modem-input-mode : modem input mode (DIFFERENTIAL/SINGLE_END).

  - lout-to-modem_mode : line out mode.

  - spk-amplify : Gain control for speaker.

Example:

rt3261: rt3261@1c {
	compatible = "rt3261";
	reg = <0x1c>;
	codec-en-gpio = <&gpio3 GPIO_D7 GPIO_ACTIVE_HIGH>;
	spk-num= <2>;
	modem-input-mode = <1>;
	lout-to-modem_mode = <1>;
	spk-amplify = <2>;
};
```

## Documentation/devicetree/bindings/sound/rt5514.txt
```
RT5514 audio CODEC

This device supports both I2C and SPI.

Required properties:

- compatible : "realtek,rt5514".

- reg : the I2C address of the device for I2C, the chip select
        number for SPI.

Optional properties:

- clocks: The phandle of the master clock to the CODEC
- clock-names: Should be "mclk"

- interrupt-parent: The phandle for the interrupt controller.
- interrupts: The interrupt number to the cpu. The interrupt specifier format
	      depends on the interrupt controller.

- realtek,dmic-init-delay-ms
  Set the DMIC initial delay (ms) to wait it ready for I2C.

Pins on the device (for linking into audio routes) for I2C:

  * DMIC1L
  * DMIC1R
  * DMIC2L
  * DMIC2R
  * AMICL
  * AMICR

Example:

codec: rt5514@57 {
	compatible = "realtek,rt5514";
	reg = <0x57>;
};
```

## Documentation/devicetree/bindings/sound/rt5616.txt
```
RT5616 audio CODEC

This device supports I2C only.

Required properties:

- compatible : "realtek,rt5616".

- reg : The I2C address of the device.

Optional properties:

- clocks: The phandle of the master clock to the CODEC.

- clock-names: Should be "mclk".

Pins on the device (for linking into audio routes) for RT5616:

  * IN1P
  * IN2P
  * IN2N
  * LOUTL
  * LOUTR
  * HPOL
  * HPOR

Example:

codec: rt5616@1b {
	compatible = "realtek,rt5616";
	reg = <0x1b>;
};
```

## Documentation/devicetree/bindings/sound/rt5631.txt
```
ALC5631/RT5631 audio CODEC

This device supports I2C only.

Required properties:

  - compatible : "realtek,alc5631" or "realtek,rt5631"

  - reg : the I2C address of the device.

Pins on the device (for linking into audio routes):

  * SPK_OUT_R_P
  * SPK_OUT_R_N
  * SPK_OUT_L_P
  * SPK_OUT_L_N
  * HP_OUT_L
  * HP_OUT_R
  * AUX_OUT2_LP
  * AUX_OUT2_RN
  * AUX_OUT1_LP
  * AUX_OUT1_RN
  * AUX_IN_L_JD
  * AUX_IN_R_JD
  * MONO_IN_P
  * MONO_IN_N
  * MIC1_P
  * MIC1_N
  * MIC2_P
  * MIC2_N
  * MONO_OUT_P
  * MONO_OUT_N
  * MICBIAS1
  * MICBIAS2

Example:

alc5631: alc5631@1a {
	compatible = "realtek,alc5631";
	reg = <0x1a>;
};

or

rt5631: rt5631@1a {
	compatible = "realtek,rt5631";
	reg = <0x1a>;
};
```

## Documentation/devicetree/bindings/sound/rt5640.txt
```
RT5640/RT5639 audio CODEC

This device supports I2C only.

Required properties:

- compatible : One of "realtek,rt5640" or "realtek,rt5639".

- reg : The I2C address of the device.

- interrupts : The CODEC's interrupt output.

Optional properties:

- clocks: The phandle of the master clock to the CODEC
- clock-names: Should be "mclk"

- realtek,in1-differential
- realtek,in2-differential
- realtek,in3-differential
  Boolean. Indicate MIC1/2/3 input are differential, rather than single-ended.

- realtek,ldo1-en-gpios : The GPIO that controls the CODEC's LDO1_EN pin.

- realtek,dmic1-data-pin
  0: dmic1 is not used
  1: using IN1P pin as dmic1 data pin
  2: using GPIO3 pin as dmic1 data pin

- realtek,dmic2-data-pin
  0: dmic2 is not used
  1: using IN1N pin as dmic2 data pin
  2: using GPIO4 pin as dmic2 data pin

- realtek,jack-detect-source
  u32. Valid values:
  0: jack-detect is not used
  1: Use GPIO1 for jack-detect
  2: Use JD1_IN4P for jack-detect
  3: Use JD2_IN4N for jack-detect
  4: Use GPIO2 for jack-detect
  5: Use GPIO3 for jack-detect
  6: Use GPIO4 for jack-detect

- realtek,jack-detect-not-inverted
  bool. Normal jack-detect switches give an inverted signal, set this bool
  in the rare case you've a jack-detect switch which is not inverted.

- realtek,over-current-threshold-microamp
  u32, micbias over-current detection threshold in µA, valid values are
  600, 1500 and 2000µA.

- realtek,over-current-scale-factor
  u32, micbias over-current detection scale-factor, valid values are:
  0: Scale current by 0.5
  1: Scale current by 0.75
  2: Scale current by 1.0
  3: Scale current by 1.5

Pins on the device (for linking into audio routes) for RT5639/RT5640:

  * DMIC1
  * DMIC2
  * MICBIAS1
  * IN1P
  * IN1N
  * IN2P
  * IN2N
  * IN3P
  * IN3N
  * HPOL
  * HPOR
  * LOUTL
  * LOUTR
  * SPOLP
  * SPOLN
  * SPORP
  * SPORN

Additional pins on the device for RT5640:

  * MONOP
  * MONON

Example:

rt5640 {
	compatible = "realtek,rt5640";
	reg = <0x1c>;
	interrupt-parent = <&gpio>;
	interrupts = <TEGRA_GPIO(W, 3) GPIO_ACTIVE_HIGH>;
	realtek,ldo1-en-gpios =
		<&gpio TEGRA_GPIO(V, 3) GPIO_ACTIVE_HIGH>;
};
```
