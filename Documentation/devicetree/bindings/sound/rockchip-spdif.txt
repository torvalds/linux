## Documentation/devicetree/bindings/sound/rt5645.txt
```
RT5650/RT5645 audio CODEC

This device supports I2C only.

Required properties:

- compatible : One of "realtek,rt5645" or "realtek,rt5650".

- reg : The I2C address of the device.

- interrupts : The CODEC's interrupt output.

- avdd-supply: Power supply for AVDD, providing 1.8V.

- cpvdd-supply: Power supply for CPVDD, providing 3.5V.

Optional properties:

- hp-detect-gpios:
  a GPIO spec for the external headphone detect pin. If jd-mode = 0,
  we will get the JD status by getting the value of hp-detect-gpios.

- realtek,in2-differential
  Boolean. Indicate MIC2 input are differential, rather than single-ended.

- realtek,dmic1-data-pin
  0: dmic1 is not used
  1: using IN2P pin as dmic1 data pin
  2: using GPIO6 pin as dmic1 data pin
  3: using GPIO10 pin as dmic1 data pin
  4: using GPIO12 pin as dmic1 data pin

- realtek,dmic2-data-pin
  0: dmic2 is not used
  1: using IN2N pin as dmic2 data pin
  2: using GPIO5 pin as dmic2 data pin
  3: using GPIO11 pin as dmic2 data pin

-- realtek,jd-mode : The JD mode of rt5645/rt5650
   0 : rt5645/rt5650 JD function is not used
   1 : Mode-0 (VDD=3.3V), two port jack detection
   2 : Mode-1 (VDD=3.3V), one port jack detection
   3 : Mode-2 (VDD=1.8V), one port jack detection

Pins on the device (for linking into audio routes) for RT5645/RT5650:

  * DMIC L1
  * DMIC R1
  * DMIC L2
  * DMIC R2
  * IN1P
  * IN1N
  * IN2P
  * IN2N
  * Haptic Generator
  * HPOL
  * HPOR
  * LOUTL
  * LOUTR
  * PDM1L
  * PDM1R
  * SPOL
  * SPOR

Example:

codec: rt5650@1a {
	compatible = "realtek,rt5650";
	reg = <0x1a>;
	hp-detect-gpios = <&gpio 19 0>;
	interrupt-parent = <&gpio>;
	interrupts = <7 IRQ_TYPE_EDGE_FALLING>;
	realtek,dmic-en = "true";
	realtek,en-jd-func = "true";
	realtek,jd-mode = <3>;
};
```

## Documentation/devicetree/bindings/sound/rt5651.txt
```
RT5651 audio CODEC

This device supports I2C only.

Required properties:

- compatible : "realtek,rt5651".

- reg : The I2C address of the device.

Optional properties:

- realtek,in2-differential
  Boolean. Indicate MIC2 input are differential, rather than single-ended.

- realtek,dmic-en
  Boolean. true if dmic is used.

- realtek,jack-detect-source
  u32. Valid values:
  1: Use JD1_1 pin for jack-detect
  2: Use JD1_2 pin for jack-detect
  3: Use JD2 pin for jack-detect

- realtek,jack-detect-not-inverted
  bool. Normal jack-detect switches give an inverted (active-low) signal,
  set this bool in the rare case you've a jack-detect switch which is not
  inverted.

- realtek,over-current-threshold-microamp
  u32, micbias over-current detection threshold in µA, valid values are
  600, 1500 and 2000µA.

- realtek,over-current-scale-factor
  u32, micbias over-current detection scale-factor, valid values are:
  0: Scale current by 0.5
  1: Scale current by 0.75
  2: Scale current by 1.0
  3: Scale current by 1.5

- spk-con-gpio: speaker amplifier enable/disable control

Pins on the device (for linking into audio routes) for RT5651:

  * DMIC L1
  * DMIC R1
  * IN1P
  * IN2P
  * IN2N
  * IN3P
  * HPOL
  * HPOR
  * LOUTL
  * LOUTR
  * PDML
  * PDMR

Example:

rt5651: codec@1a {
	compatible = "realtek,rt5651";
	reg = <0x1a>;
	realtek,dmic-en = "true";
	realtek,in2-diff = "false";
};
```

## Documentation/devicetree/bindings/sound/rt5659.txt
```
RT5659/RT5658 audio CODEC

This device supports I2C only.

Required properties:

- compatible : One of "realtek,rt5659" or "realtek,rt5658".

- reg : The I2C address of the device.

- interrupts : The CODEC's interrupt output.

Optional properties:

- clocks: The phandle of the master clock to the CODEC
- clock-names: Should be "mclk"

- realtek,in1-differential
- realtek,in3-differential
- realtek,in4-differential
  Boolean. Indicate MIC1/3/4 input are differential, rather than single-ended.

- realtek,dmic1-data-pin
  0: dmic1 is not used
  1: using IN2N pin as dmic1 data pin
  2: using GPIO5 pin as dmic1 data pin
  3: using GPIO9 pin as dmic1 data pin
  4: using GPIO11 pin as dmic1 data pin

- realtek,dmic2-data-pin
  0: dmic2 is not used
  1: using IN2P pin as dmic2 data pin
  2: using GPIO6 pin as dmic2 data pin
  3: using GPIO10 pin as dmic2 data pin
  4: using GPIO12 pin as dmic2 data pin

- realtek,jd-src
  0: No JD is used
  1: using JD3 as JD source
  2: JD source for Intel HDA header

- realtek,ldo1-en-gpios : The GPIO that controls the CODEC's LDO1_EN pin.
- realtek,reset-gpios : The GPIO that controls the CODEC's RESET pin.

- sound-name-prefix: Please refer to name-prefix.txt

- ports: A Codec may have a single or multiple I2S interfaces. These
  interfaces on Codec side can be described under 'ports' or 'port'.
  When the SoC or host device is connected to multiple interfaces of
  the Codec, the connectivity can be described using 'ports' property.
  If a single interface is used, then 'port' can be used. The usage
  depends on the platform or board design.
  Please refer to Documentation/devicetree/bindings/graph.txt

Pins on the device (for linking into audio routes) for RT5659/RT5658:

  * DMIC L1
  * DMIC R1
  * DMIC L2
  * DMIC R2
  * IN1P
  * IN1N
  * IN2P
  * IN2N
  * IN3P
  * IN3N
  * IN4P
  * IN4N
  * HPOL
  * HPOR
  * SPOL
  * SPOR
  * LOUTL
  * LOUTR
  * MONOOUT
  * PDML
  * PDMR
  * SPDIF

Example:

rt5659 {
	compatible = "realtek,rt5659";
	reg = <0x1b>;
	interrupt-parent = <&gpio>;
	interrupts = <TEGRA_GPIO(W, 3) IRQ_TYPE_LEVEL_HIGH>;
	realtek,ldo1-en-gpios =
		<&gpio TEGRA_GPIO(V, 3) GPIO_ACTIVE_HIGH>;
};
```

## Documentation/devicetree/bindings/sound/rt5660.txt
```
RT5660 audio CODEC

This device supports I2C only.

Required properties:

- compatible : "realtek,rt5660".

- reg : The I2C address of the device.

Optional properties:

- clocks: The phandle of the master clock to the CODEC
- clock-names: Should be "mclk"

- realtek,in1-differential
- realtek,in3-differential
  Boolean. Indicate MIC1/3 input are differential, rather than single-ended.

- realtek,poweroff-in-suspend
  Boolean. If the codec will be powered off in suspend, the resume should be
  added delay time for waiting codec power ready.

- realtek,dmic1-data-pin
  0: dmic1 is not used
  1: using GPIO2 pin as dmic1 data pin
  2: using IN1P pin as dmic1 data pin

Pins on the device (for linking into audio routes) for RT5660:

  * DMIC L1
  * DMIC R1
  * IN1P
  * IN1N
  * IN2P
  * IN3P
  * IN3N
  * SPO
  * LOUTL
  * LOUTR

Example:

rt5660 {
	compatible = "realtek,rt5660";
	reg = <0x1c>;
};
```

## Documentation/devicetree/bindings/sound/rt5663.txt
```
RT5663 audio CODEC

This device supports I2C only.

Required properties:

- compatible : "realtek,rt5663".

- reg : The I2C address of the device.

- interrupts : The CODEC's interrupt output.

- avdd-supply: Power supply for AVDD, providing 1.8V.

- cpvdd-supply: Power supply for CPVDD, providing 3.5V.

Optional properties:

- "realtek,dc_offset_l_manual"
- "realtek,dc_offset_r_manual"
- "realtek,dc_offset_l_manual_mic"
- "realtek,dc_offset_r_manual_mic"
  Based on the different PCB layout, add the manual offset value to
  compensate the DC offset for each L and R channel, and they are different
  between headphone and headset.
- "realtek,impedance_sensing_num"
  The matrix row number of the impedance sensing table.
  If the value is 0, it means the impedance sensing is not supported.
- "realtek,impedance_sensing_table"
  The matrix rows of the impedance sensing table are consisted by impedance
  minimum, impedance maximun, volume, DC offset w/o and w/ mic of each L and
  R channel accordingly. Example is shown as following.
  <   0    300  7  0xffd160  0xffd1c0  0xff8a10  0xff8ab0
    301  65535  4  0xffe470  0xffe470  0xffb8e0  0xffb8e0>
  The first and second column are defined for the impedance range. If the
  detected impedance value is in the range, then the volume value of the
  third column will be set to codec. In our codec design, each volume value
  should compensate different DC offset to avoid the pop sound, and it is
  also different between headphone and headset. In the example, the
  "realtek,impedance_sensing_num" is 2. It means that there are 2 ranges of
  impedance in the impedance sensing function.

Pins on the device (for linking into audio routes) for RT5663:

  * IN1P
  * IN1N
  * IN2P
  * IN2N
  * HPOL
  * HPOR

Example:

rt5663: codec@12 {
	compatible = "realtek,rt5663";
	reg = <0x12>;
	interrupts = <7 IRQ_TYPE_EDGE_FALLING>;
	avdd-supply = <&pp1800_a_alc5662>;
	cpvdd-supply = <&pp3500_a_alc5662>;
};
```

## Documentation/devicetree/bindings/sound/rt5665.txt
```
RT5665/RT5666 audio CODEC

This device supports I2C only.

Required properties:

- compatible : One of "realtek,rt5665", "realtek,rt5666".

- reg : The I2C address of the device.

- interrupts : The CODEC's interrupt output.

Optional properties:

- realtek,in1-differential
- realtek,in2-differential
- realtek,in3-differential
- realtek,in4-differential
  Boolean. Indicate MIC1/2/3/4 input are differential, rather than single-ended.

- realtek,dmic1-data-pin
  0: dmic1 is not used
  1: using GPIO4 pin as dmic1 data pin
  2: using IN2N pin as dmic2 data pin

- realtek,dmic2-data-pin
  0: dmic2 is not used
  1: using GPIO5 pin as dmic2 data pin
  2: using IN2P pin as dmic2 data pin

- realtek,jd-src
  0: No JD is used
  1: using JD1 as JD source

- realtek,ldo1-en-gpios : The GPIO that controls the CODEC's LDO1_EN pin.

Pins on the device (for linking into audio routes) for RT5659/RT5658:

  * DMIC L1
  * DMIC R1
  * DMIC L2
  * DMIC R2
  * IN1P
  * IN1N
  * IN2P
  * IN2N
  * IN3P
  * IN3N
  * IN4P
  * IN4N
  * HPOL
  * HPOR
  * LOUTL
  * LOUTR
  * MONOOUT
  * PDML
  * PDMR

Example:

rt5659 {
	compatible = "realtek,rt5665";
	reg = <0x1b>;
	interrupt-parent = <&gpio>;
	interrupts = <TEGRA_GPIO(W, 3) GPIO_ACTIVE_HIGH>;
	realtek,ldo1-en-gpios =
		<&gpio TEGRA_GPIO(V, 3) GPIO_ACTIVE_HIGH>;
};
```

## Documentation/devicetree/bindings/sound/rt5668.txt
```
RT5668B audio CODEC

This device supports I2C only.

Required properties:

- compatible : "realtek,rt5668b"

- reg : The I2C address of the device.

Optional properties:

- interrupts : The CODEC's interrupt output.

- realtek,dmic1-data-pin
  0: dmic1 is not used
  1: using GPIO2 pin as dmic1 data pin
  2: using GPIO5 pin as dmic1 data pin

- realtek,dmic1-clk-pin
  0: using GPIO1 pin as dmic1 clock pin
  1: using GPIO3 pin as dmic1 clock pin

- realtek,jd-src
  0: No JD is used
  1: using JD1 as JD source

- realtek,ldo1-en-gpios : The GPIO that controls the CODEC's LDO1_EN pin.

Pins on the device (for linking into audio routes) for RT5668B:

  * DMIC L1
  * DMIC R1
  * IN1P
  * HPOL
  * HPOR

Example:

rt5668 {
	compatible = "realtek,rt5668b";
	reg = <0x1a>;
	interrupt-parent = <&gpio>;
	interrupts = <TEGRA_GPIO(U, 6) IRQ_TYPE_LEVEL_HIGH>;
	realtek,ldo1-en-gpios =
		<&gpio TEGRA_GPIO(R, 2) GPIO_ACTIVE_HIGH>;
	realtek,dmic1-data-pin = <1>;
	realtek,dmic1-clk-pin = <1>;
	realtek,jd-src = <1>;
};
```

## Documentation/devicetree/bindings/sound/rt5677.txt
```
RT5677 audio CODEC

This device supports I2C only.

Required properties:

- compatible : "realtek,rt5677".

- reg : The I2C address of the device.

- interrupts : The CODEC's interrupt output.

- gpio-controller : Indicates this device is a GPIO controller.

- #gpio-cells : Should be two. The first cell is the pin number and the
  second cell is used to specify optional parameters (currently unused).

Optional properties:

- realtek,pow-ldo2-gpio : The GPIO that controls the CODEC's POW_LDO2 pin.

- realtek,in1-differential
- realtek,in2-differential
- realtek,lout1-differential
- realtek,lout2-differential
- realtek,lout3-differential
  Boolean. Indicate MIC1/2 input and LOUT1/2/3 outputs are differential,
  rather than single-ended.

- realtek,gpio-config
  Array of six 8bit elements that configures GPIO.
    0 - floating (reset value)
    1 - pull down
    2 - pull up

Pins on the device (for linking into audio routes):

  * IN1P
  * IN1N
  * IN2P
  * IN2N
  * MICBIAS1
  * DMIC1
  * DMIC2
  * DMIC3
  * DMIC4
  * LOUT1
  * LOUT2
  * LOUT3

Example:

rt5677 {
	compatible = "realtek,rt5677";
	reg = <0x2c>;
	interrupt-parent = <&gpio>;
	interrupts = <TEGRA_GPIO(W, 3) GPIO_ACTIVE_HIGH>;

	gpio-controller;
	#gpio-cells = <2>;

	realtek,pow-ldo2-gpio =
		<&gpio TEGRA_GPIO(V, 3) GPIO_ACTIVE_HIGH>;
	realtek,in1-differential = "true";
	realtek,gpio-config = /bits/ 8  <0 0 0 0 0 2>;   /* pull up GPIO6 */
};
```

## Documentation/devicetree/bindings/sound/rt5682.txt
```
RT5682 audio CODEC

This device supports I2C only.

Required properties:

- compatible : "realtek,rt5682" or "realtek,rt5682i"

- reg : The I2C address of the device.

- AVDD-supply: phandle to the regulator supplying analog power through the
  AVDD pin

- MICVDD-supply: phandle to the regulator supplying power for the microphone
  bias through the MICVDD pin. Either MICVDD or VBAT should be present.

- VBAT-supply: phandle to the regulator supplying battery power through the
  VBAT pin. Either MICVDD or VBAT should be present.

- DBVDD-supply: phandle to the regulator supplying I/O power through the DBVDD
  pin.

- LDO1-IN-supply: phandle to the regulator supplying power to the digital core
  and charge pump through the LDO1_IN pin.

Optional properties:

- interrupts : The CODEC's interrupt output.

- realtek,dmic1-data-pin
  0: dmic1 is not used
  1: using GPIO2 pin as dmic1 data pin
  2: using GPIO5 pin as dmic1 data pin

- realtek,dmic1-clk-pin
  0: using GPIO1 pin as dmic1 clock pin
  1: using GPIO3 pin as dmic1 clock pin

- realtek,jd-src
  0: No JD is used
  1: using JD1 as JD source

- realtek,ldo1-en-gpios : The GPIO that controls the CODEC's LDO1_EN pin.

- realtek,btndet-delay
  The debounce delay for push button.
  The delay time is realtek,btndet-delay value multiple of 8.192 ms.
  If absent, the default is 16.

- #clock-cells : Should be set to '<1>',  wclk and bclk sources provided.
- clock-output-names : Name given for DAI clocks output.

- clocks : phandle and clock specifier for codec MCLK.
- clock-names : Clock name string for 'clocks' attribute, should be "mclk".

- realtek,dmic-clk-rate-hz : Set the clock rate (hz) for the requirement of
  the particular DMIC.

- realtek,dmic-delay-ms : Set the delay time (ms) for the requirement of
  the particular DMIC.

- realtek,dmic-clk-driving-high : Set the high driving of the DMIC clock out.

- #sound-dai-cells: Should be set to '<1>'.

Pins on the device (for linking into audio routes) for RT5682:

  * DMIC L1
  * DMIC R1
  * IN1P
  * HPOL
  * HPOR

Example:

rt5682 {
	compatible = "realtek,rt5682i";
	reg = <0x1a>;
	interrupt-parent = <&gpio>;
	interrupts = <TEGRA_GPIO(U, 6) IRQ_TYPE_LEVEL_HIGH>;
	realtek,ldo1-en-gpios =
		<&gpio TEGRA_GPIO(R, 2) GPIO_ACTIVE_HIGH>;
	realtek,dmic1-data-pin = <1>;
	realtek,dmic1-clk-pin = <1>;
	realtek,jd-src = <1>;
	realtek,btndet-delay = <16>;

	#clock-cells = <1>;
	clock-output-names = "rt5682-dai-wclk", "rt5682-dai-bclk";

	clocks = <&osc>;
	clock-names = "mclk";

	AVDD-supply = <&avdd_reg>;
	MICVDD-supply = <&micvdd_reg>;
	DBVDD-supply = <&dbvdd_reg>;
	LDO1-IN-supply = <&ldo1_in_reg>;
};
```
