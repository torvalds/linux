## Documentation/devicetree/bindings/sound/qcom,q6apm.yaml
```yaml
# SPDX-License-Identifier: GPL-2.0 OR BSD-2-Clause
%YAML 1.2
---
$id: http://devicetree.org/schemas/sound/qcom,q6apm.yaml#
$schema: http://devicetree.org/meta-schemas/core.yaml#

title: Qualcomm Audio Process Manager (Q6APM)

maintainers:
  - Krzysztof Kozlowski <krzysztof.kozlowski@linaro.org>
  - Srinivas Kandagatla <srinivas.kandagatla@linaro.org>

allOf:
  - $ref: dai-common.yaml#
  - $ref: /schemas/soc/qcom/qcom,apr-services.yaml#

properties:
  compatible:
    enum:
      - qcom,q6apm

  bedais:
    type: object
    $ref: /schemas/sound/qcom,q6apm-lpass-dais.yaml#
    unevaluatedProperties: false
    description: Qualcomm DSP audio ports

  dais:
    type: object
    $ref: /schemas/sound/qcom,q6apm-dai.yaml#
    unevaluatedProperties: false
    description: Qualcomm DSP audio ports

  '#sound-dai-cells':
    const: 0

required:
  - compatible
  - bedais
  - dais

unevaluatedProperties: false

examples:
  - |
    #include <dt-bindings/soc/qcom,gpr.h>

    gpr {
        #address-cells = <1>;
        #size-cells = <0>;

        service@1 {
            reg = <GPR_APM_MODULE_IID>;
            compatible = "qcom,q6apm";
            #sound-dai-cells = <0>;
            qcom,protection-domain = "avs/audio", "msm/adsp/audio_pd";

            dais {
                compatible = "qcom,q6apm-dais";
                iommus = <&apps_smmu 0x1801 0x0>;
            };

            bedais {
                compatible = "qcom,q6apm-lpass-dais";
                #sound-dai-cells = <1>;
            };
        };
    };
```

## Documentation/devicetree/bindings/sound/qcom,q6asm-dais.yaml
```yaml
# SPDX-License-Identifier: GPL-2.0 OR BSD-2-Clause
%YAML 1.2
---
$id: http://devicetree.org/schemas/sound/qcom,q6asm-dais.yaml#
$schema: http://devicetree.org/meta-schemas/core.yaml#

title: Qualcomm Audio Stream Manager (Q6ASM)

maintainers:
  - Krzysztof Kozlowski <krzysztof.kozlowski@linaro.org>
  - Srinivas Kandagatla <srinivas.kandagatla@linaro.org>

description:
  Q6ASM is one of the APR audio services on Q6DSP. Each of its subnodes
  represent a dai with board specific configuration.

properties:
  compatible:
    enum:
      - qcom,q6asm-dais

  iommus:
    maxItems: 1

  "#sound-dai-cells":
    const: 1

  "#address-cells":
    const: 1

  "#size-cells":
    const: 0

patternProperties:
  "^dai@[0-9]+$":
    type: object
    description:
      Q6ASM Digital Audio Interface

    properties:
      reg:
        maxItems: 1

      direction:
        $ref: /schemas/types.yaml#/definitions/uint32
        enum: [0, 1, 2]
        description: |
          The direction of the dai stream::
           - Q6ASM_DAI_TX_RX (0) for both tx and rx
           - Q6ASM_DAI_TX (1) for only tx (Capture/Encode)
           - Q6ASM_DAI_RX (2) for only rx (Playback/Decode)

      is-compress-dai:
        type: boolean
        description:
          Compress offload dai.

    dependencies:
      is-compress-dai: ["direction"]

    required:
      - reg

    additionalProperties: false

required:
  - compatible
  - "#sound-dai-cells"
  - "#address-cells"
  - "#size-cells"

additionalProperties: false

examples:
  - |
    dais {
        compatible = "qcom,q6asm-dais";
        iommus = <&apps_smmu 0x1821 0x0>;
        #address-cells = <1>;
        #size-cells = <0>;
        #sound-dai-cells = <1>;

        dai@0 {
            reg = <0>;
        };

        dai@1 {
            reg = <1>;
        };

        dai@2 {
            reg = <2>;
            is-compress-dai;
            direction = <1>;
        };
    };
```

## Documentation/devicetree/bindings/sound/qcom,q6asm.txt
```
Qualcomm Audio Stream Manager (Q6ASM) binding

Q6ASM is one of the APR audio service on Q6DSP.
Please refer to qcom,apr.txt for details of the common apr service bindings
used by the apr service device.

- but must contain the following property:

- compatible:
	Usage: required
	Value type: <stringlist>
	Definition: must be "qcom,q6asm-v<MAJOR-NUMBER>.<MINOR-NUMBER>".
		    Or "qcom,q6asm" where the version number can be queried
		    from DSP.
		    example "qcom,q6asm-v2.0"

= ASM DAIs (Digial Audio Interface)
"dais" subnode of the ASM node represents dai specific configuration

- compatible:
	Usage: required
	Value type: <stringlist>
	Definition: must be "qcom,q6asm-dais".

- #sound-dai-cells
	Usage: required
	Value type: <u32>
	Definition: Must be 1

== ASM DAI is subnode of "dais" and represent a dai, it includes board specific
configuration of each dai. Must contain the following properties.

- reg
	Usage: required
	Value type: <u32>
	Definition: Must be dai id

- direction:
	Usage: Required for Compress offload dais
	Value type: <u32>
	Definition: Specifies the direction of the dai stream
			0 for both tx and rx
			1 for only tx (Capture/Encode)
			2 for only rx (Playback/Decode)

- is-compress-dai:
	Usage: Required for Compress offload dais
	Value type: <boolean>
	Definition: present for Compress offload dais


= EXAMPLE

apr-service@7 {
	compatible = "qcom,q6asm";
	reg = <APR_SVC_ASM>;
	q6asmdai: dais {
		compatible = "qcom,q6asm-dais";
		#address-cells = <1>;
		#size-cells = <0>;
		#sound-dai-cells = <1>;

		dai@0 {
			reg = <0>;
			direction = <2>;
			is-compress-dai;
		};
	};
};
```

## Documentation/devicetree/bindings/sound/qcom,q6asm.yaml
```yaml
# SPDX-License-Identifier: GPL-2.0 OR BSD-2-Clause
%YAML 1.2
---
$id: http://devicetree.org/schemas/sound/qcom,q6asm.yaml#
$schema: http://devicetree.org/meta-schemas/core.yaml#

title: Qualcomm Audio Stream Manager (Q6ASM)

maintainers:
  - Krzysztof Kozlowski <krzysztof.kozlowski@linaro.org>
  - Srinivas Kandagatla <srinivas.kandagatla@linaro.org>

allOf:
  - $ref: /schemas/soc/qcom/qcom,apr-services.yaml#

properties:
  compatible:
    enum:
      - qcom,q6asm

  dais:
    type: object
    $ref: /schemas/sound/qcom,q6asm-dais.yaml#
    unevaluatedProperties: false
    description: Qualcomm DSP audio ports

required:
  - compatible
  - dais

unevaluatedProperties: false

examples:
  - |
    #include <dt-bindings/soc/qcom,apr.h>

    apr {
        #address-cells = <1>;
        #size-cells = <0>;

        service@7 {
            compatible = "qcom,q6asm";
            reg = <APR_SVC_ASM>;
            qcom,protection-domain = "avs/audio", "msm/adsp/audio_pd";

            dais {
                compatible = "qcom,q6asm-dais";
                iommus = <&apps_smmu 0x1821 0x0>;
                #address-cells = <1>;
                #size-cells = <0>;
                #sound-dai-cells = <1>;

                dai@0 {
                    reg = <0>;
                };

                dai@1 {
                    reg = <1>;
                };

                dai@2 {
                    reg = <2>;
                    is-compress-dai;
                    direction = <1>;
                };
            };
        };
    };
```

## Documentation/devicetree/bindings/sound/qcom,q6core.txt
```
Qualcomm ADSP Core service binding

Q6CORE is one of the APR audio service on Q6DSP.
Please refer to qcom,apr.txt for details of the common apr service bindings
used by the apr service device.

- but must contain the following property:

- compatible:
	Usage: required
	Value type: <stringlist>
	Definition: must be "qcom,q6core-v<MAJOR-NUMBER>.<MINOR-NUMBER>".
		   Or "qcom,q6core" where the version number can be queried
		   from DSP.
		   example "qcom,q6core-v2.0"

= EXAMPLE
apr-service@3 {
	compatible = "qcom,q6core";
	reg = <APR_SVC_ADSP_CORE>;
};
```

## Documentation/devicetree/bindings/sound/qcom,q6core.yaml
```yaml
# SPDX-License-Identifier: GPL-2.0 OR BSD-2-Clause
%YAML 1.2
---
$id: http://devicetree.org/schemas/sound/qcom,q6core.yaml#
$schema: http://devicetree.org/meta-schemas/core.yaml#

title: Qualcomm Audio Core (Q6Core)

maintainers:
  - Krzysztof Kozlowski <krzysztof.kozlowski@linaro.org>
  - Srinivas Kandagatla <srinivas.kandagatla@linaro.org>

allOf:
  - $ref: /schemas/soc/qcom/qcom,apr-services.yaml#

properties:
  compatible:
    enum:
      - qcom,q6core

required:
  - compatible

unevaluatedProperties: false

examples:
  - |
    #include <dt-bindings/soc/qcom,apr.h>

    apr {
        #address-cells = <1>;
        #size-cells = <0>;

        service@3 {
            compatible = "qcom,q6core";
            reg = <APR_SVC_ADSP_CORE>;
            qcom,protection-domain = "avs/audio", "msm/adsp/audio_pd";
        };
    };
```

## Documentation/devicetree/bindings/sound/qcom,q6dsp-lpass-clocks.yaml
```yaml
# SPDX-License-Identifier: (GPL-2.0 OR BSD-2-Clause)
%YAML 1.2
---
$id: "http://devicetree.org/schemas/sound/qcom,q6dsp-lpass-clocks.yaml#"
$schema: "http://devicetree.org/meta-schemas/core.yaml#"

title: Qualcomm DSP LPASS Clock Controller

maintainers:
  - Srinivas Kandagatla <srinivas.kandagatla@linaro.org>

description: |
  This binding describes the Qualcomm DSP Clock Controller

properties:
  compatible:
    enum:
      - qcom,q6afe-clocks
      - qcom,q6prm-lpass-clocks

  '#clock-cells':
    const: 2
    description:
      Clock Id is followed by clock coupling attributes.
        1 = for no coupled clock
        2 = for dividend of the coupled clock
        3 = for divisor of the coupled clock
        4 = for inverted and no couple clock

required:
  - compatible
  - "#clock-cells"

additionalProperties: false

examples:
  - |
    clock-controller {
        compatible = "qcom,q6afe-clocks";
        #clock-cells = <2>;
    };
```

## Documentation/devicetree/bindings/sound/qcom,q6dsp-lpass-ports.yaml
```yaml
# SPDX-License-Identifier: (GPL-2.0 OR BSD-2-Clause)
%YAML 1.2
---
$id: "http://devicetree.org/schemas/sound/qcom,q6dsp-lpass-ports.yaml#"
$schema: "http://devicetree.org/meta-schemas/core.yaml#"

title: Qualcomm DSP LPASS(Low Power Audio SubSystem) Audio Ports binding

maintainers:
  - Srinivas Kandagatla <srinivas.kandagatla@linaro.org>

description: |
  This binding describes the Qualcomm DSP LPASS Audio ports

properties:
  compatible:
    enum:
      - qcom,q6afe-dais
      - qcom,q6apm-lpass-dais

  '#sound-dai-cells':
    const: 1

  '#address-cells':
    const: 1

  '#size-cells':
    const: 0

#Digital Audio Interfaces
patternProperties:
  '^dai@[0-9]+$':
    type: object
    description:
      Q6DSP Digital Audio Interfaces.

    properties:
      reg:
        description:
          Digital Audio Interface ID

      qcom,sd-lines:
        $ref: /schemas/types.yaml#/definitions/uint32-array
        description:
          List of serial data lines used by this dai.should be one or more of the 0-3 sd lines.
        minItems: 1
        maxItems: 4
        uniqueItems: true
        items:
          minimum: 0
          maximum: 3

      qcom,tdm-sync-mode:
        $ref: /schemas/types.yaml#/definitions/uint32
        enum: [0, 1, 2]
        description:
          TDM Synchronization mode
            0 = Short sync bit mode
            1 = Long sync mode
            2 = Short sync slot mode

      qcom,tdm-sync-src:
        $ref: /schemas/types.yaml#/definitions/uint32
        enum: [0, 1]
        description:
          TDM Synchronization source
            0 = External source
            1 = Internal source

      qcom,tdm-data-out:
        $ref: /schemas/types.yaml#/definitions/uint32
        enum: [0, 1]
        description:
          TDM Data out signal to drive with other masters
            0 = Disable
            1 = Enable

      qcom,tdm-invert-sync:
        $ref: /schemas/types.yaml#/definitions/uint32
        enum: [0, 1]
        description:
          TDM Invert the sync
            0 = Normal
            1 = Invert

      qcom,tdm-data-delay:
        $ref: /schemas/types.yaml#/definitions/uint32
        enum: [0, 1, 2]
        description:
          TDM Number of bit clock to delay data
            0 = 0 bit clock cycle
            1 = 1 bit clock cycle
            2 = 2 bit clock cycle

      qcom,tdm-data-align:
        $ref: /schemas/types.yaml#/definitions/uint32
        enum: [0, 1]
        description:
          Indicate how data is packed within the slot. For example, 32 slot
          width in case of sample bit width is 24TDM Invert the sync.
            0 = MSB
            1 = LSB

    required:
      - reg

    allOf:
      - if:
          properties:
            reg:
              contains:
                # TDM DAI ID range from PRIMARY_TDM_RX_0 - QUINARY_TDM_TX_7
                items:
                  minimum: 24
                  maximum: 103
        then:
          required:
            - qcom,tdm-sync-mode
            - qcom,tdm-sync-src
            - qcom,tdm-data-out
            - qcom,tdm-invert-sync
            - qcom,tdm-data-delay
            - qcom,tdm-data-align

      - if:
          properties:
            reg:
              contains:
                # MI2S DAI ID range PRIMARY_MI2S_RX - QUATERNARY_MI2S_TX and
                # QUINARY_MI2S_RX - QUINARY_MI2S_TX
                items:
                  oneOf:
                    - minimum: 16
                      maximum: 23
                    - minimum: 127
                      maximum: 128
        then:
          required:
            - qcom,sd-lines

    additionalProperties: false

required:
  - compatible
  - "#sound-dai-cells"
  - "#address-cells"
  - "#size-cells"

additionalProperties: false

examples:
  - |
    #include <dt-bindings/soc/qcom,apr.h>
    #include <dt-bindings/sound/qcom,q6afe.h>
    apr {
        compatible = "qcom,apr-v2";
        #address-cells = <1>;
        #size-cells = <0>;
        qcom,domain = <APR_DOMAIN_ADSP>;

        service@4 {
            compatible = "qcom,q6afe";
            reg = <APR_SVC_AFE>;
            qcom,protection-domain = "avs/audio", "msm/adsp/audio_pd";

            dais {
                compatible = "qcom,q6afe-dais";
                #address-cells = <1>;
                #size-cells = <0>;
                #sound-dai-cells = <1>;

                dai@22 {
                    reg = <QUATERNARY_MI2S_RX>;
                    qcom,sd-lines = <0 1 2 3>;
                };
            };
        };
    };
  - |
    #include <dt-bindings/soc/qcom,gpr.h>
    gpr {
        compatible = "qcom,gpr";
        #address-cells = <1>;
        #size-cells = <0>;
        qcom,domain = <GPR_DOMAIN_ID_ADSP>;

        service@1 {
            compatible = "qcom,q6apm";
            reg = <GPR_APM_MODULE_IID>;

            dais {
                compatible = "qcom,q6apm-lpass-dais";
                #address-cells = <1>;
                #size-cells = <0>;
                #sound-dai-cells = <1>;

                dai@22 {
                    reg = <QUATERNARY_MI2S_RX>;
                    qcom,sd-lines = <0 1 2 3>;
                };
            };
        };
    };
```

## Documentation/devicetree/bindings/sound/qcom,q6prm.yaml
```yaml
# SPDX-License-Identifier: GPL-2.0 OR BSD-2-Clause
%YAML 1.2
---
$id: http://devicetree.org/schemas/sound/qcom,q6prm.yaml#
$schema: http://devicetree.org/meta-schemas/core.yaml#

title: Qualcomm Proxy Resource Manager (Q6PRM)

maintainers:
  - Krzysztof Kozlowski <krzysztof.kozlowski@linaro.org>
  - Srinivas Kandagatla <srinivas.kandagatla@linaro.org>

allOf:
  - $ref: /schemas/soc/qcom/qcom,apr-services.yaml#

properties:
  compatible:
    enum:
      - qcom,q6prm

  clock-controller:
    $ref: /schemas/sound/qcom,q6dsp-lpass-clocks.yaml#
    unevaluatedProperties: false
    description: Qualcomm DSP LPASS clock controller

required:
  - compatible
  - clock-controller

unevaluatedProperties: false

examples:
  - |
    #include <dt-bindings/soc/qcom,gpr.h>

    gpr {
        #address-cells = <1>;
        #size-cells = <0>;

        service@2 {
            reg = <GPR_PRM_MODULE_IID>;
            compatible = "qcom,q6prm";
            qcom,protection-domain = "avs/audio", "msm/adsp/audio_pd";

            clock-controller {
                compatible = "qcom,q6prm-lpass-clocks";
                #clock-cells = <2>;
            };
        };
    };
```
