## Documentation/devicetree/bindings/sound/qcom,lpass-tx-macro.yaml
```yaml
# SPDX-License-Identifier: (GPL-2.0-only OR BSD-2-Clause)
%YAML 1.2
---
$id: http://devicetree.org/schemas/sound/qcom,lpass-tx-macro.yaml#
$schema: http://devicetree.org/meta-schemas/core.yaml#

title: LPASS(Low Power Audio Subsystem) TX Macro audio codec

maintainers:
  - Srinivas Kandagatla <srinivas.kandagatla@linaro.org>

properties:
  compatible:
    oneOf:
      - enum:
          - qcom,sc7280-lpass-tx-macro
          - qcom,sm6115-lpass-tx-macro
          - qcom,sm8250-lpass-tx-macro
          - qcom,sm8450-lpass-tx-macro
          - qcom,sm8550-lpass-tx-macro
          - qcom,sc8280xp-lpass-tx-macro
      - items:
          - enum:
              - qcom,sm8650-lpass-tx-macro
              - qcom,sm8750-lpass-tx-macro
              - qcom,x1e80100-lpass-tx-macro
          - const: qcom,sm8550-lpass-tx-macro

  reg:
    maxItems: 1

  "#sound-dai-cells":
    const: 1

  '#clock-cells':
    const: 0

  clocks:
    minItems: 3
    maxItems: 5

  clock-names:
    minItems: 3
    maxItems: 5

  clock-output-names:
    maxItems: 1

  power-domains:
    maxItems: 2

  power-domain-names:
    items:
      - const: macro
      - const: dcodec

  qcom,dmic-sample-rate:
    description: dmic sample rate
    $ref: /schemas/types.yaml#/definitions/uint32

required:
  - compatible
  - reg
  - "#sound-dai-cells"

allOf:
  - $ref: dai-common.yaml#
  - if:
      properties:
        compatible:
          enum:
            - qcom,sc7280-lpass-tx-macro
    then:
      properties:
        clock-names:
          oneOf:
            - items:   # for ADSP based platforms
                - const: mclk
                - const: npl
                - const: macro
                - const: dcodec
                - const: fsgen
            - items:   # for ADSP bypass based platforms
                - const: mclk
                - const: npl
                - const: fsgen

  - if:
      properties:
        compatible:
          enum:
            - qcom,sc8280xp-lpass-tx-macro
            - qcom,sm8250-lpass-tx-macro
            - qcom,sm8450-lpass-tx-macro
    then:
      properties:
        clocks:
          minItems: 5
          maxItems: 5
        clock-names:
          items:
            - const: mclk
            - const: npl
            - const: macro
            - const: dcodec
            - const: fsgen

  - if:
      properties:
        compatible:
          enum:
            - qcom,sm6115-lpass-tx-macro
    then:
      properties:
        clocks:
          minItems: 4
          maxItems: 4
        clock-names:
          items:
            - const: mclk
            - const: npl
            - const: dcodec
            - const: fsgen

  - if:
      properties:
        compatible:
          contains:
            enum:
              - qcom,sm8550-lpass-tx-macro
    then:
      properties:
        clocks:
          minItems: 4
          maxItems: 4
        clock-names:
          items:
            - const: mclk
            - const: macro
            - const: dcodec
            - const: fsgen

unevaluatedProperties: false

examples:
  - |
    #include <dt-bindings/sound/qcom,q6afe.h>
    codec@3220000 {
      compatible = "qcom,sm8250-lpass-tx-macro";
      reg = <0x3220000 0x1000>;
      #sound-dai-cells = <1>;
      #clock-cells = <0>;
      clocks = <&aoncc 0>,
               <&aoncc 1>,
               <&q6afecc LPASS_HW_MACRO_VOTE LPASS_CLK_ATTRIBUTE_COUPLE_NO>,
               <&q6afecc LPASS_HW_DCODEC_VOTE LPASS_CLK_ATTRIBUTE_COUPLE_NO>,
               <&vamacro>;
      clock-names = "mclk", "npl", "macro", "dcodec", "fsgen";
      clock-output-names = "mclk";
      qcom,dmic-sample-rate = <600000>;
    };
```

## Documentation/devicetree/bindings/sound/qcom,lpass-va-macro.yaml
```yaml
# SPDX-License-Identifier: (GPL-2.0-only OR BSD-2-Clause)
%YAML 1.2
---
$id: http://devicetree.org/schemas/sound/qcom,lpass-va-macro.yaml#
$schema: http://devicetree.org/meta-schemas/core.yaml#

title: LPASS(Low Power Audio Subsystem) VA Macro audio codec

maintainers:
  - Srinivas Kandagatla <srinivas.kandagatla@linaro.org>

properties:
  compatible:
    oneOf:
      - enum:
          - qcom,sc7280-lpass-va-macro
          - qcom,sm8250-lpass-va-macro
          - qcom,sm8450-lpass-va-macro
          - qcom,sm8550-lpass-va-macro
          - qcom,sc8280xp-lpass-va-macro
      - items:
          - enum:
              - qcom,sm8650-lpass-va-macro
              - qcom,x1e80100-lpass-va-macro
          - const: qcom,sm8550-lpass-va-macro

  reg:
    maxItems: 1

  "#sound-dai-cells":
    const: 1

  '#clock-cells':
    const: 0

  clocks:
    minItems: 1
    maxItems: 4

  clock-names:
    minItems: 1
    maxItems: 4

  clock-output-names:
    maxItems: 1

  power-domains:
    maxItems: 2

  power-domain-names:
    items:
      - const: macro
      - const: dcodec

  qcom,dmic-sample-rate:
    description: dmic sample rate
    $ref: /schemas/types.yaml#/definitions/uint32

  vdd-micb-supply:
    description: phandle to voltage regulator of MIC Bias

required:
  - compatible
  - reg
  - "#sound-dai-cells"
  - clock-names
  - clocks

allOf:
  - $ref: dai-common.yaml#

  - if:
      properties:
        compatible:
          contains:
            const: qcom,sc7280-lpass-va-macro
    then:
      properties:
        clocks:
          maxItems: 1
        clock-names:
          items:
            - const: mclk

  - if:
      properties:
        compatible:
          contains:
            const: qcom,sm8250-lpass-va-macro
    then:
      properties:
        clocks:
          minItems: 3
          maxItems: 3
        clock-names:
          items:
            - const: mclk
            - const: macro
            - const: dcodec

  - if:
      properties:
        compatible:
          contains:
            enum:
              - qcom,sc8280xp-lpass-va-macro
              - qcom,sm8450-lpass-va-macro
    then:
      properties:
        clocks:
          minItems: 4
          maxItems: 4
        clock-names:
          items:
            - const: mclk
            - const: macro
            - const: dcodec
            - const: npl

  - if:
      properties:
        compatible:
          contains:
            enum:
              - qcom,sm8550-lpass-va-macro
    then:
      properties:
        clocks:
          minItems: 3
          maxItems: 3
        clock-names:
          items:
            - const: mclk
            - const: macro
            - const: dcodec

unevaluatedProperties: false

examples:
  - |
    #include <dt-bindings/sound/qcom,q6afe.h>
    codec@3370000 {
      compatible = "qcom,sm8250-lpass-va-macro";
      reg = <0x3370000 0x1000>;
      #sound-dai-cells = <1>;
      #clock-cells = <0>;
      clocks = <&aoncc 0>,
               <&q6afecc LPASS_HW_MACRO_VOTE LPASS_CLK_ATTRIBUTE_COUPLE_NO>,
               <&q6afecc LPASS_HW_DCODEC_VOTE LPASS_CLK_ATTRIBUTE_COUPLE_NO>;
      clock-names = "mclk", "macro", "dcodec";
      clock-output-names = "fsgen";
      qcom,dmic-sample-rate = <600000>;
      vdd-micb-supply = <&vreg_s4a_1p8>;
    };
```

## Documentation/devicetree/bindings/sound/qcom,lpass-wsa-macro.yaml
```yaml
# SPDX-License-Identifier: (GPL-2.0-only OR BSD-2-Clause)
%YAML 1.2
---
$id: http://devicetree.org/schemas/sound/qcom,lpass-wsa-macro.yaml#
$schema: http://devicetree.org/meta-schemas/core.yaml#

title: LPASS(Low Power Audio Subsystem) VA Macro audio codec

maintainers:
  - Srinivas Kandagatla <srinivas.kandagatla@linaro.org>

properties:
  compatible:
    oneOf:
      - enum:
          - qcom,sc7280-lpass-wsa-macro
          - qcom,sm8250-lpass-wsa-macro
          - qcom,sm8450-lpass-wsa-macro
          - qcom,sm8550-lpass-wsa-macro
          - qcom,sc8280xp-lpass-wsa-macro
      - items:
          - enum:
              - qcom,sm8650-lpass-wsa-macro
              - qcom,sm8750-lpass-wsa-macro
              - qcom,x1e80100-lpass-wsa-macro
          - const: qcom,sm8550-lpass-wsa-macro

  reg:
    maxItems: 1

  "#sound-dai-cells":
    const: 1

  '#clock-cells':
    const: 0

  clocks:
    minItems: 4
    maxItems: 6

  clock-names:
    minItems: 4
    maxItems: 6

  clock-output-names:
    maxItems: 1

  qcom,dmic-sample-rate:
    description: dmic sample rate
    $ref: /schemas/types.yaml#/definitions/uint32

  vdd-micb-supply:
    description: phandle to voltage regulator of MIC Bias

required:
  - compatible
  - reg
  - "#sound-dai-cells"

allOf:
  - $ref: dai-common.yaml#

  - if:
      properties:
        compatible:
          enum:
            - qcom,sc7280-lpass-wsa-macro
            - qcom,sm8250-lpass-wsa-macro
            - qcom,sm8450-lpass-wsa-macro
            - qcom,sc8280xp-lpass-wsa-macro
    then:
      properties:
        clocks:
          minItems: 5
          maxItems: 5
        clock-names:
          items:
            - const: mclk
            - const: npl
            - const: macro
            - const: dcodec
            - const: fsgen

  - if:
      properties:
        compatible:
          contains:
            enum:
              - qcom,sm8550-lpass-wsa-macro
    then:
      properties:
        clocks:
          minItems: 4
          maxItems: 4
        clock-names:
          items:
            - const: mclk
            - const: macro
            - const: dcodec
            - const: fsgen

unevaluatedProperties: false

examples:
  - |
    #include <dt-bindings/clock/qcom,sm8250-lpass-aoncc.h>
    #include <dt-bindings/sound/qcom,q6afe.h>
    codec@3240000 {
      compatible = "qcom,sm8250-lpass-wsa-macro";
      reg = <0x3240000 0x1000>;
      #sound-dai-cells = <1>;
      #clock-cells = <0>;
      clocks = <&audiocc 1>,
               <&audiocc 0>,
               <&q6afecc LPASS_HW_MACRO_VOTE LPASS_CLK_ATTRIBUTE_COUPLE_NO>,
               <&q6afecc LPASS_HW_DCODEC_VOTE LPASS_CLK_ATTRIBUTE_COUPLE_NO>,
               <&vamacro>;
      clock-names = "mclk", "npl", "macro", "dcodec", "fsgen";
      clock-output-names = "mclk";
    };
```

## Documentation/devicetree/bindings/sound/qcom,msm8916-wcd-analog.txt
```
msm8916 analog audio CODEC

Bindings for codec Analog IP which is integrated in pmic pm8916,

## Bindings for codec core on pmic:

Required properties
 - compatible = "qcom,pm8916-wcd-analog-codec";
 - reg: represents the slave base address provided to the peripheral.
 - interrupt-parent : The parent interrupt controller.
 - interrupts: List of interrupts in given SPMI peripheral.
 - interrupt-names: Names specified to above list of interrupts in same
		    order. List of supported interrupt names are:
  "cdc_spk_cnp_int" - Speaker click and pop interrupt.
  "cdc_spk_clip_int" - Speaker clip interrupt.
  "cdc_spk_ocp_int" - Speaker over current protect interrupt.
  "mbhc_ins_rem_det1" - jack insert removal detect interrupt 1.
  "mbhc_but_rel_det" - button release interrupt.
  "mbhc_but_press_det" - button press event
  "mbhc_ins_rem_det" - jack insert removal detect interrupt.
  "mbhc_switch_int"	- multi button headset interrupt.
  "cdc_ear_ocp_int" - Earphone over current protect interrupt.
  "cdc_hphr_ocp_int" - Headphone R over current protect interrupt.
  "cdc_hphl_ocp_det" - Headphone L over current protect interrupt.
  "cdc_ear_cnp_int" - earphone cnp interrupt.
  "cdc_hphr_cnp_int" - hphr click and pop interrupt.
  "cdc_hphl_cnp_int" - hphl click and pop interrupt.

 - clocks: Handle to mclk.
 - clock-names: should be "mclk"
 - vdd-cdc-io-supply: phandle to VDD_CDC_IO regulator DT node.
 - vdd-cdc-tx-rx-cx-supply: phandle to VDD_CDC_TX/RX/CX regulator DT node.
 - vdd-micbias-supply: phandle of VDD_MICBIAS supply's regulator DT node.
Optional Properties:
 - qcom,mbhc-vthreshold-low: Array of 5 threshold voltages in mV for 5 buttons
			     detection on headset when the mbhc is powered up
			     by internal current source, this is a low power.
 - qcom,mbhc-vthreshold-high: Array of 5 thresold voltages in mV for 5 buttons
			      detection on headset when mbhc is powered up
			       from micbias.
- qcom,micbias-lvl:  Voltage (mV) for Mic Bias
- qcom,hphl-jack-type-normally-open: boolean, present if hphl pin on jack is a
				     NO (Normally Open). If not specified, then
				     its assumed that hphl pin on jack is NC
				     (Normally Closed).
- qcom,gnd-jack-type-normally-open: boolean, present if gnd pin on jack is
				    NO (Normally Open). If not specified, then
				    its assumed that gnd pin on jack is NC
				    (Normally Closed).
- qcom,micbias1-ext-cap: boolean, present if micbias1 has external capacitor
			 connected.
- qcom,micbias2-ext-cap: boolean, present if micbias2 has external capacitor
			 connected.

Example:

spmi_bus {
	...
	audio-codec@f000{
		compatible = "qcom,pm8916-wcd-analog-codec";
		reg = <0xf000 0x200>;
		reg-names = "pmic-codec-core";
		clocks = <&gcc GCC_CODEC_DIGCODEC_CLK>;
		clock-names = "mclk";
		qcom,mbhc-vthreshold-low = <75 150 237 450 500>;
		qcom,mbhc-vthreshold-high = <75 150 237 450 500>;
		interrupt-parent = <&spmi_bus>;
		interrupts = <0x1 0xf0 0x0 IRQ_TYPE_NONE>,
			     <0x1 0xf0 0x1 IRQ_TYPE_NONE>,
			     <0x1 0xf0 0x2 IRQ_TYPE_NONE>,
			     <0x1 0xf0 0x3 IRQ_TYPE_NONE>,
			     <0x1 0xf0 0x4 IRQ_TYPE_NONE>,
			     <0x1 0xf0 0x5 IRQ_TYPE_NONE>,
			     <0x1 0xf0 0x6 IRQ_TYPE_NONE>,
			     <0x1 0xf0 0x7 IRQ_TYPE_NONE>,
			     <0x1 0xf1 0x0 IRQ_TYPE_NONE>,
			     <0x1 0xf1 0x1 IRQ_TYPE_NONE>,
			     <0x1 0xf1 0x2 IRQ_TYPE_NONE>,
			     <0x1 0xf1 0x3 IRQ_TYPE_NONE>,
			     <0x1 0xf1 0x4 IRQ_TYPE_NONE>,
			     <0x1 0xf1 0x5 IRQ_TYPE_NONE>;
		interrupt-names = "cdc_spk_cnp_int",
				  "cdc_spk_clip_int",
				  "cdc_spk_ocp_int",
				  "mbhc_ins_rem_det1",
				  "mbhc_but_rel_det",
				  "mbhc_but_press_det",
				  "mbhc_ins_rem_det",
				  "mbhc_switch_int",
				  "cdc_ear_ocp_int",
				  "cdc_hphr_ocp_int",
				  "cdc_hphl_ocp_det",
				  "cdc_ear_cnp_int",
				  "cdc_hphr_cnp_int",
				  "cdc_hphl_cnp_int";
	               VDD-CDC-IO-supply = <&pm8916_l5>;
	               VDD-CDC-TX-RX-CX-supply = <&pm8916_l5>;
	               VDD-MICBIAS-supply = <&pm8916_l13>;
	               #sound-dai-cells = <1>;
	};
};
```

## Documentation/devicetree/bindings/sound/qcom,msm8916-wcd-digital-codec.yaml
```yaml
# SPDX-License-Identifier: GPL-2.0-only OR BSD-2-Clause
%YAML 1.2
---
$id: http://devicetree.org/schemas/sound/qcom,msm8916-wcd-digital-codec.yaml#
$schema: http://devicetree.org/meta-schemas/core.yaml#

title: Qualcomm MSM8916 WCD Digital Audio Codec

maintainers:
  - Srinivas Kandagatla <srinivas.kandagatla@linaro.org>

description:
  The digital WCD audio codec found on Qualcomm MSM8916 LPASS.

properties:
  compatible:
    const: qcom,msm8916-wcd-digital-codec

  reg:
    maxItems: 1

  clocks:
    maxItems: 2

  clock-names:
    items:
      - const: ahbix-clk
      - const: mclk

  '#sound-dai-cells':
    const: 1

required:
  - compatible
  - reg
  - clocks
  - clock-names
  - '#sound-dai-cells'

allOf:
  - $ref: dai-common.yaml#

unevaluatedProperties: false

examples:
  - |
    #include <dt-bindings/clock/qcom,gcc-msm8916.h>
    audio-codec@771c000 {
        compatible = "qcom,msm8916-wcd-digital-codec";
        reg = <0x0771c000 0x400>;
        clocks = <&gcc GCC_ULTAUDIO_AHBFABRIC_IXFABRIC_CLK>,
                 <&gcc GCC_CODEC_DIGCODEC_CLK>;
        clock-names = "ahbix-clk", "mclk";
        #sound-dai-cells = <1>;
    };
```

## Documentation/devicetree/bindings/sound/qcom,msm8916-wcd-digital.txt
```
msm8916 digital audio CODEC

## Bindings for codec core in lpass:

Required properties
 - compatible = "qcom,msm8916-wcd-digital-codec";
 - reg: address space for lpass codec.
 - clocks: Handle to mclk and ahbclk
 - clock-names: should be "mclk", "ahbix-clk".

Example:

audio-codec@771c000{
	compatible = "qcom,msm8916-wcd-digital-codec";
	reg = <0x0771c000 0x400>;
	clocks = <&gcc GCC_ULTAUDIO_AHBFABRIC_IXFABRIC_CLK>,
		 <&gcc GCC_CODEC_DIGCODEC_CLK>;
	clock-names = "ahbix-clk", "mclk";
	#sound-dai-cells = <1>;
};
```
