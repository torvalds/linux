## Documentation/devicetree/bindings/sound/qcom,q6usb.yaml
```yaml
# SPDX-License-Identifier: (GPL-2.0-only OR BSD-2-Clause)
%YAML 1.2
---
$id: http://devicetree.org/schemas/sound/qcom,q6usb.yaml#
$schema: http://devicetree.org/meta-schemas/core.yaml#

title: Qualcomm ASoC DPCM USB backend DAI

maintainers:
  - Wesley Cheng <quic_wcheng@quicinc.com>

description:
  The USB port is a supported AFE path on the Q6 DSP.  This ASoC DPCM
  backend DAI will communicate the required settings to initialize the
  XHCI host controller properly for enabling the offloaded audio stream.
  Parameters defined under this node will carry settings, which will be
  passed along during the QMI stream enable request and configuration of
  the XHCI host controller.

allOf:
  - $ref: dai-common.yaml#

properties:
  compatible:
    enum:
      - qcom,q6usb

  iommus:
    maxItems: 1

  "#sound-dai-cells":
    const: 1

  qcom,usb-audio-intr-idx:
    description:
      Desired XHCI interrupter number to use.  Depending on the audio DSP
      on the platform, it will operate on a specific XHCI interrupter.
    $ref: /schemas/types.yaml#/definitions/uint16
    maximum: 8

required:
  - compatible
  - "#sound-dai-cells"
  - qcom,usb-audio-intr-idx

additionalProperties: false

examples:
  - |
    dais {
      compatible = "qcom,q6usb";
      #sound-dai-cells = <1>;
      iommus = <&apps_smmu 0x180f 0x0>;
      qcom,usb-audio-intr-idx = /bits/ 16 <2>;
    };
```

## Documentation/devicetree/bindings/sound/qcom,sdm845.txt
```
* Qualcomm Techyeslogies Inc. SDM845 ASoC sound card driver

This binding describes the SDM845 sound card, which uses qdsp for audio.

- compatible:
	Usage: required
	Value type: <stringlist>
	Definition: must be "qcom,sdm845-sndcard"

- audio-routing:
	Usage: Optional
	Value type: <stringlist>
	Definition:  A list of the connections between audio components.
		  Each entry is a pair of strings, the first being the
		  connection's sink, the second being the connection's
		  source. Valid names could be power supplies, MicBias
		  of codec and the jacks on the board.

- model:
	Usage: required
	Value type: <stringlist>
	Definition: The user-visible name of this sound card.

= dailinks
Each subyesde of sndcard represents either a dailink, and subyesdes of each
dailinks would be cpu/codec/platform dais.

- link-name:
	Usage: required
	Value type: <string>
	Definition: User friendly name for dai link

= CPU, PLATFORM, CODEC dais subyesdes
- cpu:
	Usage: required
	Value type: <subyesde>
	Definition: cpu dai sub-yesde

- codec:
	Usage: required
	Value type: <subyesde>
	Definition: codec dai sub-yesde

- platform:
	Usage: Optional
	Value type: <subyesde>
	Definition: platform dai sub-yesde

- sound-dai:
	Usage: required
	Value type: <phandle>
	Definition: dai phandle/s and port of CPU/CODEC/PLATFORM yesde.

Example:

audio {
	compatible = "qcom,sdm845-sndcard";
	model = "sdm845-snd-card";
	pinctrl-names = "default", "sleep";
	pinctrl-0 = <&pri_mi2s_active &pri_mi2s_ws_active>;
	pinctrl-1 = <&pri_mi2s_sleep &pri_mi2s_ws_sleep>;

	mm1-dai-link {
		link-name = "MultiMedia1";
		cpu {
			sound-dai = <&q6asmdai MSM_FRONTEND_DAI_MULTIMEDIA1>;
		};
	};

	pri-mi2s-dai-link {
		link-name = "PRI MI2S Playback";
		cpu {
			sound-dai = <&q6afedai PRIMARY_MI2S_RX>;
		};

		platform {
			sound-dai = <&q6routing>;
		};
	};
};
```
