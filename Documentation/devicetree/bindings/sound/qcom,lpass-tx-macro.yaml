## Documentation/devicetree/bindings/sound/qcom,pm4125-codec.yaml
```yaml
# SPDX-License-Identifier: (GPL-2.0-only OR BSD-2-Clause)
%YAML 1.2
---
$id: http://devicetree.org/schemas/sound/qcom,pm4125-codec.yaml#
$schema: http://devicetree.org/meta-schemas/core.yaml#

title: Qualcomm PM4125 Audio Codec

maintainers:
  - Alexey Klimov <alexey.klimov@linaro.org>

description:
  The audio codec IC found on Qualcomm PM4125/PM2250 PMIC.
  It has RX and TX Soundwire slave devices.

allOf:
  - $ref: dai-common.yaml#

properties:
  compatible:
    const: qcom,pm4125-codec

  reg:
    description:
      Specifies the SPMI base address for the audio codec peripherals. The
      address space contains reset register needed to power-on the codec.
    maxItems: 1

  reg-names:
    maxItems: 1

  vdd-io-supply:
    description: A reference to the 1.8V I/O supply

  vdd-cp-supply:
    description: A reference to the charge pump I/O supply

  vdd-mic-bias-supply:
    description: A reference to the 3.3V mic bias supply

  vdd-pa-vpos-supply:
    description: A reference to the PA VPOS supply

  qcom,tx-device:
    $ref: /schemas/types.yaml#/definitions/phandle-array
    description: A reference to Soundwire tx device phandle

  qcom,rx-device:
    $ref: /schemas/types.yaml#/definitions/phandle-array
    description: A reference to Soundwire rx device phandle

  qcom,micbias1-microvolt:
    description: micbias1 voltage
    minimum: 1800000
    maximum: 2850000

  qcom,micbias2-microvolt:
    description: micbias2 voltage
    minimum: 1800000
    maximum: 2850000

  qcom,micbias3-microvolt:
    description: micbias3 voltage
    minimum: 1800000
    maximum: 2850000

  qcom,mbhc-buttons-vthreshold-microvolt:
    description:
      Array of 8 Voltage threshold values corresponding to headset
      button0 - button7
    minItems: 8
    maxItems: 8

  '#sound-dai-cells':
    const: 1

required:
  - compatible
  - reg
  - vdd-io-supply
  - vdd-cp-supply
  - vdd-mic-bias-supply
  - vdd-pa-vpos-supply
  - qcom,tx-device
  - qcom,rx-device
  - qcom,micbias1-microvolt
  - qcom,micbias2-microvolt
  - qcom,micbias3-microvolt
  - '#sound-dai-cells'

unevaluatedProperties: false

examples:
  - |
    #include <dt-bindings/spmi/spmi.h>

    spmi {
        #address-cells = <2>;
        #size-cells = <0>;

        pmic {
            #address-cells = <1>;
            #size-cells = <0>;

            audio-codec@f000 {
                compatible = "qcom,pm4125-codec";
                reg = <0xf000>;
                vdd-io-supply = <&pm4125_l15>;
                vdd-cp-supply = <&pm4125_s4>;
                vdd-pa-vpos-supply = <&pm4125_s4>;
                vdd-mic-bias-supply = <&pm4125_l22>;
                qcom,micbias1-microvolt = <1800000>;
                qcom,micbias2-microvolt = <1800000>;
                qcom,micbias3-microvolt = <1800000>;
                qcom,rx-device = <&pm4125_rx>;
                qcom,tx-device = <&pm4125_tx>;
                #sound-dai-cells = <1>;
            };
        };
    };

    /* ... */

    soundwire@a610000 {
        reg = <0x0a610000 0x2000>;
        #address-cells = <2>;
        #size-cells = <0>;
        pm4125_rx: audio-codec@0,4 {
            compatible = "sdw20217010c00";
            reg = <0 4>;
            qcom,rx-port-mapping = <1 3>;
        };
    };
...
```

## Documentation/devicetree/bindings/sound/qcom,pm4125-sdw.yaml
```yaml
# SPDX-License-Identifier: (GPL-2.0-only OR BSD-2-Clause)
%YAML 1.2
---
$id: http://devicetree.org/schemas/sound/qcom,pm4125-sdw.yaml#
$schema: http://devicetree.org/meta-schemas/core.yaml#

title: Qualcomm SoundWire Slave devices on PM4125/PM2250 PMIC audio codec.

maintainers:
  - Alexey Klimov <alexey.klimov@linaro.org>

description:
  The audio codec IC found on Qualcomm PM4125/PM2250 PMICs.
  It has RX and TX Soundwire slave devices.

properties:
  compatible:
    const: sdw20217010c00

  reg:
    maxItems: 1

  qcom,tx-port-mapping:
    description: |
      Specifies static port mapping between device and host tx ports.
      In the order of the device port index which are adc1_port, adc23_port,
      dmic03_mbhc_port, dmic46_port.
      Supports maximum 2 tx soundwire ports.

      PM4125 TX Port 1 (ADC1,2 & DMIC0 & MBHC)    <=> SWR0 Port 1
      PM4125 TX Port 2 (ADC1 & DMIC0,1,2 & MBHC)  <=> SWR0 Port 2

    $ref: /schemas/types.yaml#/definitions/uint32-array
    minItems: 2
    maxItems: 4
    items:
      enum: [1, 2, 3, 4]

  qcom,rx-port-mapping:
    description: |
      Specifies static port mapping between device and host rx ports.
      In the order of device port index which are hph_port, clsh_port,
      comp_port, lo_port, dsd port.
      Supports maximum 2 rx soundwire ports.

      PM4125 RX Port 1 (HPH_L/R)       <==>    SWR1 Port 1 (HPH_L/R)
      PM4125 RX Port 2 (COMP_L/R)      <==>    SWR1 Port 3 (COMP_L/R)

    $ref: /schemas/types.yaml#/definitions/uint32-array
    minItems: 2
    maxItems: 5
    items:
      enum: [1, 2, 3, 4, 5]

required:
  - compatible
  - reg

oneOf:
  - required:
      - qcom,tx-port-mapping
  - required:
      - qcom,rx-port-mapping

additionalProperties: false

examples:
  - |
    soundwire@a610000 {
        reg = <0x0a610000 0x2000>;
        #address-cells = <2>;
        #size-cells = <0>;
        pm4125_rx: codec@0,1 {
            compatible = "sdw20217010c00";
            reg = <0 1>;
            qcom,rx-port-mapping = <1 3>;
        };
    };
...
```

## Documentation/devicetree/bindings/sound/qcom,pm8916-wcd-analog-codec.yaml
```yaml
# SPDX-License-Identifier: GPL-2.0-only OR BSD-2-Clause
%YAML 1.2
---
$id: http://devicetree.org/schemas/sound/qcom,pm8916-wcd-analog-codec.yaml#
$schema: http://devicetree.org/meta-schemas/core.yaml#

title: Qualcomm PM8916 WCD Analog Audio Codec

maintainers:
  - Konrad Dybcio <konradybcio@kernel.org>

description:
  The analog WCD audio codec found on Qualcomm PM8916 PMIC.

properties:
  compatible:
    const: qcom,pm8916-wcd-analog-codec

  reg:
    maxItems: 1

  reg-names:
    items:
      - const: pmic-codec-core

  clocks:
    maxItems: 1

  clock-names:
    items:
      - const: mclk

  interrupts:
    maxItems: 14

  interrupt-names:
    items:
      - const: cdc_spk_cnp_int
      - const: cdc_spk_clip_int
      - const: cdc_spk_ocp_int
      - const: mbhc_ins_rem_det1
      - const: mbhc_but_rel_det
      - const: mbhc_but_press_det
      - const: mbhc_ins_rem_det
      - const: mbhc_switch_int
      - const: cdc_ear_ocp_int
      - const: cdc_hphr_ocp_int
      - const: cdc_hphl_ocp_det
      - const: cdc_ear_cnp_int
      - const: cdc_hphr_cnp_int
      - const: cdc_hphl_cnp_int

  vdd-cdc-io-supply:
    description: 1.8V buck supply

  vdd-cdc-tx-rx-cx-supply:
    description: 1.8V SIDO buck supply

  vdd-micbias-supply:
    description: micbias supply

  qcom,mbhc-vthreshold-low:
    $ref: /schemas/types.yaml#/definitions/uint32-array
    description:
      Array of 5 threshold voltages in mV for 5-button detection on
      headset when MBHC is powered by an internal current source.
    minItems: 5
    maxItems: 5

  qcom,mbhc-vthreshold-high:
    $ref: /schemas/types.yaml#/definitions/uint32-array
    description:
      Array of 5 threshold voltages in mV for 5-button detection on
      headset when MBHC is powered from micbias.
    minItems: 5
    maxItems: 5

  qcom,micbias-lvl:
    $ref: /schemas/types.yaml#/definitions/uint32
    description:
      Voltage (mV) for Mic Bias

  qcom,hphl-jack-type-normally-open:
    type: boolean
    description:
      True if the HPHL pin on the jack is NO (Normally Open), false if it's
      NC (Normally Closed).

  qcom,gnd-jack-type-normally-open:
    type: boolean
    description:
      True if the GND pin on the jack is NO (Normally Open), false if it's
      NC (Normally Closed).

  qcom,micbias1-ext-cap:
    type: boolean
    description:
      True if micbias1 has an external capacitor.

  qcom,micbias2-ext-cap:
    type: boolean
    description:
      True if micbias2 has an external capacitor.

  "#sound-dai-cells":
    const: 1

required:
  - compatible
  - reg

additionalProperties: false

examples:
  - |
    #include <dt-bindings/clock/qcom,gcc-msm8916.h>
    #include <dt-bindings/interrupt-controller/irq.h>

    audio-codec@f000{
      compatible = "qcom,pm8916-wcd-analog-codec";
      reg = <0xf000 0x200>;
      reg-names = "pmic-codec-core";
      clocks = <&gcc GCC_CODEC_DIGCODEC_CLK>;
      clock-names = "mclk";
      qcom,mbhc-vthreshold-low = <75 150 237 450 500>;
      qcom,mbhc-vthreshold-high = <75 150 237 450 500>;
      interrupt-parent = <&spmi_bus>;
      interrupts = <0x1 0xf0 0x0 IRQ_TYPE_NONE>,
            <0x1 0xf0 0x1 IRQ_TYPE_NONE>,
            <0x1 0xf0 0x2 IRQ_TYPE_NONE>,
            <0x1 0xf0 0x3 IRQ_TYPE_NONE>,
            <0x1 0xf0 0x4 IRQ_TYPE_NONE>,
            <0x1 0xf0 0x5 IRQ_TYPE_NONE>,
            <0x1 0xf0 0x6 IRQ_TYPE_NONE>,
            <0x1 0xf0 0x7 IRQ_TYPE_NONE>,
            <0x1 0xf1 0x0 IRQ_TYPE_NONE>,
            <0x1 0xf1 0x1 IRQ_TYPE_NONE>,
            <0x1 0xf1 0x2 IRQ_TYPE_NONE>,
            <0x1 0xf1 0x3 IRQ_TYPE_NONE>,
            <0x1 0xf1 0x4 IRQ_TYPE_NONE>,
            <0x1 0xf1 0x5 IRQ_TYPE_NONE>;
      interrupt-names = "cdc_spk_cnp_int",
                        "cdc_spk_clip_int",
                        "cdc_spk_ocp_int",
                        "mbhc_ins_rem_det1",
                        "mbhc_but_rel_det",
                        "mbhc_but_press_det",
                        "mbhc_ins_rem_det",
                        "mbhc_switch_int",
                        "cdc_ear_ocp_int",
                        "cdc_hphr_ocp_int",
                        "cdc_hphl_ocp_det",
                        "cdc_ear_cnp_int",
                        "cdc_hphr_cnp_int",
                        "cdc_hphl_cnp_int";
      vdd-cdc-io-supply = <&pm8916_l5>;
      vdd-cdc-tx-rx-cx-supply = <&pm8916_l5>;
      vdd-micbias-supply = <&pm8916_l13>;
      #sound-dai-cells = <1>;
    };
```

## Documentation/devicetree/bindings/sound/qcom,q6adm-routing.yaml
```yaml
# SPDX-License-Identifier: GPL-2.0 OR BSD-2-Clause
%YAML 1.2
---
$id: http://devicetree.org/schemas/sound/qcom,q6adm-routing.yaml#
$schema: http://devicetree.org/meta-schemas/core.yaml#

title: Qualcomm Audio Device Manager (Q6ADM) routing

maintainers:
  - Krzysztof Kozlowski <krzysztof.kozlowski@linaro.org>
  - Srinivas Kandagatla <srinivas.kandagatla@linaro.org>

description:
  Qualcomm Audio Device Manager (Q6ADM) routing node represents routing
  specific configuration.

properties:
  compatible:
    enum:
      - qcom,q6adm-routing

  "#sound-dai-cells":
    const: 0

required:
  - compatible
  - "#sound-dai-cells"

additionalProperties: false

examples:
  - |
    #include <dt-bindings/soc/qcom,apr.h>
    #include <dt-bindings/sound/qcom,q6asm.h>

    apr {
        compatible = "qcom,apr-v2";
        qcom,domain = <APR_DOMAIN_ADSP>;
        #address-cells = <1>;
        #size-cells = <0>;

        service@8 {
            compatible = "qcom,q6adm";
            reg = <APR_SVC_ADM>;
            qcom,protection-domain = "avs/audio", "msm/adsp/audio_pd";

            routing {
                compatible = "qcom,q6adm-routing";
                #sound-dai-cells = <0>;
            };
        };
    };
```

## Documentation/devicetree/bindings/sound/qcom,q6adm.txt
```
Qualcomm Audio Device Manager (Q6ADM) binding

Q6ADM is one of the APR audio service on Q6DSP.
Please refer to qcom,apr.txt for details of the coommon apr service bindings
used by the apr service device.

- but must contain the following property:

- compatible:
	Usage: required
	Value type: <stringlist>
	Definition: must be "qcom,q6adm-v<MAJOR-NUMBER>.<MINOR-NUMBER>".
		   Or "qcom,q6adm" where the version number can be queried
		   from DSP.
		   example "qcom,q6adm-v2.0"


= ADM routing
"routing" subnode of the ADM node represents adm routing specific configuration

- compatible:
	Usage: required
	Value type: <stringlist>
	Definition: must be "qcom,q6adm-routing".

- #sound-dai-cells
	Usage: required
	Value type: <u32>
	Definition: Must be 0

= EXAMPLE
apr-service@8 {
	compatible = "qcom,q6adm";
	reg = <APR_SVC_ADM>;
	q6routing: routing {
		compatible = "qcom,q6adm-routing";
		#sound-dai-cells = <0>;
	};
};
```

## Documentation/devicetree/bindings/sound/qcom,q6adm.yaml
```yaml
# SPDX-License-Identifier: GPL-2.0 OR BSD-2-Clause
%YAML 1.2
---
$id: http://devicetree.org/schemas/sound/qcom,q6adm.yaml#
$schema: http://devicetree.org/meta-schemas/core.yaml#

title: Qualcomm Audio Device Manager (Q6ADM)

maintainers:
  - Krzysztof Kozlowski <krzysztof.kozlowski@linaro.org>
  - Srinivas Kandagatla <srinivas.kandagatla@linaro.org>

allOf:
  - $ref: /schemas/soc/qcom/qcom,apr-services.yaml#

properties:
  compatible:
    enum:
      - qcom,q6adm

  routing:
    type: object
    $ref: /schemas/sound/qcom,q6adm-routing.yaml#
    unevaluatedProperties: false
    description: Qualcomm DSP LPASS audio routing

required:
  - compatible
  - routing

unevaluatedProperties: false

examples:
  - |
    #include <dt-bindings/soc/qcom,apr.h>

    apr {
        #address-cells = <1>;
        #size-cells = <0>;

        service@8 {
            compatible = "qcom,q6adm";
            reg = <APR_SVC_ADM>;
            qcom,protection-domain = "avs/audio", "msm/adsp/audio_pd";

            routing {
                compatible = "qcom,q6adm-routing";
                #sound-dai-cells = <0>;
            };
        };
    };
```

## Documentation/devicetree/bindings/sound/qcom,q6afe.txt
```
Qualcomm Audio Front End (Q6AFE) binding

AFE is one of the APR audio service on Q6DSP
Please refer to qcom,apr.txt for details of the common apr service bindings
used by all apr services. Must contain the following properties.

- compatible:
	Usage: required
	Value type: <stringlist>
	Definition: must be "qcom,q6afe-v<MAJOR-NUMBER>.<MINOR-NUMBER>"
		  Or "qcom,q6afe" where the version number can be queried
		  from DSP.
		  example "qcom,q6afe"

= EXAMPLE

apr-service@4 {
	compatible = "qcom,q6afe";
	reg = <APR_SVC_AFE>;
};
```

## Documentation/devicetree/bindings/sound/qcom,q6afe.yaml
```yaml
# SPDX-License-Identifier: GPL-2.0 OR BSD-2-Clause
%YAML 1.2
---
$id: http://devicetree.org/schemas/sound/qcom,q6afe.yaml#
$schema: http://devicetree.org/meta-schemas/core.yaml#

title: Qualcomm Audio FrontEnd (Q6AFE)

maintainers:
  - Krzysztof Kozlowski <krzysztof.kozlowski@linaro.org>
  - Srinivas Kandagatla <srinivas.kandagatla@linaro.org>

allOf:
  - $ref: /schemas/soc/qcom/qcom,apr-services.yaml#

properties:
  compatible:
    enum:
      - qcom,q6afe

  clock-controller:
    $ref: /schemas/sound/qcom,q6dsp-lpass-clocks.yaml#
    unevaluatedProperties: false
    description: Qualcomm DSP LPASS clock controller

  dais:
    type: object
    $ref: /schemas/sound/qcom,q6dsp-lpass-ports.yaml#
    unevaluatedProperties: false
    description: Qualcomm DSP audio ports

required:
  - compatible
  - dais

unevaluatedProperties: false

examples:
  - |
    #include <dt-bindings/soc/qcom,apr.h>
    #include <dt-bindings/sound/qcom,q6afe.h>
    apr {
        #address-cells = <1>;
        #size-cells = <0>;

        service@4 {
            compatible = "qcom,q6afe";
            reg = <APR_SVC_AFE>;
            qcom,protection-domain = "avs/audio", "msm/adsp/audio_pd";

            clock-controller {
                compatible = "qcom,q6afe-clocks";
                #clock-cells = <2>;
            };

            dais {
                compatible = "qcom,q6afe-dais";
                #address-cells = <1>;
                #size-cells = <0>;
                #sound-dai-cells = <1>;

                dai@22 {
                    reg = <QUATERNARY_MI2S_RX>;
                    qcom,sd-lines = <0 1 2 3>;
                };
            };
        };
    };
```
