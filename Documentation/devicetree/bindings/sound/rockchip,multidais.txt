## Documentation/devicetree/bindings/sound/rockchip,multidais.txt
```
ROCKCHIP multi dais driver

Required properties:
- compatible: "rockchip,multi-dais"
  - "rockchip,rk3308-multi-dais"
- dais: The phandle of sub dais, such i2s, pdm etc.
- capture,channel-mapping: map channels, one for each in dais,
  capture,channel-mapping = <2 6> means:
  i2s 2ch + pdm 6ch --> total 8ch capture.
- playback,channel-mapping: map channels, one for each in dais.
  playback,channel-mapping = <4 4> means:
  i2s 4ch + pdm 4ch --> total 8ch playback.

Required properties for i2s 16ch:
- rockchip,grf: the phandle of the syscon node for GRF register.

Optional properties:
- frame-master: bool properties, frame master, one for each in dais.
- bitclock-master: bool properties, bit clock master, one for each in dais.
- bitclock-inversion: bool properties, bit clock inversion, one for each in dais.
- frame-inversion: bool properties, frame clock inversion, one for each in dais.

Example:

multi_dais: multi-dais {
	status = "okay";
	compatible = "rockchip,multi-dais";
	dais = <&i2s_8ch_2>, <&pdm_8ch>;
	capture,channel-mapping = <2 6>;
	playback,channel-mapping = <4 4>;
	bitclock-master = <1 0>;
	frame-master = <1 0>;
	bitclock-inversion = <0 0>;
	frame-inversion = <0 0>;
	rockchip,grf = <&grf>;
};

&i2s_8ch_2 {
	status = "okay";
	rockchip,no-dmaengine;
};

&pdm_8ch {
	status = "okay";
	rockchip,no-dmaengine;
};

vad-sound {
	status = "okay";
	compatible = "rockchip,multicodecs-card";
	rockchip,card-name = "rockchip,rk3308-vad";
	rockchip,cpu = <&multi_dais>;
	rockchip,codec = <&acodec>, <&vad>;
};
```

## Documentation/devicetree/bindings/sound/rockchip,pdm.txt
```
* Rockchip PDM controller

Required properties:

- compatible: "rockchip,pdm"
  - "rockchip,px30-pdm"
  - "rockchip,rk1808-pdm"
  - "rockchip,rk3308-pdm"
  - "rockchip,rk3568-pdm"
  - "rockchip,rv1126-pdm"
- reg: physical base address of the controller and length of memory mapped
  region.
- dmas: DMA specifiers for rx dma. See the DMA client binding,
	Documentation/devicetree/bindings/dma/dma.txt
- dma-names: should include "rx".
- clocks: a list of phandle + clock-specifer pairs, one for each entry in clock-names.
- clock-names: should contain following:
   - "pdm_hclk": clock for PDM BUS
   - "pdm_clk" : clock for PDM controller
- resets: a list of phandle + reset-specifer paris, one for each entry in reset-names.
- reset-names: reset names, should include "pdm-m".
- pinctrl-names: Must contain a "default" entry.
- pinctrl-N: One property must exist for each entry in
	     pinctrl-names. See ../pinctrl/pinctrl-bindings.txt
	     for details of the property values.

Optional properties:
- rockchip,path-map: This is a variable length array, that shows the mapping
  of SDIx to PATHx. By default, they are one-to-one mapping as follows:

   path0 <-- sdi0
   path1 <-- sdi1
   path2 <-- sdi2
   path3 <-- sdi3

  e.g. "rockchip,path-map = <3 2 1 0>" means the mapping as follows:

   path0 <-- sdi3
   path1 <-- sdi2
   path2 <-- sdi1
   path3 <-- sdi0

Example for rk3328 PDM controller:

pdm: pdm@ff040000 {
	compatible = "rockchip,pdm";
	reg = <0x0 0xff040000 0x0 0x1000>;
	clocks = <&clk_pdm>, <&clk_gates28 0>;
	clock-names = "pdm_clk", "pdm_hclk";
	dmas = <&pdma 16>;
	#dma-cells = <1>;
	dma-names = "rx";
	pinctrl-names = "default", "sleep";
	pinctrl-0 = <&pdmm0_clk
		     &pdmm0_sdi0
		     &pdmm0_sdi1
		     &pdmm0_sdi2
		     &pdmm0_sdi3>;
	pinctrl-1 = <&pdmm0_clk_sleep
		     &pdmm0_sdi0_sleep
		     &pdmm0_sdi1_sleep
		     &pdmm0_sdi2_sleep
		     &pdmm0_sdi3_sleep>;
};
```

## Documentation/devicetree/bindings/sound/rockchip,pdm.yaml
```yaml
# SPDX-License-Identifier: (GPL-2.0-only OR BSD-2-Clause)
%YAML 1.2
---
$id: http://devicetree.org/schemas/sound/rockchip,pdm.yaml#
$schema: http://devicetree.org/meta-schemas/core.yaml#

title: Rockchip PDM controller

description:
  The Pulse Density Modulation Interface Controller (PDMC) is
  a PDM interface controller and decoder that support PDM format.
  It integrates a clock generator driving the PDM microphone
  and embeds filters which decimate the incoming bit stream to
  obtain most common audio rates.

maintainers:
  - Heiko Stuebner <heiko@sntech.de>

properties:
  compatible:
    enum:
      - rockchip,pdm
      - rockchip,px30-pdm
      - rockchip,rk1808-pdm
      - rockchip,rk3308-pdm
      - rockchip,rk3568-pdm
      - rockchip,rv1126-pdm

  reg:
    maxItems: 1

  interrupts:
    maxItems: 1

  clocks:
    items:
      - description: clock for PDM controller
      - description: clock for PDM BUS

  clock-names:
    items:
      - const: pdm_clk
      - const: pdm_hclk

  dmas:
    maxItems: 1

  dma-names:
    items:
      - const: rx

  power-domains:
    maxItems: 1

  resets:
    items:
      - description: reset for PDM controller

  reset-names:
    items:
      - const: pdm-m

  rockchip,path-map:
    $ref: /schemas/types.yaml#/definitions/uint32-array
    description:
      Defines the mapping of PDM SDIx to PDM PATHx.
      By default, they are mapped one-to-one.
    maxItems: 4
    uniqueItems: true
    items:
      enum: [ 0, 1, 2, 3 ]

  "#sound-dai-cells":
    const: 0

required:
  - compatible
  - reg
  - interrupts
  - clocks
  - clock-names
  - dmas
  - dma-names
  - "#sound-dai-cells"

additionalProperties: false

examples:
  - |
    #include <dt-bindings/clock/rk3328-cru.h>
    #include <dt-bindings/interrupt-controller/arm-gic.h>
    #include <dt-bindings/interrupt-controller/irq.h>
    #include <dt-bindings/pinctrl/rockchip.h>

    bus {
        #address-cells = <2>;
        #size-cells = <2>;

        pdm@ff040000 {
            compatible = "rockchip,pdm";
            reg = <0x0 0xff040000 0x0 0x1000>;
            interrupts = <GIC_SPI 82 IRQ_TYPE_LEVEL_HIGH>;
            clocks = <&cru SCLK_PDM>, <&cru HCLK_PDM>;
            clock-names = "pdm_clk", "pdm_hclk";
            dmas = <&dmac 16>;
            dma-names = "rx";
            #sound-dai-cells = <0>;
            pinctrl-names = "default", "sleep";
            pinctrl-0 = <&pdmm0_clk
                         &pdmm0_sdi0
                         &pdmm0_sdi1
                         &pdmm0_sdi2
                         &pdmm0_sdi3>;
            pinctrl-1 = <&pdmm0_clk_sleep
                         &pdmm0_sdi0_sleep
                         &pdmm0_sdi1_sleep
                         &pdmm0_sdi2_sleep
                         &pdmm0_sdi3_sleep>;
        };
    };
```

## Documentation/devicetree/bindings/sound/rockchip,rk1000-codec.txt
```
* Rockchip RK1000 codec

Required properties:

- compatible: "rockchip,rk1000-codec"
- reg : the I2C address of the device.
- rockchip,spk-en-gpio: the enable gpio of spk.
- rockchip,pa-en-time-ms: pa enable dealy time(ms).
- rockchip,ctl: phandle to the rk1000 core controller.

Example for rk1000 codec:

rk1000_codec: rk1000-codec@60 {
	compatible = "rockchip,rk1000_codec";
	reg = <0x60>;
	rockchip,spk-en-gpio = <&gpio3 31 GPIO_ACTIVE_LOW>;
	rockchip,pa-en-time-ms = <5000>;
	rockchip,ctl = <&rk1000_ctl>;
	status = "okay";
};
```

## Documentation/devicetree/bindings/sound/rockchip,rk3036-codec.yaml
```yaml
# SPDX-License-Identifier: (GPL-2.0-only OR BSD-2-Clause)
%YAML 1.2
---
$id: http://devicetree.org/schemas/sound/rockchip,rk3036-codec.yaml#
$schema: http://devicetree.org/meta-schemas/core.yaml#

title: Rockchip RK3036 internal codec

maintainers:
  - Heiko Stuebner <heiko@sntech.de>

allOf:
  - $ref: dai-common.yaml#

properties:
  compatible:
    const: rockchip,rk3036-codec

  reg:
    maxItems: 1

  clocks:
    items:
      - description: clock for audio codec

  clock-names:
    items:
      - const: acodec_pclk

  rockchip,grf:
    $ref: /schemas/types.yaml#/definitions/phandle
    description:
      The phandle of the syscon node for the GRF register.

  "#sound-dai-cells":
    const: 0

required:
  - compatible
  - reg
  - clocks
  - clock-names
  - rockchip,grf
  - "#sound-dai-cells"

unevaluatedProperties: false

examples:
  - |
    #include <dt-bindings/clock/rk3036-cru.h>
    acodec: audio-codec@20030000 {
      compatible = "rockchip,rk3036-codec";
      reg = <0x20030000 0x4000>;
      rockchip,grf = <&grf>;
      clock-names = "acodec_pclk";
      clocks = <&cru ACLK_VCODEC>;
      #sound-dai-cells = <0>;
    };
```

## Documentation/devicetree/bindings/sound/rockchip,rk3228-codec.txt
```
* Rockchip Rk3228 internal codec

Required properties:

- compatible: "rockchip,rk3228-codec"
- reg: physical base address of the controller and length of memory mapped
  region.
- clocks: a list of phandle + clock-specifer pairs, one for each entry in clock-names.
- clock-names: a list of clock names, one for each entry in clocks.
- spk-en-gpio: speaker enable gpio.
- spk-depop-time-ms: speaker depop time msec.

Example for rk3228 internal codec:

codec: codec@12010000 {
	compatible = "rockchip,rk3228-codec";
	reg = <0x12010000 0x1000>;
	clocks =  <&cru SCLK_I2S_OUT>, <&cru PCLK_ACODECPHY>, <&cru SCLK_I2S1>;
	clock-names = "mclk", "pclk", "sclk";
	spk-en-gpio = <&gpio1 RK_PA3 GPIO_ACTIVE_HIGH>;
	status = "disabled";
};
```

## Documentation/devicetree/bindings/sound/rockchip,rk3288-hdmi-analog.txt
```
ROCKCHIP RK3288 with HDMI and analog audio

Required properties:
- compatible: "rockchip,rk3288-hdmi-analog"
- rockchip,model: The user-visible name of this sound complex
- rockchip,i2s-controller: The phandle of the Rockchip I2S controller that's
  connected to the CODEC
- rockchip,audio-codec: The phandle of the analog audio codec.
- rockchip,routing: A list of the connections between audio components.
		    Each entry is a pair of strings, the first being the
		    connection's sink, the second being the connection's
		    source. For this driver the first string should always be
		    "Analog".

Optionnal properties:
- rockchip,hp-en-gpios = The phandle of the GPIO that power up/down the
  headphone (when the analog output is an headphone).
- rockchip,hp-det-gpios = The phandle of the GPIO that detects the headphone
  (when the analog output is an headphone).
- pinctrl-names, pinctrl-0: Please refer to pinctrl-bindings.txt

Example:

sound {
	compatible = "rockchip,rk3288-hdmi-analog";
	rockchip,model = "Analog audio output";
	rockchip,i2s-controller = <&i2s>;
	rockchip,audio-codec = <&es8388>;
	rockchip,routing = "Analog", "LOUT2",
			   "Analog", "ROUT2";
	rockchip,hp-en-gpios = <&gpio8 0 GPIO_ACTIVE_HIGH>;
	rockchip,hp-det-gpios = <&gpio7 7 GPIO_ACTIVE_HIGH>;
	pinctrl-names = "default";
	pinctrl-0 = <&headphone>;
};
```

## Documentation/devicetree/bindings/sound/rockchip,rk3308-codec.txt
```
* Rockchip RK3308 Internal Codec

Required properties:

- compatible: "rockchip,rk3308-codec"
- reg: The physical base address of the controller and length of memory
  mapped region.
- rockchip,grf: The phandle of the syscon node for GRF register.
- clocks: A list of phandle + clock-specifer pairs, one for each entry in
  clock-names.
- clock-names: It should be "acodec".
- resets : Must contain an entry for each entry in reset-names.
- reset-names : Must include the following entries: "acodec-reset".

Optional properties:
- rockchip,enable-all-adcs: This is a boolean type property, that shows whether
  force enable all of ADCs. The following shows the relationship between grps
  and ADC:
  * grp 0 -- select ADC1 / ADC2
  * grp 1 -- select ADC3 / ADC4
  * grp 2 -- select ADC5 / ADC6
  * grp 3 -- select ADC7 / ADC8
  If the property is not used, the enabled ADC groups refer to needed channels
  via configure hw_params.

- rockchip,adc-grps-route: This is a variable length array, that shows the
  mapping route of ACODEC sdo to I2S sdi. By default, they are one-to-one
  mapping:
  * sdi_0 <-- sdo_0
  * sdi_1 <-- sdo_1
  * sdi_2 <-- sdo_2
  * sdi_3 <-- sdo_3
  If you would like to change the route mapping like this:
  * sdi_0 <-- sdo_3
  * sdi_1 <-- sdo_0
  * sdi_2 <-- sdo_2
  * sdi_3 <-- sdo_1
  You need to add the property on dts:
  - rockchip,adc-grps-route = <3 0 2 1>;

- rockchip,delay-loopback-handle-ms: This property points out that the delay for
  handling ADC after enable PAs during loopback.
- rockchip,delay-start-play-ms: This property points out the delay ms of start
  playback according to different amplifier performance.
- rockchip,en-always-grps: This property will keep the needed ADCs enabled
  always after enabling once.
- rockchip,loopback-grp: It points out the ADC group which is the loopback used.
- rockchip,no-deep-low-power: The codec will not enter deep low power mode
  during suspend.
- rockchip,no-hp-det: If there is no headphone on boards, we don't need to
  enable headphone detection.
- rockchip,internal-micbias: Using internal micbias which are from codec.
- hp-ctl-gpios: The gpio of head phone controller.
- pa-drv-gpios: The gpio of poweramplifier controller
- rockchip,delay-pa-drv-ms: This property points out that the delay for
  power on amplifier
- spk-ctl-gpios: The gpio of speak controller.

Example for rk3308 internal codec:

acodec: acodec@ff560000 {
	compatible = "rockchip,rk3308-codec";
	reg = <0x0 0xff560000 0x0 0x10000>;
	rockchip,grf = <&grf>;
	clocks = <&cru PCLK_ACODEC>;
	clock-names = "acodec";
	resets = <&cru SRST_ACODEC_P>;
	reset-names = "acodec-reset";
	rockchip,loopback-grp = <0>;
	hp-ctl-gpios = <&gpio0 1 GPIO_ACTIVE_HIGH>;
	pa-drv-gpios = <&gpio0 RK_PC0 GPIO_ACTIVE_HIGH>;
	spk-ctl-gpios = <&gpio0 5 GPIO_ACTIVE_HIGH>;
	status = "okay";
};
```

## Documentation/devicetree/bindings/sound/rockchip,rk3308-codec.yaml
```yaml
# SPDX-License-Identifier: GPL-2.0-only OR BSD-2-Clause
%YAML 1.2
---
$id: http://devicetree.org/schemas/sound/rockchip,rk3308-codec.yaml#
$schema: http://devicetree.org/meta-schemas/core.yaml#

title: Rockchip RK3308 Internal Codec

description: |
  This is the audio codec embedded in the Rockchip RK3308
  SoC. It has 8 24-bit ADCs and 2 24-bit DACs. The maximum supported
  sampling rate is 192 kHz.

  It is connected internally to one out of a selection of the internal I2S
  controllers.

  The RK3308 audio codec has 8 independent capture channels, but some
  features work on stereo pairs called groups:
    * grp 0 -- MIC1 / MIC2
    * grp 1 -- MIC3 / MIC4
    * grp 2 -- MIC5 / MIC6
    * grp 3 -- MIC7 / MIC8

maintainers:
  - Luca Ceresoli <luca.ceresoli@bootlin.com>

properties:
  compatible:
    const: rockchip,rk3308-codec

  reg:
    maxItems: 1

  rockchip,grf:
    $ref: /schemas/types.yaml#/definitions/phandle
    description:
      Phandle to the General Register Files (GRF)

  clocks:
    items:
      - description: clock for TX
      - description: clock for RX
      - description: AHB clock driving the interface

  clock-names:
    items:
      - const: mclk_tx
      - const: mclk_rx
      - const: hclk

  resets:
    maxItems: 1

  reset-names:
    items:
      - const: codec

  "#sound-dai-cells":
    const: 0

  rockchip,micbias-avdd-percent:
    description: |
      Voltage setting for the MICBIAS pins expressed as a percentage of
      AVDD.

      E.g. if rockchip,micbias-avdd-percent = 85 and AVDD = 3v3, then the
      MIC BIAS voltage will be 3.3 V * 85% = 2.805 V.

    enum: [ 50, 55, 60, 65, 70, 75, 80, 85 ]

required:
  - compatible
  - reg
  - rockchip,grf
  - clocks
  - resets
  - "#sound-dai-cells"

additionalProperties: false

examples:
  - |
    #include <dt-bindings/clock/rk3308-cru.h>

    audio_codec: audio-codec@ff560000 {
        compatible = "rockchip,rk3308-codec";
        reg = <0xff560000 0x10000>;
        rockchip,grf = <&grf>;
        clock-names = "mclk_tx", "mclk_rx", "hclk";
        clocks = <&cru SCLK_I2S2_8CH_TX_OUT>,
                 <&cru SCLK_I2S2_8CH_RX_OUT>,
                 <&cru PCLK_ACODEC>;
        reset-names = "codec";
        resets = <&cru SRST_ACODEC_P>;
        #sound-dai-cells = <0>;
    };

...
```
