## Documentation/devicetree/bindings/sound/rockchip,rk3328-codec.txt
```
* Rockchip Rk3328 internal codec

Required properties:

- compatible: "rockchip,rk3328-codec"
- reg: physical base address of the controller and length of memory mapped
  region.
- rockchip,grf: the phandle of the syscon node for GRF register.
- clocks: a list of phandle + clock-specifer pairs, one for each entry in clock-names.
- clock-names: should be "pclk".
- spk-depop-time-ms: speak depop time msec.

Optional properties:

- mute-gpios: GPIO specifier for external line driver control (typically the
              dedicated GPIO_MUTE pin)

Example for rk3328 internal codec:

codec: codec@ff410000 {
	compatible = "rockchip,rk3328-codec";
	reg = <0x0 0xff410000 0x0 0x1000>;
	rockchip,grf = <&grf>;
	clocks = <&cru PCLK_ACODEC>;
	clock-names = "pclk";
	mute-gpios = <&grf_gpio 0 GPIO_ACTIVE_LOW>;
	spk-depop-time-ms = 100;
};
```

## Documentation/devicetree/bindings/sound/rockchip,rk3328-codec.yaml
```yaml
# SPDX-License-Identifier: (GPL-2.0-only OR BSD-2-Clause)
%YAML 1.2
---
$id: http://devicetree.org/schemas/sound/rockchip,rk3328-codec.yaml#
$schema: http://devicetree.org/meta-schemas/core.yaml#

title: Rockchip rk3328 internal codec

maintainers:
  - Heiko Stuebner <heiko@sntech.de>
allOf:
  - $ref: dai-common.yaml#


properties:
  compatible:
    const: rockchip,rk3328-codec

  reg:
    maxItems: 1

  clocks:
    items:
      - description: clock for audio codec
      - description: clock for I2S master clock

  clock-names:
    items:
      - const: pclk
      - const: mclk

  rockchip,grf:
    $ref: /schemas/types.yaml#/definitions/phandle
    description:
      The phandle of the syscon node for the GRF register.

  spk-depop-time-ms:
    default: 200
    description:
      Speaker depop time in msec.

  mute-gpios:
    maxItems: 1
    description:
      GPIO specifier for external line driver control (typically the
      dedicated GPIO_MUTE pin)

  "#sound-dai-cells":
    const: 0

required:
  - compatible
  - reg
  - clocks
  - clock-names
  - rockchip,grf
  - "#sound-dai-cells"

unevaluatedProperties: false

examples:
  - |
    #include <dt-bindings/gpio/gpio.h>
    #include <dt-bindings/clock/rk3328-cru.h>
    codec: codec@ff410000 {
      compatible = "rockchip,rk3328-codec";
      reg = <0xff410000 0x1000>;
      clocks = <&cru PCLK_ACODECPHY>, <&cru SCLK_I2S1>;
      clock-names = "pclk", "mclk";
      rockchip,grf = <&grf>;
      mute-gpios = <&grf_gpio 0 GPIO_ACTIVE_LOW>;
      spk-depop-time-ms = <100>;
      #sound-dai-cells = <0>;
    };
```

## Documentation/devicetree/bindings/sound/rockchip,rk3399-gru-sound.txt
```
ROCKCHIP with MAX98357A/RT5514/DA7219 codecs on GRU boards

Required properties:
- compatible: "rockchip,rk3399-gru-sound"
- rockchip,cpu: The phandle of the Rockchip I2S controller that's
  connected to the codecs
- rockchip,codec: The phandle of the audio codecs

Optional properties:
- dmic-wakeup-delay-ms : specify delay time (ms) for DMIC ready.
  If this option is specified, which means it's required dmic need
  delay for DMIC to ready so that rt5514 can avoid recording before
  DMIC send valid data

Example:

sound {
	compatible = "rockchip,rk3399-gru-sound";
	rockchip,cpu = <&i2s0>;
	rockchip,codec = <&max98357a &rt5514 &da7219>;
	dmic-wakeup-delay-ms = <20>;
};
```

## Documentation/devicetree/bindings/sound/rockchip,rk3399-gru-sound.yaml
```yaml
# SPDX-License-Identifier: (GPL-2.0-only OR BSD-2-Clause)
%YAML 1.2
---
$id: http://devicetree.org/schemas/sound/rockchip,rk3399-gru-sound.yaml#
$schema: http://devicetree.org/meta-schemas/core.yaml#

title: Rockchip with MAX98357A/RT5514/DA7219 codecs on GRU boards

maintainers:
  - Heiko Stuebner <heiko@sntech.de>

properties:
  compatible:
    const: rockchip,rk3399-gru-sound

  rockchip,cpu:
    $ref: /schemas/types.yaml#/definitions/phandle-array
    description: |
      List of phandles to the Rockchip CPU DAI controllers connected to codecs
    minItems: 1
    items:
      - items:
          - description: Phandle to the Rockchip I2S controllers
      - items:
          - description: |
              Phandle to the Rockchip SPDIF controller. Required when a
              DisplayPort audio codec is referenced in rockchip,codec

  rockchip,codec:
    $ref: /schemas/types.yaml#/definitions/phandle-array
    description: |
      The phandles of the audio codecs connected to the Rockchip CPU DAI
      controllers
    minItems: 1
    maxItems: 6
    items:
      maxItems: 1

  dmic-wakeup-delay-ms:
    description: |
      specify delay time (ms) for DMIC ready.
      If this option is specified, a delay is required for DMIC to get ready
      so that rt5514 can avoid recording before DMIC sends valid data

required:
  - compatible
  - rockchip,cpu
  - rockchip,codec

additionalProperties: false

examples:
  - |
    sound {
      compatible = "rockchip,rk3399-gru-sound";
      rockchip,cpu = <&i2s0 &spdif>;
      rockchip,codec = <&max98357a &rt5514 &da7219 &cdn_dp>;
      dmic-wakeup-delay-ms = <20>;
    };
```

## Documentation/devicetree/bindings/sound/rockchip,rk3576-sai.yaml
```yaml
# SPDX-License-Identifier: (GPL-2.0-only OR BSD-2-Clause)
%YAML 1.2
---
$id: http://devicetree.org/schemas/sound/rockchip,rk3576-sai.yaml#
$schema: http://devicetree.org/meta-schemas/core.yaml#

title: Rockchip Serial Audio Interface Controller

description:
  The Rockchip Serial Audio Interface (SAI) controller is a flexible audio
  controller that implements the I2S, I2S/TDM and the PDM standards.

maintainers:
  - Nicolas Frattaroli <nicolas.frattaroli@collabora.com>

allOf:
  - $ref: dai-common.yaml#

properties:
  compatible:
    const: rockchip,rk3576-sai

  reg:
    maxItems: 1

  interrupts:
    maxItems: 1

  dmas:
    minItems: 1
    maxItems: 2

  dma-names:
    minItems: 1
    items:
      - enum: [tx, rx]
      - const: rx

  clocks:
    items:
      - description: master audio clock
      - description: AHB clock driving the interface

  clock-names:
    items:
      - const: mclk
      - const: hclk

  resets:
    minItems: 1
    items:
      - description: reset for the mclk domain
      - description: reset for the hclk domain

  reset-names:
    minItems: 1
    items:
      - const: m
      - const: h

  port:
    $ref: audio-graph-port.yaml#
    unevaluatedProperties: false

  power-domains:
    maxItems: 1

  "#sound-dai-cells":
    const: 0

  rockchip,sai-rx-route:
    $ref: /schemas/types.yaml#/definitions/uint32-array
    description:
      Defines the mapping of the controller's SDI ports to actual input lanes,
      as well as the number of input lanes.
      rockchip,sai-rx-route = <3> would mean sdi3 is receiving from data0, and
      that there is only one receiving lane.
      This property's absence is to be understood as only one receiving lane
      being used if the controller has capture capabilities.
    maxItems: 4
    items:
      minimum: 0
      maximum: 3

  rockchip,sai-tx-route:
    $ref: /schemas/types.yaml#/definitions/uint32-array
    description:
      Defines the mapping of the controller's SDO ports to actual output lanes,
      as well as the number of output lanes.
      rockchip,sai-tx-route = <3> would mean sdo3 is sending to data0, and
      that there is only one transmitting lane.
      This property's absence is to be understood as only one transmitting lane
      being used if the controller has playback capabilities.
    maxItems: 4
    items:
      minimum: 0
      maximum: 3

required:
  - compatible
  - reg
  - dmas
  - dma-names
  - clocks
  - clock-names
  - "#sound-dai-cells"

unevaluatedProperties: false

examples:
  - |
    #include <dt-bindings/clock/rockchip,rk3576-cru.h>
    #include <dt-bindings/interrupt-controller/arm-gic.h>
    #include <dt-bindings/interrupt-controller/irq.h>
    #include <dt-bindings/pinctrl/rockchip.h>
    #include <dt-bindings/power/rockchip,rk3576-power.h>
    #include <dt-bindings/reset/rockchip,rk3576-cru.h>

    bus {
        #address-cells = <2>;
        #size-cells = <2>;
        sai1: sai@2a610000 {
            compatible = "rockchip,rk3576-sai";
            reg = <0x0 0x2a610000 0x0 0x1000>;
            interrupts = <GIC_SPI 188 IRQ_TYPE_LEVEL_HIGH>;
            clocks = <&cru MCLK_SAI1_8CH>, <&cru HCLK_SAI1_8CH>;
            clock-names = "mclk", "hclk";
            dmas = <&dmac0 2>, <&dmac0 3>;
            dma-names = "tx", "rx";
            power-domains = <&power RK3576_PD_AUDIO>;
            resets = <&cru SRST_M_SAI1_8CH>, <&cru SRST_H_SAI1_8CH>;
            reset-names = "m", "h";
            pinctrl-names = "default";
            pinctrl-0 = <&sai1m0_lrck
                         &sai1m0_sclk
                         &sai1m0_sdi0
                         &sai1m0_sdo0
                         &sai1m0_sdo1
                         &sai1m0_sdo2
                         &sai1m0_sdo3>;
            rockchip,sai-tx-route = <3 1 2 0>;
            #sound-dai-cells = <0>;
        };
    };
```

## Documentation/devicetree/bindings/sound/rockchip,rk817-codec.txt
```
* Rockchip rk817 codec

Required properties:

- compatible: "rockchip,rk817-codec"
- clocks: a list of phandle + clock-specifer pairs, one for each entry in clock-names.
- clock-names: should be "mclk".
- spk-ctl-gpios: spk mute enable/disable
- hp-ctl-gpios: hp mute enable/disable
- spk-mute-delay-ms: spk mute delay time
- hp-mute-delay-ms: hp mute delay time
- spk-volume: DAC L/R volume digital setting for Speaker
- hp-volume: DAC L/R volume digital setting for Headphone
  *
  * DDAC L/R volume setting
  * 0db~-95db,0.375db/step,for example:
  * 0: 0dB
  * 10: -3.75dB
  * 125: -46dB
  * 255: -95dB
  *
- capture-volume: ADC L/R volume digital setting for Microphone
  *
  * DADC L/R volume setting
  * 0db~-95db,0.375db/step,for example:
  * 0: 0dB
  * 10: -3.75dB
  * 125: -46dB
  * 255: -95dB
  *
- mic-in-differential:
  Boolean. Indicate MIC input are differential, rather than single-ended.
- pdmdata-out-enable:
  Boolean. Indicate pdmdata output is enable or disable.
- use-ext-amplifier:
  Boolean. Indicate use external amplifier or not.
- adc-for-loopback:
  Boolean. Indicate adc use for loopback or not.

Example for rk817 codec:

rk817: pmic@20 {
	compatible = "rockchip,rk817";
	reg = <0x20>;
	interrupt-parent = <&gpio0>;
	interrupts = <7 IRQ_TYPE_LEVEL_LOW>;
	pinctrl-names = "default";
	pinctrl-0 = <&pmic_int>;

	........

	rk817_codec: codec {
			#sound-dai-cells = <0>;
			compatible = "rockchip,rk817-codec";
			clocks = <&cru SCLK_I2S_8CH_OUT>;
			clock-names = "mclk";
			pinctrl-names = "default";
			pinctrl-0 = <&i2s_8ch_mclk>;
			hp-volume = <3>;
			spk-volume = <3>;
			capture-volume = <0>;
			mic-in-differential;
			status = "okay";
	};

	........

};
```

## Documentation/devicetree/bindings/sound/rockchip,rockchip-audio-max98090.yaml
```yaml
# SPDX-License-Identifier: (GPL-2.0-only OR BSD-2-Clause)
%YAML 1.2
---
$id: http://devicetree.org/schemas/sound/rockchip,rockchip-audio-max98090.yaml#
$schema: http://devicetree.org/meta-schemas/core.yaml#

title: Rockchip audio complex with MAX98090 codec

maintainers:
  - Fabio Estevam <festevam@gmail.com>

properties:
  compatible:
    const: rockchip,rockchip-audio-max98090

  rockchip,model:
    $ref: /schemas/types.yaml#/definitions/string
    description: The user-visible name of this sound complex.

  rockchip,i2s-controller:
    $ref: /schemas/types.yaml#/definitions/phandle
    description: Phandle to the Rockchip I2S controller.

  rockchip,audio-codec:
    $ref: /schemas/types.yaml#/definitions/phandle
    description: Phandle to the MAX98090 audio codec.

  rockchip,headset-codec:
    $ref: /schemas/types.yaml#/definitions/phandle
    description: Phandle to the external chip for jack detection.

  rockchip,hdmi-codec:
    $ref: /schemas/types.yaml#/definitions/phandle
    description: Phandle to the HDMI device for HDMI codec.

required:
  - compatible
  - rockchip,model
  - rockchip,i2s-controller

allOf:
  - if:
      required:
        - rockchip,audio-codec
    then:
      required:
        - rockchip,headset-codec

unevaluatedProperties: false

examples:
  - |
    sound {
        compatible = "rockchip,rockchip-audio-max98090";
        rockchip,model = "ROCKCHIP-I2S";
        rockchip,i2s-controller = <&i2s>;
        rockchip,audio-codec = <&max98090>;
        rockchip,headset-codec = <&headsetcodec>;
    };
```

## Documentation/devicetree/bindings/sound/rockchip,rt5651-tc358749x.txt
```
ROCKCHIP with RT5651_TC358749X CODECS

Required properties:
- compatible: "rockchip,rockchip-rt5651-tc358749x-sound"
- rockchip,cpu: CPU DAI, The phandle of the Rockchip I2S controller that's
  connected to the CODEC
- rockchip,audio-codec: The phandle of the RT5651 TC358749x audio codec

Example:

sound {
	compatible = "rockchip,rockchip-rt5651-tc358749x-sound";
	rockchip,cpu = <&i2s0>;
	rockchip,codec = <&rt5651 &rt5651 &tc358749x>;
	status = "okay";
};
```

## Documentation/devicetree/bindings/sound/rockchip,spdifrx.txt
```
* Rockchip SPDIF Receiver

The S/PDIF audio block is a stereo receiver that allows the
processor to receive and digital audio via an coaxial cable or
a fibre cable.

Required properties:

- compatible: should be one of the following:
   - "rockchip,rk3308-spdifrx"
- reg: physical base address of the controller and length of memory mapped
  region.
- interrupts: should contain the SPDIF interrupt.
- dmas: DMA specifiers for rx dma. See the DMA client binding,
  Documentation/devicetree/bindings/dma/dma.txt
- dma-names: should be "rx"
- clocks: a list of phandle + clock-specifier pairs, one for each entry
  in clock-names.
- clock-names: should contain following:
   - "hclk": clock for SPDIF controller
   - "mclk" : clock for SPDIF bus
- resets: a list of phandle + reset-specifer paris, one for each entry in reset-names.
- reset-names: reset names, should include "spdifrx-m".

Example for the rk3308 SPDIF-RX controller:

spdif_rx: spdif-rx@ff3b0000 {
	compatible = "rockchip,rk3308-spdifrx";
	reg = <0x0 0xff3b0000 0x0 0x1000>;
	interrupts = <GIC_SPI 56 IRQ_TYPE_LEVEL_HIGH>;
	clocks = <&cru SCLK_SPDIF_RX>, <&cru HCLK_SPDIFRX>;
	clock-names = "mclk", "hclk";
	dmas = <&dmac1 14>;
	dma-names = "rx";
	resets = <&cru SRST_SPDIFRX_M>;
	reset-names = "spdifrx-m";
	status = "disabled";
};
```

## Documentation/devicetree/bindings/sound/rockchip,vad.txt
```
* Rockchip VAD controller

Required properties:

- compatible: should be one of the following
  - "rockchip,rk1808-vad": for rk1808
  - "rockchip,rk3308-vad": for rk3308
- reg: physical base address of the controller and length of memory mapped
  region.
- clocks: a list of phandle + clock-specifer pairs, one for each entry in clock-names.
- clock-names: should contain following:
- interrupts: should contain the vad interrupt.
- rockchip,audio-sram: the phandle of audio sram for vad.
- rockchip,audio-src: the phandle of audio src for vad.
- rockchip,buffer-time-ms: vad sram buffer time msec.
- rockchip,det-channel: the channel(0~7) is used for detection.
- rockchip,mode: vad work mode.
  - 0: begin to store the data after voice detected.
  - 1: begin to store the data after vad is enabled.
  - 2: don't store the data.

Optional properties:
- rockchip,acodec-cfg: boolean, config acodec after voice activity detection.

Example for rk3308 VAD controller:

vad: vad@ff3c0000 {
	compatible = "rockchip,rk3308-vad";
	reg = <0x0 0xff3c0000 0x0 0x10000>;
	reg-names = "vad";
	clocks = <&cru HCLK_VAD>;
	clock-names = "hclk";
	interrupts = <GIC_SPI 57 IRQ_TYPE_LEVEL_HIGH>;
	rockchip,audio-sram = <&vad_sram>;
	rockchip,audio-src = <&i2s_8ch_0>;
	rockchip,det-channel = <0>;
	rockchip,mode = <0>;
	status = "disabled";
};
```
