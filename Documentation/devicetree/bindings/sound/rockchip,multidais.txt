## Documentation/devicetree/bindings/sound/rockchip-audio.txt
```
* Rockchip Audio controller

Required SoC Specific Properties:

- compatible : "rk3036-audio"
- reg: physical base address of the controller and length of memory mapped
  region.
- clocks: must include clock specifiers corresponding to entries in the
  clock-names property.
- clocks-names: list of clock names sorted in the same order as the clocks
  property. Must contain "rockchip-i2s" and "rk3036-codec".
- interrupts: interrupt number to the cpu.
- dmas: list of DMA controller phandle and DMA request line ordered pairs.
- dma-names: identifier string for each DMA request line in the dmas property.
  These strings correspond 1:1 with the ordered pairs in dmas.
- pinctrl-names: must contain a "default" entry.
- pinctrl-0: pin control group to be used for this controller.
- pinctrl-1: pin control group to be used for gpio.

Example:

rockchip-audio {
	compatible = "rk3036-audio";
	dais {
		dai0 {
			audio-codec = <&codec>;
			audio-controller = <&i2s>;
			format = "i2s";
			//continuous-clock;
			//bitclock-inversion;
			//frame-inversion;
			//bitclock-master;
			//frame-master;
		};
	};
};


- compatible : "audio-rk312x"
- reg: physical base address of the controller and length of memory mapped
  region.
- clocks: must include clock specifiers corresponding to entries in the
  clock-names property.
- clocks-names: list of clock names sorted in the same order as the clocks
  property. Must contain "rockchip-i2s" and "rk3036-codec".
- interrupts: interrupt number to the cpu.
- dmas: list of DMA controller phandle and DMA request line ordered pairs.
- dma-names: identifier string for each DMA request line in the dmas property.
  These strings correspond 1:1 with the ordered pairs in dmas.
- pinctrl-names: must contain a "default" entry.
- pinctrl-0: pin control group to be used for this controller.
- pinctrl-1: pin control group to be used for gpio.

Example:

rockchip-audio {
        compatible = "audio-rk312x";
        dais {
                dai0 {
                        audio-codec = <&codec>;
                        audio-controller = <&i2s1>;
                        format = "i2s";
                        //continuous-clock;
                        //bitclock-inversion;
                        //frame-inversion;
                        //bitclock-master;
                        //frame-master;
                };
        };
};


- compatible : "rk312x-spdif"
- reg: physical base address of the controller and length of memory mapped
  region.
- clocks: must include clock specifiers corresponding to entries in the
  clock-names property.
- clocks-names: list of clock names sorted in the same order as the clocks
  property. Must contain "rockchip-i2s" and "rk3036-codec".
- interrupts: interrupt number to the cpu.
- dmas: list of DMA controller phandle and DMA request line ordered pairs.
- dma-names: identifier string for each DMA request line in the dmas property.
  These strings correspond 1:1 with the ordered pairs in dmas.
- pinctrl-names: must contain a "default" entry.
- pinctrl-0: pin control group to be used for this controller.
- pinctrl-1: pin control group to be used for gpio.

Example:

spdif: spdif@10204000 {
	compatible = "rk312x-spdif";
	reg = <0x10204000 0x1000>;
	clocks = <&clk_spdif>, <&clk_gates10 9>;
	clock-names = "spdif_8ch_mclk", "spdif_hclk";
	interrupts = <GIC_SPI 55 IRQ_TYPE_LEVEL_HIGH>;
	dmas = <&pdma 13>;
	//#dma-cells = <1>;
	dma-names = "tx";
	pinctrl-names = "default";
	pinctrl-0 = <&spdif_tx>;
};



- compatible : "rk312x-codec"
- reg: physical base address of the controller and length of memory mapped
  region.
- clocks: must include clock specifiers corresponding to entries in the
  clock-names property.
- clocks-names: list of clock names sorted in the same order as the clocks
  property. Must contain "rockchip-i2s" and "rk3036-codec".
- interrupts: interrupt number to the cpu.
- dmas: list of DMA controller phandle and DMA request line ordered pairs.
- dma-names: identifier string for each DMA request line in the dmas property.
  These strings correspond 1:1 with the ordered pairs in dmas.
- pinctrl-names: must contain a "default" entry.
- pinctrl-0: pin control group to be used for this controller.
- pinctrl-1: pin control group to be used for gpio.

Example:

codec: codec@20030000 {
	compatible = "rk312x-codec";
	reg = <0x20030000 0x1000>;
	spk_ctl_io = <&gpio1 GPIO_A3 0>;
	//pinctrl-names = "default";
	//pinctrl-0 = <&i2s_gpio>;

	boot_depop = <1>;
	pa_enable_time = <1000>;
	clocks = <&clk_gates5 14>;
	clock-names = "g_pclk_acodec";
};
```

## Documentation/devicetree/bindings/sound/rockchip-cdndp.txt
```
ROCKCHIP with DP via I2S

Required properties:
- compatible: "rockchip,cdndp-sound"
- rockchip,cpu: The phandle of the Rockchip I2S controller controller that's
  connected to the codec
- rockchip,codec: The phandle of the the DP encoder node

Example:

sound {
	compatible = "rockchip,cdndp-sound";
	rockchip,cpu = <&i2s2>;
	rockchip,codec = <&cdn_dp>;
};
```

## Documentation/devicetree/bindings/sound/rockchip-i2s.txt
```
* Rockchip I2S controller

The I2S bus (Inter-IC sound bus) is a serial link for digital
audio data transfer between devices in the system.

Required properties:

- compatible: should be one of the following:
   - "rockchip,rk3066-i2s": for rk3066
   - "rockchip,px30-i2s", "rockchip,rk3066-i2s": for px30
   - "rockchip,rk1808-i2s", "rockchip,rk3066-i2s": for rk1808
   - "rockchip,rk3036-i2s", "rockchip,rk3066-i2s": for rk3036
   - "rockchip,rk3128-i2s", "rockchip,rk3066-i2s": for rk3128
   - "rockchip,rk3188-i2s", "rockchip,rk3066-i2s": for rk3188
   - "rockchip,rk3228-i2s", "rockchip,rk3066-i2s": for rk3228
   - "rockchip,rk3288-i2s", "rockchip,rk3066-i2s": for rk3288
   - "rockchip,rk3308-i2s", "rockchip,rk3066-i2s": for rk3308
   - "rockchip,rk3328-i2s", "rockchip,rk3066-i2s": for rk3328
   - "rockchip,rk3366-i2s", "rockchip,rk3066-i2s": for rk3366
   - "rockchip,rk3368-i2s", "rockchip,rk3066-i2s": for rk3368
   - "rockchip,rk3399-i2s", "rockchip,rk3066-i2s": for rk3399
   - "rockchip,rv1126-i2s", "rockchip,rk3066-i2s": for rv1126
- reg: physical base address of the controller and length of memory mapped
  region.
- interrupts: should contain the I2S interrupt.
- dmas: DMA specifiers for tx and rx dma. See the DMA client binding,
	Documentation/devicetree/bindings/dma/dma.txt
- dma-names: should include "tx" and "rx".
- clocks: a list of phandle + clock-specifer pairs, one for each entry in clock-names.
- clock-names: should contain the following:
   - "i2s_hclk": clock for I2S BUS
   - "i2s_clk" : clock for I2S controller
- resets: a list of phandle + reset-specifer paris, one for each entry in reset-names.
- reset-names: reset names, should include "reset-m", "reset-h", there may be only
  "reset-m" on some platforms.
- rockchip,playback-channels: max playback channels, if not set, 8 channels default.
- rockchip,capture-channels: max capture channels, if not set, 2 channels default.
- rockchip,bclk-fs: configure the i2s bclk fs.
- rockchip,clk-trcm: tx and rx lrck/bclk common use.
   - 0: both tx_lrck/bclk and rx_lrck/bclk are used
   - 1: only tx_lrck/bclk is used
   - 2: only rx_lrck/bclk is used
- rockchip,no-dmaengine: This is a boolean property. If present, driver will do not
  register pcm dmaengine, only just register dai. if the dai is part of multi-dais,
  the property should be present. Please refer to rockchip,multidais.txt about
  multi-dais usage.
- rockchip,playback-only: Specify that the controller only has playback capability.
- rockchip,capture-only: Specify that the controller only has capture capability.

Required properties for controller which support multi channels
playback/capture:

- rockchip,grf: the phandle of the syscon node for GRF register.

Optional properties:
- rockchip,mclk-calibrate: This is a boolean value, if present, enable
  clk calibrate and compenation.

  note: the corresponding property 'i2s_clk_root' should be assigned.

Example for rk3288 I2S controller:

i2s@ff890000 {
	compatible = "rockchip,rk3288-i2s", "rockchip,rk3066-i2s";
	reg = <0xff890000 0x10000>;
	interrupts = <GIC_SPI 85 IRQ_TYPE_LEVEL_HIGH>;
	dmas = <&pdma1 0>, <&pdma1 1>;
	dma-names = "tx", "rx";
	clock-names = "i2s_hclk", "i2s_clk";
	clocks = <&cru HCLK_I2S0>, <&cru SCLK_I2S0>;
	rockchip,playback-channels = <8>;
	rockchip,capture-channels = <2>;
	rockchip,bclk-fs = <64>;
};

Example for RV1126 I2S controller with mclk-calibrate:

&i2s1_2ch {
	status = "okay";
	clocks = <&cru MCLK_I2S1>, <&cru HCLK_I2S1>, <&cru PLL_CPLL>;
	clock-names = "i2s_clk", "i2s_hclk", "i2s_clk_root";
	rockchip,mclk-calibrate;
};
```

## Documentation/devicetree/bindings/sound/rockchip-i2s.yaml
```yaml
# SPDX-License-Identifier: GPL-2.0
%YAML 1.2
---
$id: http://devicetree.org/schemas/sound/rockchip-i2s.yaml#
$schema: http://devicetree.org/meta-schemas/core.yaml#

title: Rockchip I2S controller

description:
  The I2S bus (Inter-IC sound bus) is a serial link for digital
  audio data transfer between devices in the system.

maintainers:
  - Heiko Stuebner <heiko@sntech.de>

properties:
  compatible:
    oneOf:
      - const: rockchip,rk3066-i2s
      - items:
          - enum:
              - rockchip,px30-i2s
              - rockchip,rk1808-i2s
              - rockchip,rk3036-i2s
              - rockchip,rk3128-i2s
              - rockchip,rk3188-i2s
              - rockchip,rk3228-i2s
              - rockchip,rk3288-i2s
              - rockchip,rk3308-i2s
              - rockchip,rk3328-i2s
              - rockchip,rk3366-i2s
              - rockchip,rk3368-i2s
              - rockchip,rk3399-i2s
              - rockchip,rv1126-i2s
          - const: rockchip,rk3066-i2s

  reg:
    maxItems: 1

  interrupts:
    maxItems: 1

  clocks:
    items:
      - description: clock for I2S controller
      - description: clock for I2S BUS

  clock-names:
    items:
      - const: i2s_clk
      - const: i2s_hclk

  dmas:
    minItems: 1
    maxItems: 2

  dma-names:
    oneOf:
      - const: rx
      - items:
          - const: tx
          - const: rx

  pinctrl-names:
    oneOf:
      - const: default
      - items:
          - const: bclk_on
          - const: bclk_off

  power-domains:
    maxItems: 1

  reset-names:
    items:
      - const: reset-m
      - const: reset-h

  resets:
    maxItems: 2

  rockchip,capture-channels:
    $ref: /schemas/types.yaml#/definitions/uint32
    default: 2
    description:
      Max capture channels, if not set, 2 channels default.

  rockchip,playback-channels:
    $ref: /schemas/types.yaml#/definitions/uint32
    default: 8
    description:
      Max playback channels, if not set, 8 channels default.

  rockchip,grf:
    $ref: /schemas/types.yaml#/definitions/phandle
    description:
      The phandle of the syscon node for the GRF register.
      Required property for controllers which support multi channel
      playback/capture.

  "#sound-dai-cells":
    const: 0

required:
  - compatible
  - reg
  - interrupts
  - clocks
  - clock-names
  - dmas
  - dma-names
  - "#sound-dai-cells"

additionalProperties: false

examples:
  - |
    #include <dt-bindings/clock/rk3288-cru.h>
    #include <dt-bindings/interrupt-controller/arm-gic.h>
    #include <dt-bindings/interrupt-controller/irq.h>
    i2s@ff890000 {
      compatible = "rockchip,rk3288-i2s", "rockchip,rk3066-i2s";
      reg = <0xff890000 0x10000>;
      interrupts = <GIC_SPI 85 IRQ_TYPE_LEVEL_HIGH>;
      clocks = <&cru SCLK_I2S0>, <&cru HCLK_I2S0>;
      clock-names = "i2s_clk", "i2s_hclk";
      dmas = <&pdma1 0>, <&pdma1 1>;
      dma-names = "tx", "rx";
      rockchip,capture-channels = <2>;
      rockchip,playback-channels = <8>;
      #sound-dai-cells = <0>;
    };
```

## Documentation/devicetree/bindings/sound/rockchip-max98090.txt
```
ROCKCHIP with MAX98090 CODEC

Required properties:
- compatible: "rockchip,rockchip-audio-max98090"
- rockchip,model: The user-visible name of this sound complex
- rockchip,i2s-controller: The phandle of the Rockchip I2S controller that's
  connected to the CODEC

Optional properties:
- rockchip,audio-codec: The phandle of the MAX98090 audio codec.
- rockchip,headset-codec: The phandle of Ext chip for jack detection. This is
                          required if there is rockchip,audio-codec.
- rockchip,hdmi-codec: The phandle of HDMI device for HDMI codec.

Example:

/* For max98090-only board. */
sound {
	compatible = "rockchip,rockchip-audio-max98090";
	rockchip,model = "ROCKCHIP-I2S";
	rockchip,i2s-controller = <&i2s>;
	rockchip,audio-codec = <&max98090>;
	rockchip,headset-codec = <&headsetcodec>;
};

/* For HDMI-only board. */
sound {
	compatible = "rockchip,rockchip-audio-max98090";
	rockchip,model = "ROCKCHIP-I2S";
	rockchip,i2s-controller = <&i2s>;
	rockchip,hdmi-codec = <&hdmi>;
};

/* For max98090 plus HDMI board. */
sound {
	compatible = "rockchip,rockchip-audio-max98090";
	rockchip,model = "ROCKCHIP-I2S";
	rockchip,i2s-controller = <&i2s>;
	rockchip,audio-codec = <&max98090>;
	rockchip,headset-codec = <&headsetcodec>;
	rockchip,hdmi-codec = <&hdmi>;
};
```

## Documentation/devicetree/bindings/sound/rockchip-rt5645.txt
```
ROCKCHIP with RT5645/RT5650 CODECS

Required properties:
- compatible: "rockchip,rockchip-audio-rt5645"
- rockchip,model: The user-visible name of this sound complex
- rockchip,i2s-controller: The phandle of the Rockchip I2S controller that's
  connected to the CODEC
- rockchip,audio-codec: The phandle of the RT5645/RT5650 audio codec

Example:

sound {
	compatible = "rockchip,rockchip-audio-rt5645";
	rockchip,model = "ROCKCHIP-I2S";
	rockchip,i2s-controller = <&i2s>;
	rockchip,audio-codec = <&rt5645>;
};
```
