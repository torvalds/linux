## Documentation/devicetree/bindings/sound/fsl,micfil.yaml
```yaml
# SPDX-License-Identifier: (GPL-2.0-only OR BSD-2-Clause)
%YAML 1.2
---
$id: http://devicetree.org/schemas/sound/fsl,micfil.yaml#
$schema: http://devicetree.org/meta-schemas/core.yaml#

title: NXP MICFIL Digital Audio Interface (MICFIL)

maintainers:
  - Shengjiu Wang <shengjiu.wang@nxp.com>

description: |
  The MICFIL digital interface provides a 16-bit or 24-bit audio signal
  from a PDM microphone bitstream in a configurable output sampling rate.

properties:
  compatible:
    enum:
      - fsl,imx8mm-micfil
      - fsl,imx8mp-micfil

  reg:
    maxItems: 1

  interrupts:
    items:
      - description: Digital Microphone interface interrupt
      - description: Digital Microphone interface error interrupt
      - description: voice activity detector event interrupt
      - description: voice activity detector error interrupt

  dmas:
    items:
      - description: DMA controller phandle and request line for RX

  dma-names:
    items:
      - const: rx

  clocks:
    items:
      - description: The ipg clock for register access
      - description: internal micfil clock
      - description: PLL clock source for 8kHz series
      - description: PLL clock source for 11kHz series
      - description: External clock 3
    minItems: 2

  clock-names:
    items:
      - const: ipg_clk
      - const: ipg_clk_app
      - const: pll8k
      - const: pll11k
      - const: clkext3
    minItems: 2

required:
  - compatible
  - reg
  - interrupts
  - dmas
  - dma-names
  - clocks
  - clock-names

additionalProperties: false

examples:
  - |
    #include <dt-bindings/interrupt-controller/arm-gic.h>
    #include <dt-bindings/clock/imx8mm-clock.h>
    micfil: audio-controller@30080000 {
        compatible = "fsl,imx8mm-micfil";
        reg = <0x30080000 0x10000>;
        interrupts = <GIC_SPI 109 IRQ_TYPE_LEVEL_HIGH>,
                     <GIC_SPI 110 IRQ_TYPE_LEVEL_HIGH>,
                     <GIC_SPI 44 IRQ_TYPE_LEVEL_HIGH>,
                     <GIC_SPI 45 IRQ_TYPE_LEVEL_HIGH>;
        clocks = <&clk IMX8MM_CLK_PDM_IPG>,
                 <&clk IMX8MM_CLK_PDM_ROOT>;
        clock-names = "ipg_clk", "ipg_clk_app";
        dmas = <&sdma2 24 25 0>;
        dma-names = "rx";
    };
```

## Documentation/devicetree/bindings/sound/fsl,mqs.txt
```
fsl,mqs audio CODEC

Required properties:
  - compatible : Must contain one of "fsl,imx6sx-mqs", "fsl,codec-mqs"
		"fsl,imx8qm-mqs", "fsl,imx8qxp-mqs", "fsl,imx93-mqs".
  - clocks : A list of phandles + clock-specifiers, one for each entry in
	     clock-names
  - clock-names : "mclk" - must required.
		  "core" - required if compatible is "fsl,imx8qm-mqs", it
		           is for register access.
  - gpr : A phandle of General Purpose Registers in IOMUX Controller.
	  Required if compatible is "fsl,imx6sx-mqs".

Required if compatible is "fsl,imx8qm-mqs":
  - power-domains: A phandle of PM domain provider node.
  - reg: Offset and length of the register set for the device.

Example:

mqs: mqs {
	compatible = "fsl,imx6sx-mqs";
	gpr = <&gpr>;
	clocks = <&clks IMX6SX_CLK_SAI1>;
	clock-names = "mclk";
	status = "disabled";
};

mqs: mqs@59850000 {
	compatible = "fsl,imx8qm-mqs";
	reg = <0x59850000 0x10000>;
	clocks = <&clk IMX8QM_AUD_MQS_IPG>,
		 <&clk IMX8QM_AUD_MQS_HMCLK>;
	clock-names = "core", "mclk";
	power-domains = <&pd_mqs0>;
	status = "disabled";
};
```

## Documentation/devicetree/bindings/sound/fsl,mqs.yaml
```yaml
# SPDX-License-Identifier: (GPL-2.0-only OR BSD-2-Clause)
%YAML 1.2
---
$id: http://devicetree.org/schemas/sound/fsl,mqs.yaml#
$schema: http://devicetree.org/meta-schemas/core.yaml#

title: NXP Medium Quality Sound (MQS)

maintainers:
  - Shengjiu Wang <shengjiu.wang@nxp.com>
  - Chancel Liu <chancel.liu@nxp.com>

description: |
  Medium quality sound (MQS) is used to generate medium quality audio
  via a standard GPIO in the pinmux, allowing the user to connect
  stereo speakers or headphones to a power amplifier without an
  additional DAC chip.

properties:
  compatible:
    enum:
      - fsl,imx6sx-mqs
      - fsl,imx8qm-mqs
      - fsl,imx8qxp-mqs
      - fsl,imx93-mqs
      - fsl,imx943-aonmix-mqs
      - fsl,imx943-wakeupmix-mqs
      - fsl,imx95-aonmix-mqs
      - fsl,imx95-netcmix-mqs

  "#sound-dai-cells":
    const: 0

  clocks:
    minItems: 1
    maxItems: 2

  clock-names:
    minItems: 1
    maxItems: 2

  gpr:
    $ref: /schemas/types.yaml#/definitions/phandle
    description: The phandle to the General Purpose Register (GPR) node

  reg:
    maxItems: 1

  power-domains:
    maxItems: 1

  resets:
    maxItems: 1

  port:
    $ref: audio-graph-port.yaml#
    unevaluatedProperties: false

required:
  - compatible
  - clocks
  - clock-names

allOf:
  - $ref: dai-common.yaml#
  - if:
      properties:
        compatible:
          contains:
            enum:
              - fsl,imx8qm-mqs
              - fsl,imx8qxp-mqs
    then:
      properties:
        clocks:
          items:
            - description: Master clock
            - description: Clock for register access
        clock-names:
          items:
            - const: mclk
            - const: core
      required:
        - reg
        - power-domains
    else:
      properties:
        clocks:
          items:
            - description: Master clock
        clock-names:
          items:
            - const: mclk
      required:
        - gpr

unevaluatedProperties: false

examples:
  - |
    #include <dt-bindings/clock/imx6sx-clock.h>
    mqs0: mqs {
        compatible = "fsl,imx6sx-mqs";
        gpr = <&gpr>;
        clocks = <&clks IMX6SX_CLK_SAI1>;
        clock-names = "mclk";
    };

  - |
    #include <dt-bindings/firmware/imx/rsrc.h>
    mqs1: mqs@59850000 {
        compatible = "fsl,imx8qm-mqs";
        reg = <0x59850000 0x10000>;
        clocks = <&mqs0_lpcg 0>, <&mqs0_lpcg 1>;
        clock-names = "mclk", "core";
        power-domains = <&pd IMX_SC_R_MQS_0>;
    };
```

## Documentation/devicetree/bindings/sound/fsl,mxs-audio-sgtl5000.yaml
```yaml
# SPDX-License-Identifier: (GPL-2.0-only OR BSD-2-Clause)
%YAML 1.2
---
$id: http://devicetree.org/schemas/sound/fsl,mxs-audio-sgtl5000.yaml#
$schema: http://devicetree.org/meta-schemas/core.yaml#

title: Freescale MXS audio complex with SGTL5000 codec

maintainers:
  - Frank Li <Frank.Li@nxp.com>

properties:
  compatible:
    items:
      - enum:
          - bluegiga,apx4devkit-sgtl5000
          - denx,m28evk-sgtl5000
          - fsl,imx28-evk-sgtl5000
          - fsl,imx28-mbmx28lc-sgtl5000
          - fsl,imx28-tx28-sgtl5000
      - const: fsl,mxs-audio-sgtl5000

  model:
    $ref: /schemas/types.yaml#/definitions/string
    description: The user-visible name of this sound complex

  saif-controllers:
    $ref: /schemas/types.yaml#/definitions/phandle-array
    description: The phandle list of the MXS SAIF controller

  audio-codec:
    $ref: /schemas/types.yaml#/definitions/phandle
    description: The phandle of the SGTL5000 audio codec

  audio-routing:
    $ref: /schemas/types.yaml#/definitions/non-unique-string-array
    description: |
      A list of the connections between audio components.
      Each entry is a pair of strings, the first being the
      connection's sink, the second being the connection's
      source. Valid names could be power supplies, SGTL5000
      pins, and the jacks on the board:

      Power supplies:
        * Mic Bias

      SGTL5000 pins:
        * MIC_IN
        * LINE_IN
        * HP_OUT
        * LINE_OUT

      Board connectors:
        * Mic Jack
        * Line In Jack
        * Headphone Jack
        * Line Out Jack
        * Ext Spk

required:
  - compatible
  - saif-controllers
  - audio-codec

allOf:
  - $ref: dai-common.yaml#

unevaluatedProperties: false

examples:
  - |
    sound {
        compatible = "fsl,imx28-evk-sgtl5000", "fsl,mxs-audio-sgtl5000";
        model = "imx28-evk-sgtl5000";
        saif-controllers = <&saif0 &saif1>;
        audio-codec = <&sgtl5000>;
        audio-routing =
            "MIC_IN", "Mic Jack",
            "Mic Jack", "Mic Bias",
            "Headphone Jack", "HP_OUT";
    };
```

## Documentation/devicetree/bindings/sound/fsl,qmc-audio.yaml
```yaml
# SPDX-License-Identifier: (GPL-2.0-only OR BSD-2-Clause)
%YAML 1.2
---
$id: http://devicetree.org/schemas/sound/fsl,qmc-audio.yaml#
$schema: http://devicetree.org/meta-schemas/core.yaml#

title: QMC audio

maintainers:
  - Herve Codina <herve.codina@bootlin.com>

description: |
  The QMC audio is an ASoC component which uses QMC (QUICC Multichannel
  Controller) channels to transfer the audio data.
  It provides several DAIs. For each DAI, the DAI is working in interleaved mode
  if only one QMC channel is used by the DAI or it is working in non-interleaved
  mode if several QMC channels are used by the DAI.

allOf:
  - $ref: dai-common.yaml#

properties:
  compatible:
    const: fsl,qmc-audio

  '#address-cells':
    const: 1
  '#size-cells':
    const: 0
  '#sound-dai-cells':
    const: 1

patternProperties:
  '^dai@([0-9]|[1-5][0-9]|6[0-3])$':
    description:
      A DAI managed by this controller
    type: object
    additionalProperties: false

    properties:
      reg:
        minimum: 0
        maximum: 63
        description:
          The DAI number

      fsl,qmc-chan:
        $ref: /schemas/types.yaml#/definitions/phandle-array
        items:
          items:
            - description: phandle to QMC node
            - description: Channel number
        minItems: 1
        description:
          Should be a phandle/number pair list. The list of phandle to QMC node
          and the QMC channel pair to use for this DAI.
          If only one phandle/number pair is provided, this DAI works in
          interleaved mode, i.e. audio channels for this DAI are interleaved in
          the QMC channel. If more than one pair is provided, this DAI works
          in non-interleave mode. In that case the first audio channel uses the
          the first QMC channel, the second audio channel uses the second QMC
          channel, etc...

    required:
      - reg
      - fsl,qmc-chan

required:
  - compatible
  - '#address-cells'
  - '#size-cells'
  - '#sound-dai-cells'

additionalProperties: false

examples:
  - |
    audio_controller: audio-controller {
        compatible = "fsl,qmc-audio";
        #address-cells = <1>;
        #size-cells = <0>;
        #sound-dai-cells = <1>;
        dai@16 {
            reg = <16>;
            fsl,qmc-chan = <&qmc 16>;
        };
        dai@17 {
            reg = <17>;
            fsl,qmc-chan = <&qmc 17>;
        };
        dai@18 {
            reg = <18>;
            /* Non-interleaved mode */
            fsl,qmc-chan = <&qmc 18>, <&qmc 19>;
        };
    };

    sound {
        compatible = "simple-audio-card";
        #address-cells = <1>;
        #size-cells = <0>;
        simple-audio-card,dai-link@0 {
            reg = <0>;
            format = "dsp_b";
            cpu {
                sound-dai = <&audio_controller 16>;
            };
            codec {
                sound-dai = <&codec1>;
                dai-tdm-slot-num = <4>;
                dai-tdm-slot-width = <8>;
                /* TS 3, 5, 7, 9 */
                dai-tdm-slot-tx-mask = <0 0 0 1 0 1 0 1 0 1>;
                dai-tdm-slot-rx-mask = <0 0 0 1 0 1 0 1 0 1>;
            };
        };
        simple-audio-card,dai-link@1 {
            reg = <1>;
            format = "dsp_b";
            cpu {
                sound-dai = <&audio_controller 17>;
            };
            codec {
                sound-dai = <&codec2>;
                dai-tdm-slot-num = <4>;
                dai-tdm-slot-width = <8>;
                /* TS 2, 4, 6, 8 */
                dai-tdm-slot-tx-mask = <0 0 1 0 1 0 1 0 1>;
                dai-tdm-slot-rx-mask = <0 0 1 0 1 0 1 0 1>;
            };
        };
        simple-audio-card,dai-link@2 {
            reg = <2>;
            format = "dsp_b";
            cpu {
                sound-dai = <&audio_controller 18>;
            };
            codec {
                sound-dai = <&codec3>;
                dai-tdm-slot-num = <2>;
                dai-tdm-slot-width = <8>;
                /* TS 9, 10 */
                dai-tdm-slot-tx-mask = <0 0 0 0 0 0 0 0 0 1 1>;
                dai-tdm-slot-rx-mask = <0 0 0 0 0 0 0 0 0 1 1>;
            };
        };
    };
```
