## Documentation/devicetree/bindings/sound/fsl,esai.yaml
```yaml
# SPDX-License-Identifier: (GPL-2.0-only OR BSD-2-Clause)
%YAML 1.2
---
$id: http://devicetree.org/schemas/sound/fsl,esai.yaml#
$schema: http://devicetree.org/meta-schemas/core.yaml#

title: Freescale Enhanced Serial Audio Interface (ESAI) Controller

maintainers:
  - Shengjiu Wang <shengjiu.wang@nxp.com>
  - Frank Li <Frank.Li@nxp.com>

description:
  The Enhanced Serial Audio Interface (ESAI) provides a full-duplex serial port
  for serial communication with a variety of serial devices, including industry
  standard codecs, Sony/Phillips Digital Interface (S/PDIF) transceivers, and
  other DSPs. It has up to six transmitters and four receivers.

properties:
  compatible:
    enum:
      - fsl,imx35-esai
      - fsl,imx6ull-esai
      - fsl,imx8qm-esai
      - fsl,vf610-esai

  reg:
    maxItems: 1

  interrupts:
    maxItems: 1

  clocks:
    minItems: 3
    items:
      - description:
          The core clock used to access registers.
      - description:
          The esai baud clock for esai controller used to
          derive HCK, SCK and FS.
      - description:
          The system clock derived from ahb clock used to
          derive HCK, SCK and FS.
      - description:
          The spba clock is required when ESAI is placed as a
          bus slave of the Shared Peripheral Bus and when two
          or more bus masters (CPU, DMA or DSP) try to access
          it. This property is optional depending on the SoC
          design.

  clock-names:
    minItems: 3
    items:
      - const: core
      - const: extal
      - const: fsys
      - const: spba

  dmas:
    minItems: 2
    maxItems: 2

  dma-names:
    items:
      - const: rx
      - const: tx

  fsl,fifo-depth:
    $ref: /schemas/types.yaml#/definitions/uint32
    default: 64
    description:
      The number of elements in the transmit and receive
      FIFOs. This number is the maximum allowed value for
      TFCR[TFWM] or RFCR[RFWM].

  fsl,esai-synchronous:
    $ref: /schemas/types.yaml#/definitions/flag
    description:
      This is a boolean property. If present, indicating
      that ESAI would work in the synchronous mode, which
      means all the settings for Receiving would be
      duplicated from Transmission related registers.

  big-endian:
    $ref: /schemas/types.yaml#/definitions/flag
    description:
      If this property is absent, the native endian mode
      will be in use as default, or the big endian mode
      will be in use for all the device registers.

required:
  - compatible
  - reg
  - interrupts
  - clocks
  - clock-names
  - dmas
  - dma-names

unevaluatedProperties: false

allOf:
  - $ref: dai-common.yaml#

examples:
  - |
    esai@2024000 {
      compatible = "fsl,imx35-esai";
      reg = <0x02024000 0x4000>;
      interrupts = <0 51 0x04>;
      clocks = <&clks 208>, <&clks 118>, <&clks 208>;
      clock-names = "core", "extal", "fsys";
      dmas = <&sdma 23 21 0>, <&sdma 24 21 0>;
      dma-names = "rx", "tx";
      fsl,fifo-depth = <128>;
      fsl,esai-synchronous;
      big-endian;
    };
```

## Documentation/devicetree/bindings/sound/fsl,imx-asrc.yaml
```yaml
# SPDX-License-Identifier: (GPL-2.0-only OR BSD-2-Clause)
%YAML 1.2
---
$id: http://devicetree.org/schemas/sound/fsl,imx-asrc.yaml#
$schema: http://devicetree.org/meta-schemas/core.yaml#

title: Freescale Asynchronous Sample Rate Converter (ASRC) Controller

description:
  The Asynchronous Sample Rate Converter (ASRC) converts the sampling rate of
  a signal associated with an input clock into a signal associated with a
  different output clock. The driver currently works as a Front End of DPCM
  with other Back Ends Audio controller such as ESAI, SSI and SAI. It has
  three pairs to support three substreams within totally 10 channels.

maintainers:
  - Shawn Guo <shawnguo@kernel.org>
  - Sascha Hauer <s.hauer@pengutronix.de>

properties:
  compatible:
    oneOf:
      - enum:
          - fsl,imx35-asrc
          - fsl,imx53-asrc
          - fsl,imx8qm-asrc
          - fsl,imx8qxp-asrc
      - items:
          - enum:
              - fsl,imx6sx-asrc
              - fsl,imx6ul-asrc
          - const: fsl,imx53-asrc

  reg:
    maxItems: 1

  interrupts:
    maxItems: 1

  dmas:
    maxItems: 6

  dma-names:
    items:
      - const: rxa
      - const: rxb
      - const: rxc
      - const: txa
      - const: txb
      - const: txc

  clocks:
    maxItems: 19

  clock-names:
    items:
      - const: mem
      - const: ipg
      - const: asrck_0
      - const: asrck_1
      - const: asrck_2
      - const: asrck_3
      - const: asrck_4
      - const: asrck_5
      - const: asrck_6
      - const: asrck_7
      - const: asrck_8
      - const: asrck_9
      - const: asrck_a
      - const: asrck_b
      - const: asrck_c
      - const: asrck_d
      - const: asrck_e
      - const: asrck_f
      - const: spba

  power-domains:
    maxItems: 1

  fsl,asrc-rate:
    $ref: /schemas/types.yaml#/definitions/uint32
    description: The mutual sample rate used by DPCM Back Ends

  fsl,asrc-width:
    $ref: /schemas/types.yaml#/definitions/uint32
    description: The mutual sample width used by DPCM Back Ends
    enum: [16, 24]

  fsl,asrc-clk-map:
    $ref: /schemas/types.yaml#/definitions/uint32
    description:
      Defines clock map used in driver
      <0> - select the map for asrc0 in imx8qm/imx8qxp
      <1> - select the map for asrc1 in imx8qm/imx8qxp
    enum: [0, 1]

  big-endian:
    type: boolean
    description:
      If this property is absent, the little endian mode will be in use as
      default. Otherwise, the big endian mode will be in use for all the
      device registers.

  fsl,asrc-format:
    $ref: /schemas/types.yaml#/definitions/uint32
    description:
      Defines a mutual sample format used by DPCM Back Ends, which can
      replace the fsl,asrc-width. The value is 2 (S16_LE), or 6 (S24_LE).
    enum: [2, 6]

required:
  - compatible
  - reg
  - interrupts
  - dmas
  - dma-names
  - clocks
  - clock-names
  - fsl,asrc-rate
  - fsl,asrc-width

allOf:
  - if:
      properties:
        compatible:
          contains:
            enum:
              - fsl,imx8qm-asrc
              - fsl,imx8qxp-asrc
    then:
      required:
        - fsl,asrc-clk-map
    else:
      properties:
        fsl,asrc-clk-map: false

  - if:
      properties:
        compatible:
          contains:
            enum:
              - fsl,imx8qm-asrc
              - fsl,imx8qxp-asrc
    then:
      required:
        - power-domains

additionalProperties: false

examples:
  - |
    #include <dt-bindings/interrupt-controller/irq.h>
    #include <dt-bindings/clock/imx6qdl-clock.h>
    asrc: asrc@2034000 {
        compatible = "fsl,imx53-asrc";
        reg = <0x02034000 0x4000>;
        interrupts = <0 50 IRQ_TYPE_LEVEL_HIGH>;
        clocks = <&clks IMX6QDL_CLK_ASRC_IPG>,
                 <&clks IMX6QDL_CLK_ASRC_MEM>, <&clks 0>,
                 <&clks 0>, <&clks 0>, <&clks 0>, <&clks 0>,
                 <&clks 0>, <&clks 0>, <&clks 0>, <&clks 0>,
                 <&clks 0>, <&clks 0>, <&clks 0>, <&clks 0>,
                 <&clks IMX6QDL_CLK_ASRC>, <&clks 0>, <&clks 0>,
                 <&clks IMX6QDL_CLK_SPBA>;
        clock-names = "mem", "ipg", "asrck_0",
                "asrck_1", "asrck_2", "asrck_3", "asrck_4",
                "asrck_5", "asrck_6", "asrck_7", "asrck_8",
                "asrck_9", "asrck_a", "asrck_b", "asrck_c",
                "asrck_d", "asrck_e", "asrck_f", "spba";
        dmas = <&sdma 17 23 1>, <&sdma 18 23 1>, <&sdma 19 23 1>,
               <&sdma 20 23 1>, <&sdma 21 23 1>, <&sdma 22 23 1>;
        dma-names = "rxa", "rxb", "rxc",
                    "txa", "txb", "txc";
        fsl,asrc-rate  = <48000>;
        fsl,asrc-width = <16>;
    };
```

## Documentation/devicetree/bindings/sound/fsl,imx-audio-es8328.yaml
```yaml
# SPDX-License-Identifier: (GPL-2.0-only OR BSD-2-Clause)
%YAML 1.2
---
$id: http://devicetree.org/schemas/sound/fsl,imx-audio-es8328.yaml#
$schema: http://devicetree.org/meta-schemas/core.yaml#

title: Freescale i.MX audio complex with ES8328 codec

maintainers:
  - Shawn Guo <shawnguo@kernel.org>
  - Sascha Hauer <s.hauer@pengutronix.de>

allOf:
  - $ref: sound-card-common.yaml#

properties:
  compatible:
    const: fsl,imx-audio-es8328

  model:
    $ref: /schemas/types.yaml#/definitions/string
    description: The user-visible name of this sound complex

  ssi-controller:
    $ref: /schemas/types.yaml#/definitions/phandle
    description: The phandle of the i.MX SSI controller

  jack-gpio:
    description: Optional GPIO for headphone jack
    maxItems: 1

  audio-amp-supply:
    description: Power regulator for speaker amps

  audio-codec:
    $ref: /schemas/types.yaml#/definitions/phandle
    description: The phandle to the ES8328 audio codec

  audio-routing:
    $ref: /schemas/types.yaml#/definitions/non-unique-string-array
    description: |
      A list of the connections between audio components. Each entry
      is a pair of strings, the first being the connection's sink, the second
      being the connection's source. Valid names could be power supplies,
      ES8328 pins, and the jacks on the board:

      Power supplies:
        * audio-amp

      ES8328 pins:
        * LOUT1
        * LOUT2
        * ROUT1
        * ROUT2
        * LINPUT1
        * LINPUT2
        * RINPUT1
        * RINPUT2
        * Mic PGA

      Board connectors:
        * Headphone
        * Speaker
        * Mic Jack

  mux-int-port:
    $ref: /schemas/types.yaml#/definitions/uint32
    description: The internal port of the i.MX audio muxer (AUDMUX)
    enum: [1, 2, 7]
    default: 1

  mux-ext-port:
    $ref: /schemas/types.yaml#/definitions/uint32
    description: The external port of the i.MX audio muxer (AUDMIX)
    enum: [3, 4, 5, 6]
    default: 3

required:
  - compatible
  - model
  - ssi-controller
  - jack-gpio
  - audio-amp-supply
  - audio-codec
  - audio-routing
  - mux-int-port
  - mux-ext-port

unevaluatedProperties: false

examples:
  - |
    sound {
        compatible = "fsl,imx-audio-es8328";
        model = "imx-audio-es8328";
        ssi-controller = <&ssi1>;
        audio-codec = <&codec>;
        jack-gpio = <&gpio5 15 0>;
        audio-amp-supply = <&reg_audio_amp>;
        audio-routing =
            "Speaker", "LOUT2",
            "Speaker", "ROUT2",
            "Speaker", "audio-amp",
            "Headphone", "ROUT1",
            "Headphone", "LOUT1",
            "LINPUT1", "Mic Jack",
            "RINPUT1", "Mic Jack",
            "Mic Jack", "Mic Bias";
        mux-int-port = <1>;
        mux-ext-port = <3>;
    };
```

## Documentation/devicetree/bindings/sound/fsl,imx-audio-spdif.yaml
```yaml
# SPDX-License-Identifier: (GPL-2.0-only OR BSD-2-Clause)
%YAML 1.2
---
$id: http://devicetree.org/schemas/sound/fsl,imx-audio-spdif.yaml#
$schema: http://devicetree.org/meta-schemas/core.yaml#

title: Freescale i.MX audio complex with S/PDIF transceiver

maintainers:
  - Shengjiu Wang <shengjiu.wang@nxp.com>

properties:
  compatible:
    oneOf:
      - items:
          - enum:
              - fsl,imx-sabreauto-spdif
              - fsl,imx6sx-sdb-spdif
          - const: fsl,imx-audio-spdif
      - enum:
          - fsl,imx-audio-spdif

  model:
    $ref: /schemas/types.yaml#/definitions/string
    description: User specified audio sound card name

  spdif-controller:
    $ref: /schemas/types.yaml#/definitions/phandle
    description: The phandle of the i.MX S/PDIF controller

  spdif-out:
    type: boolean
    description:
      If present, the transmitting function of S/PDIF will be enabled,
      indicating there's a physical S/PDIF out connector or jack on the
      board or it's connecting to some other IP block, such as an HDMI
      encoder or display-controller.

  spdif-in:
    type: boolean
    description:
      If present, the receiving function of S/PDIF will be enabled,
      indicating there is a physical S/PDIF in connector/jack on the board.

required:
  - compatible
  - model
  - spdif-controller

anyOf:
  - required:
      - spdif-in
  - required:
      - spdif-out

additionalProperties: false

examples:
  - |
    sound-spdif {
        compatible = "fsl,imx-audio-spdif";
        model = "imx-spdif";
        spdif-controller = <&spdif>;
        spdif-out;
        spdif-in;
    };
```

## Documentation/devicetree/bindings/sound/fsl,imx95-cm7-sof.yaml
```yaml
# SPDX-License-Identifier: (GPL-2.0 OR BSD-2-Clause)
%YAML 1.2
---
$id: http://devicetree.org/schemas/sound/fsl,imx95-cm7-sof.yaml#
$schema: http://devicetree.org/meta-schemas/core.yaml#

title: NXP imx95 CM7 core

maintainers:
  - Daniel Baluta <daniel.baluta@nxp.com>

description: NXP imx95 CM7 core used for audio processing

properties:
  compatible:
    const: fsl,imx95-cm7-sof

  reg:
    maxItems: 1

  reg-names:
    const: sram

  memory-region:
    maxItems: 1

  memory-region-names:
    const: dma

  port:
    description: SAI3 port
    $ref: audio-graph-port.yaml#
    unevaluatedProperties: false

required:
  - compatible
  - reg
  - reg-names
  - memory-region
  - memory-region-names
  - port

allOf:
  - $ref: fsl,sof-cpu.yaml#

unevaluatedProperties: false

examples:
  - |
    cm7-cpu@80000000 {
        compatible = "fsl,imx95-cm7-sof";
        reg = <0x80000000 0x6100000>;
        reg-names = "sram";
        mboxes = <&mu7 2 0>, <&mu7 2 1>, <&mu7 3 0>, <&mu7 3 1>;
        mbox-names = "txdb0", "txdb1", "rxdb0", "rxdb1";
        memory-region = <&adma_res>;
        memory-region-names = "dma";
        port {
            /* SAI3-WM8962 link */
            endpoint {
                remote-endpoint = <&wm8962_ep>;
            };
        };
    };
```

## Documentation/devicetree/bindings/sound/fsl,micfil.txt
```
NXP MICFIL Digital Audio Interface (MICFIL).

The MICFIL digital interface provides a 16-bit audio signal from a PDM
microphone bitstream in a configurable output sampling rate.

Required properties:

  - compatible		: Compatible list, contains "fsl,imx8mm-micfil"
			  or "fsl,imx8mp-micfil"

  - reg			: Offset and length of the register set for the device.

  - interrupts		: Contains the micfil interrupts.

  - clocks		: Must contain an entry for each entry in clock-names.

  - clock-names		: Must include the "ipg_clk" for register access and
			  "ipg_clk_app" for internal micfil clock.

  - dmas		: Generic dma devicetree binding as described in
			  Documentation/devicetree/bindings/dma/dma.txt.

Example:
micfil: micfil@30080000 {
	compatible = "fsl,imx8mm-micfil";
	reg = <0x0 0x30080000 0x0 0x10000>;
	interrupts = <GIC_SPI 109 IRQ_TYPE_LEVEL_HIGH>,
		     <GIC_SPI 110 IRQ_TYPE_LEVEL_HIGH>;
	clocks = <&clk IMX8MM_CLK_PDM_IPG>,
		 <&clk IMX8MM_CLK_PDM_ROOT>;
	clock-names = "ipg_clk", "ipg_clk_app";
	dmas = <&sdma2 24 26 0x80000000>;
};
```
