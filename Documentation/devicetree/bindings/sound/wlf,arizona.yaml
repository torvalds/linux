## Documentation/devicetree/bindings/sound/wlf,arizona.yaml
```yaml
# SPDX-License-Identifier: GPL-2.0-only OR BSD-2-Clause
%YAML 1.2
---
$id: http://devicetree.org/schemas/sound/wlf,arizona.yaml#
$schema: http://devicetree.org/meta-schemas/core.yaml#

title: Cirrus Logic/Wolfson Microelectronics Arizona class audio SoCs

maintainers:
  - patches@opensource.cirrus.com

description: |
  These devices are audio SoCs with extensive digital capabilities and a range
  of analogue I/O.

  This document lists sound specific bindings, see the primary binding
  document ../mfd/arizona.yaml

properties:
  '#sound-dai-cells':
    description:
      The first cell indicating the audio interface.
    const: 1

  wlf,inmode:
    description:
      A list of INn_MODE register values, where n is the number of input
      signals. Valid values are 0 (Differential), 1 (Single-ended) and
      2 (Digital Microphone). If absent, INn_MODE registers set to 0 by
      default.  If present, values must be specified less than or equal
      to the number of input signals. If values less than the number of
      input signals, elements that have not been specified are set to 0 by
      default. Entries are <IN1, IN2, IN3, IN4> (wm5102, wm5110, wm8280,
      wm8997) and <IN1A, IN2A, IN1B, IN2B> (wm8998, wm1814)
    $ref: /schemas/types.yaml#/definitions/uint32-array
    minItems: 1
    maxItems: 4
    items:
      minimum: 0
      maximum: 2
      default: 0

  wlf,out-mono:
    description:
      A list of boolean values indicating whether each output is mono
      or stereo. Position within the list indicates the output affected
      (eg. First entry in the list corresponds to output 1). A non-zero
      value indicates a mono output. If present, the number of values
      should be less than or equal to the number of outputs, if less values
      are supplied the additional outputs will be treated as stereo.
    $ref: /schemas/types.yaml#/definitions/uint32-array
    minItems: 1
    maxItems: 6
    items:
      minimum: 0
      maximum: 1
      default: 0

  wlf,dmic-ref:
    description:
      DMIC reference voltage source for each input, can be selected from
      either MICVDD or one of the MICBIAS's, defines (ARIZONA_DMIC_xxxx)
      are provided in dt-bindings/mfd/arizona.h. If present, the number
      of values should be less than or equal to the number of inputs,
      unspecified inputs will use the chip default.
    $ref: /schemas/types.yaml#/definitions/uint32-array
    minItems: 1
    maxItems: 4
    items:
      minimum: 0
      maximum: 3
      default: 0

  wlf,max-channels-clocked:
    description:
      The maximum number of channels to be clocked on each AIF, useful for
      I2S systems with multiple data lines being mastered.  Specify one
      cell for each AIF to be configured, specify zero for AIFs that should
      be handled normally.  If present, number of cells must be less than
      or equal to the number of AIFs. If less than the number of AIFs, for
      cells that have not been specified the corresponding AIFs will be
      treated as default setting.
    $ref: /schemas/types.yaml#/definitions/uint32-array
    minItems: 1
    maxItems: 3
    items:
      default: 0

  wlf,spk-fmt:
    description:
      PDM speaker data format, must contain 2 cells (OUT5 and OUT6).  See
      the datasheet for values.  The second cell is ignored for codecs that
      do not have OUT6 (wm5102, wm8997, wm8998, wm1814)
    $ref: /schemas/types.yaml#/definitions/uint32-array
    minItems: 2
    maxItems: 2

  wlf,spk-mute:
    description:
      PDM speaker mute setting, must contain 2 cells (OUT5 and OUT6).  See
      the datasheet for values.  The second cell is ignored for codecs that
      do not have OUT6 (wm5102, wm8997, wm8998, wm1814)
    $ref: /schemas/types.yaml#/definitions/uint32-array
    minItems: 2
    maxItems: 2

  wlf,out-volume-limit:
    description:
      The volume limit value that should be applied to each output
      channel. See the datasheet for exact values. Channels are specified
      in the order OUT1L, OUT1R, OUT2L, OUT2R, etc.
    $ref: /schemas/types.yaml#/definitions/uint32-array
    minItems: 1
    maxItems: 12
```

## Documentation/devicetree/bindings/sound/wlf,wm8524.yaml
```yaml
# SPDX-License-Identifier: (GPL-2.0-only OR BSD-2-Clause)
%YAML 1.2
---
$id: http://devicetree.org/schemas/sound/wlf,wm8524.yaml#
$schema: http://devicetree.org/meta-schemas/core.yaml#

title: Wolfson WM8524 24-bit 192KHz Stereo DAC

maintainers:
  - patches@opensource.cirrus.com

allOf:
  - $ref: dai-common.yaml#

properties:
  compatible:
    const: wlf,wm8524

  "#sound-dai-cells":
    const: 0

  wlf,mute-gpios:
    maxItems: 1
    description:
      a GPIO spec for the MUTE pin.

required:
  - compatible
  - wlf,mute-gpios

unevaluatedProperties: false

examples:
  - |
    #include <dt-bindings/gpio/gpio.h>

    wm8524: codec {
        compatible = "wlf,wm8524";
        wlf,mute-gpios = <&gpio1 8 GPIO_ACTIVE_LOW>;
    };
```

## Documentation/devicetree/bindings/sound/wlf,wm8731.yaml
```yaml
# SPDX-License-Identifier: (GPL-2.0-only OR BSD-2-Clause)
%YAML 1.2
---
$id: http://devicetree.org/schemas/sound/wlf,wm8731.yaml#
$schema: http://devicetree.org/meta-schemas/core.yaml#

title: Wolfson Microelectromics WM8731 audio CODEC

maintainers:
  - patches@opensource.cirrus.com

description: |
  Wolfson Microelectronics WM8731 audio CODEC

  Pins on the device (for linking into audio routes):
    * LOUT: Left Channel Line Output
    * ROUT: Right Channel Line Output
    * LHPOUT: Left Channel Headphone Output
    * RHPOUT: Right Channel Headphone Output
    * LLINEIN: Left Channel Line Input
    * RLINEIN: Right Channel Line Input
    * MICIN: Microphone Input

properties:
  compatible:
    enum:
      - wlf,wm8731

  reg:
    maxItems: 1

  "#sound-dai-cells":
    const: 0

  clocks:
    description: Clock provider for MCLK pin.
    maxItems: 1

  clock-names:
    items:
      - const: mclk

  AVDD-supply:
    description: Analog power supply regulator on the AVDD pin.

  HPVDD-supply:
    description: Headphone power supply regulator on the HPVDD pin.

  DBVDD-supply:
    description: Digital buffer supply regulator for the DBVDD pin.

  DCVDD-supply:
    description: Digital core supply regulator for the DCVDD pin.

required:
  - reg
  - compatible
  - AVDD-supply
  - HPVDD-supply
  - DBVDD-supply
  - DCVDD-supply

allOf:
  - $ref: dai-common.yaml#
  - $ref: /schemas/spi/spi-peripheral-props.yaml#

unevaluatedProperties: false

examples:
  - |
    spi {
        #address-cells = <1>;
        #size-cells = <0>;
        wm8731_i2c: codec@0 {
            compatible = "wlf,wm8731";
            reg = <0>;
            spi-max-frequency = <12500000>;

            AVDD-supply = <&avdd_reg>;
            HPVDD-supply = <&hpvdd_reg>;
            DCVDD-supply = <&dcvdd_reg>;
            DBVDD-supply = <&dbvdd_reg>;
        };
    };
  - |

    i2c {
        #address-cells = <1>;
        #size-cells = <0>;
        wm8731_spi: codec@1b {
            compatible = "wlf,wm8731";
            reg = <0x1b>;

            AVDD-supply = <&avdd_reg>;
            HPVDD-supply = <&hpvdd_reg>;
            DCVDD-supply = <&dcvdd_reg>;
            DBVDD-supply = <&dbvdd_reg>;
        };
    };
```

## Documentation/devicetree/bindings/sound/wlf,wm8737.yaml
```yaml
# SPDX-License-Identifier: (GPL-2.0 OR BSD-2-Clause)
%YAML 1.2
---
$id: http://devicetree.org/schemas/sound/wlf,wm8737.yaml#
$schema: http://devicetree.org/meta-schemas/core.yaml#

title: WM8737 audio CODEC

maintainers:
  - patches@opensource.cirrus.com

allOf:
  - $ref: dai-common.yaml#

properties:
  compatible:
    const: wlf,wm8737

  reg:
    maxItems: 1

  "#sound-dai-cells":
    const: 0

required:
  - compatible
  - reg

unevaluatedProperties: false

examples:
  - |
    i2c {
        #address-cells = <1>;
        #size-cells = <0>;
        codec@1a {
            compatible = "wlf,wm8737";
            reg = <0x1a>;
        };
    };
```

## Documentation/devicetree/bindings/sound/wlf,wm8753.yaml
```yaml
# SPDX-License-Identifier: (GPL-2.0 OR BSD-2-Clause)
%YAML 1.2
---
$id: http://devicetree.org/schemas/sound/wlf,wm8753.yaml#
$schema: http://devicetree.org/meta-schemas/core.yaml#

title: WM8753 audio CODEC

description: |
  Pins on the device (for linking into audio routes):
      * LOUT1
      * LOUT2
      * ROUT1
      * ROUT2
      * MONO1
      * MONO2
      * OUT3
      * OUT4
      * LINE1
      * LINE2
      * RXP
      * RXN
      * ACIN
      * ACOP
      * MIC1N
      * MIC1
      * MIC2N
      * MIC2
      * Mic Bias

maintainers:
  - patches@opensource.cirrus.com

allOf:
  - $ref: dai-common.yaml#

properties:
  compatible:
    const: wlf,wm8753

  reg:
    maxItems: 1

  "#sound-dai-cells":
    const: 0

required:
  - compatible
  - reg

unevaluatedProperties: false

examples:
  - |
    i2c {
        #address-cells = <1>;
        #size-cells = <0>;
        codec@1a {
            compatible = "wlf,wm8753";
            reg = <0x1a>;
        };
    };
```

## Documentation/devicetree/bindings/sound/wlf,wm8782.yaml
```yaml
# SPDX-License-Identifier: (GPL-2.0-only OR BSD-2-Clause)
%YAML 1.2
---
$id: http://devicetree.org/schemas/sound/wlf,wm8782.yaml#
$schema: http://devicetree.org/meta-schemas/core.yaml#

title: Wolfson Microelectromics WM8782 audio CODEC

maintainers:
  - patches@opensource.cirrus.com

allOf:
  - $ref: dai-common.yaml#

properties:
  compatible:
    const: wlf,wm8782

  Vdda-supply:
    description: Regulator for the analog power supply (2.7V - 5.5V)

  Vdd-supply:
    description: Regulator for the digital power supply (2.7V - 3.6V)

  wlf,fsampen:
    description: FSAMPEN pin value, 0 for low, 1 for high, 2 for disconnected.
    $ref: /schemas/types.yaml#/definitions/uint32
    enum: [0, 1, 2]

  "#sound-dai-cells":
    const: 0

required:
  - compatible
  - Vdda-supply
  - Vdd-supply

unevaluatedProperties: false

examples:
  - |
    wm8782: codec {
        compatible = "wlf,wm8782";
        Vdda-supply = <&vdda_supply>;
        Vdd-supply = <&vdd_supply>;
        wlf,fsampen = <2>;
    };
```

## Documentation/devicetree/bindings/sound/wlf,wm8804.yaml
```yaml
# SPDX-License-Identifier: (GPL-2.0-only OR BSD-2-Clause)
%YAML 1.2
---
$id: http://devicetree.org/schemas/sound/wlf,wm8804.yaml#
$schema: http://devicetree.org/meta-schemas/core.yaml#

title: WM8804 audio codec

description: |
  This device supports both I2C and SPI (configured with pin strapping on the
  board).

maintainers:
  - patches@opensource.cirrus.com

properties:
  compatible:
    const: wlf,wm8804

  reg:
    description:
      The I2C address of the device for I2C, the chip select number for SPI.
    maxItems: 1

  "#sound-dai-cells":
    const: 0

  PVDD-supply:
    description: PLL core supply

  DVDD-supply:
    description: Digital core supply

  wlf,reset-gpio:
    description: A GPIO specifier for the GPIO controlling the reset pin.
    maxItems: 1

required:
  - reg
  - compatible
  - PVDD-supply
  - DVDD-supply

additionalProperties: false

examples:
  - |
    i2c {
        #address-cells = <1>;
        #size-cells = <0>;

        codec@1a {
            compatible = "wlf,wm8804";
            reg = <0x1a>;
            PVDD-supply = <&pvdd_reg>;
            DVDD-supply = <&dvdd_reg>;
        };
    };
```

## Documentation/devicetree/bindings/sound/wlf,wm8903.yaml
```yaml
# SPDX-License-Identifier: (GPL-2.0 OR BSD-2-Clause)
%YAML 1.2
---
$id: http://devicetree.org/schemas/sound/wlf,wm8903.yaml#
$schema: http://devicetree.org/meta-schemas/core.yaml#

title: WM8903 audio codec

description: |
  This device supports I2C only.
  Pins on the device (for linking into audio routes):
      * IN1L
      * IN1R
      * IN2L
      * IN2R
      * IN3L
      * IN3R
      * DMICDAT
      * HPOUTL
      * HPOUTR
      * LINEOUTL
      * LINEOUTR
      * LOP
      * LON
      * ROP
      * RON
      * MICBIAS

maintainers:
  - patches@opensource.cirrus.com

properties:
  compatible:
    const: wlf,wm8903

  reg:
    maxItems: 1

  gpio-controller: true
  '#gpio-cells':
    const: 2

  interrupts:
    maxItems: 1

  micdet-cfg:
    $ref: /schemas/types.yaml#/definitions/uint32
    default: 0
    description: Default register value for R6 (Mic Bias).

  micdet-delay:
    $ref: /schemas/types.yaml#/definitions/uint32
    default: 100
    description: The debounce delay for microphone detection in mS.

  gpio-cfg:
    $ref: /schemas/types.yaml#/definitions/uint32-array
    description: |
      minItems: 5
      maxItems: 5
      A list of GPIO configuration register values.
      If absent, no configuration of these registers is performed.
      If any entry has the value 0xffffffff, that GPIO's
      configuration will not be modified.

  AVDD-supply:
    description: Analog power supply regulator on the AVDD pin.

  CPVDD-supply:
    description: Charge pump supply regulator on the CPVDD pin.

  DBVDD-supply:
    description: Digital buffer supply regulator for the DBVDD pin.

  DCVDD-supply:
    description: Digital core supply regulator for the DCVDD pin.


required:
  - compatible
  - reg
  - gpio-controller
  - '#gpio-cells'

additionalProperties: false

examples:
  - |
    i2c {
      #address-cells = <1>;
      #size-cells = <0>;

      wm8903: codec@1a {
        compatible = "wlf,wm8903";
        reg = <0x1a>;
        interrupts = <347>;

        AVDD-supply = <&fooreg_a>;
        CPVDD-supply = <&fooreg_b>;
        DBVDD-supply = <&fooreg_c>;
        DCVDD-supply = <&fooreg_d>;

        gpio-controller;
        #gpio-cells = <2>;

        micdet-cfg = <0>;
        micdet-delay = <100>;
        gpio-cfg = <
          0x0600 /* DMIC_LR, output */
          0x0680 /* DMIC_DAT, input */
          0x0000 /* GPIO, output, low */
          0x0200 /* Interrupt, output */
          0x01a0 /* BCLK, input, active high */
        >;
      };
    };
```
