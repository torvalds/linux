## Documentation/devicetree/bindings/sound/wlf,wm8904.yaml
```yaml
# SPDX-License-Identifier: GPL-2.0-only OR BSD-2-Clause
%YAML 1.2
---
$id: http://devicetree.org/schemas/sound/wlf,wm8904.yaml#
$schema: http://devicetree.org/meta-schemas/core.yaml#

title: Wolfson WM8904/WM8912 audio codecs

maintainers:
  - patches@opensource.cirrus.com

description: |
  Pins on the device (for linking into audio routes):
  IN1L, IN1R, IN2L, IN2R, IN3L, IN3R, HPOUTL, HPOUTR, LINEOUTL, LINEOUTR,
  MICBIAS

properties:
  compatible:
    enum:
      - wlf,wm8904
      - wlf,wm8912

  reg:
    maxItems: 1

  "#sound-dai-cells":
    const: 0

  clocks:
    maxItems: 1

  clock-names:
    const: mclk

  AVDD-supply: true
  CPVDD-supply: true
  DBVDD-supply: true
  DCVDD-supply: true
  MICVDD-supply: true

  wlf,in1l-as-dmicdat1:
    type: boolean
    description:
      Use IN1L/DMICDAT1 as DMICDAT1, enabling the DMIC input path.
      Can be used separately or together with wlf,in1r-as-dmicdat2.

  wlf,in1r-as-dmicdat2:
    type: boolean
    description:
      Use IN1R/DMICDAT2 as DMICDAT2, enabling the DMIC input path.
      Can be used separately or together with wlf,in1l-as-dmicdat1.

  wlf,gpio-cfg:
    $ref: /schemas/types.yaml#/definitions/uint32-array
    minItems: 4
    maxItems: 4
    description:
      Default register values for R121/122/123/124 (GPIO Control).
      If any entry has the value 0xFFFF, the related register won't be set.
    default: [0xFFFF, 0xFFFF, 0xFFFF, 0xFFFF]

  wlf,micbias-cfg:
    $ref: /schemas/types.yaml#/definitions/uint32-array
    minItems: 2
    maxItems: 2
    description:
      Default register values for R6/R7 (Mic Bias Control).
    default: [0, 0]

  wlf,drc-cfg-names:
    $ref: /schemas/types.yaml#/definitions/string-array
    description:
      List of strings for the available DRC modes.
      If absent, DRC is disabled.

  wlf,drc-cfg-regs:
    $ref: /schemas/types.yaml#/definitions/uint16-matrix
    description:
      Sets of default register values for R40/41/42/43 (DRC).
      Each set corresponds to a DRC mode, so the number of sets should equal
      the length of wlf,drc-cfg-names.
      If absent, DRC is disabled.
    items:
      minItems: 4
      maxItems: 4

  wlf,retune-mobile-cfg-names:
    $ref: /schemas/types.yaml#/definitions/non-unique-string-array
    description:
      List of strings for the available retune modes.
      If absent, retune is disabled.

  wlf,retune-mobile-cfg-hz:
    description:
      The list must be the same length as wlf,retune-mobile-cfg-names.
      If absent, retune is disabled.

  wlf,retune-mobile-cfg-regs:
    $ref: /schemas/types.yaml#/definitions/uint16-matrix
    description:
      Sets of default register values for R134/.../157 (EQ).
      Each set corresponds to a retune mode, so the number of sets should equal
      the length of wlf,retune-mobile-cfg-names.
      If absent, retune is disabled.
    items:
      minItems: 24
      maxItems: 24

dependencies:
  wlf,drc-cfg-names: [ 'wlf,drc-cfg-regs' ]
  wlf,drc-cfg-regs: [ 'wlf,drc-cfg-names' ]

  wlf,retune-mobile-cfg-names: [ 'wlf,retune-mobile-cfg-hz', 'wlf,retune-mobile-cfg-regs' ]
  wlf,retune-mobile-cfg-regs: [ 'wlf,retune-mobile-cfg-names', 'wlf,retune-mobile-cfg-hz' ]
  wlf,retune-mobile-cfg-hz: [ 'wlf,retune-mobile-cfg-names', 'wlf,retune-mobile-cfg-regs' ]

required:
  - compatible
  - reg
  - clocks
  - clock-names
  - AVDD-supply
  - CPVDD-supply
  - DBVDD-supply
  - DCVDD-supply
  - MICVDD-supply

allOf:
  - $ref: dai-common.yaml#

unevaluatedProperties: false

examples:
  - |
    i2c {
        #address-cells = <1>;
        #size-cells = <0>;

        codec@1a {
            compatible = "wlf,wm8904";
            reg = <0x1a>;
            clocks = <&pck0>;
            clock-names = "mclk";
            AVDD-supply = <&reg_1p8v>;
            CPVDD-supply = <&reg_1p8v>;
            DBVDD-supply = <&reg_1p8v>;
            DCVDD-supply = <&reg_1p8v>;
            MICVDD-supply = <&reg_1p8v>;

            wlf,drc-cfg-names = "default", "peaklimiter", "tradition", "soft",
                                "music";
            /*
             * Config registers per name, respectively:
             * KNEE_IP = 0,   KNEE_OP = 0,     HI_COMP = 1,   LO_COMP = 1
             * KNEE_IP = -24, KNEE_OP = -6,    HI_COMP = 1/4, LO_COMP = 1
             * KNEE_IP = -42, KNEE_OP = -3,    HI_COMP = 0,   LO_COMP = 1
             * KNEE_IP = -45, KNEE_OP = -9,    HI_COMP = 1/8, LO_COMP = 1
             * KNEE_IP = -30, KNEE_OP = -10.5, HI_COMP = 1/4, LO_COMP = 1
             */
            wlf,drc-cfg-regs = /bits/ 16 <0x01af 0x3248 0x0000 0x0000>,
                               /bits/ 16 <0x04af 0x324b 0x0010 0x0408>,
                               /bits/ 16 <0x04af 0x324b 0x0028 0x0704>,
                               /bits/ 16 <0x04af 0x324b 0x0018 0x078c>,
                               /bits/ 16 <0x04af 0x324b 0x0010 0x050e>;

            /* GPIO1 = DMIC_CLK, don't touch others */
            wlf,gpio-cfg = <0x0018>, <0xffff>, <0xffff>, <0xffff>;

            /* Use IN1R as DMICDAT2, leave IN1L as an analog input path */
            wlf,in1r-as-dmicdat2;

            wlf,retune-mobile-cfg-names = "bassboost", "bassboost", "treble";
            wlf,retune-mobile-cfg-hz = <48000>, <44100>, <48000>;
            /*
             * Config registers per name, respectively:
             * EQ_ENA,  100 Hz,  300 Hz,  875 Hz, 2400 Hz, 6900 Hz
             *      1,   +6 dB,   +3 dB,    0 dB,    0 dB,    0 dB
             *      1,   +6 dB,   +3 dB,    0 dB,    0 dB,    0 dB
             *      1,   -2 dB,   -2 dB,    0 dB,    0 dB,   +3 dB
             * Each one uses the defaults for ReTune Mobile registers 140-157
             */
            wlf,retune-mobile-cfg-regs = /bits/ 16 <0x1 0x12 0xf 0xc 0xc 0xc
                                                    0x0fca 0x0400 0x00d8 0x1eb5
                                                    0xf145 0x0bd5 0x0075 0x1c58
                                                    0xf3d3 0x0a54 0x0568 0x168e
                                                    0xf829 0x07ad 0x1103 0x0564
                                                    0x0559 0x4000>,

                                         /bits/ 16 <0x1 0x12 0xf 0xc 0xc 0xc
                                                    0x0fca 0x0400 0x00d8 0x1eb5
                                                    0xf145 0x0bd5 0x0075 0x1c58
                                                    0xf3d3 0x0a54 0x0568 0x168e
                                                    0xf829 0x07ad 0x1103 0x0564
                                                    0x0559 0x4000>,

                                         /bits/ 16 <0x1 0xa 0xa 0xc 0xc 0xf
                                                    0x0fca 0x0400 0x00d8 0x1eb5
                                                    0xf145 0x0bd5 0x0075 0x1c58
                                                    0xf3d3 0x0a54 0x0568 0x168e
                                                    0xf829 0x07ad 0x1103 0x0564
                                                    0x0559 0x4000>;
        };
    };
```

## Documentation/devicetree/bindings/sound/wlf,wm8960.yaml
```yaml
# SPDX-License-Identifier: GPL-2.0-only OR BSD-2-Clause
%YAML 1.2
---
$id: http://devicetree.org/schemas/sound/wlf,wm8960.yaml#
$schema: http://devicetree.org/meta-schemas/core.yaml#

title: Wolfson WM8960 audio codec

maintainers:
  - patches@opensource.cirrus.com

description: |
  Wolfson WM8960 audio codec

  Pins on the device (for linking into audio routes):

    Outputs:
      * HP_L    : Left Headphone/Line Output
      * HP_R    : Right Headphone/Line Output
      * SPK_LP  : Left Speaker Output (Positive)
      * SPK_LN  : Left Speaker Output (Negative)
      * SPK_RP  : Right Speaker Output (Positive)
      * SPK_RN  : Right Speaker Output (Negative)
      * OUT3    : Mono, Left, Right or buffered midrail output for capless mode

    Inputs:
      * LINPUT1 : Left single-ended or negative differential microphone input
      * RINPUT1 : Right single-ended or negative differential microphone input
      * LINPUT2 : Left line input or positive differential microphone input
      * RINPUT2 : Right line input or positive differential microphone input
      * LINPUT3 : Left line input, positive differential microphone, or Jack Detect 2
      * RINPUT3 : Right line input, positive differential microphone, or Jack Detect 3

properties:
  compatible:
    const: wlf,wm8960

  reg:
    maxItems: 1

  clocks:
    maxItems: 1

  clock-names:
    items:
      - const: mclk

  '#sound-dai-cells':
    const: 0

  AVDD-supply:
    description: Analogue supply.

  DBVDD-supply:
    description: Digital Buffer Supply.

  DCVDD-supply:
    description: Digital Core Supply.

  SPKVDD1-supply:
    description: Supply for speaker drivers 1.

  SPKVDD2-supply:
    description: Supply for speaker drivers 2.

  wlf,capless:
    type: boolean
    description:
      If present, OUT3 pin will be enabled and disabled together with HP_L and
      HP_R pins in response to jack detect events.

  wlf,gpio-cfg:
    $ref: /schemas/types.yaml#/definitions/uint32-array
    maxItems: 2
    description: |
      A list of GPIO configuration register values.
       - gpio-cfg[0]: ALRCGPIO of R9 (Audio interface)
       - gpio-cfg[1]: {GPIOPOL:GPIOSEL[2:0]} of R48 (Additional Control 4).

  wlf,hp-cfg:
    $ref: /schemas/types.yaml#/definitions/uint32-array
    maxItems: 3
    description: |
      A list of headphone jack detect configuration register values:
       - hp-cfg[0]: HPSEL[1:0] of R48 (Additional Control 4).
       - hp-cfg[1]: {HPSWEN:HPSWPOL} of R24 (Additional Control 2).
       - hp-cfg[2]: {TOCLKSEL:TOEN} of R23 (Additional Control 1).

  wlf,shared-lrclk:
    type: boolean
    description:
      If present, the LRCM bit of R24 (Additional control 2) gets set,
      indicating that ADCLRC and DACLRC pins will be disabled only when ADC
      (Left and Right) and DAC (Left and Right) are disabled.
      When WM8960 works on synchronize mode and DACLRC pin is used to supply
      frame clock, it will no frame clock for captrue unless enable DAC to
      enable DACLRC pin. If shared-lrclk is present, no need to enable DAC for
      captrue.

  port:
    $ref: audio-graph-port.yaml#
    unevaluatedProperties: false

required:
  - compatible
  - reg

allOf:
  - $ref: dai-common.yaml#

unevaluatedProperties: false

examples:
  - |
    i2c {
        #address-cells = <1>;
        #size-cells = <0>;

        audio-codec@1a {
            compatible = "wlf,wm8960";
            reg = <0x1a>;
            clocks = <&clks 0>;
            clock-names = "mclk";
            #sound-dai-cells = <0>;
            wlf,hp-cfg = <3 2 3>;
            wlf,gpio-cfg = <1 3>;
            wlf,shared-lrclk;
            DCVDD-supply = <&reg_audio>;
            DBVDD-supply = <&reg_audio>;
            AVDD-supply = <&reg_audio>;
            SPKVDD1-supply = <&reg_audio>;
            SPKVDD2-supply = <&reg_audio>;
        };
    };
```

## Documentation/devicetree/bindings/sound/wlf,wm8961.yaml
```yaml
# SPDX-License-Identifier: (GPL-2.0-only OR BSD-2-Clause)
%YAML 1.2
---
$id: http://devicetree.org/schemas/sound/wlf,wm8961.yaml#
$schema: http://devicetree.org/meta-schemas/core.yaml#

title: Wolfson WM8961 Ultra-Low Power Stereo CODEC

maintainers:
  - patches@opensource.cirrus.com

allOf:
  - $ref: dai-common.yaml#

properties:
  compatible:
    const: wlf,wm8961

  reg:
    maxItems: 1

  '#sound-dai-cells':
    const: 0

required:
  - compatible
  - reg
  - '#sound-dai-cells'

unevaluatedProperties: false

examples:
  - |
    i2c {
          #address-cells = <1>;
          #size-cells = <0>;

          wm8961: codec@4a {
                  compatible = "wlf,wm8961";
                  reg = <0x4a>;
                  #sound-dai-cells = <0>;
          };
    };
```

## Documentation/devicetree/bindings/sound/wlf,wm8962.yaml
```yaml
# SPDX-License-Identifier: (GPL-2.0-only OR BSD-2-Clause)
%YAML 1.2
---
$id: http://devicetree.org/schemas/sound/wlf,wm8962.yaml#
$schema: http://devicetree.org/meta-schemas/core.yaml#

title: Wolfson WM8962 Ultra-Low Power Stereo CODEC

maintainers:
  - patches@opensource.cirrus.com

allOf:
  - $ref: dai-common.yaml#

properties:
  compatible:
    const: wlf,wm8962

  reg:
    maxItems: 1

  clocks:
    maxItems: 1

  interrupts:
    maxItems: 1

  "#sound-dai-cells":
    const: 0

  AVDD-supply:
    description: Analogue supply.

  CPVDD-supply:
    description: Charge pump power supply.

  DBVDD-supply:
    description: Digital Buffer Supply.

  DCVDD-supply:
    description: Digital Core Supply.

  MICVDD-supply:
    description: Microphone bias amp supply.

  PLLVDD-supply:
    description: PLL Supply

  SPKVDD1-supply:
    description: Supply for left speaker drivers.

  SPKVDD2-supply:
    description: Supply for right speaker drivers.

  spk-mono:
    $ref: /schemas/types.yaml#/definitions/flag
    description:
      If present, the SPK_MONO bit of R51 (Class D Control 2) gets set,
      indicating that the speaker is in mono mode.

  mic-cfg:
    $ref: /schemas/types.yaml#/definitions/uint32
    description:
      Default register value for R48 (Additional Control 4).
      If absent, the default should be the register default.

  gpio-cfg:
    $ref: /schemas/types.yaml#/definitions/uint32-array
    minItems: 6
    maxItems: 6
    description:
      A list of GPIO configuration register values.  If absent, no
      configuration of these registers is performed.  Note that only values
      within [0x0, 0xffff] are valid.  Any other value is regarded as setting
      the GPIO register to its reset value 0x0.

  port:
    $ref: audio-graph-port.yaml#
    unevaluatedProperties: false

required:
  - compatible
  - reg
  - AVDD-supply
  - CPVDD-supply
  - DBVDD-supply
  - DCVDD-supply
  - MICVDD-supply
  - PLLVDD-supply
  - SPKVDD1-supply
  - SPKVDD2-supply

unevaluatedProperties: false

examples:
  - |
    #include <dt-bindings/clock/imx6qdl-clock.h>

    i2c {
          #address-cells = <1>;
          #size-cells = <0>;

          wm8962: codec@1a {
                  compatible = "wlf,wm8962";
                  reg = <0x1a>;
                  clocks = <&clks IMX6QDL_CLK_CKO>;
                  DCVDD-supply = <&reg_audio>;
                  DBVDD-supply = <&reg_audio>;
                  AVDD-supply = <&reg_audio>;
                  CPVDD-supply = <&reg_audio>;
                  MICVDD-supply = <&reg_audio>;
                  PLLVDD-supply = <&reg_audio>;
                  SPKVDD1-supply = <&reg_audio>;
                  SPKVDD2-supply = <&reg_audio>;
                  gpio-cfg = <
                          0x0000 /* 0:Default */
                          0x0000 /* 1:Default */
                          0x0013 /* 2:FN_DMICCLK */
                          0x0000 /* 3:Default */
                          0x8014 /* 4:FN_DMICCDAT */
                          0x0000 /* 5:Default */
                  >;
          };
    };
```

## Documentation/devicetree/bindings/sound/wlf,wm8974.txt
```
WM8974 audio CODEC

This device supports both I2C and SPI (configured with pin strapping
on the board).

Required properties:
  - compatible: "wlf,wm8974"
  - reg: the I2C address or SPI chip select number of the device

Examples:

codec: wm8974@1a {
	compatible = "wlf,wm8974";
	reg = <0x1a>;
};
```
