## Documentation/devicetree/bindings/sound/wlf,wm8978.yaml
```yaml
# SPDX-License-Identifier: (GPL-2.0 OR BSD-2-Clause)
%YAML 1.2
---
$id: http://devicetree.org/schemas/sound/wlf,wm8978.yaml#
$schema: http://devicetree.org/meta-schemas/core.yaml#

title: Wolfson WM8978 Codec

maintainers:
  - patches@opensource.cirrus.com

allOf:
  - $ref: dai-common.yaml#

properties:
  '#sound-dai-cells':
    const: 0

  compatible:
    const: wlf,wm8978

  reg:
    maxItems: 1

  spi-max-frequency:
    maximum: 526000

required:
  - '#sound-dai-cells'
  - compatible
  - reg

unevaluatedProperties: false

examples:
  - |
    spi {
        #address-cells = <1>;
        #size-cells = <0>;

        codec@0 {
            #sound-dai-cells = <0>;
            compatible = "wlf,wm8978";
            reg = <0>;
            spi-max-frequency = <500000>;
        };
    };

  - |
    i2c {
        #address-cells = <1>;
        #size-cells = <0>;

        codec@1a {
            #sound-dai-cells = <0>;
            compatible = "wlf,wm8978";
            reg = <0x1a>;
        };
    };

...
```

## Documentation/devicetree/bindings/sound/wlf,wm8994.yaml
```yaml
# SPDX-License-Identifier: GPL-2.0-only OR BSD-2-Clause
%YAML 1.2
---
$id: http://devicetree.org/schemas/sound/wlf,wm8994.yaml#
$schema: http://devicetree.org/meta-schemas/core.yaml#

title: Wolfson WM1811/WM8994/WM8958 audio codecs

maintainers:
  - Krzysztof Kozlowski <krzysztof.kozlowski@linaro.org>
  - patches@opensource.cirrus.com

description: |
  These devices support both I2C and SPI (configured with pin strapping on the
  board).

  Pins on the device (for linking into audio routes):
  IN1LN, IN1LP, IN2LN, IN2LP:VXRN, IN1RN, IN1RP, IN2RN, IN2RP:VXRP, SPKOUTLP,
  SPKOUTLN, SPKOUTRP, SPKOUTRN, HPOUT1L, HPOUT1R, HPOUT2P, HPOUT2N, LINEOUT1P,
  LINEOUT1N, LINEOUT2P, LINEOUT2N.

properties:
  compatible:
    enum:
      - wlf,wm1811
      - wlf,wm8994
      - wlf,wm8958

  reg:
    maxItems: 1

  clocks:
    minItems: 1
    maxItems: 2

  clock-names:
    minItems: 1
    items:
      - const: MCLK1
      - const: MCLK2

  gpio-controller: true

  '#gpio-cells':
    const: 2

  interrupts:
    maxItems: 1

  interrupt-controller: true

  '#interrupt-cells':
    const: 2
    description:
      The first cell is the IRQ number. The second cell is the flags, encoded
      as the trigger masks.

  AVDD1-supply: true
  AVDD2-supply: true
  CPVDD-supply: true
  DBVDD-supply: true
  DBVDD1-supply: true
  DBVDD2-supply: true
  DBVDD3-supply: true
  DCVDD-supply: true
  LDO1VDD-supply: true
  LDO2VDD-supply: true
  SPKVDD1-supply: true
  SPKVDD2-supply: true

  '#sound-dai-cells':
    const: 0

  wlf,gpio-cfg:
    $ref: /schemas/types.yaml#/definitions/uint32-array
    maxItems: 11
    description:
      A list of GPIO configuration register values. If absent, no configuration
      of these registers is performed. If any value is over 0xffff then the
      register will be left as default. If present 11 values must be supplied.

  wlf,micbias-cfg:
    $ref: /schemas/types.yaml#/definitions/uint32-array
    maxItems: 2
    description:
      Two MICBIAS register values for WM1811 or WM8958.  If absent the register
      defaults will be used.

  wlf,ldo1ena-gpios:
    maxItems: 1
    description:
      Control of LDO1ENA input to device.

  wlf,ldo2ena-gpios:
    maxItems: 1
    description:
      Control of LDO2ENA input to device.

  wlf,lineout1-se:
    type: boolean
    description:
      LINEOUT1 is in single ended mode.

  wlf,lineout2-se:
    type: boolean
    description:
      INEOUT2 is in single ended mode.

  wlf,lineout1-feedback:
    type: boolean
    description:
      LINEOUT1 has common mode feedback connected.

  wlf,lineout2-feedback:
    type: boolean
    description:
      LINEOUT2 has common mode feedback connected.

  wlf,ldoena-always-driven:
    type: boolean
    description:
      LDOENA is always driven.

  wlf,spkmode-pu:
    type: boolean
    description:
      Enable the internal pull-up resistor on the SPKMODE pin.

  wlf,csnaddr-pd:
    type: boolean
    description:
      Enable the internal pull-down resistor on the CS/ADDR pin.

required:
  - compatible
  - reg
  - AVDD2-supply
  - CPVDD-supply
  - SPKVDD1-supply
  - SPKVDD2-supply

allOf:
  - $ref: dai-common.yaml#
  - if:
      properties:
        compatible:
          enum:
            - wlf,wm1811
            - wlf,wm8958
    then:
      properties:
        DBVDD-supply: false
        LDO2VDD-supply: false
      required:
        - DBVDD1-supply
        - DBVDD2-supply
        - DBVDD3-supply
    else:
      properties:
        DBVDD1-supply: false
        DBVDD2-supply: false
        DBVDD3-supply: false
      required:
        - DBVDD-supply

unevaluatedProperties: false

examples:
  - |
    #include <dt-bindings/gpio/gpio.h>

    i2c {
        #address-cells = <1>;
        #size-cells = <0>;

        audio-codec@1a {
            compatible = "wlf,wm1811";
            reg = <0x1a>;
            clocks = <&i2s0 0>;
            clock-names = "MCLK1";

            AVDD2-supply = <&main_dc_reg>;
            CPVDD-supply = <&main_dc_reg>;
            DBVDD1-supply = <&main_dc_reg>;
            DBVDD2-supply = <&main_dc_reg>;
            DBVDD3-supply = <&main_dc_reg>;
            LDO1VDD-supply = <&main_dc_reg>;
            SPKVDD1-supply = <&main_dc_reg>;
            SPKVDD2-supply = <&main_dc_reg>;

            wlf,ldo1ena-gpios = <&gpb0 0 GPIO_ACTIVE_HIGH>;
            wlf,ldo2ena-gpios = <&gpb0 1 GPIO_ACTIVE_HIGH>;
        };
    };
```

## Documentation/devicetree/bindings/sound/wm8510.txt
```
WM8510 audio CODEC

This device supports both I2C and SPI (configured with pin strapping
on the board).

Required properties:

  - compatible : "wlf,wm8510"

  - reg : the I2C address of the device for I2C, the chip select
          number for SPI.

Example:

wm8510: codec@1a {
	compatible = "wlf,wm8510";
	reg = <0x1a>;
};
```

## Documentation/devicetree/bindings/sound/wm8523.txt
```
WM8523 audio CODEC

This device supports I2C only.

Required properties:

  - compatible : "wlf,wm8523"

  - reg : the I2C address of the device.

Example:

wm8523: codec@1a {
	compatible = "wlf,wm8523";
	reg = <0x1a>;
};
```

## Documentation/devicetree/bindings/sound/wm8524.txt
```
WM8524 audio CODEC

This device does not use I2C or SPI but a simple Hardware Control Interface.

Required properties:

  - compatible : "wlf,wm8524"

  - wlf,mute-gpios: a GPIO spec for the MUTE pin.

Example:

wm8524: codec {
	compatible = "wlf,wm8524";
	wlf,mute-gpios = <&gpio1 8 GPIO_ACTIVE_LOW>;
};
```

## Documentation/devicetree/bindings/sound/wm8580.txt
```
WM8580 and WM8581 audio CODEC

This device supports I2C only.

Required properties:

  - compatible : "wlf,wm8580", "wlf,wm8581"

  - reg : the I2C address of the device.

Example:

wm8580: codec@1a {
	compatible = "wlf,wm8580";
	reg = <0x1a>;
};
```

## Documentation/devicetree/bindings/sound/wm8711.txt
```
WM8711 audio CODEC

This device supports both I2C and SPI (configured with pin strapping
on the board).

Required properties:

  - compatible : "wlf,wm8711"

  - reg : the I2C address of the device for I2C, the chip select
          number for SPI.

Example:

wm8711: codec@1a {
	compatible = "wlf,wm8711";
	reg = <0x1a>;
};
```

## Documentation/devicetree/bindings/sound/wm8728.txt
```
WM8728 audio CODEC

This device supports both I2C and SPI (configured with pin strapping
on the board).

Required properties:

  - compatible : "wlf,wm8728"

  - reg : the I2C address of the device for I2C, the chip select
          number for SPI.

Example:

wm8728: codec@1a {
	compatible = "wlf,wm8728";
	reg = <0x1a>;
};
```

## Documentation/devicetree/bindings/sound/wm8731.txt
```
WM8731 audio CODEC

This device supports both I2C and SPI (configured with pin strapping
on the board).

Required properties:

  - compatible : "wlf,wm8731"

  - reg : the I2C address of the device for I2C, the chip select
          number for SPI.

Example:

codec: wm8731@1a {
	compatible = "wlf,wm8731";
	reg = <0x1a>;
};

Available audio endpoints for an audio-routing table:
 * LOUT: Left Channel Line Output
 * ROUT: Right Channel Line Output
 * LHPOUT: Left Channel Headphone Output
 * RHPOUT: Right Channel Headphone Output
 * LLINEIN: Left Channel Line Input
 * RLINEIN: Right Channel Line Input
 * MICIN: Microphone Input
```

## Documentation/devicetree/bindings/sound/wm8741.txt
```
WM8741 audio CODEC

This device supports both I2C and SPI (configured with pin strapping
on the board).

Required properties:

  - compatible : "wlf,wm8741"

  - reg : the I2C address of the device for I2C, the chip select
          number for SPI.

Optional properties:

  - diff-mode: Differential output mode configuration. Default value for field
    DIFF in register R8 (MODE_CONTROL_2). If absent, the default is 0, shall be:
    0 = stereo
    1 = mono left
    2 = stereo reversed
    3 = mono right

Example:

codec: wm8741@1a {
	compatible = "wlf,wm8741";
	reg = <0x1a>;

	diff-mode = <3>;
};
```

## Documentation/devicetree/bindings/sound/wm8750.txt
```
WM8750 and WM8987 audio CODECs

These devices support both I2C and SPI (configured with pin strapping
on the board).

Required properties:

  - compatible : "wlf,wm8750" or "wlf,wm8987"

  - reg : the I2C address of the device for I2C, the chip select
          number for SPI.

Example:

codec: wm8750@1a {
	compatible = "wlf,wm8750";
	reg = <0x1a>;
};
```

## Documentation/devicetree/bindings/sound/wm8750.yaml
```yaml
# SPDX-License-Identifier: GPL-2.0-only OR BSD-2-Clause
%YAML 1.2
---
$id: http://devicetree.org/schemas/sound/wm8750.yaml#
$schema: http://devicetree.org/meta-schemas/core.yaml#

title: WM8750 and WM8987 audio CODECs

description: |
  These devices support both I2C and SPI (configured with pin strapping
  on the board).

maintainers:
  - Mark Brown <broonie@kernel.org>

properties:
  compatible:
    enum:
      - wlf,wm8750
      - wlf,wm8987

  reg:
    description:
      The I2C address of the device for I2C, the chip select number for SPI
    maxItems: 1

additionalProperties: false

required:
  - reg

examples:
  - |
    i2c {
        #address-cells = <1>;
        #size-cells = <0>;

        codec@1a {
            compatible = "wlf,wm8750";
            reg = <0x1a>;
        };
    };
```
