## Documentation/devicetree/bindings/sound/ti,tas2781.yaml
```yaml
# SPDX-License-Identifier: (GPL-2.0-only OR BSD-2-Clause)
# Copyright (C) 2022 - 2025 Texas Instruments Incorporated
%YAML 1.2
---
$id: http://devicetree.org/schemas/sound/ti,tas2781.yaml#
$schema: http://devicetree.org/meta-schemas/core.yaml#

title: Texas Instruments TAS2563/TAS2781 SmartAMP

maintainers:
  - Shenghao Ding <shenghao-ding@ti.com>

description: |
  The TAS2118/TAS2X20 is mono, digital input Class-D audio
  amplifier optimized for efficiently driving high peak power into
  small loudspeakers.
  The TAS257x is mono, digital input Class-D audio amplifier optimized
  for efficiently driving high peak power into small loudspeakers.
  Integrated speaker voltage and current sense provides for real time
  monitoring of loudspeaker behavior.
  The TAS2563/TAS2781 is a mono, digital input Class-D audio
  amplifier optimized for efficiently driving high peak power into
  small loudspeakers. An integrated on-chip DSP supports Texas
  Instruments Smart Amp speaker protection algorithm. The
  integrated speaker voltage and current sense provides for real time
  monitoring of loudspeaker behavior.
  The TAS5802/TAS5815/TAS5825/TAS5827/TAS5828 is a stereo, digital input
  Class-D audio amplifier optimized for efficiently driving high peak
  power into small loudspeakers. An integrated on-chip DSP supports
  Texas Instruments Smart Amp speaker protection algorithm.

  Specifications about the audio amplifier can be found at:
    https://www.ti.com/lit/gpn/tas2120
    https://www.ti.com/lit/gpn/tas2320
    https://www.ti.com/lit/gpn/tas2563
    https://www.ti.com/lit/gpn/tas2572
    https://www.ti.com/lit/gpn/tas2781
    https://www.ti.com/lit/gpn/tas5815
    https://www.ti.com/lit/gpn/tas5825m
    https://www.ti.com/lit/gpn/tas5827
    https://www.ti.com/lit/gpn/tas5828m

properties:
  compatible:
    description: |
      ti,tas2020: 3.2-W Mono Digital Input Class-D Speaker Amp with 5.5V PVDD
      Support.

      ti,tas2118: 5-W Mono Digital Input Class-D Speaker Amp with Integrated
      8.4-V Class-H Boost.

      ti,tas2120: 8.2-W Mono Digital Input Class-D Speaker Amp with
      Integrated 14.75V Class-H Boost.

      ti,tas2320: 15-W Mono Digital Input Class-D Speaker Amp with 15V Support.

      ti,tas2563: 6.1-W Boosted Class-D Audio Amplifier With Integrated
      DSP and IV Sense, 16/20/24/32bit stereo I2S or multichannel TDM.

      ti,tas2570: 5.8-W Digital Input smart amp with I/V sense and integrated
      11-V Class-H Boost

      ti,tas2572: 6.6-W Digital Input smart amp with I/V sense and integrated
      13-V Class-H Boost

      ti,tas2781: 24-V Class-D Amplifier with Real Time Integrated Speaker
      Protection and Audio Processing, 16/20/24/32bit stereo I2S or
      multichannel TDM.

      ti,tas5802: 22-W, Inductor-Less, Digital Input, Closed-Loop Class-D
      Audio Amplifier with 96-Khz Extended Processing and Low Idle Power
      Dissipation.

      ti,tas5815: 30-W, Digital Input, Stereo, Closed-loop Class-D Audio
      Amplifier with 96 kHz Enhanced Processing

      ti,tas5825: 38-W Stereo, Inductor-Less, Digital Input, Closed-Loop 4.5V
      to 26.4V Class-D Audio Amplifier with 192-kHz Extended Audio Processing.

      ti,tas5827: 47-W Stereo, Digital Input, High Efficiency Closed-Loop
      Class-D Amplifier with Class-H Algorithm

      ti,tas5828: 50-W Stereo, Digital Input, High Efficiency Closed-Loop
      Class-D Amplifier with Hybrid-Pro Algorithm
    oneOf:
      - items:
          - enum:
              - ti,tas2020
              - ti,tas2118
              - ti,tas2120
              - ti,tas2320
              - ti,tas2563
              - ti,tas2570
              - ti,tas2572
              - ti,tas5802
              - ti,tas5815
              - ti,tas5825
              - ti,tas5827
              - ti,tas5828
          - const: ti,tas2781
      - enum:
          - ti,tas2781

  reg:
    description:
      I2C address, in multiple-AMP case, all the i2c address
      aggregate as one Audio Device to support multiple audio slots.
    maxItems: 8
    minItems: 1

  reset-gpios:
    maxItems: 1

  interrupts:
    maxItems: 1

  '#sound-dai-cells':
    const: 0

required:
  - compatible
  - reg

allOf:
  - $ref: dai-common.yaml#
  - if:
      properties:
        compatible:
          contains:
            enum:
              - ti,tas2020
              - ti,tas2118
              - ti,tas2120
              - ti,tas2320
    then:
      properties:
        reg:
          maxItems: 4
          items:
            minimum: 0x48
            maximum: 0x4b

  - if:
      properties:
        compatible:
          contains:
            enum:
              - ti,tas2563
              - ti,tas5825
    then:
      properties:
        reg:
          description:
            I2C address, in multiple-AMP case, all the i2c address
            aggregate as one Audio Device to support multiple audio slots.
          maxItems: 4
          minItems: 1
          items:
            minimum: 0x4c
            maximum: 0x4f

  - if:
      properties:
        compatible:
          contains:
            enum:
              - ti,tas2570
              - ti,tas2572
    then:
      properties:
        reg:
          maxItems: 4
          items:
            minimum: 0x48
            maximum: 0x4b

  - if:
      properties:
        compatible:
          contains:
            enum:
              - ti,tas2781
    then:
      properties:
        reg:
          description:
            I2C address, in multiple-AMP case, all the i2c address
            aggregate as one Audio Device to support multiple audio slots.
          maxItems: 8
          minItems: 1
          items:
            minimum: 0x38
            maximum: 0x3f

  - if:
      properties:
        compatible:
          contains:
            enum:
              - ti,tas5802
              - ti,tas5815
    then:
      properties:
        reg:
          maxItems: 4
          items:
            minimum: 0x54
            maximum: 0x57

  - if:
      properties:
        compatible:
          contains:
            enum:
              - ti,tas5827
              - ti,tas5828
    then:
      properties:
        reg:
          maxItems: 6
          items:
            minimum: 0x60
            maximum: 0x65

additionalProperties: false

examples:
  - |
    #include <dt-bindings/gpio/gpio.h>

    i2c {
        /* example with quad tas2781s, such as tablet or pad device */
        #address-cells = <1>;
        #size-cells = <0>;

        audio-codec@38 {
            compatible = "ti,tas2781";
            reg = <0x38>, /* Audio slot 0 */
                  <0x3a>, /* Audio slot 1 */
                  <0x39>, /* Audio slot 2 */
                  <0x3b>; /* Audio slot 3 */

            #sound-dai-cells = <0>;
            reset-gpios = <&gpio1 10 GPIO_ACTIVE_HIGH>;
            interrupt-parent = <&gpio1>;
            interrupts = <15>;
        };
    };
...
```

## Documentation/devicetree/bindings/sound/ti,tas27xx.yaml
```yaml
# SPDX-License-Identifier: (GPL-2.0-only OR BSD-2-Clause)
# Copyright (C) 2020-2022 Texas Instruments Incorporated
%YAML 1.2
---
$id: http://devicetree.org/schemas/sound/ti,tas27xx.yaml#
$schema: http://devicetree.org/meta-schemas/core.yaml#

title: Texas Instruments TAS2764/TAS2780 Smart PA

maintainers:
  - Shenghao Ding <shenghao-ding@ti.com>

description: |
  The TAS2764/TAS2780 is a mono, digital input Class-D audio amplifier
  optimized for efficiently driving high peak power into small
  loudspeakers. Integrated speaker voltage and current sense provides
  for real time monitoring of loudspeaker behavior.

allOf:
  - $ref: dai-common.yaml#

properties:
  compatible:
    enum:
      - ti,tas2764
      - ti,tas2780

  reg:
    maxItems: 1
    description: |
       I2C address of the device can be between 0x38 to 0x45.

  reset-gpios:
    maxItems: 1
    description: GPIO used to reset the device.

  shutdown-gpios:
    maxItems: 1
    description: GPIO used to control the state of the device.

  interrupts:
    maxItems: 1

  ti,imon-slot-no:
    $ref: /schemas/types.yaml#/definitions/uint32
    description: TDM TX current sense time slot.

  ti,vmon-slot-no:
    $ref: /schemas/types.yaml#/definitions/uint32
    description: TDM TX voltage sense time slot.

  '#sound-dai-cells':
    # The codec has a single DAI, the #sound-dai-cells=<1>; case is left in for backward
    # compatibility but is deprecated.
    enum: [0, 1]

required:
  - compatible
  - reg

unevaluatedProperties: false

examples:
  - |
   #include <dt-bindings/gpio/gpio.h>
   i2c {
     #address-cells = <1>;
     #size-cells = <0>;
     codec: codec@38 {
       compatible = "ti,tas2764";
       reg = <0x38>;
       #sound-dai-cells = <0>;
       interrupt-parent = <&gpio1>;
       interrupts = <14>;
       reset-gpios = <&gpio1 15 0>;
       shutdown-gpios = <&gpio1 15 0>;
       ti,imon-slot-no = <0>;
       ti,vmon-slot-no = <2>;
     };
   };

...
```

## Documentation/devicetree/bindings/sound/ti,tas5086.txt
```
Texas Instruments TAS5086 6-channel PWM Processor

Required properties:

 - compatible:		Should contain "ti,tas5086".
 - reg:			The i2c address. Should contain <0x1b>.

Optional properties:

 - reset-gpio: 		A GPIO spec to define which pin is connected to the
			chip's !RESET pin. If specified, the driver will
			assert a hardware reset at probe time.

 - ti,charge-period:	This property should contain the time in microseconds
			that closely matches the external single-ended
			split-capacitor charge period. The hardware chip
			waits for this period of time before starting the
			PWM signals. This helps reduce pops and clicks.

			When not specified, the hardware default of 1300ms
			is retained.

 - ti,mid-z-channel-X:	Boolean properties, X being a number from 1 to 6.
			If given, channel X will start with the Mid-Z start
			sequence, otherwise the default Low-Z scheme is used.

			The correct configuration depends on how the power
			stages connected to the PWM output pins work. Not all
			power stages are compatible to Mid-Z - please refer
			to the datasheets for more details.

			Most systems should not set any of these properties.

 - avdd-supply:         Power supply for AVDD, providing 3.3V
 - dvdd-supply:         Power supply for DVDD, providing 3.3V

Examples:

	i2c_bus {
		tas5086@1b {
			compatible = "ti,tas5086";
			reg = <0x1b>;
			reset-gpio = <&gpio 23 0>;
			ti,charge-period = <156000>;
			avdd-supply = <&vdd_3v3_reg>;
			dvdd-supply = <&vdd_3v3_reg>;
		};
	};
```

## Documentation/devicetree/bindings/sound/ti,tas57xx.yaml
```yaml
# SPDX-License-Identifier: (GPL-2.0-only OR BSD-2-Clause)
%YAML 1.2
---
$id: http://devicetree.org/schemas/sound/ti,tas57xx.yaml#
$schema: http://devicetree.org/meta-schemas/core.yaml#

title: Texas Instruments TAS5711/TAS5717/TAS5719/TAS5721 stereo power amplifiers

maintainers:
  - Neil Armstrong <neil.armstrong@linaro.org>

properties:
  compatible:
    enum:
      - ti,tas5707
      - ti,tas5711
      - ti,tas5717
      - ti,tas5719
      - ti,tas5721
      - ti,tas5733

  reg:
    maxItems: 1

  reset-gpios:
    maxItems: 1
    description: GPIO for the active low reset line

  pdn-gpios:
    maxItems: 1
    description: GPIO for the active low powerdown line

  clocks:
    maxItems: 1

  clock-names:
    const: mclk

  AVDD-supply: true
  DVDD-supply: true
  HPVDD-supply: true
  PVDD_AB-supply: true
  PVDD_CD-supply: true
  PVDD_A-supply: true
  PVDD_B-supply: true
  PVDD_C-supply: true
  PVDD_D-supply: true
  DRVDD-supply: true
  PVDD-supply: true

  '#sound-dai-cells':
    const: 0

  port:
    $ref: audio-graph-port.yaml#
    unevaluatedProperties: false

required:
  - compatible
  - reg
  - '#sound-dai-cells'

allOf:
  - $ref: dai-common.yaml#
  - if:
      properties:
        compatible:
          contains:
            enum:
              - ti,tas5717
              - ti,tas5719
    then:
      properties:
        PVDD_A-supply: false
        PVDD_B-supply: false
        PVDD_C-supply: false
        PVDD_D-supply: false
        DRVDD-supply: false
        PVDD-supply: false

  - if:
      properties:
        compatible:
          contains:
            enum:
              - ti,tas5711
    then:
      properties:
        HPVDD-supply: false
        PVDD_AB-supply: false
        PVDD_CD-supply: false
        DRVDD-supply: false
        PVDD-supply: false

  - if:
      properties:
        compatible:
          contains:
            enum:
              - ti,tas5721
    then:
      properties:
        HPVDD-supply: false
        PVDD_AB-supply: false
        PVDD_CD-supply: false
        PVDD_A-supply: false
        PVDD_B-supply: false
        PVDD_C-supply: false
        PVDD_D-supply: false

unevaluatedProperties: false

examples:
  - |
    #include <dt-bindings/gpio/gpio.h>

    i2c {
        #address-cells = <1>;
        #size-cells = <0>;

        codec@2a {
            compatible = "ti,tas5717";
            reg = <0x2a>;
            #sound-dai-cells = <0>;
            reset-gpios = <&gpio1 15 GPIO_ACTIVE_HIGH>;
            pdn-gpios = <&gpio1 15 GPIO_ACTIVE_HIGH>;
            AVDD-supply = <&avdd_supply>;
            DVDD-supply = <&dvdd_supply>;
            HPVDD-supply = <&hpvdd_supply>;
            PVDD_AB-supply = <&pvdd_ab_supply>;
            PVDD_CD-supply = <&pvdd_cd_supply>;
        };
    };

...
```
