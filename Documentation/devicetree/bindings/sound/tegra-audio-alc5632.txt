## Documentation/devicetree/bindings/sound/ti,omap-twl4030.yaml
```yaml
# SPDX-License-Identifier: GPL-2.0-only OR BSD-2-Clause
%YAML 1.2
---
$id: http://devicetree.org/schemas/sound/ti,omap-twl4030.yaml#
$schema: http://devicetree.org/meta-schemas/core.yaml#

title: Texas Instruments SoC with twl4030 based audio setups

maintainers:
  - Peter Ujfalusi <peter.ujfalusi@gmail.com>

description:
  Audio setups on TI OMAP SoCs using TWL4030-family
  audio codec connected via a McBSP port.

properties:
  compatible:
    const: ti,omap-twl4030

  ti,model:
    $ref: /schemas/types.yaml#/definitions/string
    description: Name of the sound card (for example "omap3beagle").

  ti,mcbsp:
    $ref: /schemas/types.yaml#/definitions/phandle
    description: phandle for the McBSP node.

  ti,codec:
    $ref: /schemas/types.yaml#/definitions/phandle
    description: phandle for the twl4030 audio node.

  ti,mcbsp-voice:
    $ref: /schemas/types.yaml#/definitions/phandle
    description: phandle to the McBSP node connected to the voice port.

  ti,jack-det-gpio:
    description: GPIO specifier for jack detection.
    maxItems: 1

  ti,audio-routing:
    description: |
      A list of audio routing connections. Each entry is a pair of strings,
      with the first being the connection's sink and the second being the
      source. If not provided, all possible connections are available.

    $ref: /schemas/types.yaml#/definitions/non-unique-string-array
    items:
      enum:
        # Board Connectors
        - Headset Stereophone
        - Earpiece Spk
        - Handsfree Spk
        - Ext Spk
        - Main Mic
        - Sub Mic
        - Headset Mic
        - Carkit Mic
        - Digital0 Mic
        - Digital1 Mic
        - Line In

        # CODEC Pins
        - HSOL
        - HSOR
        - EARPIECE
        - HFL
        - HFR
        - PREDRIVEL
        - PREDRIVER
        - CARKITL
        - CARKITR
        - MAINMIC
        - SUBMIC
        - HSMIC
        - DIGIMIC0
        - DIGIMIC1
        - CARKITMIC
        - AUXL
        - AUXR

        # Headset Mic Bias
        - Mic Bias 1   # Used for Main Mic or Digimic0
        - Mic Bias 2   # Used for Sub Mic or Digimic1

required:
  - compatible
  - ti,model
  - ti,mcbsp

additionalProperties: false

examples:
  - |
    sound {
        compatible = "ti,omap-twl4030";
        ti,model = "omap3beagle";
        ti,mcbsp = <&mcbsp2>;
    };
```

## Documentation/devicetree/bindings/sound/ti,omap4-mcpdm.yaml
```yaml
# SPDX-License-Identifier: GPL-2.0-only OR BSD-2-Clause
%YAML 1.2
---
$id: http://devicetree.org/schemas/sound/ti,omap4-mcpdm.yaml#
$schema: http://devicetree.org/meta-schemas/core.yaml#

title: OMAP McPDM

maintainers:
  - Misael Lopez Cruz <misael.lopez@ti.com>

description:
  OMAP ALSA SoC DAI driver using McPDM port used by TWL6040

properties:
  compatible:
    const: ti,omap4-mcpdm

  reg:
    items:
      - description: MPU access base address
      - description: L3 interconnect address

  reg-names:
    items:
      - const: mpu
      - const: dma

  interrupts:
    maxItems: 1

  dmas:
    maxItems: 2

  dma-names:
    items:
      - const: up_link
      - const: dn_link

  clocks:
    maxItems: 1

  clock-names:
    items:
      - const: pdmclk

required:
  - compatible
  - reg
  - reg-names
  - interrupts
  - dmas
  - dma-names
  - clocks
  - clock-names

additionalProperties: false

examples:
  - |
    #include <dt-bindings/interrupt-controller/arm-gic.h>
    mcpdm@0 {
      compatible = "ti,omap4-mcpdm";
      reg = <0x0 0x7f>, /* MPU private access */
            <0x49032000 0x7f>; /* L3 Interconnect */
      reg-names = "mpu", "dma";
      interrupts = <GIC_SPI 112 IRQ_TYPE_LEVEL_HIGH>;
      interrupt-parent = <&gic>;
      dmas = <&sdma 65>, <&sdma 66>;
      dma-names = "up_link", "dn_link";
      clocks = <&twl6040>;
      clock-names = "pdmclk";
    };
```

## Documentation/devicetree/bindings/sound/ti,pcm1681.txt
```
Texas Instruments PCM1681 8-channel PWM Processor

Required properties:

 - compatible:		Should contain "ti,pcm1681".
 - reg:			The i2c address. Should contain <0x4c>.

Examples:

	i2c_bus {
		pcm1681@4c {
			compatible = "ti,pcm1681";
			reg = <0x4c>;
		};
	};
```

## Documentation/devicetree/bindings/sound/ti,pcm1681.yaml
```yaml
# SPDX-License-Identifier: (GPL-2.0-only OR BSD-2-Clause)
%YAML 1.2
---
$id: http://devicetree.org/schemas/sound/ti,pcm1681.yaml#
$schema: http://devicetree.org/meta-schemas/core.yaml#

title: Texas Instruments PCM1681 8-channel PWM Processor

maintainers:
  - Shenghao Ding <shenghao-ding@ti.com>
  - Kevin Lu <kevin-lu@ti.com>
  - Baojun Xu <baojun.xu@ti.com>

allOf:
  - $ref: dai-common.yaml#

properties:
  compatible:
    const: ti,pcm1681

  reg:
    maxItems: 1

  "#sound-dai-cells":
    const: 0

required:
  - compatible
  - reg

unevaluatedProperties: false

examples:
  - |
    i2c {
        #address-cells = <1>;
        #size-cells = <0>;

        pcm1681: audio-codec@4c {
            compatible = "ti,pcm1681";
            reg = <0x4c>;
        };
    };
```

## Documentation/devicetree/bindings/sound/ti,pcm1754.yaml
```yaml
# SPDX-License-Identifier: (GPL-2.0-only OR BSD-2-Clause)
%YAML 1.2
---
$id: http://devicetree.org/schemas/sound/ti,pcm1754.yaml#
$schema: http://devicetree.org/meta-schemas/core.yaml#

title: Texas Instruments PCM1754 Stereo DAC

description:
  The PCM1754 is a simple stereo DAC that is controlled via hardware gpios.

maintainers:
  - Stefan Kerkmann <s.kerkmann@pengutronix.de>

allOf:
  - $ref: dai-common.yaml#

properties:
  compatible:
    enum:
      - ti,pcm1754

  vcc-supply: true

  '#sound-dai-cells':
    const: 0

  format-gpios:
    maxItems: 1
    description:
      GPIO used to select the PCM format

  mute-gpios:
    maxItems: 1
    description:
      GPIO used to mute all outputs

required:
  - compatible
  - '#sound-dai-cells'
  - vcc-supply

additionalProperties: false

examples:
  - |
    #include <dt-bindings/gpio/gpio.h>
    codec {
      compatible = "ti,pcm1754";
      #sound-dai-cells = <0>;

      vcc-supply = <&vcc_reg>;
      mute-gpios = <&gpio 0 GPIO_ACTIVE_HIGH>;
      format-gpios = <&gpio 1 GPIO_ACTIVE_HIGH>;
    };
```

## Documentation/devicetree/bindings/sound/ti,pcm1862.yaml
```yaml
# SPDX-License-Identifier: (GPL-2.0-only OR BSD-2-Clause)
%YAML 1.2
---
$id: http://devicetree.org/schemas/sound/ti,pcm1862.yaml#
$schema: http://devicetree.org/meta-schemas/core.yaml#

title: Texas Instruments PCM186x Universal Audio ADC

maintainers:
  - Ranganath V N <vnranganath.20@gmail.com>

description: |
  The Texas Instruments PCM186x family are multi-channel audio ADCs
  that support both I2C and SPI control interfaces, selected by
  pin strapping. These devices include on-chip programmable gain
  amplifiers and support differential or single-ended analog inputs.

  CODEC input pins:
    * VINL1
    * VINR1
    * VINL2
    * VINR2
    * VINL3
    * VINR3
    * VINL4
    * VINR4

  The pins can be used in referring sound node's audio-routing property.

allOf:
  - $ref: dai-common.yaml#

properties:
  compatible:
    enum:
      - ti,pcm1862
      - ti,pcm1863
      - ti,pcm1864
      - ti,pcm1865

  reg:
    maxItems: 1

  avdd-supply: true

  dvdd-supply: true

  iovdd-supply: true

  '#sound-dai-cells':
    const: 0

required:
  - compatible
  - reg
  - avdd-supply
  - dvdd-supply
  - iovdd-supply

unevaluatedProperties: false

examples:
  - |
    i2c {
        #address-cells = <1>;
        #size-cells = <0>;

        audio-codec@4a {
            compatible = "ti,pcm1865";
            reg = <0x4a>;

            avdd-supply = <&reg_3v3_analog>;
            dvdd-supply = <&reg_3v3>;
            iovdd-supply = <&reg_1v8>;
        };
    };
```

## Documentation/devicetree/bindings/sound/ti,pcm3168a.txt
```
Texas Instruments pcm3168a DT bindings

This driver supports both SPI and I2C bus access for this codec

Required properties:

  - compatible: "ti,pcm3168a"

  - clocks : Contains an entry for each entry in clock-names

  - clock-names : Includes the following entries:
	"scki"	The system clock

  - VDD1-supply : Digital power supply regulator 1 (+3.3V)

  - VDD2-supply : Digital power supply regulator 2 (+3.3V)

  - VCCAD1-supply : ADC power supply regulator 1 (+5V)

  - VCCAD2-supply : ADC power supply regulator 2 (+5V)

  - VCCDA1-supply : DAC power supply regulator 1 (+5V)

  - VCCDA2-supply : DAC power supply regulator 2 (+5V)

For required properties on SPI/I2C, consult SPI/I2C device tree documentation

Optional properties:

  - rst-gpios : Optional RST gpio line for the codec
		RST = low: device power-down
		RST = high: device is enabled

Examples:

i2c0: i2c0@0 {

	...

	pcm3168a: audio-codec@44 {
		compatible = "ti,pcm3168a";
		reg = <0x44>;
		rst-gpios = <&gpio0 4 GPIO_ACTIVE_HIGH>;
		clocks = <&clk_core CLK_AUDIO>;
		clock-names = "scki";
		VDD1-supply = <&supply3v3>;
		VDD2-supply = <&supply3v3>;
		VCCAD1-supply = <&supply5v0>;
		VCCAD2-supply = <&supply5v0>;
		VCCDA1-supply = <&supply5v0>;
		VCCDA2-supply = <&supply5v0>;
		pinctrl-names = "default";
		pinctrl-0 = <&dac_clk_pin>;
	};
};
```

## Documentation/devicetree/bindings/sound/ti,pcm3168a.yaml
```yaml
# SPDX-License-Identifier: (GPL-2.0-only OR BSD-2-Clause)
%YAML 1.2
---
$id: http://devicetree.org/schemas/sound/ti,pcm3168a.yaml#
$schema: http://devicetree.org/meta-schemas/core.yaml#

title: Texas Instruments PCM3168A Audio Codec

maintainers:
  - Damien Horsley <Damien.Horsley@imgtec.com>
  - Geert Uytterhoeven <geert+renesas@glider.be>
  - Kuninori Morimoto <kuninori.morimoto.gx@renesas.com>

description:
  The Texas Instruments PCM3168A is a 24-bit Multi-channel Audio CODEC with
  96/192kHz sampling rate, supporting both SPI and I2C bus access.

properties:
  compatible:
    const: ti,pcm3168a

  reg:
    maxItems: 1

  clocks:
    items:
      - description: System clock input

  clock-names:
    items:
      - const: scki

  reset-gpios:
    items:
      - description: |
          GPIO line connected to the active-low RST pin of the codec.
            RST = low: device power-down
            RST = high: device is enabled

  "#sound-dai-cells":
    enum: [0, 1]

  VDD1-supply:
    description: Digital power supply regulator 1 (+3.3V)

  VDD2-supply:
    description: Digital power supply regulator 2 (+3.3V)

  VCCAD1-supply:
    description: ADC power supply regulator 1 (+5V)

  VCCAD2-supply:
    description: ADC power supply regulator 2 (+5V)

  VCCDA1-supply:
    description: DAC power supply regulator 1 (+5V)

  VCCDA2-supply:
    description: DAC power supply regulator 2 (+5V)

  ports:
    $ref: audio-graph-port.yaml#/definitions/port-base
    unevaluatedProperties: false
    properties:
      port@0:
        $ref: audio-graph-port.yaml#
        description: Audio input port.

      port@1:
        $ref: audio-graph-port.yaml#
        description: Audio output port.

required:
  - compatible
  - reg
  - clocks
  - clock-names
  - VDD1-supply
  - VDD2-supply
  - VCCAD1-supply
  - VCCAD2-supply
  - VCCDA1-supply
  - VCCDA2-supply

additionalProperties: false

examples:
  - |
    #include <dt-bindings/gpio/gpio.h>

    i2c {
        #address-cells = <1>;
        #size-cells = <0>;

        pcm3168a: audio-codec@44 {
            compatible = "ti,pcm3168a";
            reg = <0x44>;
            reset-gpios = <&gpio0 4 GPIO_ACTIVE_LOW>;
            clocks = <&clk_core 42>;
            clock-names = "scki";
            VDD1-supply = <&supply3v3>;
            VDD2-supply = <&supply3v3>;
            VCCAD1-supply = <&supply5v0>;
            VCCAD2-supply = <&supply5v0>;
            VCCDA1-supply = <&supply5v0>;
            VCCDA2-supply = <&supply5v0>;
        };
    };
```

## Documentation/devicetree/bindings/sound/ti,pcm512x.yaml
```yaml
# SPDX-License-Identifier: (GPL-2.0-only OR BSD-2-Clause)
%YAML 1.2
---
$id: http://devicetree.org/schemas/sound/ti,pcm512x.yaml#
$schema: http://devicetree.org/meta-schemas/core.yaml#

title: PCM512x and TAS575x audio CODECs/amplifiers

maintainers:
  - Animesh Agarwal <animeshagarwal28@gmail.com>

allOf:
  - $ref: dai-common.yaml#

properties:
  compatible:
    enum:
      - ti,pcm5121
      - ti,pcm5122
      - ti,pcm5141
      - ti,pcm5142
      - ti,pcm5242
      - ti,tas5754
      - ti,tas5756

  reg:
    maxItems: 1

  AVDD-supply: true

  DVDD-supply: true

  CPVDD-supply: true

  clocks:
    maxItems: 1
    description: A clock specifier for the clock connected as SCLK. If this is
      absent the device will be configured to clock from BCLK. If pll-in and
      pll-out are specified in addition to a clock, the device is configured to
      accept clock input on a specified gpio pin.

  '#sound-dai-cells':
    const: 0

  pll-in:
    description: GPIO pin used to connect the pll using <1> through <6>. The
      device will be configured for clock input on the given pll-in pin.
    $ref: /schemas/types.yaml#/definitions/uint32
    minimum: 1
    maximum: 6

  pll-out:
    description: GPIO pin used to connect the pll using <1> through <6>. The
      device will be configured for PLL output on the given pll-out pin.  An
      external connection from the pll-out pin to the SCLK pin is assumed.
    $ref: /schemas/types.yaml#/definitions/uint32
    minimum: 1
    maximum: 6

required:
  - compatible
  - reg
  - AVDD-supply
  - DVDD-supply
  - CPVDD-supply

if:
  properties:
    compatible:
      contains:
        enum:
          - ti,tas5754
          - ti,tas5756

then:
  properties:
    pll-in:
      maximum: 3

    pll-out:
      maximum: 3

unevaluatedProperties: false

examples:
  - |
    i2c {
        #address-cells = <1>;
        #size-cells = <0>;
        codec@4c {
            compatible = "ti,pcm5142";
            reg = <0x4c>;
            AVDD-supply = <&reg_3v3_analog>;
            DVDD-supply = <&reg_1v8>;
            CPVDD-supply = <&reg_3v3>;
            #sound-dai-cells = <0>;
            clocks = <&sck>;
            pll-in = <3>;
            pll-out = <6>;
        };
    };
```
