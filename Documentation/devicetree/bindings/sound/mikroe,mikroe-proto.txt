## Documentation/devicetree/bindings/sound/mikroe,mikroe-proto.txt
```
Mikroe-PROTO audio board

Required properties:
  - compatible: "mikroe,mikroe-proto"
  - dai-format: Must be "i2s".
  - i2s-controller: The phandle of the I2S controller.
  - audio-codec: The phandle of the WM8731 audio codec.
Optional properties:
  - model: The user-visible name of this sound complex.
  - bitclock-master: Indicates dai-link bit clock master; for details see simple-card.txt (1).
  - frame-master: Indicates dai-link frame master; for details see simple-card.txt (1).

(1) : There must be the same master for both bit and frame clocks.

Example:
	sound {
		compatible = "mikroe,mikroe-proto";
		model = "wm8731 @ sama5d2_xplained";
		i2s-controller = <&i2s0>;
		audio-codec = <&wm8731>;
		dai-format = "i2s";
        };
};
```

## Documentation/devicetree/bindings/sound/mrvl,pxa-ssp.txt
```
Marvell PXA SSP CPU DAI bindings

Required properties:

	compatible	Must be "mrvl,pxa-ssp-dai"
	port		A phandle reference to a PXA ssp upstream device

Optional properties:

	clock-names
	clocks		Through "clock-names" and "clocks", external clocks
			can be configured. If a clock names "extclk" exists,
			it will be set to the mclk rate of the audio stream
			and be used as clock provider of the DAI.

Example:

	/* upstream device */

	ssp1: ssp@41000000 {
		compatible = "mrvl,pxa3xx-ssp";
		reg = <0x41000000 0x40>;
		interrupts = <24>;
		clock-names = "pxa27x-ssp.0";
	};

	/* DAI as user */

	ssp_dai0: ssp_dai@0 {
		compatible = "mrvl,pxa-ssp-dai";
		port = <&ssp1>;
		#sound-dai-cells = <0>;
	};
```

## Documentation/devicetree/bindings/sound/mrvl,pxa2xx-pcm.txt
```
DT bindings for ARM PXA2xx PCM platform driver

This is just a dummy driver that registers the PXA ASoC platform driver.
It does not have any resources assigned.

Required properties:

	- compatible		'mrvl,pxa-pcm-audio'

Example:

	pxa_pcm_audio: snd_soc_pxa_audio {
		compatible = "mrvl,pxa-pcm-audio";
	};
```

## Documentation/devicetree/bindings/sound/mt2701-afe-pcm.txt
```
Mediatek AFE PCM controller for mt2701

Required properties:
- compatible: should be one of the followings.
	      - "mediatek,mt2701-audio"
	      - "mediatek,mt7622-audio"
- interrupts: should contain AFE and ASYS interrupts
- interrupt-names: should be "afe" and "asys"
- power-domains: should define the power domain
- clocks: Must contain an entry for each entry in clock-names
  See ../clocks/clock-bindings.txt for details
- clock-names: should have these clock names:
		"infra_sys_audio_clk",
		"top_audio_mux1_sel",
		"top_audio_mux2_sel",
		"top_audio_a1sys_hp",
		"top_audio_a2sys_hp",
		"i2s0_src_sel",
		"i2s1_src_sel",
		"i2s2_src_sel",
		"i2s3_src_sel",
		"i2s0_src_div",
		"i2s1_src_div",
		"i2s2_src_div",
		"i2s3_src_div",
		"i2s0_mclk_en",
		"i2s1_mclk_en",
		"i2s2_mclk_en",
		"i2s3_mclk_en",
		"i2so0_hop_ck",
		"i2so1_hop_ck",
		"i2so2_hop_ck",
		"i2so3_hop_ck",
		"i2si0_hop_ck",
		"i2si1_hop_ck",
		"i2si2_hop_ck",
		"i2si3_hop_ck",
		"asrc0_out_ck",
		"asrc1_out_ck",
		"asrc2_out_ck",
		"asrc3_out_ck",
		"audio_afe_pd",
		"audio_afe_conn_pd",
		"audio_a1sys_pd",
		"audio_a2sys_pd",
		"audio_mrgif_pd";
- assigned-clocks: list of input clocks and dividers for the audio system.
		   See ../clocks/clock-bindings.txt for details.
- assigned-clocks-parents: parent of input clocks of assigned clocks.
- assigned-clock-rates: list of clock frequencies of assigned clocks.

Must be a subnode of MediaTek audsys device tree node.
See ../arm/mediatek/mediatek,audsys.txt for details about the parent node.

Example:

	audsys: audio-subsystem@11220000 {
		compatible = "mediatek,mt2701-audsys", "syscon";
		...

		afe: audio-controller {
			compatible = "mediatek,mt2701-audio";
			interrupts =  <GIC_SPI 104 IRQ_TYPE_LEVEL_LOW>,
				      <GIC_SPI 132 IRQ_TYPE_LEVEL_LOW>;
			interrupt-names	= "afe", "asys";
			power-domains = <&scpsys MT2701_POWER_DOMAIN_IFR_MSC>;

			clocks = <&infracfg CLK_INFRA_AUDIO>,
				 <&topckgen CLK_TOP_AUD_MUX1_SEL>,
				 <&topckgen CLK_TOP_AUD_MUX2_SEL>,
				 <&topckgen CLK_TOP_AUD_48K_TIMING>,
				 <&topckgen CLK_TOP_AUD_44K_TIMING>,
				 <&topckgen CLK_TOP_AUD_K1_SRC_SEL>,
				 <&topckgen CLK_TOP_AUD_K2_SRC_SEL>,
				 <&topckgen CLK_TOP_AUD_K3_SRC_SEL>,
				 <&topckgen CLK_TOP_AUD_K4_SRC_SEL>,
				 <&topckgen CLK_TOP_AUD_K1_SRC_DIV>,
				 <&topckgen CLK_TOP_AUD_K2_SRC_DIV>,
				 <&topckgen CLK_TOP_AUD_K3_SRC_DIV>,
				 <&topckgen CLK_TOP_AUD_K4_SRC_DIV>,
				 <&topckgen CLK_TOP_AUD_I2S1_MCLK>,
				 <&topckgen CLK_TOP_AUD_I2S2_MCLK>,
				 <&topckgen CLK_TOP_AUD_I2S3_MCLK>,
				 <&topckgen CLK_TOP_AUD_I2S4_MCLK>,
				 <&audsys CLK_AUD_I2SO1>,
				 <&audsys CLK_AUD_I2SO2>,
				 <&audsys CLK_AUD_I2SO3>,
				 <&audsys CLK_AUD_I2SO4>,
				 <&audsys CLK_AUD_I2SIN1>,
				 <&audsys CLK_AUD_I2SIN2>,
				 <&audsys CLK_AUD_I2SIN3>,
				 <&audsys CLK_AUD_I2SIN4>,
				 <&audsys CLK_AUD_ASRCO1>,
				 <&audsys CLK_AUD_ASRCO2>,
				 <&audsys CLK_AUD_ASRCO3>,
				 <&audsys CLK_AUD_ASRCO4>,
				 <&audsys CLK_AUD_AFE>,
				 <&audsys CLK_AUD_AFE_CONN>,
				 <&audsys CLK_AUD_A1SYS>,
				 <&audsys CLK_AUD_A2SYS>,
				 <&audsys CLK_AUD_AFE_MRGIF>;

			clock-names = "infra_sys_audio_clk",
				      "top_audio_mux1_sel",
				      "top_audio_mux2_sel",
				      "top_audio_a1sys_hp",
				      "top_audio_a2sys_hp",
				      "i2s0_src_sel",
				      "i2s1_src_sel",
				      "i2s2_src_sel",
				      "i2s3_src_sel",
				      "i2s0_src_div",
				      "i2s1_src_div",
				      "i2s2_src_div",
				      "i2s3_src_div",
				      "i2s0_mclk_en",
				      "i2s1_mclk_en",
				      "i2s2_mclk_en",
				      "i2s3_mclk_en",
				      "i2so0_hop_ck",
				      "i2so1_hop_ck",
				      "i2so2_hop_ck",
				      "i2so3_hop_ck",
				      "i2si0_hop_ck",
				      "i2si1_hop_ck",
				      "i2si2_hop_ck",
				      "i2si3_hop_ck",
				      "asrc0_out_ck",
				      "asrc1_out_ck",
				      "asrc2_out_ck",
				      "asrc3_out_ck",
				      "audio_afe_pd",
				      "audio_afe_conn_pd",
				      "audio_a1sys_pd",
				      "audio_a2sys_pd",
				      "audio_mrgif_pd";

			assigned-clocks = <&topckgen CLK_TOP_AUD_MUX1_SEL>,
					  <&topckgen CLK_TOP_AUD_MUX2_SEL>,
					  <&topckgen CLK_TOP_AUD_MUX1_DIV>,
					  <&topckgen CLK_TOP_AUD_MUX2_DIV>;
			assigned-clock-parents = <&topckgen CLK_TOP_AUD1PLL_98M>,
						 <&topckgen CLK_TOP_AUD2PLL_90M>;
			assigned-clock-rates = <0>, <0>, <49152000>, <45158400>;
		};
	};
```

## Documentation/devicetree/bindings/sound/mt2701-cs42448.txt
```
MT2701 with CS42448 CODEC

Required properties:
- compatible: "mediatek,mt2701-cs42448-machine"
- mediatek,platform: the phandle of MT2701 ASoC platform
- audio-routing: a list of the connections between audio
- mediatek,audio-codec: the phandles of cs42448 codec
- mediatek,audio-codec-bt-mrg the phandles of bt-sco dummy codec
- pinctrl-names: Should contain only one value - "default"
- pinctrl-0: Should specify pin control groups used for this controller.
- i2s1-in-sel-gpio1, i2s1-in-sel-gpio2: Should specify two gpio pins to
					control I2S1-in mux.

Example:

	sound:sound {
		compatible = "mediatek,mt2701-cs42448-machine";
		mediatek,platform = <&afe>;
		/* CS42448 Machine name */
		audio-routing =
			"Line Out Jack", "AOUT1L",
			"Line Out Jack", "AOUT1R",
			"Line Out Jack", "AOUT2L",
			"Line Out Jack", "AOUT2R",
			"Line Out Jack", "AOUT3L",
			"Line Out Jack", "AOUT3R",
			"Line Out Jack", "AOUT4L",
			"Line Out Jack", "AOUT4R",
			"AIN1L", "AMIC",
			"AIN1R", "AMIC",
			"AIN2L", "Tuner In",
			"AIN2R", "Tuner In",
			"AIN3L", "Satellite Tuner In",
			"AIN3R", "Satellite Tuner In",
			"AIN3L", "AUX In",
			"AIN3R", "AUX In";
		mediatek,audio-codec = <&cs42448>;
		mediatek,audio-codec-bt-mrg = <&bt_sco_codec>;
		pinctrl-names = "default";
		pinctrl-0 = <&aud_pins_default>;
		i2s1-in-sel-gpio1 = <&pio 53 0>;
		i2s1-in-sel-gpio2 = <&pio 54 0>;
	};
```

## Documentation/devicetree/bindings/sound/mt2701-wm8960.txt
```
MT2701 with WM8960 CODEC

Required properties:
- compatible: "mediatek,mt2701-wm8960-machine"
- mediatek,platform: the phandle of MT2701 ASoC platform
- audio-routing: a list of the connections between audio
- mediatek,audio-codec: the phandles of wm8960 codec
- pinctrl-names: Should contain only one value - "default"
- pinctrl-0: Should specify pin control groups used for this controller.

Example:

	sound:sound {
		compatible = "mediatek,mt2701-wm8960-machine";
		mediatek,platform = <&afe>;
		audio-routing =
			"Headphone", "HP_L",
			"Headphone", "HP_R",
			"LINPUT1", "AMIC",
			"RINPUT1", "AMIC";
		mediatek,audio-codec = <&wm8960>;
		pinctrl-names = "default";
		pinctrl-0 = <&aud_pins_default>;
	};
```

## Documentation/devicetree/bindings/sound/mt6351.txt
```
Mediatek MT6351 Audio Codec

The communication between MT6351 and SoC is through Mediatek PMIC wrapper.
For more detail, please visit Mediatek PMIC wrapper documentation.

Must be a child node of PMIC wrapper.

Required properties:

- compatible : "mediatek,mt6351-sound".

Example:

mt6351_snd {
	compatible = "mediatek,mt6351-sound";
};
```

## Documentation/devicetree/bindings/sound/mt6358.txt
```
Mediatek MT6358 Audio Codec

The communication between MT6358 and SoC is through Mediatek PMIC wrapper.
For more detail, please visit Mediatek PMIC wrapper documentation.

Must be a child node of PMIC wrapper.

Required properties:

- compatible : "mediatek,mt6358-sound".
- Avdd-supply : power source of AVDD

Optional properties:
- mediatek,dmic-mode : Indicates how many data pins are used to transmit two
	channels of PDM signal. 0 means two wires, 1 means one wire. Default
	value is 0.

Example:

mt6358_snd {
	compatible = "mediatek,mt6358-sound";
	Avdd-supply = <&mt6358_vaud28_reg>;
	mediatek,dmic-mode = <0>;
};
```

## Documentation/devicetree/bindings/sound/mt6359-accdet.yaml
```yaml
# SPDX-License-Identifier: (GPL-2.0-only OR BSD-2-Clause)
%YAML 1.2
---
$id: http://devicetree.org/schemas/sound/mt6359-accdet.yaml#
$schema: http://devicetree.org/meta-schemas/core.yaml#

title: Mediatek Technologies Inc. MT6359 ASoC accdet jack driver bindings

maintainers:
  - Chipeng Chang <chipeng.chang@mediatek.com>

description: |
  This binding describes the Mediatek Technologies MT6359 ASoC
  accdet jack driver.

properties:
  mediatek,accdet-name:
    maxItems: 1
    description: named as "mt6359-accdet" jack.

  mediatek,mic-vol:
    maxItems: 1
    description: |
      accdet micbias1 voltage.

      enum:
        - 0x00 # 1.7v - micbias1 volage is 1.7v.
        - 0x01 # 1.8v - micbias1 volage is 1.8v.
        - 0x02 # 1.9v - micbias1 volage is 1.9v.
        - 0x03 # 2.0v - micbias1 volage is 2.0v.
        - 0x04 # 2.1v - micbias1 volage is 2.1v.
        - 0x05 # 2.5v - micbias1 volage is 2.5v.
        - 0x06 # 2.6v - micbias1 volage is 2.6v.
        - 0x07 # 2.7v - micbias1 volage is 2.7v.
        - 0x08 # 2.8v - micbias1 volage is 2.8v.
        - 0x09 # 2.85v - micbias1 volage is 2.85v.

  mediatek,mic-mode:
    maxItems: 1
    description: |
      value as 1, 2, 6 to indicate ACC/DCC mode. default is DCC mode 2.

      enum:
        - 0x01 # ACC - ACC mode.
        - 0x02 # DCC - low cost without in bias.
        - 0x06 # DCC - low cost with in bias.

  mediatek,pwm-deb-setting:
    maxItems: 15
    description: |
       headset-mode-setting : Indicates customized pwm, debounce setting
       accdet pwm_width, pwm_thresh, fall_delay, rise_delay
       debounce0, debounce1, debounce3, debounce4
       eint pwm_width, eint pwm_thresh
       eint deb(debounce0, debounce1, debounce2, debounce3), inv_debounce.

  mediatek,eint-use-ap:
    maxItems: 1
    description: |
      indicates to use ap gpio.

      enum:
        - 0x00 # MT6359 eint detection mode.
        - 0x01 # SoC GPIO detection mode.

  mediatek,eint-detect-mode:
    maxItems: 1
    description: |
      indicates to use ap gpio.

      enum:
        - 0x00 # detection mode with higher detection power.
        - 0x01 # detection mode with lower detection power.
        - 0x02 # detection mode with sw moisture detection mode.
        - 0x03 # detection mode with hw moisture detection mode1.
        - 0x04 # detection mode with hw moisture detection mode2.

  mediatek,eint-num:
    maxItems: 1
    description: |
      incicates pmic eint usage.

      enum:
        - 0x0 # PMIC_EINT0 - use pmic eint0 to trigger plug interrupt.
        - 0x1 # PMIC_EINT1 - use pmic eint1 to trigger plug interrupt.
        - 0x2 # PMIC_BI_EINT - use pmic eint0/1 to trigger plug interrupt.

  mediatek,eint-trig-mode:
    maxItems: 1
    description: |
      incicates pmic eint trigger mode.

      enum:
        - 0x0 # PMIC_GPIO - use pmic gpio to detect plug status.
        - 0x1 # PMIC_INVERTER - use pmic inverter to detect plug status.

  mediatek,eint-use-ext-res:
    maxItems: 1
    description: |
      select HP_EINT pull up resistance, default 0 use internal resistance.

      enum:
        - 0x0 # use internal resistor.
        - 0x1 # use external resistor.

  mediatek,eint-comp-vth:
    maxItems: 1
    description: |
      indicates comparator detection voltage.

      enum:
        - 0x00 # 2.8v.
        - 0x01 # 2.4v.
        - 0x02 # 2.0v.
        - 0x03 # 0.7v.

  mediatek,key-mode:
    maxItems: 1
    description: |
      incicates key mode type.

      enum:
        - 0x0 # THREE_KEY - support 3-key key mode.
        - 0x1 # FOUR_KEY - support 4-key key mode.
        - 0x2 # TRI_KEY_CDD - support 3-key google CDD key mode.

  mediatek,three-key-thr:
    maxItems: 4
    description: |
      3 key device detection threshold: 0--MD_MAX--UP_MAX--DW_MAX.

  mediatek,tri-key-cdd-thr:
    maxItems: 4
    description: |
      3 key CDD device detection threshold: 0--MD_MAX--UP_MAX--DW_MAX.

  mediatek,four-key-thr:
    maxItems: 4
    description: |
      4 key device detection threshold: 0--MD_MAX--VOICE_MAX--UP_MAX--DW_MAX.

additionalProperties: false

examples:
  - |
    accdet: accdet {
        mediatek,accdet-name = "mt6359-accdet";
        mediatek,mic-vol = <8>;
        mediatek,mic-mode = <2>;
        mediatek,pwm-deb-setting = <0x500 0x500 1 0x1f0
                                    0x800 0x800 0x20 0x44
                                    0x4 0x1
                                    0x5 0x3 0x3 0x5 0xe>;
        mediatek,eint-use-ap = <0>;
        mediatek,eint-detect-mode = <4>;
        mediatek,eint-num = <0>;
        mediatek,eint-trig-mode = <1>;
        mediatek,eint-use-ext-res = <0>;
        mediatek,eint-comp-vth = <2>;
        mediatek,key-mode = <0>;
        mediatek,three-key-thr = <0 80 220 400>;
        status = "okay";
    };
...
```
