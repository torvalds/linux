## Documentation/devicetree/bindings/sound/mt6359.yaml
```yaml
# SPDX-License-Identifier: GPL-2.0
%YAML 1.2
---
$id: http://devicetree.org/schemas/sound/mt6359.yaml#
$schema: http://devicetree.org/meta-schemas/core.yaml#

title: Mediatek MT6359 Codec

maintainers:
  - Eason Yen <eason.yen@mediatek.com>
  - Jiaxin Yu <jiaxin.yu@mediatek.com>
  - Shane Chien <shane.chien@mediatek.com>

description: |
  The communication between MT6359 and SoC is through Mediatek PMIC wrapper.
  For more detail, please visit Mediatek PMIC wrapper documentation.
  Must be a child node of PMIC wrapper.

properties:
  mediatek,dmic-mode:
    $ref: /schemas/types.yaml#/definitions/uint32
    description: |
      Indicates how many data pins are used to transmit two channels of PDM
      signal. 0 means two wires, 1 means one wire. Default value is 0.
    enum:
      - 0 # two wires
      - 1 # one wire

  mediatek,mic-type-0:
    $ref: /schemas/types.yaml#/definitions/uint32
    description: |
      Specifies the type of mic type connected to adc0

    enum:
      - 0 # IDLE - mic in turn-off status
      - 1 # ACC - analog mic with alternating coupling
      - 2 # DMIC - digital mic
      - 3 # DCC - analog mic with direct couping
      - 4 # DCC_ECM_DIFF - analog electret condenser mic with differential mode
      - 5 # DCC_ECM_SINGLE - analog electret condenser mic with single mode

  mediatek,mic-type-1:
    $ref: /schemas/types.yaml#/definitions/uint32
    description: |
      Specifies the type of mic type connected to adc1

  mediatek,mic-type-2:
    $ref: /schemas/types.yaml#/definitions/uint32
    description: |
      Specifies the type of mic type connected to adc2

additionalProperties: false

examples:
  - |
    mt6359codec: audio-codec {
        mediatek,dmic-mode = <0>;
        mediatek,mic-type-0 = <2>;
    };

...
```

## Documentation/devicetree/bindings/sound/mt6797-afe-pcm.txt
```
Mediatek AFE PCM controller for mt6797

Required properties:
- compatible = "mediatek,mt6797-audio";
- reg: register location and size
- interrupts: should contain AFE interrupt
- power-domains: should define the power domain
- clocks: Must contain an entry for each entry in clock-names
- clock-names: should have these clock names:
		"infra_sys_audio_clk",
		"infra_sys_audio_26m",
		"mtkaif_26m_clk",
		"top_mux_audio",
		"top_mux_aud_intbus",
		"top_sys_pll3_d4",
		"top_sys_pll1_d4",
		"top_clk26m_clk";

Example:

	afe: mt6797-afe-pcm@11220000  {
		compatible = "mediatek,mt6797-audio";
		reg = <0 0x11220000 0 0x1000>;
		interrupts = <GIC_SPI 151 IRQ_TYPE_LEVEL_LOW>;
		power-domains = <&scpsys MT6797_POWER_DOMAIN_AUDIO>;
		clocks = <&infrasys CLK_INFRA_AUDIO>,
			 <&infrasys CLK_INFRA_AUDIO_26M>,
			 <&infrasys CLK_INFRA_AUDIO_26M_PAD_TOP>,
			 <&topckgen CLK_TOP_MUX_AUDIO>,
			 <&topckgen CLK_TOP_MUX_AUD_INTBUS>,
			 <&topckgen CLK_TOP_SYSPLL3_D4>,
			 <&topckgen CLK_TOP_SYSPLL1_D4>,
			 <&clk26m>;
		clock-names = "infra_sys_audio_clk",
			      "infra_sys_audio_26m",
			      "mtkaif_26m_clk",
			      "top_mux_audio",
			      "top_mux_aud_intbus",
			      "top_sys_pll3_d4",
			      "top_sys_pll1_d4",
			      "top_clk26m_clk";
	};
```

## Documentation/devicetree/bindings/sound/mt6797-mt6351.txt
```
MT6797 with MT6351 CODEC

Required properties:
- compatible: "mediatek,mt6797-mt6351-sound"
- mediatek,platform: the phandle of MT6797 ASoC platform
- mediatek,audio-codec: the phandles of MT6351 codec

Example:

	sound {
		compatible = "mediatek,mt6797-mt6351-sound";
		mediatek,audio-codec = <&mt6351_snd>;
		mediatek,platform = <&afe>;
	};
```

## Documentation/devicetree/bindings/sound/mt8173-max98090.txt
```
MT8173 with MAX98090 CODEC

Required properties:
- compatible : "mediatek,mt8173-max98090"
- mediatek,audio-codec: the phandle of the MAX98090 audio codec
- mediatek,platform: the phandle of MT8173 ASoC platform

Example:

	sound {
		compatible = "mediatek,mt8173-max98090";
		mediatek,audio-codec = <&max98090>;
		mediatek,platform = <&afe>;
	};
```

## Documentation/devicetree/bindings/sound/mt8173-rt5650-rt5514.txt
```
MT8173 with RT5650 RT5514 CODECS

Required properties:
- compatible : "mediatek,mt8173-rt5650-rt5514"
- mediatek,audio-codec: the phandles of rt5650 and rt5514 codecs
- mediatek,platform: the phandle of MT8173 ASoC platform

Example:

	sound {
		compatible = "mediatek,mt8173-rt5650-rt5514";
		mediatek,audio-codec = <&rt5650 &rt5514>;
		mediatek,platform = <&afe>;
	};
```

## Documentation/devicetree/bindings/sound/mt8173-rt5650-rt5676.txt
```
MT8173 with RT5650 RT5676 CODECS and HDMI via I2S

Required properties:
- compatible : "mediatek,mt8173-rt5650-rt5676"
- mediatek,audio-codec: the phandles of rt5650 and rt5676 codecs
			and of the hdmi encoder node
- mediatek,platform: the phandle of MT8173 ASoC platform

Example:

	sound {
		compatible = "mediatek,mt8173-rt5650-rt5676";
		mediatek,audio-codec = <&rt5650 &rt5676 &hdmi0>;
		mediatek,platform = <&afe>;
	};
```

## Documentation/devicetree/bindings/sound/mt8173-rt5650.txt
```
MT8173 with RT5650 CODECS and HDMI via I2S

Required properties:
- compatible : "mediatek,mt8173-rt5650"
- mediatek,audio-codec: the phandles of rt5650 codecs
                        and of the hdmi encoder node
- mediatek,platform: the phandle of MT8173 ASoC platform

Optional subnodes:
- codec-capture : the subnode of rt5650 codec capture
Required codec-capture subnode properties:
- sound-dai: audio codec dai name on capture path
  <&rt5650 0> : Default setting. Connect rt5650 I2S1 for capture. (dai_name = rt5645-aif1)
  <&rt5650 1> : Connect rt5650 I2S2 for capture. (dai_name = rt5645-aif2)

- mediatek,mclk: the MCLK source
  0 : external oscillator, MCLK = 12.288M
  1 : internal source from mt8173, MCLK = sampling rate*256

Example:

	sound {
		compatible = "mediatek,mt8173-rt5650";
		mediatek,audio-codec = <&rt5650 &hdmi0>;
		mediatek,platform = <&afe>;
		mediatek,mclk = <0>;
		codec-capture {
			sound-dai = <&rt5650 1>;
		};
	};
```

## Documentation/devicetree/bindings/sound/mt8183-afe-pcm.txt
```
Mediatek AFE PCM controller for mt8183

Required properties:
- compatible = "mediatek,mt68183-audio";
- reg: register location and size
- interrupts: should contain AFE interrupt
- resets: Must contain an entry for each entry in reset-names
  See ../reset/reset.txt for details.
- reset-names: should have these reset names:
		"audiosys";
- power-domains: should define the power domain
- clocks: Must contain an entry for each entry in clock-names
- clock-names: should have these clock names:
		"infra_sys_audio_clk",
		"mtkaif_26m_clk",
		"top_mux_audio",
		"top_mux_aud_intbus",
		"top_sys_pll3_d4",
		"top_clk26m_clk";

Example:

	afe: mt8183-afe-pcm@11220000  {
		compatible = "mediatek,mt8183-audio";
		reg = <0 0x11220000 0 0x1000>;
		interrupts = <GIC_SPI 161 IRQ_TYPE_LEVEL_LOW>;
		resets = <&watchdog MT8183_TOPRGU_AUDIO_SW_RST>;
		reset-names = "audiosys";
		power-domains = <&scpsys MT8183_POWER_DOMAIN_AUDIO>;
		clocks = <&infrasys CLK_INFRA_AUDIO>,
			 <&infrasys CLK_INFRA_AUDIO_26M_BCLK>,
			 <&topckgen CLK_TOP_MUX_AUDIO>,
			 <&topckgen CLK_TOP_MUX_AUD_INTBUS>,
			 <&topckgen CLK_TOP_SYSPLL_D2_D4>,
			 <&clk26m>;
		clock-names = "infra_sys_audio_clk",
			      "mtkaif_26m_clk",
			      "top_mux_audio",
			      "top_mux_aud_intbus",
			      "top_sys_pll_d2_d4",
			      "top_clk26m_clk";
	};
```

## Documentation/devicetree/bindings/sound/mt8183-da7219-max98357.txt
```
MT8183 with MT6358, DA7219, MAX98357, and RT1015 CODECS

Required properties:
- compatible : "mediatek,mt8183_da7219_max98357" for MAX98357A codec
               "mediatek,mt8183_da7219_rt1015" for RT1015 codec
               "mediatek,mt8183_da7219_rt1015p" for RT1015P codec
- mediatek,headset-codec: the phandles of da7219 codecs
- mediatek,platform: the phandle of MT8183 ASoC platform

Optional properties:
- mediatek,hdmi-codec: the phandles of HDMI codec

Example:

	sound {
		compatible = "mediatek,mt8183_da7219_max98357";
		mediatek,headset-codec = <&da7219>;
		mediatek,hdmi-codec = <&it6505dptx>;
		mediatek,platform = <&afe>;
	};
```

## Documentation/devicetree/bindings/sound/mt8183-mt6358-ts3a227-max98357.txt
```
MT8183 with MT6358, TS3A227, MAX98357, and RT1015 CODECS

Required properties:
- compatible : "mediatek,mt8183_mt6358_ts3a227_max98357" for MAX98357A codec
               "mediatek,mt8183_mt6358_ts3a227_max98357b" for MAX98357B codec
               "mediatek,mt8183_mt6358_ts3a227_rt1015" for RT1015 codec
               "mediatek,mt8183_mt6358_ts3a227_rt1015p" for RT1015P codec
- mediatek,platform: the phandle of MT8183 ASoC platform

Optional properties:
- mediatek,headset-codec: the phandles of ts3a227 codecs
- mediatek,ec-codec: the phandle of EC codecs.
                     See google,cros-ec-codec.txt for more details.
- mediatek,hdmi-codec: the phandles of HDMI codec

Example:

	sound {
		compatible = "mediatek,mt8183_mt6358_ts3a227_max98357";
		mediatek,headset-codec = <&ts3a227>;
		mediatek,ec-codec = <&ec_codec>;
		mediatek,hdmi-codec = <&it6505dptx>;
		mediatek,platform = <&afe>;
	};
```

## Documentation/devicetree/bindings/sound/mt8186-afe-pcm.yaml
```yaml
# SPDX-License-Identifier: (GPL-2.0-only OR BSD-2-Clause)
%YAML 1.2
---
$id: http://devicetree.org/schemas/sound/mt8186-afe-pcm.yaml#
$schema: http://devicetree.org/meta-schemas/core.yaml#

title: Mediatek AFE PCM controller for mt8186

maintainers:
  - Jiaxin Yu <jiaxin.yu@mediatek.com>

properties:
  compatible:
    const: mediatek,mt8186-sound

  reg:
    maxItems: 1

  interrupts:
    maxItems: 1

  resets:
    maxItems: 1

  reset-names:
    const: audiosys

  mediatek,apmixedsys:
    $ref: /schemas/types.yaml#/definitions/phandle
    description: The phandle of the mediatek apmixedsys controller

  mediatek,infracfg:
    $ref: /schemas/types.yaml#/definitions/phandle
    description: The phandle of the mediatek infracfg controller

  mediatek,topckgen:
    $ref: /schemas/types.yaml#/definitions/phandle
    description: The phandle of the mediatek topckgen controller

  clocks:
    items:
      - description: audio infra sys clock
      - description: audio infra 26M clock
      - description: audio top mux
      - description: audio intbus mux
      - description: mainpll 136.5M clock
      - description: faud1 mux
      - description: apll1 clock
      - description: faud2 mux
      - description: apll2 clock
      - description: audio engen1 mux
      - description: apll1_d8 22.5792M clock
      - description: audio engen2 mux
      - description: apll2_d8 24.576M clock
      - description: i2s0 mclk mux
      - description: i2s1 mclk mux
      - description: i2s2 mclk mux
      - description: i2s4 mclk mux
      - description: tdm mclk mux
      - description: i2s0_mck divider
      - description: i2s1_mck divider
      - description: i2s2_mck divider
      - description: i2s4_mck divider
      - description: tdm_mck divider
      - description: audio hires mux
      - description: 26M clock

  clock-names:
    items:
      - const: aud_infra_clk
      - const: mtkaif_26m_clk
      - const: top_mux_audio
      - const: top_mux_audio_int
      - const: top_mainpll_d2_d4
      - const: top_mux_aud_1
      - const: top_apll1_ck
      - const: top_mux_aud_2
      - const: top_apll2_ck
      - const: top_mux_aud_eng1
      - const: top_apll1_d8
      - const: top_mux_aud_eng2
      - const: top_apll2_d8
      - const: top_i2s0_m_sel
      - const: top_i2s1_m_sel
      - const: top_i2s2_m_sel
      - const: top_i2s4_m_sel
      - const: top_tdm_m_sel
      - const: top_apll12_div0
      - const: top_apll12_div1
      - const: top_apll12_div2
      - const: top_apll12_div4
      - const: top_apll12_div_tdm
      - const: top_mux_audio_h
      - const: top_clk26m_clk

required:
  - compatible
  - interrupts
  - resets
  - reset-names
  - mediatek,apmixedsys
  - mediatek,infracfg
  - mediatek,topckgen
  - clocks
  - clock-names

additionalProperties: false

examples:
  - |
    #include <dt-bindings/interrupt-controller/arm-gic.h>
    #include <dt-bindings/interrupt-controller/irq.h>

    afe: mt8186-afe-pcm@11210000 {
        compatible = "mediatek,mt8186-sound";
        reg = <0x11210000 0x2000>;
        interrupts = <GIC_SPI 169 IRQ_TYPE_LEVEL_HIGH>;
        resets = <&watchdog 17>; //MT8186_TOPRGU_AUDIO_SW_RST
        reset-names = "audiosys";
        mediatek,apmixedsys = <&apmixedsys>;
        mediatek,infracfg = <&infracfg>;
        mediatek,topckgen = <&topckgen>;
        clocks = <&infracfg_ao 44>, //CLK_INFRA_AO_AUDIO
                 <&infracfg_ao 54>, //CLK_INFRA_AO_AUDIO_26M_BCLK
                 <&topckgen 15>, //CLK_TOP_AUDIO
                 <&topckgen 16>, //CLK_TOP_AUD_INTBUS
                 <&topckgen 70>, //CLK_TOP_MAINPLL_D2_D4
                 <&topckgen 17>, //CLK_TOP_AUD_1
                 <&apmixedsys 12>, //CLK_APMIXED_APLL1
                 <&topckgen 18>, //CLK_TOP_AUD_2
                 <&apmixedsys 13>, //CLK_APMIXED_APLL2
                 <&topckgen 19>, //CLK_TOP_AUD_ENGEN1
                 <&topckgen 101>, //CLK_TOP_APLL1_D8
                 <&topckgen 20>, //CLK_TOP_AUD_ENGEN2
                 <&topckgen 104>, //CLK_TOP_APLL2_D8
                 <&topckgen 63>, //CLK_TOP_APLL_I2S0_MCK_SEL
                 <&topckgen 64>, //CLK_TOP_APLL_I2S1_MCK_SEL
                 <&topckgen 65>, //CLK_TOP_APLL_I2S2_MCK_SEL
                 <&topckgen 66>, //CLK_TOP_APLL_I2S4_MCK_SEL
                 <&topckgen 67>, //CLK_TOP_APLL_TDMOUT_MCK_SEL
                 <&topckgen 131>, //CLK_TOP_APLL12_CK_DIV0
                 <&topckgen 132>, //CLK_TOP_APLL12_CK_DIV1
                 <&topckgen 133>, //CLK_TOP_APLL12_CK_DIV2
                 <&topckgen 134>, //CLK_TOP_APLL12_CK_DIV4
                 <&topckgen 135>, //CLK_TOP_APLL12_CK_DIV_TDMOUT_M
                 <&topckgen 44>, //CLK_TOP_AUDIO_H
                 <&clk26m>;
        clock-names = "aud_infra_clk",
                      "mtkaif_26m_clk",
                      "top_mux_audio",
                      "top_mux_audio_int",
                      "top_mainpll_d2_d4",
                      "top_mux_aud_1",
                      "top_apll1_ck",
                      "top_mux_aud_2",
                      "top_apll2_ck",
                      "top_mux_aud_eng1",
                      "top_apll1_d8",
                      "top_mux_aud_eng2",
                      "top_apll2_d8",
                      "top_i2s0_m_sel",
                      "top_i2s1_m_sel",
                      "top_i2s2_m_sel",
                      "top_i2s4_m_sel",
                      "top_tdm_m_sel",
                      "top_apll12_div0",
                      "top_apll12_div1",
                      "top_apll12_div2",
                      "top_apll12_div4",
                      "top_apll12_div_tdm",
                      "top_mux_audio_h",
                      "top_clk26m_clk";
    };

...
```
