## Documentation/devicetree/bindings/sound/nvidia,tegra-audio-wm9712.yaml
```yaml
# SPDX-License-Identifier: (GPL-2.0-only OR BSD-2-Clause)
%YAML 1.2
---
$id: http://devicetree.org/schemas/sound/nvidia,tegra-audio-wm9712.yaml#
$schema: http://devicetree.org/meta-schemas/core.yaml#

title: NVIDIA Tegra audio complex with WM9712 CODEC

maintainers:
  - Jon Hunter <jonathanh@nvidia.com>
  - Thierry Reding <thierry.reding@gmail.com>

allOf:
  - $ref: nvidia,tegra-audio-common.yaml#

properties:
  compatible:
    items:
      - pattern: '^[a-z0-9]+,tegra-audio-wm9712([-_][a-z0-9]+)+$'
      - const: nvidia,tegra-audio-wm9712

  nvidia,audio-routing:
    $ref: /schemas/types.yaml#/definitions/non-unique-string-array
    description: |
      A list of the connections between audio components.
      Each entry is a pair of strings, the first being the connection's sink,
      the second being the connection's source. Valid names for sources and
      sinks are the pins (documented in the binding document),
      and the jacks on the board.
    minItems: 2
    items:
      enum:
        # Board Connectors
        - Headphone
        - LineIn
        - Mic

        # CODEC Pins
        - MONOOUT
        - HPOUTL
        - HPOUTR
        - LOUT2
        - ROUT2
        - OUT3
        - LINEINL
        - LINEINR
        - PHONE
        - PCBEEP
        - MIC1
        - MIC2
        - Mic Bias

required:
  - nvidia,ac97-controller

unevaluatedProperties: false

examples:
  - |
    sound {
        compatible = "nvidia,tegra-audio-wm9712-colibri_t20",
                     "nvidia,tegra-audio-wm9712";
        nvidia,model = "Toradex Colibri T20";

        nvidia,audio-routing =
                "Headphone", "HPOUTL",
                "Headphone", "HPOUTR",
                "LineIn", "LINEINL",
                "LineIn", "LINEINR",
                "Mic", "MIC1";

        nvidia,ac97-controller = <&ac97>;

        clocks = <&clk 112>, <&clk 113>, <&clk 93>;
        clock-names = "pll_a", "pll_a_out0", "mclk";
    };
```

## Documentation/devicetree/bindings/sound/nvidia,tegra186-asrc.yaml
```yaml
# SPDX-License-Identifier: (GPL-2.0-only OR BSD-2-Clause)
%YAML 1.2
---
$id: http://devicetree.org/schemas/sound/nvidia,tegra186-asrc.yaml#
$schema: http://devicetree.org/meta-schemas/core.yaml#

title: Tegra186 ASRC

description: |
  Asynchronous Sample Rate Converter (ASRC) converts the sampling frequency
  of the input signal from one frequency to another. It can handle over a
  wide range of sample rate ratios (freq_in/freq_out) from 1:24 to 24:1.
  ASRC has two modes of operation. One where ratio can be programmed in SW
  and the other where it gets the information from ratio estimator module.

  It supports  sample rate conversions in the range of 8 to 192 kHz and
  supports 6 streams upto 12 total channels. The input data size can be
  16, 24 and 32 bits.

maintainers:
  - Jon Hunter <jonathanh@nvidia.com>
  - Mohan Kumar <mkumard@nvidia.com>
  - Sameer Pujar <spujar@nvidia.com>

allOf:
  - $ref: name-prefix.yaml#

properties:
  $nodename:
    pattern: "^asrc@[0-9a-f]*$"

  compatible:
    oneOf:
      - const: nvidia,tegra186-asrc
      - items:
          - enum:
              - nvidia,tegra234-asrc
              - nvidia,tegra194-asrc
          - const: nvidia,tegra186-asrc

  reg:
    maxItems: 1

  sound-name-prefix:
    pattern: "^ASRC[1-9]$"

  ports:
    $ref: /schemas/graph.yaml#/properties/ports
    description: |
      ASRC has seven input ports and six output ports. Accordingly ACIF
      (Audio Client Interfaces) port nodes are defined to represent the
      ASRC inputs (port 0 to 6) and outputs (port 7 to 12). These are
      connected to corresponding ports on AHUB (Audio Hub). Additional
      input (port 6) is for receiving ratio information from estimator.

    patternProperties:
      '^port@[0-6]':
        $ref: audio-graph-port.yaml#
        unevaluatedProperties: false
        description: ASRC ACIF input ports
      '^port@[7-9]|1[1-2]':
        $ref: audio-graph-port.yaml#
        unevaluatedProperties: false
        description: ASRC ACIF output ports

required:
  - compatible
  - reg

additionalProperties: false

examples:
  - |

    asrc@2910000 {
        compatible = "nvidia,tegra186-asrc";
        reg = <0x2910000 0x2000>;
        sound-name-prefix = "ASRC1";
    };

...
```

## Documentation/devicetree/bindings/sound/nvidia,tegra186-dspk.yaml
```yaml
# SPDX-License-Identifier: (GPL-2.0-only OR BSD-2-Clause)
%YAML 1.2
---
$id: http://devicetree.org/schemas/sound/nvidia,tegra186-dspk.yaml#
$schema: http://devicetree.org/meta-schemas/core.yaml#

title: Tegra186 DSPK Controller Device Tree Bindings

description: |
  The Digital Speaker Controller (DSPK) can be viewed as a Pulse
  Density Modulation (PDM) transmitter that up-samples the input to
  the desired sampling rate by interpolation and then converts the
  over sampled Pulse Code Modulation (PCM) input to the desired 1-bit
  output via Delta Sigma Modulation (DSM).

maintainers:
  - Jon Hunter <jonathanh@nvidia.com>
  - Sameer Pujar <spujar@nvidia.com>

allOf:
  - $ref: name-prefix.yaml#

properties:
  $nodename:
    pattern: "^dspk@[0-9a-f]*$"

  compatible:
    oneOf:
      - const: nvidia,tegra186-dspk
      - items:
          - const: nvidia,tegra194-dspk
          - const: nvidia,tegra186-dspk

  reg:
    maxItems: 1

  clocks:
    maxItems: 1

  clock-names:
    const: dspk

  assigned-clocks:
    maxItems: 1

  assigned-clock-parents:
    maxItems: 1

  assigned-clock-rates:
    maxItems: 1

  sound-name-prefix:
    pattern: "^DSPK[1-9]$"

  ports:
    $ref: /schemas/graph.yaml#/properties/ports
    properties:
      port@0:
        $ref: audio-graph-port.yaml#
        unevaluatedProperties: false
        description: |
          DSPK ACIF (Audio Client Interface) port connected to the
          corresponding AHUB (Audio Hub) ACIF port.

      port@1:
        $ref: audio-graph-port.yaml#
        unevaluatedProperties: false
        description: |
          DSPK DAP (Digital Audio Port) interface which can be connected
          to external audio codec for playback.

required:
  - compatible
  - reg
  - clocks
  - clock-names
  - assigned-clocks
  - assigned-clock-parents
  - sound-name-prefix

additionalProperties: false

examples:
  - |
    #include<dt-bindings/clock/tegra186-clock.h>

    dspk@2905000 {
        compatible = "nvidia,tegra186-dspk";
        reg = <0x2905000 0x100>;
        clocks = <&bpmp TEGRA186_CLK_DSPK1>;
        clock-names = "dspk";
        assigned-clocks = <&bpmp TEGRA186_CLK_DSPK1>;
        assigned-clock-parents = <&bpmp TEGRA186_CLK_PLL_A_OUT0>;
        assigned-clock-rates = <12288000>;
        sound-name-prefix = "DSPK1";
    };

...
```

## Documentation/devicetree/bindings/sound/nvidia,tegra20-ac97.txt
```
NVIDIA Tegra 20 AC97 controller

Required properties:
- compatible : "nvidia,tegra20-ac97"
- reg : Should contain AC97 controller registers location and length
- interrupts : Should contain AC97 interrupt
- resets : Must contain an entry for each entry in reset-names.
  See ../reset/reset.txt for details.
- reset-names : Must include the following entries:
  - ac97
- dmas : Must contain an entry for each entry in clock-names.
  See ../dma/dma.txt for details.
- dma-names : Must include the following entries:
  - rx
  - tx
- clocks : Must contain one entry, for the module clock.
  See ../clocks/clock-bindings.txt for details.
- nvidia,codec-reset-gpio : The Tegra GPIO controller's phandle and the number
  of the GPIO used to reset the external AC97 codec
- nvidia,codec-sync-gpio : The Tegra GPIO controller's phandle and the number
  of the GPIO corresponding with the AC97 DAP _FS line

Example:

ac97@70002000 {
	compatible = "nvidia,tegra20-ac97";
	reg = <0x70002000 0x200>;
	interrupts = <0 81 0x04>;
	nvidia,codec-reset-gpio = <&gpio 170 0>;
	nvidia,codec-sync-gpio = <&gpio 120 0>;
	clocks = <&tegra_car 3>;
	resets = <&tegra_car 3>;
	reset-names = "ac97";
	dmas = <&apbdma 12>, <&apbdma 12>;
	dma-names = "rx", "tx";
};
```

## Documentation/devicetree/bindings/sound/nvidia,tegra20-ac97.yaml
```yaml
# SPDX-License-Identifier: (GPL-2.0-only OR BSD-2-Clause)
%YAML 1.2
---
$id: http://devicetree.org/schemas/sound/nvidia,tegra20-ac97.yaml#
$schema: http://devicetree.org/meta-schemas/core.yaml#

title: NVIDIA Tegra20 AC97 controller

maintainers:
  - Thierry Reding <treding@nvidia.com>
  - Jon Hunter <jonathanh@nvidia.com>

properties:
  compatible:
    const: nvidia,tegra20-ac97

  reg:
    maxItems: 1

  resets:
    maxItems: 1

  reset-names:
    const: ac97

  interrupts:
    maxItems: 1

  clocks:
    maxItems: 1

  dmas:
    maxItems: 2

  dma-names:
    items:
      - const: rx
      - const: tx

  nvidia,codec-reset-gpios:
    description: Reset pin of external AC97 codec
    maxItems: 1

  nvidia,codec-sync-gpios:
    description: AC97 DAP _FS line
    maxItems: 1

required:
  - compatible
  - reg
  - resets
  - reset-names
  - interrupts
  - clocks
  - dmas
  - dma-names
  - nvidia,codec-reset-gpios
  - nvidia,codec-sync-gpios

additionalProperties: false

examples:
  - |
    #include <dt-bindings/clock/tegra20-car.h>
    #include <dt-bindings/gpio/tegra-gpio.h>
    #include <dt-bindings/interrupt-controller/arm-gic.h>
    #include <dt-bindings/interrupt-controller/irq.h>
    #include <dt-bindings/gpio/gpio.h>

    ac97@70002000 {
        compatible = "nvidia,tegra20-ac97";
        reg = <0x70002000 0x200>;
        resets = <&tegra_car 3>;
        reset-names = "ac97";
        interrupts = <GIC_SPI 81 IRQ_TYPE_LEVEL_HIGH>;
        clocks = <&tegra_car 3>;
        dmas = <&apbdma 12>, <&apbdma 12>;
        dma-names = "rx", "tx";
        nvidia,codec-reset-gpios = <&gpio TEGRA_GPIO(V, 2) GPIO_ACTIVE_HIGH>;
        nvidia,codec-sync-gpios = <&gpio TEGRA_GPIO(P, 0) GPIO_ACTIVE_HIGH>;
    };
...
```

## Documentation/devicetree/bindings/sound/nvidia,tegra20-das.txt
```
NVIDIA Tegra 20 DAS (Digital Audio Switch) controller

Required properties:
- compatible : "nvidia,tegra20-das"
- reg : Should contain DAS registers location and length

Example:

das@70000c00 {
	compatible = "nvidia,tegra20-das";
	reg = <0x70000c00 0x80>;
};
```

## Documentation/devicetree/bindings/sound/nvidia,tegra20-das.yaml
```yaml
# SPDX-License-Identifier: (GPL-2.0-only OR BSD-2-Clause)
%YAML 1.2
---
$id: http://devicetree.org/schemas/sound/nvidia,tegra20-das.yaml#
$schema: http://devicetree.org/meta-schemas/core.yaml#

title: NVIDIA Tegra 20 DAS (Digital Audio Switch) controller

maintainers:
  - Thierry Reding <treding@nvidia.com>
  - Jon Hunter <jonathanh@nvidia.com>

properties:
  compatible:
    const: nvidia,tegra20-das

  reg:
    maxItems: 1

required:
  - compatible
  - reg

additionalProperties: false

examples:
  - |
    bus {
        #address-cells = <1>;
        #size-cells = <1>;
        das@70000c00 {
            compatible = "nvidia,tegra20-das";
            reg = <0x70000c00 0x80>;
        };
    };
...
```

## Documentation/devicetree/bindings/sound/nvidia,tegra20-i2s.txt
```
NVIDIA Tegra 20 I2S controller

Required properties:
- compatible : "nvidia,tegra20-i2s"
- reg : Should contain I2S registers location and length
- interrupts : Should contain I2S interrupt
- resets : Must contain an entry for each entry in reset-names.
  See ../reset/reset.txt for details.
- reset-names : Must include the following entries:
  - i2s
- dmas : Must contain an entry for each entry in clock-names.
  See ../dma/dma.txt for details.
- dma-names : Must include the following entries:
  - rx
  - tx
- clocks : Must contain one entry, for the module clock.
  See ../clocks/clock-bindings.txt for details.

Example:

i2s@70002800 {
	compatible = "nvidia,tegra20-i2s";
	reg = <0x70002800 0x200>;
	interrupts = < 45 >;
	clocks = <&tegra_car 11>;
	resets = <&tegra_car 11>;
	reset-names = "i2s";
	dmas = <&apbdma 21>, <&apbdma 21>;
	dma-names = "rx", "tx";
};
```

## Documentation/devicetree/bindings/sound/nvidia,tegra20-i2s.yaml
```yaml
# SPDX-License-Identifier: (GPL-2.0-only OR BSD-2-Clause)
%YAML 1.2
---
$id: http://devicetree.org/schemas/sound/nvidia,tegra20-i2s.yaml#
$schema: http://devicetree.org/meta-schemas/core.yaml#

title: NVIDIA Tegra20 I2S Controller

description: |
  The I2S Controller streams synchronous serial audio data between system
  memory and an external audio device. The controller supports the I2S Left
  Justified Mode, Right Justified Mode, and DSP mode formats.

maintainers:
  - Thierry Reding <treding@nvidia.com>
  - Jon Hunter <jonathanh@nvidia.com>

properties:
  compatible:
    const: nvidia,tegra20-i2s

  reg:
    maxItems: 1

  resets:
    maxItems: 1

  reset-names:
    const: i2s

  interrupts:
    maxItems: 1

  clocks:
    minItems: 1

  dmas:
    minItems: 2

  dma-names:
    items:
      - const: rx
      - const: tx

  nvidia,fixed-parent-rate:
    description: |
      Specifies whether board prefers parent clock to stay at a fixed rate.
      This allows multiple Tegra20 audio components work simultaneously by
      limiting number of supportable audio rates.
    type: boolean

required:
  - compatible
  - reg
  - resets
  - reset-names
  - interrupts
  - clocks
  - dmas
  - dma-names

additionalProperties: false

examples:
  - |
    i2s@70002800 {
        compatible = "nvidia,tegra20-i2s";
        reg = <0x70002800 0x200>;
        interrupts = <45>;
        clocks = <&tegra_car 11>;
        resets = <&tegra_car 11>;
        reset-names = "i2s";
        dmas = <&apbdma 21>, <&apbdma 21>;
        dma-names = "rx", "tx";
    };

...
```

## Documentation/devicetree/bindings/sound/nvidia,tegra20-spdif.yaml
```yaml
# SPDX-License-Identifier: (GPL-2.0-only OR BSD-2-Clause)
%YAML 1.2
---
$id: http://devicetree.org/schemas/sound/nvidia,tegra20-spdif.yaml#
$schema: http://devicetree.org/meta-schemas/core.yaml#

title: NVIDIA Tegra20 S/PDIF Controller

description: |
  The S/PDIF controller supports both input and output in serial audio
  digital interface format. The input controller can digitally recover
  a clock from the received stream. The S/PDIF controller is also used
  to generate the embedded audio for HDMI output channel.

maintainers:
  - Thierry Reding <treding@nvidia.com>
  - Jon Hunter <jonathanh@nvidia.com>

allOf:
  - $ref: dai-common.yaml#

properties:
  compatible:
    const: nvidia,tegra20-spdif

  reg:
    maxItems: 1

  resets:
    maxItems: 1

  interrupts:
    maxItems: 1

  clocks:
    minItems: 2

  clock-names:
    items:
      - const: out
      - const: in

  dmas:
    minItems: 2

  dma-names:
    items:
      - const: rx
      - const: tx

  "#sound-dai-cells":
    const: 0

  nvidia,fixed-parent-rate:
    description: |
      Specifies whether board prefers parent clock to stay at a fixed rate.
      This allows multiple Tegra20 audio components work simultaneously by
      limiting number of supportable audio rates.
    type: boolean

required:
  - compatible
  - reg
  - resets
  - interrupts
  - clocks
  - clock-names
  - dmas
  - dma-names
  - "#sound-dai-cells"

unevaluatedProperties: false

examples:
  - |
    spdif@70002400 {
        compatible = "nvidia,tegra20-spdif";
        reg = <0x70002400 0x200>;
        interrupts = <77>;
        clocks = <&clk 99>, <&clk 98>;
        clock-names = "out", "in";
        resets = <&rst 10>;
        dmas = <&apbdma 3>, <&apbdma 3>;
        dma-names = "rx", "tx";
        #sound-dai-cells = <0>;
    };

...
```
