## Documentation/devicetree/bindings/sound/nvidia,tegra210-i2s.yaml
```yaml
# SPDX-License-Identifier: (GPL-2.0-only OR BSD-2-Clause)
%YAML 1.2
---
$id: http://devicetree.org/schemas/sound/nvidia,tegra210-i2s.yaml#
$schema: http://devicetree.org/meta-schemas/core.yaml#

title: Tegra210 I2S Controller Device Tree Bindings

description: |
  The Inter-IC Sound (I2S) controller implements full-duplex,
  bi-directional and single direction point-to-point serial
  interfaces. It can interface with I2S compatible devices.
  I2S controller can operate both in master and slave mode.

maintainers:
  - Jon Hunter <jonathanh@nvidia.com>
  - Sameer Pujar <spujar@nvidia.com>

allOf:
  - $ref: audio-graph-port.yaml#

properties:
  $nodename:
    pattern: "^i2s@[0-9a-f]*$"

  compatible:
    oneOf:
      - const: nvidia,tegra210-i2s
      - items:
          - enum:
              - nvidia,tegra194-i2s
              - nvidia,tegra186-i2s
          - const: nvidia,tegra210-i2s

  reg:
    maxItems: 1

  clocks:
    minItems: 1
    maxItems: 2
    items:
      - description: I2S bit clock
      - description:
          Sync input clock, which can act as clock source to other I/O
          modules in AHUB. The Tegra I2S driver sets this clock rate as
          per bit clock rate. I/O module which wants to use this clock
          as source, can mention this clock as parent in the DT bindings.
          This is an optional clock entry, since it is only required when
          some other I/O wants to reference from a particular I2Sx
          instance.

  clock-names:
    minItems: 1
    maxItems: 2
    items:
      - const: i2s
      - const: sync_input

  assigned-clocks:
    minItems: 1
    maxItems: 2

  assigned-clock-parents:
    minItems: 1
    maxItems: 2

  assigned-clock-rates:
    minItems: 1
    maxItems: 2

  sound-name-prefix:
    pattern: "^I2S[1-9]$"
    $ref: /schemas/types.yaml#/definitions/string
    description:
      Used as prefix for sink/source names of the component. Must be a
      unique string among multiple instances of the same component.
      The name can be "I2S1" or "I2S2" ... "I2Sx", where x depends
      on the maximum available instances on a Tegra SoC.

  ports:
    type: object
    properties:
      port@0:
        description: |
          I2S ACIF (Audio Client Interface) port connected to the
          corresponding AHUB (Audio Hub) ACIF port.

      port@1:
        description: |
          I2S DAP (Digital Audio Port) interface which can be connected
          to external audio codec for playback or capture.

required:
  - compatible
  - reg
  - clocks
  - clock-names
  - assigned-clocks
  - assigned-clock-parents

unevaluatedProperties: false

examples:
  - |
    #include<dt-bindings/clock/tegra210-car.h>

    i2s@702d1000 {
        compatible = "nvidia,tegra210-i2s";
        reg = <0x702d1000 0x100>;
        clocks = <&tegra_car TEGRA210_CLK_I2S0>;
        clock-names = "i2s";
        assigned-clocks = <&tegra_car TEGRA210_CLK_I2S0>;
        assigned-clock-parents = <&tegra_car TEGRA210_CLK_PLL_A_OUT0>;
        assigned-clock-rates = <1536000>;
        sound-name-prefix = "I2S1";
    };

...
```

## Documentation/devicetree/bindings/sound/nvidia,tegra210-mbdrc.yaml
```yaml
# SPDX-License-Identifier: (GPL-2.0-only OR BSD-2-Clause)
%YAML 1.2
---
$id: http://devicetree.org/schemas/sound/nvidia,tegra210-mbdrc.yaml#
$schema: http://devicetree.org/meta-schemas/core.yaml#

title: Tegra210 MBDRC

description:
  The Multi Band Dynamic Range Compressor (MBDRC) is part of Output
  Processing Engine (OPE) which interfaces with Audio Hub (AHUB) via
  Audio Client Interface (ACIF). MBDRC can be used as a traditional
  single full band or a dual band or a multi band dynamic processor.

maintainers:
  - Jon Hunter <jonathanh@nvidia.com>
  - Mohan Kumar <mkumard@nvidia.com>
  - Sameer Pujar <spujar@nvidia.com>

properties:
  compatible:
    oneOf:
      - const: nvidia,tegra210-mbdrc
      - items:
          - enum:
              - nvidia,tegra264-mbdrc
              - nvidia,tegra234-mbdrc
              - nvidia,tegra194-mbdrc
              - nvidia,tegra186-mbdrc
          - const: nvidia,tegra210-mbdrc

  reg:
    maxItems: 1

required:
  - compatible
  - reg

additionalProperties: false

examples:
  - |
    dynamic-range-compressor@702d8200 {
        compatible = "nvidia,tegra210-mbdrc";
        reg = <0x702d8200 0x200>;
    };

...
```

## Documentation/devicetree/bindings/sound/nvidia,tegra210-mixer.yaml
```yaml
# SPDX-License-Identifier: (GPL-2.0-only OR BSD-2-Clause)
%YAML 1.2
---
$id: http://devicetree.org/schemas/sound/nvidia,tegra210-mixer.yaml#
$schema: http://devicetree.org/meta-schemas/core.yaml#

title: Tegra210 Mixer

description: |
  The Mixer supports mixing of up to ten 7.1 audio input streams and
  generate five outputs (each of which can be any combination of the
  ten input streams).

maintainers:
  - Jon Hunter <jonathanh@nvidia.com>
  - Mohan Kumar <mkumard@nvidia.com>
  - Sameer Pujar <spujar@nvidia.com>

allOf:
  - $ref: name-prefix.yaml#

properties:
  $nodename:
    pattern: "^amixer@[0-9a-f]*$"

  compatible:
    oneOf:
      - const: nvidia,tegra210-amixer
      - items:
          - enum:
              - nvidia,tegra234-amixer
              - nvidia,tegra194-amixer
              - nvidia,tegra186-amixer
          - const: nvidia,tegra210-amixer

  reg:
    maxItems: 1

  sound-name-prefix:
    pattern: "^MIXER[1-9]$"

  ports:
    $ref: /schemas/graph.yaml#/properties/ports
    description: |
      Mixer has ten inputs and five outputs. Accordingly ACIF (Audio
      Client Interfaces) port nodes are defined to represent Mixer
      inputs (port 0 to 9) and outputs (port 10 to 14). These are
      connected to corresponding ports on AHUB (Audio Hub).

    patternProperties:
      '^port@[0-9]':
        $ref: audio-graph-port.yaml#
        unevaluatedProperties: false
        description: Mixer ACIF input ports
      '^port@[10-14]':
        $ref: audio-graph-port.yaml#
        unevaluatedProperties: false
        description: Mixer ACIF output ports

required:
  - compatible
  - reg

additionalProperties: false

examples:
  - |

    amixer@702dbb00 {
        compatible = "nvidia,tegra210-amixer";
        reg = <0x702dbb00 0x800>;
        sound-name-prefix = "MIXER1";
    };

...
```

## Documentation/devicetree/bindings/sound/nvidia,tegra210-mvc.yaml
```yaml
# SPDX-License-Identifier: (GPL-2.0-only OR BSD-2-Clause)
%YAML 1.2
---
$id: http://devicetree.org/schemas/sound/nvidia,tegra210-mvc.yaml#
$schema: http://devicetree.org/meta-schemas/core.yaml#

title: Tegra210 MVC

description: |
  The Master Volume Control (MVC) provides gain or attenuation to a digital
  signal path. It can be used in input or output signal path for per-stream
  volume control or it can be used as master volume control. The MVC block
  has one input and one output. The input digital stream can be mono or
  multi-channel (up to 7.1 channels) stream. An independent mute control is
  also included in the MVC block.

maintainers:
  - Jon Hunter <jonathanh@nvidia.com>
  - Mohan Kumar <mkumard@nvidia.com>
  - Sameer Pujar <spujar@nvidia.com>

allOf:
  - $ref: name-prefix.yaml#

properties:
  $nodename:
    pattern: "^mvc@[0-9a-f]*$"

  compatible:
    oneOf:
      - const: nvidia,tegra210-mvc
      - items:
          - enum:
              - nvidia,tegra234-mvc
              - nvidia,tegra194-mvc
              - nvidia,tegra186-mvc
          - const: nvidia,tegra210-mvc

  reg:
    maxItems: 1

  sound-name-prefix:
    pattern: "^MVC[1-9]$"

  ports:
    $ref: /schemas/graph.yaml#/properties/ports
    properties:
      port@0:
        $ref: audio-graph-port.yaml#
        unevaluatedProperties: false
        description: |
          MVC ACIF (Audio Client Interface) input port. This is connected
          to corresponding ACIF output port on AHUB (Audio Hub).

      port@1:
        $ref: audio-graph-port.yaml#
        unevaluatedProperties: false
        description: |
          MVC ACIF output port. This is connected to corresponding ACIF
          input port on AHUB.

required:
  - compatible
  - reg

additionalProperties: false

examples:
  - |

    mvc@702da000 {
        compatible = "nvidia,tegra210-mvc";
        reg = <0x702da000 0x200>;
        sound-name-prefix = "MVC1";
    };

...
```

## Documentation/devicetree/bindings/sound/nvidia,tegra210-ope.yaml
```yaml
# SPDX-License-Identifier: (GPL-2.0-only OR BSD-2-Clause)
%YAML 1.2
---
$id: http://devicetree.org/schemas/sound/nvidia,tegra210-ope.yaml#
$schema: http://devicetree.org/meta-schemas/core.yaml#

title: Tegra210 OPE

description:
  The Output Processing Engine (OPE) is one of the AHUB client. It has
  PEQ (Parametric Equalizer) and MBDRC (Multi Band Dynamic Range Compressor)
  sub blocks for data processing.

maintainers:
  - Jon Hunter <jonathanh@nvidia.com>
  - Mohan Kumar <mkumard@nvidia.com>
  - Sameer Pujar <spujar@nvidia.com>

allOf:
  - $ref: name-prefix.yaml#

properties:
  compatible:
    oneOf:
      - const: nvidia,tegra210-ope
      - items:
          - enum:
              - nvidia,tegra234-ope
              - nvidia,tegra194-ope
              - nvidia,tegra186-ope
          - const: nvidia,tegra210-ope

  reg:
    maxItems: 1

  "#address-cells":
    const: 1

  "#size-cells":
    const: 1

  ranges: true

  sound-name-prefix:
    pattern: "^OPE[1-9]$"

  ports:
    $ref: /schemas/graph.yaml#/properties/ports
    properties:
      port@0:
        $ref: audio-graph-port.yaml#
        unevaluatedProperties: false
        description:
          OPE ACIF (Audio Client Interface) input port. This is connected
          to corresponding ACIF output port on AHUB (Audio Hub).

      port@1:
        $ref: audio-graph-port.yaml#
        unevaluatedProperties: false
        description:
          OPE ACIF output port. This is connected to corresponding ACIF
          input port on AHUB.

patternProperties:
  '^equalizer@[0-9a-f]+$':
    type: object
    $ref: nvidia,tegra210-peq.yaml#

  '^dynamic-range-compressor@[0-9a-f]+$':
    type: object
    $ref: nvidia,tegra210-mbdrc.yaml#

required:
  - compatible
  - reg

additionalProperties: false

examples:
  - |
    processing-engine@702d8000 {
        compatible = "nvidia,tegra210-ope";
        reg = <0x702d8000 0x100>;
        sound-name-prefix = "OPE1";
    };

...
```

## Documentation/devicetree/bindings/sound/nvidia,tegra210-peq.yaml
```yaml
# SPDX-License-Identifier: (GPL-2.0-only OR BSD-2-Clause)
%YAML 1.2
---
$id: http://devicetree.org/schemas/sound/nvidia,tegra210-peq.yaml#
$schema: http://devicetree.org/meta-schemas/core.yaml#

title: Tegra210 PEQ

description:
  The Parametric Equalizer (PEQ) is a cascade of biquad filters with
  each filter tuned based on certain parameters. It can be used to
  equalize the irregularities in the speaker frequency response.
  PEQ sits inside Output Processing Engine (OPE) which interfaces
  with Audio Hub (AHUB) via Audio Client Interface (ACIF).

maintainers:
  - Jon Hunter <jonathanh@nvidia.com>
  - Mohan Kumar <mkumard@nvidia.com>
  - Sameer Pujar <spujar@nvidia.com>

properties:
  compatible:
    oneOf:
      - const: nvidia,tegra210-peq
      - items:
          - enum:
              - nvidia,tegra234-peq
              - nvidia,tegra194-peq
              - nvidia,tegra186-peq
          - const: nvidia,tegra210-peq

  reg:
    maxItems: 1

required:
  - compatible
  - reg

additionalProperties: false

examples:
  - |
    equalizer@702d8100 {
        compatible = "nvidia,tegra210-peq";
        reg = <0x702d8100 0x100>;
    };

...
```

## Documentation/devicetree/bindings/sound/nvidia,tegra210-sfc.yaml
```yaml
# SPDX-License-Identifier: (GPL-2.0-only OR BSD-2-Clause)
%YAML 1.2
---
$id: http://devicetree.org/schemas/sound/nvidia,tegra210-sfc.yaml#
$schema: http://devicetree.org/meta-schemas/core.yaml#

title: Tegra210 SFC

description: |
  The Sampling Frequency Converter (SFC) converts the sampling frequency
  of the input signal from one frequency to another. It supports sampling
  frequency conversions of streams of up to two channels (stereo).

maintainers:
  - Jon Hunter <jonathanh@nvidia.com>
  - Mohan Kumar <mkumard@nvidia.com>
  - Sameer Pujar <spujar@nvidia.com>

allOf:
  - $ref: dai-common.yaml#

properties:
  $nodename:
    pattern: "^sfc@[0-9a-f]*$"

  compatible:
    oneOf:
      - const: nvidia,tegra210-sfc
      - items:
          - enum:
              - nvidia,tegra264-sfc
              - nvidia,tegra234-sfc
              - nvidia,tegra194-sfc
              - nvidia,tegra186-sfc
          - const: nvidia,tegra210-sfc

  reg:
    maxItems: 1

  sound-name-prefix:
    pattern: "^SFC[1-9]$"

  ports:
    $ref: /schemas/graph.yaml#/properties/ports
    properties:
      port@0:
        $ref: audio-graph-port.yaml#
        unevaluatedProperties: false
        description: |
          SFC ACIF (Audio Client Interface) input port. This is connected
          to corresponding ACIF output port on AHUB (Audio Hub).

      port@1:
        $ref: audio-graph-port.yaml#
        unevaluatedProperties: false
        description: |
          SFC ACIF output port. This is connected to corresponding ACIF
          input port on AHUB.

required:
  - compatible
  - reg

additionalProperties: false

examples:
  - |

    sfc@702d2000 {
        compatible = "nvidia,tegra210-sfc";
        reg = <0x702d2000 0x200>;
        sound-name-prefix = "SFC1";
    };

...
```
