## Documentation/devicetree/bindings/sound/img,i2s-in.txt
```
Imagination Technologies I2S Input Controller

Required Properties:

  - compatible : Compatible list, must contain "img,i2s-in"

  - #sound-dai-cells : Must be equal to 0

  - reg : Offset and length of the register set for the device

  - clocks : Contains an entry for each entry in clock-names

  - clock-names : Must include the following entry:
	"sys"	The system clock

  - dmas: Contains an entry for each entry in dma-names.

  - dma-names: Must include the following entry:
	"rx"	Single DMA channel used by all active I2S channels

  - img,i2s-channels : Number of I2S channels instantiated in the I2S in block

Optional Properties:

  - interrupts : Contains the I2S in interrupts. Depending on
	the configuration, there may be no interrupts, one interrupt,
	or an interrupt per I2S channel. For the case where there is
	one interrupt per channel, the interrupts should be listed
	in ascending channel order

  - resets: Contains a phandle to the I2S in reset signal

  - reset-names: Contains the reset signal name "rst"

Example:

i2s_in: i2s-in@18100800 {
	compatible = "img,i2s-in";
	reg = <0x18100800 0x200>;
	interrupts = <GIC_SHARED 7 IRQ_TYPE_LEVEL_HIGH>;
	dmas = <&mdc 30 0xffffffff 0>;
	dma-names = "rx";
	clocks = <&cr_periph SYS_CLK_I2S_IN>;
	clock-names = "sys";
	img,i2s-channels = <6>;
	#sound-dai-cells = <0>;
};
```

## Documentation/devicetree/bindings/sound/img,i2s-out.txt
```
Imagination Technologies I2S Output Controller

Required Properties:

  - compatible : Compatible list, must contain "img,i2s-out"

  - #sound-dai-cells : Must be equal to 0

  - reg : Offset and length of the register set for the device

  - clocks : Contains an entry for each entry in clock-names

  - clock-names : Must include the following entries:
	"sys"	The system clock
	"ref"	The reference clock

  - dmas: Contains an entry for each entry in dma-names.

  - dma-names: Must include the following entry:
	"tx"	Single DMA channel used by all active I2S channels

  - img,i2s-channels : Number of I2S channels instantiated in the I2S out block

  - resets: Contains a phandle to the I2S out reset signal

  - reset-names: Contains the reset signal name "rst"

Optional Properties:

  - interrupts : Contains the I2S out interrupts. Depending on
	the configuration, there may be no interrupts, one interrupt,
	or an interrupt per I2S channel. For the case where there is
	one interrupt per channel, the interrupts should be listed
	in ascending channel order

Example:

i2s_out: i2s-out@18100a00 {
	compatible = "img,i2s-out";
	reg = <0x18100A00 0x200>;
	interrupts = <GIC_SHARED 13 IRQ_TYPE_LEVEL_HIGH>;
	dmas = <&mdc 23 0xffffffff 0>;
	dma-names = "tx";
	clocks = <&cr_periph SYS_CLK_I2S_OUT>,
		 <&clk_core CLK_I2S>;
	clock-names = "sys", "ref";
	img,i2s-channels = <6>;
	resets = <&pistachio_reset PISTACHIO_RESET_I2S_OUT>;
	reset-names = "rst";
	#sound-dai-cells = <0>;
};
```

## Documentation/devicetree/bindings/sound/img,parallel-out.txt
```
Imagination Technologies Parallel Output Controller

Required Properties:

  - compatible : Compatible list, must contain "img,parallel-out".

  - #sound-dai-cells : Must be equal to 0

  - reg : Offset and length of the register set for the device.

  - dmas: Contains an entry for each entry in dma-names.

  - dma-names: Must include the following entry:
	"tx"

  - clocks : Contains an entry for each entry in clock-names.

  - clock-names : Includes the following entries:
	"sys"	The system clock
	"ref"	The reference clock

  - resets: Contains a phandle to the parallel out reset signal

  - reset-names: Contains the reset signal name "rst"

Optional Properties:

  - interrupts : Contains the parallel out interrupt, if present

Example:

parallel_out: parallel-out@18100c00 {
	compatible = "img,parallel-out";
	reg = <0x18100C00 0x100>;
	interrupts = <GIC_SHARED 19 IRQ_TYPE_LEVEL_HIGH>;
	dmas = <&mdc 16 0xffffffff 0>;
	dma-names = "tx";
	clocks = <&cr_periph SYS_CLK_PAUD_OUT>,
		 <&clk_core CLK_AUDIO_DAC>;
	clock-names = "sys", "ref";
	resets = <&pistachio_reset PISTACHIO_RESET_PRL_OUT>;
	reset-names = "rst";
	#sound-dai-cells = <0>;
};
```

## Documentation/devicetree/bindings/sound/img,pistachio-internal-dac.txt
```
Pistachio internal DAC DT bindings

Required properties:

  - compatible: "img,pistachio-internal-dac"

  - img,cr-top : Must contain a phandle to the top level control syscon
		 node which contains the internal dac control registers

  - VDD-supply : Digital power supply regulator (+1.8V or +3.3V)

Examples:

internal_dac: internal-dac {
	compatible = "img,pistachio-internal-dac";
	img,cr-top = <&cr_top>;
	VDD-supply = <&supply3v3>;
};
```

## Documentation/devicetree/bindings/sound/img,spdif-in.txt
```
Imagination Technologies SPDIF Input Controller

Required Properties:

  - compatible : Compatible list, must contain "img,spdif-in"

  - #sound-dai-cells : Must be equal to 0

  - reg : Offset and length of the register set for the device

  - dmas: Contains an entry for each entry in dma-names.

  - dma-names: Must include the following entry:
	"rx"

  - clocks : Contains an entry for each entry in clock-names

  - clock-names : Includes the following entries:
	"sys"	The system clock

Optional Properties:

  - resets: Should contain a phandle to the spdif in reset signal, if any

  - reset-names: Should contain the reset signal name "rst", if a
	reset phandle is given

  - interrupts : Contains the spdif in interrupt, if present

Example:

spdif_in: spdif-in@18100e00 {
	compatible = "img,spdif-in";
	reg = <0x18100E00 0x100>;
	interrupts = <GIC_SHARED 20 IRQ_TYPE_LEVEL_HIGH>;
	dmas = <&mdc 15 0xffffffff 0>;
	dma-names = "rx";
	clocks = <&cr_periph SYS_CLK_SPDIF_IN>;
	clock-names = "sys";
	#sound-dai-cells = <0>;
};
```

## Documentation/devicetree/bindings/sound/img,spdif-out.txt
```
Imagination Technologies SPDIF Output Controller

Required Properties:

  - compatible : Compatible list, must contain "img,spdif-out"

  - #sound-dai-cells : Must be equal to 0

  - reg : Offset and length of the register set for the device

  - dmas: Contains an entry for each entry in dma-names.

  - dma-names: Must include the following entry:
	"tx"

  - clocks : Contains an entry for each entry in clock-names.

  - clock-names : Includes the following entries:
	"sys"	The system clock
	"ref"	The reference clock

  - resets: Contains a phandle to the spdif out reset signal

  - reset-names: Contains the reset signal name "rst"

Optional Properties:

  - interrupts : Contains the parallel out interrupt, if present

Example:

spdif_out: spdif-out@18100d00 {
	compatible = "img,spdif-out";
	reg = <0x18100D00 0x100>;
	interrupts = <GIC_SHARED 21 IRQ_TYPE_LEVEL_HIGH>;
	dmas = <&mdc 14 0xffffffff 0>;
	dma-names = "tx";
	clocks = <&cr_periph SYS_CLK_SPDIF_OUT>,
		 <&clk_core CLK_SPDIF>;
	clock-names = "sys", "ref";
	resets = <&pistachio_reset PISTACHIO_RESET_SPDIF_OUT>;
	reset-names = "rst";
	#sound-dai-cells = <0>;
};
```

## Documentation/devicetree/bindings/sound/imx-audio-card.yaml
```yaml
# SPDX-License-Identifier: (GPL-2.0-only OR BSD-2-Clause)
%YAML 1.2
---
$id: http://devicetree.org/schemas/sound/imx-audio-card.yaml#
$schema: http://devicetree.org/meta-schemas/core.yaml#

title: NXP i.MX audio sound card.

maintainers:
  - Shengjiu Wang <shengjiu.wang@nxp.com>

allOf:
  - $ref: sound-card-common.yaml#

properties:
  compatible:
    enum:
      - fsl,imx-audio-card

patternProperties:
  ".*-dai-link$":
    description:
      Each subnode represents a dai link. Subnodes of each dai links would be
      cpu/codec dais.

    type: object

    properties:
      link-name:
        description: Indicates dai-link name and PCM stream name.
        $ref: /schemas/types.yaml#/definitions/string
        maxItems: 1

      format:
        description: audio format.
        items:
          enum:
            - i2s
            - dsp_b

      dai-tdm-slot-num:
        description: see tdm-slot.txt.
        $ref: /schemas/types.yaml#/definitions/uint32

      dai-tdm-slot-width:
        description: see tdm-slot.txt.
        $ref: /schemas/types.yaml#/definitions/uint32

      playback-only:
        description: link is used only for playback
        $ref: /schemas/types.yaml#/definitions/flag

      capture-only:
        description: link is used only for capture
        $ref: /schemas/types.yaml#/definitions/flag

      cpu:
        description: Holds subnode which indicates cpu dai.
        type: object
        additionalProperties: false
        properties:
          sound-dai:
            maxItems: 1

      codec:
        description: Holds subnode which indicates codec dai.
        type: object
        additionalProperties: false
        properties:
          sound-dai:
            minItems: 1
            maxItems: 2

      fsl,mclk-equal-bclk:
        description: Indicates mclk can be equal to bclk, especially for sai interface
        $ref: /schemas/types.yaml#/definitions/flag

    required:
      - link-name
      - cpu

    allOf:
      - not:
          required:
            - playback-only
            - capture-only

    additionalProperties: false

required:
  - compatible

unevaluatedProperties: false

examples:
  - |
    sound-ak4458 {
        compatible = "fsl,imx-audio-card";
        model = "ak4458-audio";
        pri-dai-link {
            link-name = "akcodec";
            format = "i2s";
            fsl,mclk-equal-bclk;
            cpu {
                 sound-dai = <&sai1>;
            };
            codec {
                 sound-dai = <&ak4458_1>, <&ak4458_2>;
            };
        };
        fe-dai-link {
            link-name = "HiFi-ASRC-FE";
            format = "i2s";
            cpu {
                sound-dai = <&easrc>;
            };
        };
        be-dai-link {
            link-name = "HiFi-ASRC-BE";
            format = "dsp_b";
            dai-tdm-slot-num = <8>;
            dai-tdm-slot-width = <32>;
            fsl,mclk-equal-bclk;
            cpu {
                sound-dai = <&sai1>;
            };
            codec {
                sound-dai = <&ak4458_1>, <&ak4458_2>;
            };
        };
    };
```

## Documentation/devicetree/bindings/sound/imx-audio-cs42888.txt
```
Freescale i.MX audio complex with CS42888 codec

Required properties:
- compatible : "fsl,imx-audio-cs42888"
- model : The user-visible name of this sound complex
- esai-controller : The phandle of the i.MX SSI controller
- audio-codec : The phandle of the CS42888 audio codec

Optional properties:
- asrc-controller : The phandle of the i.MX ASRC controller
- audio-routing : A list of the connections between audio components.
  Each entry is a pair of strings, the first being the connection's sink,
  the second being the connection's source. Valid names could be power
  supplies, CS42888 pins, and the jacks on the board:

Example:

sound {
	compatible = "fsl,imx6q-sabresd-wm8962",
		     "fsl,imx-audio-wm8962";
	model = "cs42888-audio";
	esai-controller = <&esai>;
	asrc-controller = <&asrc_p2p>;
	audio-codec = <&codec>;
};
```

## Documentation/devicetree/bindings/sound/imx-audio-es8328.txt
```
Freescale i.MX audio complex with ES8328 codec

Required properties:
- compatible       : "fsl,imx-audio-es8328"
- model            : The user-visible name of this sound complex
- ssi-controller   : The phandle of the i.MX SSI controller
- jack-gpio        : Optional GPIO for headphone jack
- audio-amp-supply : Power regulator for speaker amps
- audio-codec      : The phandle of the ES8328 audio codec
- audio-routing    : A list of the connections between audio components.
                     Each entry is a pair of strings, the first being the
		     connection's sink, the second being the connection's
		     source. Valid names could be power supplies, ES8328
		     pins, and the jacks on the board:

			Power supplies:
			   * audio-amp

			ES8328 pins:
			   * LOUT1
			   * LOUT2
			   * ROUT1
			   * ROUT2
			   * LINPUT1
			   * LINPUT2
			   * RINPUT1
			   * RINPUT2
			   * Mic PGA

			Board connectors:
			   * Headphone
			   * Speaker
			   * Mic Jack
- mux-int-port     : The internal port of the i.MX audio muxer (AUDMUX)
- mux-ext-port     : The external port of the i.MX audio muxer (AUDMIX)

Note: The AUDMUX port numbering should start at 1, which is consistent with
hardware manual.

Example:

sound {
	compatible = "fsl,imx-audio-es8328";
	model = "imx-audio-es8328";
	ssi-controller = <&ssi1>;
	audio-codec = <&codec>;
	jack-gpio = <&gpio5 15 0>;
	audio-amp-supply = <&reg_audio_amp>;
	audio-routing =
		"Speaker", "LOUT2",
		"Speaker", "ROUT2",
		"Speaker", "audio-amp",
		"Headphone", "ROUT1",
		"Headphone", "LOUT1",
		"LINPUT1", "Mic Jack",
		"RINPUT1", "Mic Jack",
		"Mic Jack", "Mic Bias";
	mux-int-port = <1>;
	mux-ext-port = <3>;
};
```

## Documentation/devicetree/bindings/sound/imx-audio-hdmi.yaml
```yaml
# SPDX-License-Identifier: (GPL-2.0-only OR BSD-2-Clause)
%YAML 1.2
---
$id: http://devicetree.org/schemas/sound/imx-audio-hdmi.yaml#
$schema: http://devicetree.org/meta-schemas/core.yaml#

title: NXP i.MX audio complex with HDMI

maintainers:
  - Shengjiu Wang <shengjiu.wang@nxp.com>

properties:
  compatible:
    enum:
      - fsl,imx-audio-hdmi
      - fsl,imx-audio-sii902x

  model:
    $ref: /schemas/types.yaml#/definitions/string
    description: User specified audio sound card name

  audio-cpu:
    $ref: /schemas/types.yaml#/definitions/phandle
    description: The phandle of an CPU DAI controller

  hdmi-out:
    type: boolean
    description: |
      This is a boolean property. If present, the transmitting function
      of HDMI will be enabled, indicating there's a physical HDMI out
      connector or jack on the board or it's connecting to some other IP
      block, such as an HDMI encoder or display-controller.

  hdmi-in:
    type: boolean
    description: |
      This is a boolean property. If present, the receiving function of
      HDMI will be enabled, indicating there is a physical HDMI in
      connector/jack on the board.

required:
  - compatible
  - model
  - audio-cpu

additionalProperties: false

examples:
  - |
    sound-hdmi {
        compatible = "fsl,imx-audio-hdmi";
        model = "audio-hdmi";
        audio-cpu = <&aud2htx>;
        hdmi-out;
    };
```

## Documentation/devicetree/bindings/sound/imx-audio-mqs.txt
```
Freescale i.MX audio complex with mqs codec

Required properties:
- compatible : "fsl,imx-audio-mqs"
- model : The user-visible name of this sound complex
- cpu-dai : The phandle of the i.MX sai controller
- audio-codec : The phandle of the mqs audio codec

Example:

sound-mqs {
	compatible = "fsl,imx6sx-sdb-mqs",
			"fsl,imx-audio-mqs";
	model = "mqs-audio";
	cpu-dai = <&sai1>;
	audio-codec = <&mqs>;
};
```
