## Documentation/devicetree/bindings/sound/google,cros-ec-codec.txt
```
Audio codec controlled by ChromeOS EC

Google's ChromeOS EC codec is a digital mic codec provided by the
Embedded Controller (EC) and is controlled via a host-command interface.

An EC codec node should only be found as a sub-node of the EC node (see
Documentation/devicetree/bindings/mfd/cros-ec.txt).

Required properties:
- compatible: Must contain "google,cros-ec-codec"
- #sound-dai-cells: Should be 1. The cell specifies number of DAIs.

Optional properties:
- reg: Pysical base address and length of shared memory region from EC.
       It contains 3 unsigned 32-bit integer.  The first 2 integers
       combine to become an unsigned 64-bit physical address.  The last
       one integer is length of the shared memory.
- memory-region: Shared memory region to EC.  A "shared-dma-pool".  See
                 ../reserved-memory/reserved-memory.txt for details.

Example:

{
	...

	reserved_mem: reserved_mem {
		compatible = "shared-dma-pool";
		reg = <0 0x52800000 0 0x100000>;
		no-map;
	};
}

cros-ec@0 {
	compatible = "google,cros-ec-spi";

	...

	cros_ec_codec: ec-codec {
		compatible = "google,cros-ec-codec";
		#sound-dai-cells = <1>;
		reg = <0x0 0x10500000 0x80000>;
		memory-region = <&reserved_mem>;
	};
};
```

## Documentation/devicetree/bindings/sound/google,cros-ec-codec.yaml
```yaml
# SPDX-License-Identifier: GPL-2.0-only
%YAML 1.2
---
$id: http://devicetree.org/schemas/sound/google,cros-ec-codec.yaml#
$schema: http://devicetree.org/meta-schemas/core.yaml#

title: Audio codec controlled by ChromeOS EC

maintainers:
  - Cheng-Yi Chiang <cychiang@chromium.org>
  - Tzung-Bi Shih <tzungbi@kernel.org>

description: |
  Google's ChromeOS EC codec is a digital mic codec provided by the
  Embedded Controller (EC) and is controlled via a host-command
  interface.  An EC codec node should only be found inside the "codecs"
  subnode of a cros-ec node.
  (see Documentation/devicetree/bindings/mfd/google,cros-ec.yaml).

properties:
  compatible:
    const: google,cros-ec-codec

  "#sound-dai-cells":
    const: 1

  reg:
    items:
      - description: |
          Physical base address and length of shared memory region from EC.
          It contains 3 unsigned 32-bit integer. The first 2 integers
          combine to become an unsigned 64-bit physical address.
          The last one integer is the length of the shared memory.

  memory-region:
    maxItems: 1
    description: |
      Shared memory region to EC.  A "shared-dma-pool".
      See ../reserved-memory/reserved-memory.txt for details.

required:
  - compatible
  - '#sound-dai-cells'

additionalProperties: false

examples:
  - |
    reserved_mem: reserved-mem@52800000 {
        compatible = "shared-dma-pool";
        reg = <0x52800000 0x100000>;
        no-map;
    };
    spi {
        #address-cells = <1>;
        #size-cells = <0>;
        cros-ec@0 {
            compatible = "google,cros-ec-spi";
            reg = <0>;

            codecs {
                #address-cells = <2>;
                #size-cells = <1>;

                cros_ec_codec: ec-codec@10500000 {
                    compatible = "google,cros-ec-codec";
                    #sound-dai-cells = <1>;
                    reg = <0x0 0x10500000 0x80000>;
                    memory-region = <&reserved_mem>;
                };

            };
        };
    };
```

## Documentation/devicetree/bindings/sound/google,goldfish-audio.yaml
```yaml
# SPDX-License-Identifier: (GPL-2.0-only OR BSD-2-Clause)
%YAML 1.2
---
$id: http://devicetree.org/schemas/sound/google,goldfish-audio.yaml#
$schema: http://devicetree.org/meta-schemas/core.yaml#

title: Android Goldfish Audio

maintainers:
  - Kuan-Wei Chiu <visitorckw@gmail.com>

description:
  Android goldfish audio device generated by Android emulator.

properties:
  compatible:
    const: google,goldfish-audio

  reg:
    maxItems: 1

  interrupts:
    maxItems: 1

required:
  - compatible
  - reg
  - interrupts

additionalProperties: false

examples:
  - |
    sound@9030000 {
        compatible = "google,goldfish-audio";
        reg = <0x9030000 0x100>;
        interrupts = <4>;
    };
```

## Documentation/devicetree/bindings/sound/google,sc7180-trogdor.yaml
```yaml
# SPDX-License-Identifier: (GPL-2.0-only OR BSD-2-Clause)
%YAML 1.2
---
$id: http://devicetree.org/schemas/sound/google,sc7180-trogdor.yaml#
$schema: http://devicetree.org/meta-schemas/core.yaml#

title: Google SC7180-Trogdor ASoC sound card driver

maintainers:
  - Rohit kumar <rohitkr@codeaurora.org>
  - Cheng-Yi Chiang <cychiang@chromium.org>

description:
  This binding describes the SC7180 sound card which uses LPASS for audio.

properties:
  compatible:
    enum:
      - google,sc7180-trogdor
      - google,sc7180-coachz

  audio-routing:
    $ref: /schemas/types.yaml#/definitions/non-unique-string-array
    description:
      A list of the connections between audio components. Each entry is a
      pair of strings, the first being the connection's sink, the second
      being the connection's source.

  model:
    $ref: /schemas/types.yaml#/definitions/string
    description: User specified audio sound card name

  "#address-cells":
    const: 1

  "#size-cells":
    const: 0

  dmic-gpios:
    maxItems: 1
    description: GPIO for switching between DMICs

patternProperties:
  "^dai-link(@[0-9])?$":
    description:
      Each subnode represents a dai link. Subnodes of each dai links would be
      cpu/codec dais.

    type: object

    properties:
      link-name:
        description: Indicates dai-link name and PCM stream name.
        $ref: /schemas/types.yaml#/definitions/string
        maxItems: 1

      reg:
        description: dai link address.

      cpu:
        description: Holds subnode which indicates cpu dai.
        type: object
        properties:
          sound-dai: true

      codec:
        description: Holds subnode which indicates codec dai.
        type: object
        properties:
          sound-dai: true

    required:
      - link-name
      - cpu
      - codec

    additionalProperties: false

required:
  - compatible
  - model
  - "#address-cells"
  - "#size-cells"

additionalProperties: false

examples:

  - |
    sound {
        compatible = "google,sc7180-trogdor";
        model = "sc7180-rt5682-max98357a-2mic";

        audio-routing =
                    "Headphone Jack", "HPOL",
                    "Headphone Jack", "HPOR";

        #address-cells = <1>;
        #size-cells = <0>;

        dmic-gpios = <&tlmm 86 0>;

        dai-link@0 {
            link-name = "MultiMedia0";
            reg = <0>;
            cpu {
                sound-dai = <&lpass_cpu 0>;
            };

            codec {
                sound-dai = <&alc5682 0>;
            };
        };

        dai-link@1 {
            link-name = "MultiMedia1";
            reg = <1>;
            cpu {
                sound-dai = <&lpass_cpu 1>;
            };

            codec {
                sound-dai = <&max98357a>;
            };
        };

        dai-link@2 {
            link-name = "MultiMedia2";
            reg = <2>;
            cpu {
                sound-dai = <&lpass_hdmi 0>;
            };

            codec {
                sound-dai = <&msm_dp>;
            };
        };
    };
```

## Documentation/devicetree/bindings/sound/google,sc7280-herobrine.yaml
```yaml
# SPDX-License-Identifier: (GPL-2.0-only OR BSD-2-Clause)
%YAML 1.2
---
$id: http://devicetree.org/schemas/sound/google,sc7280-herobrine.yaml#
$schema: http://devicetree.org/meta-schemas/core.yaml#

title: Google SC7280-Herobrine ASoC sound card driver

maintainers:
  - Srinivasa Rao Mandadapu <srivasam@codeaurora.org>
  - Judy Hsiao <judyhsiao@chromium.org>

description:
  This binding describes the SC7280 sound card which uses LPASS for audio.

properties:
  compatible:
    enum:
      - google,sc7280-herobrine

  audio-routing:
    $ref: /schemas/types.yaml#/definitions/non-unique-string-array
    description:
      A list of the connections between audio components. Each entry is a
      pair of strings, the first being the connection's sink, the second
      being the connection's source.

  model:
    $ref: /schemas/types.yaml#/definitions/string
    description: User specified audio sound card name

  "#address-cells":
    const: 1

  "#size-cells":
    const: 0

patternProperties:
  "^dai-link@[0-9a-f]$":
    description:
      Each subnode represents a dai link. Subnodes of each dai links would be
      cpu/codec dais.

    type: object

    properties:
      link-name:
        description: Indicates dai-link name and PCM stream name.
        $ref: /schemas/types.yaml#/definitions/string
        maxItems: 1

      reg:
        maxItems: 1
        description: dai link address.

      cpu:
        description: Holds subnode which indicates cpu dai.
        type: object
        properties:
          sound-dai: true

        required:
          - sound-dai

        additionalProperties: false

      codec:
        description: Holds subnode which indicates codec dai.
        type: object
        properties:
          sound-dai: true

        required:
          - sound-dai

        additionalProperties: false

      platform:
        description: Holds subnode which includes the phandle of q6apm platform device.
        type: object
        properties:
          sound-dai:
            maxItems: 1

        required:
          - sound-dai

        additionalProperties: false

    required:
      - link-name
      - cpu
      - codec
      - reg

    additionalProperties: false

required:
  - compatible
  - model
  - "#address-cells"
  - "#size-cells"

additionalProperties: false

examples:

  - |
    #include <dt-bindings/sound/qcom,lpass.h>
    sound {
        compatible = "google,sc7280-herobrine";
        model = "sc7280-wcd938x-max98360a-4dmic";

        audio-routing =
            "IN1_HPHL", "HPHL_OUT",
            "IN2_HPHR", "HPHR_OUT",
            "AMIC1", "MIC BIAS1",
            "AMIC2", "MIC BIAS2",
            "VA DMIC0", "MIC BIAS3",
            "VA DMIC1", "MIC BIAS3",
            "VA DMIC2", "MIC BIAS4",
            "VA DMIC3", "MIC BIAS4",
            "TX SWR_ADC0", "ADC1_OUTPUT",
            "TX SWR_ADC1", "ADC2_OUTPUT",
            "TX SWR_ADC2", "ADC3_OUTPUT",
            "TX SWR_DMIC0", "DMIC1_OUTPUT",
            "TX SWR_DMIC1", "DMIC2_OUTPUT",
            "TX SWR_DMIC2", "DMIC3_OUTPUT",
            "TX SWR_DMIC3", "DMIC4_OUTPUT";

        #address-cells = <1>;
        #size-cells = <0>;

        dai-link@0 {
            link-name = "WCD Playback";
            reg = <LPASS_CDC_DMA_RX0>;
            cpu {
                sound-dai = <&lpass_cpu LPASS_CDC_DMA_RX0>;
            };

            codec {
                sound-dai = <&wcd938x 0>, <&swr0 0>, <&rxmacro 0>;
            };
        };
        dai-link@1 {
            link-name = "WCD Capture";
            reg = <LPASS_CDC_DMA_TX3>;
            cpu {
                sound-dai = <&lpass_cpu LPASS_CDC_DMA_TX3>;
            };

            codec {
                sound-dai = <&wcd938x 1>, <&swr1 0>, <&txmacro 0>;
            };
        };

        dai-link@2 {
            link-name = "MI2S Playback";
            reg = <MI2S_SECONDARY>;
            cpu {
                sound-dai = <&lpass_cpu MI2S_SECONDARY>;
            };

            codec {
                sound-dai = <&max98360a>;
            };
        };

        dai-link@3 {
            link-name = "DMIC Capture";
            reg = <LPASS_CDC_DMA_VA_TX0>;
            cpu {
                sound-dai = <&lpass_cpu LPASS_CDC_DMA_VA_TX0>;
            };

            codec {
                sound-dai = <&vamacro 0>;
            };
        };

        dai-link@5 {
            link-name = "DP Playback";
            reg = <LPASS_DP_RX>;
            cpu {
                sound-dai = <&lpass_cpu LPASS_DP_RX>;
            };

            codec {
                sound-dai = <&mdss_dp>;
            };
        };
    };
```
