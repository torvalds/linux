## Documentation/devicetree/bindings/sound/gpio-audio-amp.yaml
```yaml
# SPDX-License-Identifier: (GPL-2.0-only OR BSD-2-Clause)
%YAML 1.2
---
$id: http://devicetree.org/schemas/sound/gpio-audio-amp.yaml#
$schema: http://devicetree.org/meta-schemas/core.yaml#

title: Audio amplifier driven by GPIOs

maintainers:
  - Herve Codina <herve.codina@bootlin.com>

description: |
  Audio GPIO amplifiers are driven by GPIO in order to control the gain value
  of the amplifier, its mute function and/or its bypass function.

  Those amplifiers are based on discrete components (analog switches, op-amps
  and more) where some of them, mostly analog switches, are controlled by GPIOs
  to adjust the gain value of the whole amplifier and/or to control
  the mute and/or bypass function.

  For instance, the following piece of hardware is a GPIO amplifier

                                         +5VA
                                           ^
                                        |\ |
                                        | \
        Vin >---------------------------|+ \
                                        |   +-------+-----> Vout
                .--\/\/\/--+------------|- /        |
                |          |            | /         |
                v          |            |/ |        |
               GND         o               v        |
                            \             GND       |
       gpio >----------->    \                      |
                         o    o                     |
                         |    |                     |
                         |    '--\/\/\/--.          |
                         |               +--\/\/\/--'
                         '---------------'

properties:
  compatible:
    oneOf:
      - const: gpio-audio-amp-mono
        description:
          A single channel amplifier. All features apply to this sole channel.

      - const: gpio-audio-amp-stereo
        description:
          A dual channel amplifier (left and right). All features apply to both
          channels producing the same effect on both channels at the same time.

  vdd-supply:
    description: Main power supply of the amplifier

  vddio-supply:
    description: Power supply related to the control path

  vdda1-supply:
    description: Analog power supply

  vdda2-supply:
    description: Additional analog power supply

  mute-gpios:
    description: GPIO to control the mute function
    maxItems: 1

  bypass-gpios:
    description: GPIO to control the bypass function
    maxItems: 1

  gain-gpios:
    description: |
      GPIOs to control the amplifier gain

      The gain value is computed from GPIOs value from 0 to 2^N-1 with N the
      number of GPIO described. The first GPIO described is the lsb of the gain
      value.

      For instance assuming 2 gpios
         gain-gpios = <&gpio1 GPIO_ACTIVE_HIGH> <&gpio2 GPIO_ACTIVE_HIGH>;
      The gain value will be the following:

          gpio1 | gpio2 | gain
          ------+-------+-----
            0   |    0  | 0b00 -> 0
            1   |    0  | 0b01 -> 1
            0   |    1  | 0b10 -> 2
            1   |    1  | 0b11 -> 3
          ------+-------+-----

      Note: The gain value, bits set to 1 or 0, indicate the state active (bit
            set) or the state inactive (bit unset) of the related GPIO. The
            physical voltage corresponding to this active/inactive state is
            given by the GPIO_ACTIVE_HIGH and GPIO_ACTIVE_LOW flags.

    minItems: 1
    maxItems: 16

  gain-ranges:
    $ref: /schemas/types.yaml#/definitions/int32-matrix
    description: |
      A list of one or more ranges of possible values. Each range is defined by
      the first and last point in the range. Each point is defined by the pair
      (GPIOs value, Gain in 0.01 dB unit).

      Ranges can be contiguous or holes can be present between ranges if some
      gpios value should not be used. Also in a range the first point and the
      last point can be identical. In that case, the range contains only one
      item, the given point.

    items:
      items:
        - description: GPIOs value of the first point in the range
        - description: Gain in 0.01 dB unit of the first point in the range
        - description: GPIOs value of the last point in the range
        - description: Gain in 0.01 dB unit of the last point in the range
      description: |
        A range defines a linear function (linear in dB) from the first point
        to the last point, both included. The number of items in the range is
          N = abs(first_point.gpio_value - last_point.gpio_value) + 1

        It allows to define the gain range from the first_point.gain to
        the last_point.gain, both points included.

             Gain (0.01 dB unit)
               ^
               |                      last
               +- - - - - - - - - - + point
               |                 +  .
               |              +     .
               |           +        .
               +- - - - +           .
               |  first .           .
               |  point .           .
               |        .           .
               +--------+-----------+---> gpios
                                          value

        Note: Even if first_point.gpio_value is lower than last_point.gpio_value
              and first_point.gain is lower than last_point.gain in the above
              graphic, all combination of values are supported leading to an
              increasing or a decreasing linear segment.

    minItems: 1
    maxItems: 65536

  gain-labels:
    $ref: /schemas/types.yaml#/definitions/string-array
    minItems: 2
    maxItems: 65536
    description: |
      List of the gain labels attached to the combination of GPIOs controlling
      the gain. The first label is related to the gain value 0, the second label
      is related to the gain value 1 and so on.

      With 2 GPIOs controlling the gain, GPIOs value can be 0, 1, 2 and 3.
      Assuming that gain value set the hardware according to the following
      table:

         GPIOs | Hardware
         value | amplification
         ------+--------------
           0   | Low
           1   | Middle
           2   | High
           3   | Max
         ------+--------------

      The description using gain labels can be:
        gain-labels = "Low", "Middle", "High", "Max";

dependencies:
  gain-ranges: [ gain-gpios ]
  gain-labels: [ gain-gpios ]

required:
  - compatible
  - vdd-supply

anyOf:
  - required:
      - gain-gpios
  - required:
      - mute-gpios
  - required:
      - bypass-gpios

allOf:
  - $ref: component-common.yaml#
  - if:
      required:
        - gain-ranges
    then:
      properties:
        gain-labels: false
  - if:
      required:
        - gain-labels
    then:
      properties:
        gain-ranges: false

unevaluatedProperties: false

examples:
  - |
    #include <dt-bindings/gpio/gpio.h>

    /* Gain controlled by gpios */
    amplifier-0 {
        compatible = "gpio-audio-amp-mono";
        vdd-supply = <&regulator>;
        gain-gpios = <&gpio 0 GPIO_ACTIVE_HIGH>, <&gpio 1 GPIO_ACTIVE_HIGH>;
    };

    /* Gain controlled by gpio using a simple range on a stereo amplifier */
    amplifier-1 {
        compatible = "gpio-audio-amp-stereo";
        vdd-supply = <&regulator>;
        gain-gpios = <&gpio 0 GPIO_ACTIVE_HIGH>, <&gpio 1 GPIO_ACTIVE_HIGH>;
        gain-ranges = <0 (-300) 3 600>;
    };

    /* Gain controlled by gpio with labels */
    amplifier-3 {
        compatible = "gpio-audio-amp-mono";
        vdd-supply = <&regulator>;
        gain-gpios = <&gpio 0 GPIO_ACTIVE_HIGH>;
        gain-labels = "Low", "High";
    };

    /* A mutable stereo amplifier without any gain control */
    amplifier-4 {
        compatible = "gpio-audio-amp-stereo";
        vdd-supply = <&regulator>;
        mute-gpios = <&gpio 0 GPIO_ACTIVE_HIGH>;
    };

    /*
     * Several supplies, gain controlled using more complex ranges, mute and
     * bypass.
     *
     * Assuming 3 gpios for controlling the gain with the following table
     *   gpios value    Gain
     *      0b000       Do not use (gpios value not allowed)
     *      0b001       - 3dB
     *      0b010       + 3dB
     *      0b011       + 10dB
     *      0b100       Do not use (gpios value not allowed)
     *      0b101       + 6dB
     *      0b110       + 7dB
     *      0b111       + 8dB
     */
    amplifier-5 {
        compatible = "gpio-audio-amp-mono";
        vdd-supply = <&regulator>;
        vddio-supply = <&regulator1>;
        vdda1-supply = <&regulator2>;
        gain-gpios = <&gpio 0 GPIO_ACTIVE_HIGH>,
                     <&gpio 1 GPIO_ACTIVE_HIGH>,
                     <&gpio 2 GPIO_ACTIVE_HIGH>;
        gain-ranges = <1 (-300) 2 300>,
                      <3 1000   3 1000>,
                      <5 600    7 800>;
        mute-gpios = <&gpio 3 GPIO_ACTIVE_HIGH>;
        bypass-gpios = <&gpio 4 GPIO_ACTIVE_HIGH>;
    };
...
```

## Documentation/devicetree/bindings/sound/gtm601.txt
```
GTM601 UMTS modem audio interface CODEC

This device has no configuration interface. The sample rate and channels are
based on the compatible string
	"option,gtm601" = 8kHz mono
	"broadmobi,bm818" = 48KHz stereo

Required properties:

  - compatible : one of
	"option,gtm601"
	"broadmobi,bm818"


Example:

codec: gtm601_codec {
	compatible = "option,gtm601";
};
```

## Documentation/devicetree/bindings/sound/gva-codec.txt
```
 GVA audio virtual codec

This device support generic audio link.

Required properties:

  - compatible : "rockchip,gva-codec"

Example:

codec: gva_codec {
	compatible = "rockchip,gva-codec";
	#sound-dai-cells = <0>;
};
```

## Documentation/devicetree/bindings/sound/hdmi.txt
```
Device-Tree bindings for dummy HDMI codec

Required properties:
	- compatible: should be "linux,hdmi-audio".

CODEC output pins:
  * TX

CODEC input pins:
  * RX

Example node:

	hdmi_audio: hdmi_audio@0 {
		compatible = "linux,hdmi-audio";
		status = "okay";
	};
```

## Documentation/devicetree/bindings/sound/hisilicon,hi3660-i2s.txt
```
* Hisilicon 6210 i2s controller

Required properties:

- compatible: should be one of the following:
   - "hisilicon,hi3660-i2s-1.0"
- reg: physical base address of the i2s controller unit and length of
   memory mapped region.
- interrupts: should contain the i2s interrupt.
- clocks: a list of phandle + clock-specifier pairs, one for each entry
  in clock-names.
- clock-names: should contain following:
   - "dacodec"
   - "i2s-base"
- dmas: DMA specifiers for tx dma. See the DMA client binding,
  Documentation/devicetree/bindings/dma/dma.txt
- dma-names: should be "tx" and "rx"
- hisilicon,sysctrl-syscon: phandle to sysctrl syscon
- #sound-dai-cells: Should be set to 1 (for multi-dai)

Example for the hi3660 i2s controller:

	i2s2: hisi_i2s {
		compatible = "hisilicon,hi3660-i2s-1.0";
		reg = <0x0 0xe804f800 0x0 0x400>,
			  <0x0 0xe804e000 0x0 0x400>;
		pinctrl-names = "default";
		pinctrl-0 = <&i2s2_pmx_func &i2s2_cfg_func>;
		dmas = <&asp_dmac 18 &asp_dmac 19>;
		dma-names = "rx", "tx";
		#sound-dai-cells = <0>;
	};

	sound {
		compatible = "simple-audio-card";
		simple-audio-card,name = "hikey-hdmi";
		simple-audio-card,format = "i2s";

		simple-audio-card,bitclock-master = <&sound_master>;
		simple-audio-card,frame-master = <&sound_master>;

		sound_master: simple-audio-card,cpu {
			sound-dai = <&i2s2>;
		};

		simple-audio-card,codec {
			sound-dai = <&adv7533>;
		};
	};
```

## Documentation/devicetree/bindings/sound/hisilicon,hi6210-i2s.txt
```
* Hisilicon 6210 i2s controller

Required properties:

- compatible: should be one of the following:
   - "hisilicon,hi6210-i2s"
- reg: physical base address of the i2s controller unit and length of
   memory mapped region.
- interrupts: should contain the i2s interrupt.
- clocks: a list of phandle + clock-specifier pairs, one for each entry
  in clock-names.
- clock-names: should contain following:
   - "dacodec"
   - "i2s-base"
- dmas: DMA specifiers for tx dma. See the DMA client binding,
  Documentation/devicetree/bindings/dma/dma.txt
- dma-names: should be "tx" and "rx"
- hisilicon,sysctrl-syscon: phandle to sysctrl syscon
- #sound-dai-cells: Should be set to 1 (for multi-dai)
   - The dai cell indexes reference the following interfaces:
       0: S2 interface
       (Currently that is the only one available, but more may be
        supported in the future)

Example for the hi6210 i2s controller:

i2s0: i2s@f7118000{
	compatible = "hisilicon,hi6210-i2s";
	reg = <0x0 0xf7118000 0x0 0x8000>; /* i2s unit */
	interrupts = <GIC_SPI 123 IRQ_TYPE_LEVEL_HIGH>; /* 155 "DigACodec_intr"-32 */
	clocks = <&sys_ctrl HI6220_DACODEC_PCLK>,
		 <&sys_ctrl HI6220_BBPPLL0_DIV>;
	clock-names = "dacodec", "i2s-base";
	dmas = <&dma0 15 &dma0 14>;
	dma-names = "rx", "tx";
	hisilicon,sysctrl-syscon = <&sys_ctrl>;
	#sound-dai-cells = <1>;
};

Then when referencing the i2s controller:
	sound-dai = <&i2s0 0>; /* index 0 => S2 interface */
```

## Documentation/devicetree/bindings/sound/hisilicon,hi6210-i2s.yaml
```yaml
# SPDX-License-Identifier: (GPL-2.0-only OR BSD-2-Clause)
%YAML 1.2
---
$id: http://devicetree.org/schemas/sound/hisilicon,hi6210-i2s.yaml#
$schema: http://devicetree.org/meta-schemas/core.yaml#

title: HiSilicon hi6210 I2S controller

maintainers:
  - John Stultz <john.stultz@linaro.org>

allOf:
  - $ref: dai-common.yaml#

properties:
  compatible:
    const: hisilicon,hi6210-i2s

  reg:
    maxItems: 1

  interrupts:
    maxItems: 1

  clocks:
    maxItems: 2

  clock-names:
    items:
      - const: dacodec
      - const: i2s-base

  dmas:
    maxItems: 2

  dma-names:
    items:
      - const: tx
      - const: rx

  hisilicon,sysctrl-syscon:
    $ref: /schemas/types.yaml#/definitions/phandle
    description: phandle to sysctrl syscon

  "#sound-dai-cells":
    const: 1
    description: |
      The dai cell indexes reference the following interfaces:
        0: S2 interface

required:
  - compatible
  - reg
  - interrupts
  - clocks
  - clock-names
  - dmas
  - dma-names
  - hisilicon,sysctrl-syscon
  - "#sound-dai-cells"

unevaluatedProperties: false

examples:
  - |
    #include <dt-bindings/interrupt-controller/arm-gic.h>
    #include <dt-bindings/clock/hi6220-clock.h>

    i2s@f7118000 {
        compatible = "hisilicon,hi6210-i2s";
        reg = <0xf7118000 0x8000>;
        interrupts = <GIC_SPI 123 IRQ_TYPE_LEVEL_HIGH>;
        clocks = <&sys_ctrl HI6220_DACODEC_PCLK>,
                 <&sys_ctrl HI6220_BBPPLL0_DIV>;
        clock-names = "dacodec", "i2s-base";
        dmas = <&dma0 14>, <&dma0 15>;
        dma-names = "tx", "rx";
        hisilicon,sysctrl-syscon = <&sys_ctrl>;
        #sound-dai-cells = <1>;
    };
```

## Documentation/devicetree/bindings/sound/ics43432.txt
```
Invensense ICS-43432-compatible MEMS microphone with I2S output.

There are no software configuration options for this device, indeed, the only
host connection is the I2S interface. Apart from requirements on clock
frequency (460 kHz to 3.379 MHz according to the data sheet) there must be
64 clock cycles in each stereo output frame; 24 of the 32 available bits
contain audio data. A hardware pin determines if the device outputs data
on the left or right channel of the I2S frame.

Required properties:
  - compatible: should be one of the following.
     "invensense,ics43432": For the Invensense ICS43432
     "cui,cmm-4030d-261": For the CUI CMM-4030D-261-I2S-TR

Example:

	ics43432: ics43432 {
		compatible = "invensense,ics43432";
	};
```
