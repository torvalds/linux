## Documentation/devicetree/bindings/sound/ts3a227e.txt
```
Texas Instruments TS3A227E
Autonomous Audio Accessory Detection and Configuration Switch

The TS3A227E detect headsets of 3-ring and 4-ring standards and
switches automatically to route the microphone correctly.  It also
handles key press detection in accordance with the Android audio
headset specification v1.0.

Required properties:

 - compatible:		Should contain "ti,ts3a227e".
 - reg:			The i2c address. Should contain <0x3b>.
 - interrupt-parent:	The parent interrupt controller
 - interrupts:		Interrupt number for /INT pin from the 227e

Optional properies:
 - ti,micbias:   Intended MICBIAS voltage (datasheet section 9.6.7).
      Select 0/1/2/3/4/5/6/7 to specify MACBIAS voltage
      2.1V/2.2V/2.3V/2.4V/2.5V/2.6V/2.7V/2.8V
      Default value is "1" (2.2V).

Examples:

	i2c {
		ts3a227e@3b {
			compatible = "ti,ts3a227e";
			reg = <0x3b>;
			interrupt-parent = <&gpio>;
			interrupts = <3 IRQ_TYPE_LEVEL_LOW>;
		};
	};
```

## Documentation/devicetree/bindings/sound/tscs42xx.txt
```
TSCS42XX Audio CODEC

Required Properties:

	- compatible :	"tempo,tscs42A1" for analog mic
			"tempo,tscs42A2" for digital mic

	- reg : 	<0x71> for analog mic
			<0x69> for digital mic

	- clock-names:	Must one of  the following "mclk1", "xtal", "mclk2"

	- clocks:	phandle of the clock that provides the codec sysclk

Example:

wookie: codec@69 {
	compatible = "tempo,tscs42A2";
	reg = <0x69>;
	clock-names = "xtal";
	clocks = <&audio_xtal>;
};
```

## Documentation/devicetree/bindings/sound/tscs454.txt
```
TSCS454 Audio CODEC

Required Properties:

	- compatible :	"tempo,tscs454"

	- reg : 	<0x69>

	- clock-names:	Must one of  the following "xtal", "mclk1", "mclk2"

	- clocks:	phandle of the clock that provides the codec sysclk

	Note: If clock is not provided then bit clock is assumed

Example:

redwood: codec@69 {
	#sound-dai-cells = <1>;
	compatible = "tempo,tscs454";
	reg = <0x69>;
	clock-names = "mclk1";
	clocks = <&audio_mclk>;
};
```

## Documentation/devicetree/bindings/sound/uda1334.txt
```
UDA1334 audio CODEC

This device uses simple GPIO pins for controlling codec settings.

Required properties:

  - compatible : "nxp,uda1334"
  - nxp,mute-gpios: a GPIO spec for the MUTE pin.
  - nxp,deemph-gpios: a GPIO spec for the De-emphasis pin

Example:

uda1334: audio-codec {
	compatible = "nxp,uda1334";
	nxp,mute-gpios = <&gpio1 8 GPIO_ACTIVE_LOW>;
	nxp,deemph-gpios = <&gpio3 3 GPIO_ACTIVE_LOW>;
};
```

## Documentation/devicetree/bindings/sound/uniphier,aio.txt
```
Socionext UniPhier SoC audio driver

The Socionext UniPhier audio subsystem consists of I2S and S/PDIF blocks in
the same register space.

Required properties:
- compatible      : should be one of the following:
		    "socionext,uniphier-ld11-aio"
		    "socionext,uniphier-ld20-aio"
		    "socionext,uniphier-pxs2-aio"
- reg             : offset and length of the register set for the device.
- interrupts      : should contain I2S or S/PDIF interrupt.
- pinctrl-names   : should be "default".
- pinctrl-0       : defined I2S signal pins for an external codec chip.
- clock-names     : should include following entries:
                    "aio"
- clocks          : a list of phandle, should contain an entry for each
                    entry in clock-names.
- reset-names     : should include following entries:
                    "aio"
- resets          : a list of phandle, should contain an entry for each
                    entry in reset-names.
- #sound-dai-cells: should be 1.

Optional properties:
- socionext,syscon: a phandle, should contain soc-glue.
                    The soc-glue is used for changing mode of S/PDIF signal pin
                    to Output from Hi-Z. This property is optional if you use
                    I2S signal pins only.

Example:
	audio {
		compatible = "socionext,uniphier-ld20-aio";
		reg = <0x56000000 0x80000>;
		interrupts = <0 144 4>;
		pinctrl-names = "default";
		pinctrl-0 = <&pinctrl_aout>;
		clock-names = "aio";
		clocks = <&sys_clk 40>;
		reset-names = "aio";
		resets = <&sys_rst 40>;
		#sound-dai-cells = <1>;

		socionext,syscon = <&sg>;
	};
```

## Documentation/devicetree/bindings/sound/uniphier,evea.txt
```
Socionext EVEA - UniPhier SoC internal codec driver

Required properties:
- compatible      : should be "socionext,uniphier-evea".
- reg             : offset and length of the register set for the device.
- clock-names     : should include following entries:
                    "evea", "exiv"
- clocks          : a list of phandle, should contain an entry for each
                    entries in clock-names.
- reset-names     : should include following entries:
                    "evea", "exiv", "adamv"
- resets          : a list of phandle, should contain reset entries of
                    reset-names.
- #sound-dai-cells: should be 1.

Example:

	codec {
		compatible = "socionext,uniphier-evea";
		reg = <0x57900000 0x1000>;
		clock-names = "evea", "exiv";
		clocks = <&sys_clk 41>, <&sys_clk 42>;
		reset-names = "evea", "exiv", "adamv";
		resets = <&sys_rst 41>, <&sys_rst 42>, <&adamv_rst 0>;
		#sound-dai-cells = <1>;
	};
```

## Documentation/devicetree/bindings/sound/ux500-mop500.txt
```
* MOP500 Audio Machine Driver

This node is responsible for linking together all ux500 Audio Driver components.

Required properties:
 - compatible              : "stericsson,snd-soc-mop500"

Non-standard properties:
 - stericsson,cpu-dai      : Phandle to the CPU-side DAI
 - stericsson,audio-codec  : Phandle to the Audio CODEC
 - stericsson,card-name    : Over-ride default card name

Example:

	sound {
		compatible = "stericsson,snd-soc-mop500";

		stericsson,cpu-dai = <&msp1 &msp3>;
		stericsson,audio-codec = <&codec>;
	};

	msp1: msp@80124000 {
		compatible = "stericsson,ux500-msp-i2s";
		reg = <0x80124000 0x1000>;
		interrupts = <0 62 0x4>;
		v-ape-supply = <&db8500_vape_reg>;
	};

	msp3: msp@80125000 {
		compatible = "stericsson,ux500-msp-i2s";
		reg = <0x80125000 0x1000>;
		interrupts = <0 62 0x4>;
		v-ape-supply = <&db8500_vape_reg>;
	};

	codec: ab8500-codec {
		compatible = "stericsson,ab8500-codec";
		stericsson,earpeice-cmv = <950>; /* Units in mV. */
	};
```

## Documentation/devicetree/bindings/sound/ux500-msp.txt
```
* ux500 MSP (CPU-side Digital Audio Interface)

Required properties:
 - compatible       :"stericsson,ux500-msp-i2s"
 - reg              : Physical base address and length of the device's registers.

Optional properties:
 - interrupts       : The interrupt output from the device.
 - interrupt-parent : The parent interrupt controller.
 - <name>-supply    : Phandle to the regulator <name> supply

Example:

	sound {
		compatible = "stericsson,snd-soc-mop500";

		stericsson,platform-pcm-dma = <&pcm>;
		stericsson,cpu-dai = <&msp1 &msp3>;
		stericsson,audio-codec = <&codec>;
	};

	pcm: ux500-pcm {
		compatible = "stericsson,ux500-pcm";
	};

	msp1: msp@80124000 {
		compatible = "stericsson,ux500-msp-i2s";
		reg = <0x80124000 0x1000>;
		interrupts = <0 62 0x4>;
		v-ape-supply = <&db8500_vape_reg>;
	};

	msp3: msp@80125000 {
		compatible = "stericsson,ux500-msp-i2s";
		reg = <0x80125000 0x1000>;
		interrupts = <0 62 0x4>;
		v-ape-supply = <&db8500_vape_reg>;
	};

	codec: ab8500-codec {
		compatible = "stericsson,ab8500-codec";
		stericsson,earpeice-cmv = <950>; /* Units in mV. */
	};
```

## Documentation/devicetree/bindings/sound/wlf,arizona.txt
```
Cirrus Logic Arizona class audio SoCs

These devices are audio SoCs with extensive digital capabilities and a range
of analogue I/O.

This document lists sound specific bindings, see the primary binding
document:
  ../mfd/arizona.txt

Optional properties:

  - wlf,inmode : A list of INn_MODE register values, where n is the number
    of input signals. Valid values are 0 (Differential), 1 (Single-ended) and
    2 (Digital Microphone). If absent, INn_MODE registers set to 0 by default.
    If present, values must be specified less than or equal to the number of
    input signals. If values less than the number of input signals, elements
    that have not been specified are set to 0 by default. Entries are:
    <IN1, IN2, IN3, IN4> (wm5102, wm5110, wm8280, wm8997)
    <IN1A, IN2A, IN1B, IN2B> (wm8998, wm1814)
  - wlf,out-mono : A list of boolean values indicating whether each output is
    mono or stereo. Position within the list indicates the output affected
    (eg. First entry in the list corresponds to output 1). A non-zero value
    indicates a mono output. If present, the number of values should be less
    than or equal to the number of outputs, if less values are supplied the
    additional outputs will be treated as stereo.

  - wlf,dmic-ref : DMIC reference voltage source for each input, can be
    selected from either MICVDD or one of the MICBIAS's, defines
    (ARIZONA_DMIC_xxxx) are provided in <dt-bindings/mfd/arizona.txt>. If
    present, the number of values should be less than or equal to the
    number of inputs, unspecified inputs will use the chip default.

  - wlf,max-channels-clocked : The maximum number of channels to be clocked on
    each AIF, useful for I2S systems with multiple data lines being mastered.
    Specify one cell for each AIF to be configured, specify zero for AIFs that
    should be handled normally.
    If present, number of cells must be less than or equal to the number of
    AIFs. If less than the number of AIFs, for cells that have not been
    specified the corresponding AIFs will be treated as default setting.

  - wlf,spk-fmt : PDM speaker data format, must contain 2 cells (OUT5 and OUT6).
    See the datasheet for values.
    The second cell is ignored for codecs that do not have OUT6 (wm5102, wm8997,
      wm8998, wm1814)

  - wlf,spk-mute : PDM speaker mute setting, must contain 2 cells (OUT5 and OUT6).
    See the datasheet for values.
    The second cell is ignored for codecs that do not have OUT6 (wm5102, wm8997,
    wm8998, wm1814)

  - wlf,out-volume-limit : The volume limit value that should be applied to each
    output channel. See the datasheet for exact values. Channels are specified
    in the order OUT1L, OUT1R, OUT2L, OUT2R, etc.
```
