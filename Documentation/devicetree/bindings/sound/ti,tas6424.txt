## Documentation/devicetree/bindings/sound/ti,tlv320aic32x4.yaml
```yaml
# SPDX-License-Identifier: (GPL-2.0-only OR BSD-2-Clause)
# Copyright (C) 2019 Texas Instruments Incorporated
%YAML 1.2
---
$id: http://devicetree.org/schemas/sound/ti,tlv320aic32x4.yaml#
$schema: http://devicetree.org/meta-schemas/core.yaml#

title: Texas Instruments TLV320AIC32x4 Stereo Audio codec

maintainers:
  - Alexander Stein <alexander.stein@ew.tq-group.com>

description: |
  The TLV320AIC32x4 audio codec can be accessed using I2C or SPI

properties:
  compatible:
    enum:
      - ti,tas2505
      - ti,tlv320aic32x4
      - ti,tlv320aic32x6

  reg:
    maxItems: 1

  clocks:
    items:
      - description: Master clock

  clock-names:
    items:
      - const: mclk

  av-supply:
    description: Analog core power supply

  dv-supply:
    description: Digital core power supply

  iov-supply:
    description: Digital IO power supply

  ldoin-supply:
    description: LDO power supply

  reset-gpios:
    maxItems: 1

  '#sound-dai-cells':
    const: 0

  aic32x4-gpio-func:
    description: |
       GPIO function configuration for pins MFP1-MFP5.
       Types are defined in include/sound/tlv320aic32x4.h
    $ref: /schemas/types.yaml#/definitions/uint32-array
    minItems: 5
    maxItems: 5

required:
  - compatible
  - reg
  - clocks
  - clock-names
  - iov-supply

allOf:
  - $ref: dai-common.yaml#
  - if:
      not:
        required:
          - ldoin-supply
    then:
      required:
        - av-supply
        - dv-supply

additionalProperties: false

examples:
  - |
    #include <dt-bindings/gpio/gpio.h>
    i2c {
      #address-cells = <1>;
      #size-cells = <0>;
      audio-codec@18 {
        compatible = "ti,tlv320aic32x4";
        reg = <0x18>;
        iov-supply = <&reg_3v3>;
        ldoin-supply = <&reg_3v3>;
        clocks = <&clks 201>;
        clock-names = "mclk";
        aic32x4-gpio-func= <
          0xff /* AIC32X4_MFPX_DEFAULT_VALUE */
          0xff /* AIC32X4_MFPX_DEFAULT_VALUE */
          0x04 /* MFP3 AIC32X4_MFP3_GPIO_ENABLED */
          0xff /* AIC32X4_MFPX_DEFAULT_VALUE */
          0x08 /* MFP5 AIC32X4_MFP5_GPIO_INPUT */
        >;
      };
    };
```

## Documentation/devicetree/bindings/sound/ti,tlv320aic3x.yaml
```yaml
# SPDX-License-Identifier: GPL-2.0-only OR BSD-2-Clause
# Copyright (C) 2022 Texas Instruments Incorporated
%YAML 1.2
---
$id: http://devicetree.org/schemas/sound/ti,tlv320aic3x.yaml#
$schema: http://devicetree.org/meta-schemas/core.yaml#

title: Texas Instruments TLV320AIC3x Codec

description: |
  TLV320AIC3x are a series of low-power stereo audio codecs with stereo
  headphone amplifier, as well as multiple inputs and outputs programmable in
  single-ended or fully differential configurations.

  The serial control bus supports SPI or I2C protocols, while the serial audio
  data bus is programmable for I2S, left/right-justified, DSP, or TDM modes.

  The following pins can be referred in the sound node's audio routing property:

  CODEC output pins:
     LLOUT
     RLOUT
     MONO_LOUT
     HPLOUT
     HPROUT
     HPLCOM
     HPRCOM

  CODEC input pins for TLV320AIC3104:
     MIC2L
     MIC2R
     LINE1L
     LINE1R

  CODEC input pins for other compatible codecs:
     MIC3L
     MIC3R
     LINE1L
     LINE2L
     LINE1R
     LINE2R

maintainers:
  - Jai Luthra <j-luthra@ti.com>

properties:
  compatible:
    enum:
      - ti,tlv320aic3x
      - ti,tlv320aic33
      - ti,tlv320aic3007
      - ti,tlv320aic3106
      - ti,tlv320aic3104

  reg:
    maxItems: 1

  reset-gpios:
    maxItems: 1
    description:
      GPIO specification for the active low RESET input.

  gpio-reset:
    $ref: /schemas/types.yaml#/definitions/uint32-matrix
    maxItems: 1
    description:
      Deprecated, please use reset-gpios instead.
    deprecated: true

  ai3x-gpio-func:
    description: AIC3X_GPIO1 & AIC3X_GPIO2 Functionality
    $ref: /schemas/types.yaml#/definitions/uint32-array
    maxItems: 2

  ai3x-micbias-vg:
    description: MicBias required voltage. If node is omitted then MicBias is powered down.
    $ref: /schemas/types.yaml#/definitions/uint32
    oneOf:
      - const: 1
        description: MICBIAS output is powered to 2.0V.
      - const: 2
        description: MICBIAS output is powered to 2.5V.
      - const: 3
        description: MICBIAS output is connected to AVDD.

  ai3x-ocmv:
    description: Output Common-Mode Voltage selection.
    $ref: /schemas/types.yaml#/definitions/uint32
    oneOf:
      - const: 0
        description: 1.35V
      - const: 1
        description: 1.5V
      - const: 2
        description: 1.65V
      - const: 3
        description: 1.8V

  AVDD-supply:
    description: Analog DAC voltage.

  IOVDD-supply:
    description: I/O voltage.

  DRVDD-supply:
    description: ADC analog and output driver voltage.

  DVDD-supply:
    description: Digital core voltage.

  '#sound-dai-cells':
    const: 0

  clocks:
    maxItems: 1

  port:
    $ref: audio-graph-port.yaml#
    unevaluatedProperties: false

required:
  - compatible
  - reg

additionalProperties: false

examples:
  - |
    #include <dt-bindings/gpio/gpio.h>
    i2c {
      #address-cells = <1>;
      #size-cells = <0>;

      tlv320aic3x_i2c: audio-codec@1b {
        compatible = "ti,tlv320aic3x";
        reg = <0x1b>;

        reset-gpios = <&gpio1 17 GPIO_ACTIVE_LOW>;

        AVDD-supply = <&regulator>;
        IOVDD-supply = <&regulator>;
        DRVDD-supply = <&regulator>;
        DVDD-supply = <&regulator>;
      };
    };

  - |
    #include <dt-bindings/gpio/gpio.h>
    spi {
      #address-cells = <1>;
      #size-cells = <0>;

      tlv320aic3x_spi: audio-codec@0 {
        compatible = "ti,tlv320aic3x";
        reg = <0>; /* CS number */
        #sound-dai-cells = <0>;

        AVDD-supply = <&regulator>;
        IOVDD-supply = <&regulator>;
        DRVDD-supply = <&regulator>;
        DVDD-supply = <&regulator>;
        ai3x-ocmv = <0>;
      };
    };

...
```

## Documentation/devicetree/bindings/sound/ti,tlv320dac3100.yaml
```yaml
# SPDX-License-Identifier: (GPL-2.0-only OR BSD-2-Clause)
%YAML 1.2
---
$id: http://devicetree.org/schemas/sound/ti,tlv320dac3100.yaml#
$schema: http://devicetree.org/meta-schemas/core.yaml#

title: Texas Instruments - tlv320aic31xx Codec module

maintainers:
  - Shenghao Ding <shenghao-ding@ti.com>

description: |
  CODEC output pins:
    * HPL
    * HPR
    * SPL, devices with stereo speaker amp
    * SPR, devices with stereo speaker amp
    * SPK, devices with mono speaker amp
    * MICBIAS

  CODEC input pins:
    * MIC1LP, devices with ADC
    * MIC1RP, devices with ADC
    * MIC1LM, devices with ADC
    * AIN1, devices without ADC
    * AIN2, devices without ADC

  The pins can be used in referring sound node's audio-routing property.

properties:
  compatible:
    enum:
      - ti,tlv320aic310x # - Generic TLV320AIC31xx with mono speaker amp
      - ti,tlv320aic311x # - Generic TLV320AIC31xx with stereo speaker amp
      - ti,tlv320aic3100 # - TLV320AIC3100 (mono speaker amp, no MiniDSP)
      - ti,tlv320aic3110 # - TLV320AIC3110 (stereo speaker amp, no MiniDSP)
      - ti,tlv320aic3120 # - TLV320AIC3120 (mono speaker amp, MiniDSP)
      - ti,tlv320aic3111 # - TLV320AIC3111 (stereo speaker amp, MiniDSP)
      - ti,tlv320dac3100 # - TLV320DAC3100 (no ADC, mono speaker amp, no MiniDSP)
      - ti,tlv320dac3101 # - TLV320DAC3101 (no ADC, stereo speaker amp, no MiniDSP)

  reg:
    maxItems: 1

  '#sound-dai-cells':
    const: 0

  HPVDD-supply: true

  SPRVDD-supply: true

  SPLVDD-supply: true

  AVDD-supply: true

  IOVDD-supply: true

  DVDD-supply: true

  reset-gpios:
    description: GPIO specification for the active low RESET input.

  ai31xx-micbias-vg:
    $ref: /schemas/types.yaml#/definitions/uint32
    default: 1
    enum: [1, 2, 3]
    description: |
      MicBias Voltage setting
        1 or MICBIAS_2_0V - MICBIAS output is powered to 2.0V
        2 or MICBIAS_2_5V - MICBIAS output is powered to 2.5V
        3 or MICBIAS_AVDD - MICBIAS output is connected to AVDD

  ai31xx-ocmv:
    $ref: /schemas/types.yaml#/definitions/uint32
    enum: [0, 1, 2, 3]
    description: |
      output common-mode voltage setting
        0 - 1.35V,
        1 - 1.5V,
        2 - 1.65V,
        3 - 1.8V

  gpio-reset:
    description: gpio pin number used for codec reset
    deprecated: true


required:
  - compatible
  - reg
  - HPVDD-supply
  - SPRVDD-supply
  - SPLVDD-supply
  - AVDD-supply
  - IOVDD-supply
  - DVDD-supply

allOf:
  - $ref: dai-common.yaml#

unevaluatedProperties: false

examples:
  - |
    #include <dt-bindings/gpio/gpio.h>
    #include <dt-bindings/sound/tlv320aic31xx.h>

    i2c {
        #address-cells = <1>;
        #size-cells = <0>;

        sound@18 {
            compatible = "ti,tlv320aic311x";
            reg = <0x18>;

            ai31xx-micbias-vg = <MICBIAS_2_0V>;
            reset-gpios = <&gpio1 17 GPIO_ACTIVE_LOW>;

            HPVDD-supply = <&regulator>;
            SPRVDD-supply = <&regulator>;
            SPLVDD-supply = <&regulator>;
            AVDD-supply = <&regulator>;
            IOVDD-supply = <&regulator>;
            DVDD-supply = <&regulator>;
       };
    };
```

## Documentation/devicetree/bindings/sound/ti,tpa6130a2.yaml
```yaml
# SPDX-License-Identifier: (GPL-2.0-only OR BSD-2-Clause)
%YAML 1.2
---
$id: http://devicetree.org/schemas/sound/ti,tpa6130a2.yaml#
$schema: http://devicetree.org/meta-schemas/core.yaml#

title: Texas Instruments - tpa6130a2 Codec module

maintainers:
  - Sebastian Reichel <sre@kernel.org>

description:
  Stereo, analog input headphone amplifier

properties:
  compatible:
    enum:
      - ti,tpa6130a2
      - ti,tpa6140a2

  reg:
    maxItems: 1

  Vdd-supply:
    description: power supply regulator

  power-gpio:
    description: gpio pin to power the device

required:
  - compatible
  - reg
  - Vdd-supply

allOf:
  - $ref: dai-common.yaml#

unevaluatedProperties: false

examples:
  - |
    #include <dt-bindings/gpio/gpio.h>

    i2c {
        #address-cells = <1>;
        #size-cells = <0>;

        amplifier@60 {
            compatible = "ti,tpa6130a2";
            reg = <0x60>;
            Vdd-supply = <&vmmc2>;
            power-gpio = <&gpio4 2 GPIO_ACTIVE_HIGH>;
       };
    };
```

## Documentation/devicetree/bindings/sound/ti,ts3a227e.yaml
```yaml
# SPDX-License-Identifier: (GPL-2.0-only OR BSD-2-Clause)
%YAML 1.2
---
$id: http://devicetree.org/schemas/sound/ti,ts3a227e.yaml#
$schema: http://devicetree.org/meta-schemas/core.yaml#

title: Texas Instruments TS3A227E
  Autonomous Audio Accessory Detection and Configuration Switch

maintainers:
  - Dylan Reid <dgreid@chromium.org>

description: |
  The TS3A227E detect headsets of 3-ring and 4-ring standards and
  switches automatically to route the microphone correctly. It also
  handles key press detection in accordance with the Android audio
  headset specification v1.0.

properties:
  compatible:
    enum:
      - ti,ts3a227e

  reg:
    const: 0x3b

  interrupts:
    maxItems: 1

  ti,micbias:
    $ref: /schemas/types.yaml#/definitions/uint32
    description: Intended MICBIAS voltage (datasheet section 9.6.7).
    enum:
      - 0 # 2.1 V
      - 1 # 2.2 V
      - 2 # 2.3 V
      - 3 # 2.4 V
      - 4 # 2.5 V
      - 5 # 2.6 V
      - 6 # 2.7 V
      - 7 # 2.8 V
    default: 1

  ti,debounce-release-ms:
    description: key release debounce time in ms (datasheet section 9.6.7).
    enum:
      - 0
      - 20
    default: 20

  ti,debounce-press-ms:
    description: key press debounce time in ms (datasheet section 9.6.7).
    enum:
      - 2
      - 40
      - 80
      - 120
    default: 80

  ti,debounce-insertion-ms:
    description: headset insertion debounce time in ms (datasheet section 9.6.5).
    enum:
      - 2
      - 30
      - 60
      - 90
      - 120
      - 150
      - 1000
      - 2000
    default: 90

required:
  - compatible
  - reg
  - interrupts

additionalProperties: false

examples:
  - |
    #include <dt-bindings/interrupt-controller/irq.h>
    i2c {
        #address-cells = <1>;
        #size-cells = <0>;
        codec: audio-controller@3b {
            compatible = "ti,ts3a227e";
            reg = <0x3b>;
            interrupt-parent = <&gpio1>;
            interrupts = <3 IRQ_TYPE_LEVEL_LOW>;
        };
    };

...
```

## Documentation/devicetree/bindings/sound/ti,twl4030-audio.yaml
```yaml
# SPDX-License-Identifier: (GPL-2.0-only OR BSD-2-Clause)
%YAML 1.2
---
$id: http://devicetree.org/schemas/sound/ti,twl4030-audio.yaml#
$schema: http://devicetree.org/meta-schemas/core.yaml#

title: Texas Instruments TWL4030-family Audio Module

maintainers:
  - Peter Ujfalusi <peter.ujfalusi@gmail.com>

description:
  The audio module within the TWL4030-family of companion chips consists
  of an audio codec and a vibra driver. This binding describes the parent
  node for these functions.

properties:
  compatible:
    const: ti,twl4030-audio

  codec:
    type: object
    description: Node containing properties for the audio codec functionality.

    properties:
      ti,digimic_delay:
        $ref: /schemas/types.yaml#/definitions/uint32
        description:
          Delay in milliseconds after enabling digital microphones to reduce
          artifacts.

      ti,ramp_delay_value:
        $ref: /schemas/types.yaml#/definitions/uint32
        description:
          Headset ramp delay configuration to reduce pop noise.

      ti,hs_extmute:
        type: boolean
        description:
          Enable the use of an external mute for headset pop reduction.

      ti,hs_extmute_gpio:
        $ref: /schemas/types.yaml#/definitions/phandle-array
        description:
          The GPIO specifier for the external mute control.
        maxItems: 1

      ti,offset_cncl_path:
        $ref: /schemas/types.yaml#/definitions/uint32
        description:
          Offset cancellation path selection. Refer to the Technical
          Reference Manual for valid values.

  # The 'codec' node itself is optional, but if it exists, it can be empty.
  # We don't require any of its sub-properties.

  ti,enable-vibra:
    $ref: /schemas/types.yaml#/definitions/uint32
    enum: [0, 1]
    description:
      Enable or disable the vibra functionality.

additionalProperties: false

required:
  - compatible

examples:
  - |
    i2c {
      #address-cells = <1>;
      #size-cells = <0>;

      twl: twl@48 {
        reg = <0x48>;
        interrupts = <7>; /* SYS_NIRQ cascaded to intc */
        interrupt-parent = <&intc>;

        twl_audio: audio {
          compatible = "ti,twl4030-audio";

          ti,enable-vibra = <1>;

          codec {
            ti,ramp_delay_value = <3>;
          };

        };
      };
    };
```
