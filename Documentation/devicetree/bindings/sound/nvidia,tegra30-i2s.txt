## Documentation/devicetree/bindings/sound/nvidia,tegra30-i2s.txt
```
NVIDIA Tegra30 I2S controller

Required properties:
- compatible : For Tegra30, must contain "nvidia,tegra30-i2s".  For Tegra124,
  must contain "nvidia,tegra124-i2s".  Otherwise, must contain
  "nvidia,<chip>-i2s" plus at least one of the above, where <chip> is
  tegra114 or tegra132.
- reg : Should contain I2S registers location and length
- clocks : Must contain one entry, for the module clock.
  See ../clocks/clock-bindings.txt for details.
- resets : Must contain an entry for each entry in reset-names.
  See ../reset/reset.txt for details.
- reset-names : Must include the following entries:
  - i2s
- nvidia,ahub-cif-ids : The list of AHUB CIF IDs for this port, rx (playback)
  first, tx (capture) second. See nvidia,tegra30-ahub.txt for values.

Example:

i2s@70080300 {
	compatible = "nvidia,tegra30-i2s";
	reg = <0x70080300 0x100>;
	nvidia,ahub-cif-ids = <4 4>;
	clocks = <&tegra_car 11>;
	resets = <&tegra_car 11>;
	reset-names = "i2s";
};
```

## Documentation/devicetree/bindings/sound/nvidia,tegra30-i2s.yaml
```yaml
# SPDX-License-Identifier: (GPL-2.0-only OR BSD-2-Clause)
%YAML 1.2
---
$id: http://devicetree.org/schemas/sound/nvidia,tegra30-i2s.yaml#
$schema: http://devicetree.org/meta-schemas/core.yaml#

title: NVIDIA Tegra30 I2S controller

maintainers:
  - Thierry Reding <treding@nvidia.com>
  - Jon Hunter <jonathanh@nvidia.com>

properties:
  compatible:
    oneOf:
      - enum:
          - nvidia,tegra124-i2s
          - nvidia,tegra30-i2s
      - items:
          - const: nvidia,tegra114-i2s
          - const: nvidia,tegra30-i2s

  reg:
    maxItems: 1

  clocks:
    maxItems: 1

  clock-names:
    const: i2s

  resets:
    maxItems: 1

  reset-names:
    const: i2s

  nvidia,ahub-cif-ids:
    description: list of AHUB CIF IDs
    $ref: /schemas/types.yaml#/definitions/uint32-array
    items:
      - description: rx (playback)
      - description: tx (capture)

required:
  - compatible
  - reg
  - clocks
  - resets
  - reset-names
  - nvidia,ahub-cif-ids

additionalProperties: false

examples:
  - |
    #include <dt-bindings/clock/tegra30-car.h>

    i2s@70080300 {
        compatible = "nvidia,tegra30-i2s";
        reg = <0x70080300 0x100>;
        nvidia,ahub-cif-ids = <4 4>;
        clocks = <&tegra_car TEGRA30_CLK_I2S0>;
        resets = <&tegra_car 30>;
        reset-names = "i2s";
    };
...
```

## Documentation/devicetree/bindings/sound/nxp,lpc3220-i2s.yaml
```yaml
# SPDX-License-Identifier: (GPL-2.0-only OR BSD-2-Clause)
%YAML 1.2
---
$id: http://devicetree.org/schemas/sound/nxp,lpc3220-i2s.yaml#
$schema: http://devicetree.org/meta-schemas/core.yaml#

title: NXP LPC32XX I2S Controller

description:
  The I2S controller in LPC32XX SoCs, ASoC DAI.

maintainers:
  - J.M.B. Downing <jonathan.downing@nautel.com>
  - Piotr Wojtaszczyk <piotr.wojtaszczyk@timesys.com>

allOf:
  - $ref: dai-common.yaml#

properties:
  compatible:
    enum:
      - nxp,lpc3220-i2s

  reg:
    maxItems: 1

  interrupts:
    maxItems: 1

  clocks:
    items:
      - description: input clock of the peripheral.

  dmas:
    items:
      - description: RX DMA Channel
      - description: TX DMA Channel

  dma-names:
    items:
      - const: rx
      - const: tx

  "#sound-dai-cells":
    const: 0

required:
  - compatible
  - reg
  - interrupts
  - clocks
  - dmas
  - dma-names
  - '#sound-dai-cells'

additionalProperties: false

examples:
  - |
    #include <dt-bindings/clock/lpc32xx-clock.h>
    #include <dt-bindings/interrupt-controller/irq.h>

    i2s@20094000 {
      compatible = "nxp,lpc3220-i2s";
      reg = <0x20094000 0x1000>;
      interrupts = <22 IRQ_TYPE_LEVEL_HIGH>;
      clocks = <&clk LPC32XX_CLK_I2S0>;
      dmas = <&dma 0 1>, <&dma 13 1>;
      dma-names = "rx", "tx";
      #sound-dai-cells = <0>;
    };

...
```

## Documentation/devicetree/bindings/sound/nxp,tfa9879.yaml
```yaml
# SPDX-License-Identifier: (GPL-2.0 OR BSD-2-Clause)
%YAML 1.2
---
$id: http://devicetree.org/schemas/sound/nxp,tfa9879.yaml#
$schema: http://devicetree.org/meta-schemas/core.yaml#

title: NXP TFA9879 class-D audio amplifier

maintainers:
  - Peter Rosin <peda@axentia.se>

allOf:
  - $ref: dai-common.yaml#

properties:
  compatible:
    const: nxp,tfa9879

  reg:
    maxItems: 1

  "#sound-dai-cells":
    const: 0

required:
  - compatible
  - reg
  - '#sound-dai-cells'

unevaluatedProperties: false

examples:
  - |
    i2c1 {
       #address-cells = <1>;
       #size-cells = <0>;
       amplifier@6c {
          compatible = "nxp,tfa9879";
          reg = <0x6c>;
          pinctrl-names = "default";
          pinctrl-0 = <&pinctrl_i2c1>;
          #sound-dai-cells = <0>;
       };
    };
```

## Documentation/devicetree/bindings/sound/nxp,tfa989x.yaml
```yaml
# SPDX-License-Identifier: (GPL-2.0-only OR BSD-2-Clause)
%YAML 1.2
---
$id: http://devicetree.org/schemas/sound/nxp,tfa989x.yaml#
$schema: http://devicetree.org/meta-schemas/core.yaml#

title: NXP/Goodix TFA989X (TFA1) Audio Amplifiers

maintainers:
  - Stephan Gerhold <stephan@gerhold.net>

allOf:
  - $ref: name-prefix.yaml#

properties:
  compatible:
    enum:
      - nxp,tfa9890
      - nxp,tfa9895
      - nxp,tfa9897

  reg:
    maxItems: 1

  '#sound-dai-cells':
    const: 0

  rcv-gpios:
    description: optional GPIO to be asserted when receiver mode is enabled.

  sound-name-prefix: true

  vddd-supply:
    description: regulator phandle for the VDDD power supply.

if:
  not:
    properties:
      compatible:
        const: nxp,tfa9897
then:
  properties:
    rcv-gpios: false

required:
  - compatible
  - reg
  - '#sound-dai-cells'

additionalProperties: false

examples:
  - |
    i2c {
      #address-cells = <1>;
      #size-cells = <0>;

      audio-codec@34 {
        compatible = "nxp,tfa9895";
        reg = <0x34>;
        sound-name-prefix = "Speaker Left";
        #sound-dai-cells = <0>;
      };
      audio-codec@36 {
        compatible = "nxp,tfa9895";
        reg = <0x36>;
        sound-name-prefix = "Speaker Right";
        #sound-dai-cells = <0>;
      };
    };

  - |
    #include <dt-bindings/gpio/gpio.h>
    i2c {
      #address-cells = <1>;
      #size-cells = <0>;

      speaker_codec_top: audio-codec@34 {
        compatible = "nxp,tfa9897";
        reg = <0x34>;
        vddd-supply = <&pm8916_l6>;
        rcv-gpios = <&msmgpio 50 GPIO_ACTIVE_HIGH>;
        pinctrl-names = "default";
        pinctrl-0 = <&speaker_top_default>;
        sound-name-prefix = "Speaker Top";
        #sound-dai-cells = <0>;
      };

      speaker_codec_bottom: audio-codec@36 {
        compatible = "nxp,tfa9897";
        reg = <0x36>;
        vddd-supply = <&pm8916_l6>;
        rcv-gpios = <&msmgpio 111 GPIO_ACTIVE_HIGH>;
        pinctrl-names = "default";
        pinctrl-0 = <&speaker_bottom_default>;
        sound-name-prefix = "Speaker Bottom";
        #sound-dai-cells = <0>;
      };
    };
```

## Documentation/devicetree/bindings/sound/nxp,uda1342.yaml
```yaml
# SPDX-License-Identifier: (GPL-2.0-only OR BSD-2-Clause)
%YAML 1.2
---
$id: http://devicetree.org/schemas/sound/nxp,uda1342.yaml#
$schema: http://devicetree.org/meta-schemas/core.yaml#

title: NXP uda1342 audio CODECs

maintainers:
  - Binbin Zhou <zhoubinbin@loongson.cn>

allOf:
  - $ref: dai-common.yaml#

properties:
  compatible:
    const: nxp,uda1342

  reg:
    maxItems: 1

  '#sound-dai-cells':
    const: 0

required:
  - compatible
  - reg
  - '#sound-dai-cells'

unevaluatedProperties: false

examples:
  - |
    i2c {
      #address-cells = <1>;
      #size-cells = <0>;
      codec@1a {
        compatible = "nxp,uda1342";
        reg = <0x1a>;
        #sound-dai-cells = <0>;
      };
    };
```

## Documentation/devicetree/bindings/sound/omap-abe-twl6040.txt
```
* Texas Instruments OMAP4+ and twl6040 based audio setups

Required properties:
- compatible: "ti,abe-twl6040"
- ti,model: Name of the sound card ( for example "SDP4430")
- ti,mclk-freq: MCLK frequency for HPPLL operation
- ti,mcpdm: phandle for the McPDM node
- ti,twl6040: phandle for the twl6040 core node
- ti,audio-routing: List of connections between audio components.
  Each entry is a pair of strings, the first being the connection's sink,
  the second being the connection's source.

Optional properties:
- ti,dmic: phandle for the OMAP dmic node if the machine have it connected
- ti,jack_detection: Need to be set to <1> if the board capable to detect jack
  insertion, removal.

Available audio endpoints for the audio-routing table:

Board connectors:
 * Headset Stereophone
 * Earphone Spk
 * Ext Spk
 * Line Out
 * Vibrator
 * Headset Mic
 * Main Handset Mic
 * Sub Handset Mic
 * Line In
 * Digital Mic

twl6040 pins:
 * HSOL
 * HSOR
 * EP
 * HFL
 * HFR
 * AUXL
 * AUXR
 * VIBRAL
 * VIBRAR
 * HSMIC
 * MAINMIC
 * SUBMIC
 * AFML
 * AFMR

 * Headset Mic Bias
 * Main Mic Bias
 * Digital Mic1 Bias
 * Digital Mic2 Bias

Digital mic pins:
 * DMic

Example:

sound {
	compatible = "ti,abe-twl6040";
	ti,model = "SDP4430";

	ti,jack-detection = <1>;
	ti,mclk-freq = <38400000>;

	ti,mcpdm = <&mcpdm>;
	ti,dmic = <&dmic>;

	ti,twl6040 = <&twl6040>;

	/* Audio routing */
	ti,audio-routing =
		"Headset Stereophone", "HSOL",
		"Headset Stereophone", "HSOR",
		"Earphone Spk", "EP",
		"Ext Spk", "HFL",
		"Ext Spk", "HFR",
		"Line Out", "AUXL",
		"Line Out", "AUXR",
		"Vibrator", "VIBRAL",
		"Vibrator", "VIBRAR",
		"HSMIC", "Headset Mic",
		"Headset Mic", "Headset Mic Bias",
		"MAINMIC", "Main Handset Mic",
		"Main Handset Mic", "Main Mic Bias",
		"SUBMIC", "Sub Handset Mic",
		"Sub Handset Mic", "Main Mic Bias",
		"AFML", "Line In",
		"AFMR", "Line In",
		"DMic", "Digital Mic",
		"Digital Mic", "Digital Mic1 Bias";
};
```

## Documentation/devicetree/bindings/sound/omap-dmic.txt
```
* Texas Instruments OMAP4+ Digital Microphone Module

Required properties:
- compatible: "ti,omap4-dmic"
- reg: Register location and size as an array:
       <MPU access base address, size>,
       <L3 interconnect address, size>;
- interrupts: Interrupt number for DMIC
- interrupt-parent: The parent interrupt controller
- ti,hwmods: Name of the hwmod associated with OMAP dmic IP

Example:

dmic: dmic@4012e000 {
	compatible = "ti,omap4-dmic";
	reg = <0x4012e000 0x7f>, /* MPU private access */
	      <0x4902e000 0x7f>; /* L3 Interconnect */
	interrupts = <0 114 0x4>;
	interrupt-parent = <&gic>;
	ti,hwmods = "dmic";
};
```

## Documentation/devicetree/bindings/sound/omap-mcbsp.txt
```
* Texas Instruments OMAP2+ McBSP module

Required properties:
- compatible: "ti,omap2420-mcbsp" for McBSP on OMAP2420
	      "ti,omap2430-mcbsp" for McBSP on OMAP2430
	      "ti,omap3-mcbsp" for McBSP on OMAP3
	      "ti,omap4-mcbsp" for McBSP on OMAP4 and newer SoC
- reg: Register location and size, for OMAP4+ as an array:
       <MPU access base address, size>,
       <L3 interconnect address, size>;
- reg-names: Array of strings associated with the address space
- interrupts: Interrupt numbers for the McBSP port, as an array in case the
	      McBSP IP have more interrupt lines:
	<OCP compliant irq>,
	<TX irq>,
	<RX irq>;
- interrupt-names: Array of strings associated with the interrupt numbers
- ti,buffer-size: Size of the FIFO on the port (OMAP2430 and newer SoC)
- ti,hwmods: Name of the hwmod associated to the McBSP port

Example:

mcbsp2: mcbsp@49022000 {
	compatible = "ti,omap3-mcbsp";
	reg = <0x49022000 0xff>,
	      <0x49028000 0xff>;
	reg-names = "mpu", "sidetone";
	interrupts = <0 17 0x4>, /* OCP compliant interrupt */
		     <0 62 0x4>, /* TX interrupt */
		     <0 63 0x4>, /* RX interrupt */
		     <0 4 0x4>;  /* Sidetone */
	interrupt-names = "common", "tx", "rx", "sidetone";
	interrupt-parent = <&intc>;
	ti,buffer-size = <1280>;
	ti,hwmods = "mcbsp2";
};
```

## Documentation/devicetree/bindings/sound/omap-mcpdm.txt
```
* Texas Instruments OMAP4+ McPDM

Required properties:
- compatible: "ti,omap4-mcpdm"
- reg: Register location and size as an array:
       <MPU access base address, size>,
       <L3 interconnect address, size>;
- interrupts: Interrupt number for McPDM
- interrupt-parent: The parent interrupt controller
- ti,hwmods: Name of the hwmod associated to the McPDM
- clocks:  phandle for the pdmclk provider, likely <&twl6040>
- clock-names: Must be "pdmclk"

Example:

mcpdm: mcpdm@40132000 {
	compatible = "ti,omap4-mcpdm";
	reg = <0x40132000 0x7f>, /* MPU private access */
	      <0x49032000 0x7f>; /* L3 Interconnect */
	interrupts = <0 112 0x4>;
	interrupt-parent = <&gic>;
	ti,hwmods = "mcpdm";
};

In board DTS file the pdmclk needs to be added:

&mcpdm {
	clocks = <&twl6040>;
	clock-names = "pdmclk";
	status = "okay";
};
```

## Documentation/devicetree/bindings/sound/omap-twl4030.txt
```
* Texas Instruments SoC with twl4030 based audio setups

Required properties:
- compatible: "ti,omap-twl4030"
- ti,model: Name of the sound card (for example "omap3beagle")
- ti,mcbsp: phandle for the McBSP node

Optional properties:
- ti,codec: phandle for the twl4030 audio node
- ti,mcbsp-voice: phandle for the McBSP node connected to the voice port of twl
- ti, jack-det-gpio: Jack detect GPIO
- ti,audio-routing: List of connections between audio components.
  Each entry is a pair of strings, the first being the connection's sink,
  the second being the connection's source.
  If the routing is not provided all possible connection will be available

Available audio endpoints for the audio-routing table:

Board connectors:
 * Headset Stereophone
 * Earpiece Spk
 * Handsfree Spk
 * Ext Spk
 * Main Mic
 * Sub Mic
 * Headset Mic
 * Carkit Mic
 * Digital0 Mic
 * Digital1 Mic
 * Line In

twl4030 pins:
 * HSOL
 * HSOR
 * EARPIECE
 * HFL
 * HFR
 * PREDRIVEL
 * PREDRIVER
 * CARKITL
 * CARKITR
 * MAINMIC
 * SUBMIC
 * HSMIC
 * DIGIMIC0
 * DIGIMIC1
 * CARKITMIC
 * AUXL
 * AUXR

 * Headset Mic Bias
 * Mic Bias 1 /* Used for Main Mic or Digimic0 */
 * Mic Bias 2 /* Used for Sub Mic or Digimic1 */

Example:

sound {
	compatible = "ti,omap-twl4030";
	ti,model = "omap3beagle";

	ti,mcbsp = <&mcbsp2>;
};
```

## Documentation/devicetree/bindings/sound/option,gtm601.yaml
```yaml
# SPDX-License-Identifier: GPL-2.0-only OR BSD-2-Clause
%YAML 1.2
---
$id: http://devicetree.org/schemas/sound/option,gtm601.yaml#
$schema: http://devicetree.org/meta-schemas/core.yaml#

title: GTM601 UMTS modem audio interface CODEC

maintainers:
  - kernel@puri.sm

description: >
  This device has no configuration interface. The sample rate and channels are
  based on the compatible string

properties:
  compatible:
    oneOf:
      - description: Broadmobi BM818 (48Khz stereo)
        items:
          - const: broadmobi,bm818
          - const: option,gtm601
      - description: GTM601 (8kHz mono)
        const: option,gtm601

  '#sound-dai-cells':
    const: 0

required:
  - compatible

allOf:
  - $ref: dai-common.yaml#

additionalProperties: false

examples:
  - |
    codec {
        compatible = "option,gtm601";
        #sound-dai-cells = <0>;
    };
```

## Documentation/devicetree/bindings/sound/pcm1789.txt
```
Texas Instruments pcm1789 DT bindings

PCM1789 is a simple audio codec that can be connected via
I2C or SPI. Currently, only I2C bus is supported.

Required properties:

 - compatible: "ti,pcm1789"

Required properties on I2C:

 - reg: the I2C address
 - reset-gpios: GPIO to control the RESET pin

Examples:

	audio-codec@4c {
		compatible = "ti,pcm1789";
		reg = <0x4c>;
		reset-gpios = <&gpio2 14 GPIO_ACTIVE_LOW>;
		#sound-dai-cells = <0>;
	};
```

## Documentation/devicetree/bindings/sound/pcm1792a.txt
```
Texas Instruments pcm1792a DT bindings

This driver supports the SPI bus.

Required properties:

 - compatible: "ti,pcm1792a"

For required properties on SPI, please consult
Documentation/devicetree/bindings/spi/spi-bus.txt

Examples:

	codec_spi: 1792a@0 {
		compatible = "ti,pcm1792a";
		spi-max-frequency = <600000>;
	};
```
