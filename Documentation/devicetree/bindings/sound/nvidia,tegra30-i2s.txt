## Documentation/devicetree/bindings/sound/pcm179x.txt
```
Texas Instruments pcm179x DT bindings

This driver supports both the I2C and SPI bus.

Required properties:

 - compatible: "ti,pcm1792a"

For required properties on SPI, please consult
Documentation/devicetree/bindings/spi/spi-bus.txt

Required properties on I2C:

 - reg: the I2C address


Examples:

	codec_spi: 1792a@0 {
		compatible = "ti,pcm1792a";
		spi-max-frequency = <600000>;
	};

	codec_i2c: 1792a@4c {
		compatible = "ti,pcm1792a";
		reg = <0x4c>;
	};
```

## Documentation/devicetree/bindings/sound/pcm186x.txt
```
Texas Instruments PCM186x Universal Audio ADC

These devices support both I2C and SPI (configured with pin strapping
on the board).

Required properties:

 - compatible : "ti,pcm1862",
                "ti,pcm1863",
                "ti,pcm1864",
                "ti,pcm1865"

 - reg : The I2C address of the device for I2C, the chip select
         number for SPI.

 - avdd-supply: Analog core power supply (3.3v)
 - dvdd-supply: Digital core power supply
 - iovdd-supply: Digital IO power supply
        See regulator/regulator.txt for more information

CODEC input pins:
 * VINL1
 * VINR1
 * VINL2
 * VINR2
 * VINL3
 * VINR3
 * VINL4
 * VINR4

The pins can be used in referring sound node's audio-routing property.

Example:

	pcm186x: audio-codec@4a {
		compatible = "ti,pcm1865";
		reg = <0x4a>;

		avdd-supply = <&reg_3v3_analog>;
		dvdd-supply = <&reg_3v3>;
		iovdd-supply = <&reg_1v8>;
	};
```

## Documentation/devicetree/bindings/sound/pcm3060.txt
```
PCM3060 audio CODEC

This driver supports both I2C and SPI.

Required properties:

- compatible: "ti,pcm3060"

- reg : the I2C address of the device for I2C, the chip select
        number for SPI.

Examples:

	pcm3060: pcm3060@46 {
		 compatible = "ti,pcm3060";
		 reg = <0x46>;
	};
```

## Documentation/devicetree/bindings/sound/pcm5102a.txt
```
PCM5102a audio CODECs

These devices does not use I2C or SPI.

Required properties:

  - compatible : set as "ti,pcm5102a"

Examples:

	pcm5102a: pcm5102a {
		compatible = "ti,pcm5102a";
	};
```

## Documentation/devicetree/bindings/sound/pcm512x.txt
```
PCM512x audio CODECs

These devices support both I2C and SPI (configured with pin strapping
on the board).

Required properties:

  - compatible : One of "ti,pcm5121", "ti,pcm5122", "ti,pcm5141" or
                 "ti,pcm5142"

  - reg : the I2C address of the device for I2C, the chip select
          number for SPI.

  - AVDD-supply, DVDD-supply, and CPVDD-supply : power supplies for the
    device, as covered in bindings/regulator/regulator.txt

Optional properties:

  - clocks : A clock specifier for the clock connected as SCLK.  If this
    is absent the device will be configured to clock from BCLK.  If pll-in
    and pll-out are specified in addition to a clock, the device is
    configured to accept clock input on a specified gpio pin.

  - pll-in, pll-out : gpio pins used to connect the pll using <1>
    through <6>.  The device will be configured for clock input on the
    given pll-in pin and PLL output on the given pll-out pin.  An
    external connection from the pll-out pin to the SCLK pin is assumed.

Examples:

	pcm5122: pcm5122@4c {
		compatible = "ti,pcm5122";
		reg = <0x4c>;

		AVDD-supply = <&reg_3v3_analog>;
		DVDD-supply = <&reg_1v8>;
		CPVDD-supply = <&reg_3v3>;
	};


	pcm5142: pcm5142@4c {
		compatible = "ti,pcm5142";
		reg = <0x4c>;

		AVDD-supply = <&reg_3v3_analog>;
		DVDD-supply = <&reg_1v8>;
		CPVDD-supply = <&reg_3v3>;

		clocks = <&sck>;
		pll-in = <3>;
		pll-out = <6>;
	};
```

## Documentation/devicetree/bindings/sound/qcom,apq8016-sbc-sndcard.yaml
```yaml
# SPDX-License-Identifier: GPL-2.0-only OR BSD-2-Clause
%YAML 1.2
---
$id: http://devicetree.org/schemas/sound/qcom,apq8016-sbc-sndcard.yaml#
$schema: http://devicetree.org/meta-schemas/core.yaml#

title: Qualcomm APQ8016 and similar sound cards

maintainers:
  - Srinivas Kandagatla <srinivas.kandagatla@linaro.org>
  - Stephan Gerhold <stephan@gerhold.net>

properties:
  compatible:
    enum:
      - qcom,apq8016-sbc-sndcard
      - qcom,msm8916-qdsp6-sndcard

  reg:
    items:
      - description: Microphone I/O mux register address
      - description: Speaker I/O mux register address

  reg-names:
    items:
      - const: mic-iomux
      - const: spkr-iomux

  audio-routing:
    $ref: /schemas/types.yaml#/definitions/non-unique-string-array
    description:
      A list of the connections between audio components. Each entry is a
      pair of strings, the first being the connection's sink, the second
      being the connection's source. Valid names could be power supplies,
      MicBias of codec and the jacks on the board.

  aux-devs:
    $ref: /schemas/types.yaml#/definitions/phandle-array
    description: |
      List of phandles pointing to auxiliary devices, such
      as amplifiers, to be added to the sound card.

  model:
    $ref: /schemas/types.yaml#/definitions/string
    description: User visible long sound card name

  pin-switches:
    description: List of widget names for which pin switches should be created.
    $ref: /schemas/types.yaml#/definitions/string-array

  widgets:
    description: User specified audio sound widgets.
    $ref: /schemas/types.yaml#/definitions/non-unique-string-array

patternProperties:
  ".*-dai-link$":
    description:
      Each subnode represents a dai link. Subnodes of each dai links would be
      cpu/codec dais.

    type: object

    properties:
      link-name:
        description: Indicates dai-link name and PCM stream name.
        $ref: /schemas/types.yaml#/definitions/string
        maxItems: 1

      cpu:
        description: Holds subnode which indicates cpu dai.
        type: object
        additionalProperties: false

        properties:
          sound-dai:
            maxItems: 1

      platform:
        description: Holds subnode which indicates platform dai.
        type: object
        additionalProperties: false

        properties:
          sound-dai:
            maxItems: 1

      codec:
        description: Holds subnode which indicates codec dai.
        type: object
        additionalProperties: false

        properties:
          sound-dai:
            minItems: 1
            maxItems: 8

    required:
      - link-name
      - cpu

    additionalProperties: false

required:
  - compatible
  - reg
  - reg-names
  - model

additionalProperties: false

examples:
  - |
    #include <dt-bindings/sound/qcom,lpass.h>
    sound@7702000 {
        compatible = "qcom,apq8016-sbc-sndcard";
        reg = <0x07702000 0x4>, <0x07702004 0x4>;
        reg-names = "mic-iomux", "spkr-iomux";

        model = "DB410c";
        audio-routing =
            "AMIC2", "MIC BIAS Internal2",
            "AMIC3", "MIC BIAS External1";

        pinctrl-0 = <&cdc_pdm_lines_act &ext_sec_tlmm_lines_act &ext_mclk_tlmm_lines_act>;
        pinctrl-1 = <&cdc_pdm_lines_sus &ext_sec_tlmm_lines_sus &ext_mclk_tlmm_lines_sus>;
        pinctrl-names = "default", "sleep";

        quaternary-dai-link {
            link-name = "ADV7533";
            cpu {
                sound-dai = <&lpass MI2S_QUATERNARY>;
            };
            codec {
                sound-dai = <&adv_bridge 0>;
            };
        };

        primary-dai-link {
            link-name = "WCD";
            cpu {
                sound-dai = <&lpass MI2S_PRIMARY>;
            };
            codec {
                sound-dai = <&lpass_codec 0>, <&wcd_codec 0>;
            };
        };

        tertiary-dai-link {
            link-name = "WCD-Capture";
            cpu {
                sound-dai = <&lpass MI2S_TERTIARY>;
            };
            codec {
                sound-dai = <&lpass_codec 1>, <&wcd_codec 1>;
            };
        };
    };

  - |
    #include <dt-bindings/sound/qcom,q6afe.h>
    #include <dt-bindings/sound/qcom,q6asm.h>
    sound@7702000 {
        compatible = "qcom,msm8916-qdsp6-sndcard";
        reg = <0x07702000 0x4>, <0x07702004 0x4>;
        reg-names = "mic-iomux", "spkr-iomux";

        model = "msm8916";
        widgets =
            "Speaker", "Speaker",
            "Headphone", "Headphones";
        pin-switches = "Speaker";
        audio-routing =
            "Speaker", "Speaker Amp OUT",
            "Speaker Amp IN", "HPH_R",
            "Headphones", "HPH_L",
            "Headphones", "HPH_R",
            "AMIC1", "MIC BIAS Internal1",
            "AMIC2", "MIC BIAS Internal2",
            "AMIC3", "MIC BIAS Internal3";
        aux-devs = <&speaker_amp>;

        pinctrl-names = "default", "sleep";
        pinctrl-0 = <&cdc_pdm_lines_act>;
        pinctrl-1 = <&cdc_pdm_lines_sus>;

        mm1-dai-link {
            link-name = "MultiMedia1";
            cpu {
                sound-dai = <&q6asmdai MSM_FRONTEND_DAI_MULTIMEDIA1>;
            };
        };

        primary-dai-link {
            link-name = "Primary MI2S";
            cpu {
                sound-dai = <&q6afedai PRIMARY_MI2S_RX>;
            };
            platform {
                sound-dai = <&q6routing>;
            };
            codec {
                sound-dai = <&lpass_codec 0>, <&wcd_codec 0>;
            };
        };
    };
```

## Documentation/devicetree/bindings/sound/qcom,apq8016-sbc.txt
```
* Qualcomm Technologies APQ8016 SBC ASoC machine driver

This node models the Qualcomm Technologies APQ8016 SBC ASoC machine driver

Required properties:

- compatible		: "qcom,apq8016-sbc-sndcard"

- pinctrl-N		: One property must exist for each entry in
			  pinctrl-names.  See ../pinctrl/pinctrl-bindings.txt
			  for details of the property values.
- pinctrl-names		: Must contain a "default" entry.
- reg			: Must contain an address for each entry in reg-names.
- reg-names		: A list which must include the following entries:
				* "mic-iomux"
				* "spkr-iomux"
- qcom,model		: Name of the sound card.

- qcom,audio-routing	: A list of the connections between audio components.
			  Each entry is a pair of strings, the first being the
			  connection's sink, the second being the connection's
			  source. Valid names could be power supplies, MicBias
			  of msm8x16_wcd codec and the jacks on the board:

			  Power supplies:
			  * MIC BIAS External1
			  * MIC BIAS External2
			  * MIC BIAS Internal1
			  * MIC BIAS Internal2

			  Board connectors:
			  * Headset Mic
			  * Secondary Mic",
			  * DMIC
			  * Ext Spk

Dai-link subnode properties and subnodes:

Required dai-link subnodes:

- cpu					: CPU   sub-node
- codec					: CODEC sub-node

Required CPU/CODEC subnodes properties:

-link-name		: Name of the dai link.
-sound-dai		: phandle and port of CPU/CODEC
-capture-dai		: phandle and port of CPU/CODEC

Example:

sound: sound {
	compatible = "qcom,apq8016-sbc-sndcard";
	reg = <0x07702000 0x4>, <0x07702004 0x4>;
	reg-names = "mic-iomux", "spkr-iomux";
	qcom,model = "DB410c";

	qcom,audio-routing =
		"MIC BIAS External1", "Handset Mic",
		"MIC BIAS Internal2", "Headset Mic",
		"MIC BIAS External1", "Secondary Mic",
		"AMIC1", "MIC BIAS External1",
		"AMIC2", "MIC BIAS Internal2",
		"AMIC3", "MIC BIAS External1",
		"DMIC1", "MIC BIAS Internal1",
		"MIC BIAS Internal1", "Digital Mic1",
		"DMIC2", "MIC BIAS Internal1",
		"MIC BIAS Internal1", "Digital Mic2";

	/* I2S - Internal codec */
	internal-dai-link@0 {
		cpu { /* PRIMARY */
			sound-dai = <&lpass MI2S_PRIMARY>;
		};
		codec {
			sound-dai = <&wcd_codec 0>;
		};
	};

	/* External Primary or External Secondary -ADV7533 HDMI */
	external-dai-link@0 {
		link-name = "ADV7533";
		cpu { /* QUAT */
			sound-dai = <&lpass MI2S_QUATERNARY>;
		};
		codec {
			sound-dai = <&adv_bridge 0>;
		};
	};
};
```

## Documentation/devicetree/bindings/sound/qcom,apq8096.txt
```
* Qualcomm Technologies APQ8096 ASoC sound card driver

This binding describes the APQ8096 sound card, which uses qdsp for audio.

- compatible:
	Usage: required
	Value type: <stringlist>
	Definition: must be "qcom,apq8096-sndcard"

- qcom,audio-routing:
	Usage: Optional
	Value type: <stringlist>
	Definition:  A list of the connections between audio components.
		  Each entry is a pair of strings, the first being the
		  connection's sink, the second being the connection's
		  source. Valid names could be power supplies, MicBias
		  of codec and the jacks on the board:
		  Valid names include:

		Board Connectors:
			"Headphone Left"
			"Headphone Right"
			"Earphone"
			"Line Out1"
			"Line Out2"
			"Line Out3"
			"Line Out4"
			"Analog Mic1"
			"Analog Mic2"
			"Analog Mic3"
			"Analog Mic4"
			"Analog Mic5"
			"Analog Mic6"
			"Digital Mic2"
			"Digital Mic3"

		Audio pins and MicBias on WCD9335 Codec:
			"MIC_BIAS1
			"MIC_BIAS2"
			"MIC_BIAS3"
			"MIC_BIAS4"
			"AMIC1"
			"AMIC2"
			"AMIC3"
			"AMIC4"
			"AMIC5"
			"AMIC6"
			"AMIC6"
			"DMIC1"
			"DMIC2"
			"DMIC3"
= dailinks
Each subnode of sndcard represents either a dailink, and subnodes of each
dailinks would be cpu/codec/platform dais.

- link-name:
	Usage: required
	Value type: <string>
	Definition: User friendly name for dai link

= CPU, PLATFORM, CODEC dais subnodes
- cpu:
	Usage: required
	Value type: <subnode>
	Definition: cpu dai sub-node

- codec:
	Usage: Optional
	Value type: <subnode>
	Definition: codec dai sub-node

- platform:
	Usage: Optional
	Value type: <subnode>
	Definition: platform dai sub-node

- sound-dai:
	Usage: required
	Value type: <phandle with arguments>
	Definition: dai phandle/s and port of CPU/CODEC/PLATFORM node.

Example:

audio {
	compatible = "qcom,apq8096-sndcard";
	qcom,model = "DB820c";

	mm1-dai-link {
		link-name = "MultiMedia1";
		cpu {
			sound-dai = <&q6asmdai MSM_FRONTEND_DAI_MULTIMEDIA1>;
		};
	};

	hdmi-dai-link {
		link-name = "HDMI Playback";
		cpu {
			sound-dai = <&q6afe HDMI_RX>;
		};

		platform {
			sound-dai = <&q6adm>;
		};

		codec {
			sound-dai = <&hdmi 0>;
		};
	};
};
```
