## Documentation/devicetree/bindings/sound/ak4642.yaml
```yaml
# SPDX-License-Identifier: GPL-2.0
%YAML 1.2
---
$id: http://devicetree.org/schemas/sound/ak4642.yaml#
$schema: http://devicetree.org/meta-schemas/core.yaml#

title: AK4642 I2C transmitter

maintainers:
  - Kuninori Morimoto <kuninori.morimoto.gx@renesas.com>

allOf:
  - $ref: dai-common.yaml#

properties:
  compatible:
    enum:
      - asahi-kasei,ak4642
      - asahi-kasei,ak4643
      - asahi-kasei,ak4648

  reg:
    maxItems: 1

  "#clock-cells":
    const: 0
  "#sound-dai-cells":
    const: 0

  clocks:
    maxItems: 1

  clock-frequency:
    description: common clock binding; frequency of MCKO

  clock-output-names:
    description: common clock name

required:
  - compatible
  - reg

unevaluatedProperties: false

examples:
  - |
    i2c {
        #address-cells = <1>;
        #size-cells = <0>;
        ak4643: codec@12 {
            compatible = "asahi-kasei,ak4643";
            #sound-dai-cells = <0>;
            reg = <0x12>;
            #clock-cells = <0>;
            clocks = <&audio_clock>;
            clock-frequency = <12288000>;
            clock-output-names = "ak4643_mcko";
        };
    };
```

## Documentation/devicetree/bindings/sound/ak5386.txt
```
AK5386 Single-ended 24-Bit 192kHz delta-sigma ADC

This device has no control interface.

Required properties:

  - compatible : "asahi-kasei,ak5386"

Optional properties:

  - reset-gpio : a GPIO spec for the reset/power down pin.
		 If specified, it will be deasserted at probe time.
  - va-supply : a regulator spec, providing 5.0V
  - vd-supply : a regulator spec, providing 3.3V

Example:

spdif: ak5386@0 {
	compatible = "asahi-kasei,ak5386";
	reset-gpio = <&gpio0 23>;
	va-supply = <&vdd_5v0_reg>;
	vd-supply = <&vdd_3v3_reg>;
};
```

## Documentation/devicetree/bindings/sound/ak5558.txt
```
AK5558 8 channel differential 32-bit delta-sigma ADC

This device supports I2C mode only.

Required properties:

- compatible : "asahi-kasei,ak5558" or "asahi-kasei,ak5552".
- reg : The I2C address of the device.

Optional properties:

- reset-gpios: A GPIO specifier for the power down & reset pin.
- AVDD-supply: Analog power supply
- DVDD-supply: Digital power supply

Example:

&i2c {
	ak5558: adc@10 {
		compatible = "asahi-kasei,ak5558";
		reg = <0x10>;
		reset-gpios = <&gpio1 10 GPIO_ACTIVE_LOW>;
	};
};
```

## Documentation/devicetree/bindings/sound/alc5623.txt
```
ALC5621/ALC5622/ALC5623 audio Codec

Required properties:

 - compatible:	"realtek,alc5623"
 - reg:		the I2C address of the device.

Optional properties:

 - add-ctrl:	  Default register value for Reg-40h, Additional Control
		  Register. If absent or has the value of 0, the
		  register is untouched.

 - jack-det-ctrl: Default register value for Reg-5Ah, Jack Detect
		  Control Register. If absent or has value 0, the
		  register is untouched.

Example:

	alc5621: alc5621@1a {
		compatible = "alc5621";
		reg = <0x1a>;
		add-ctrl = <0x3700>;
		jack-det-ctrl = <0x4810>;
	};
```

## Documentation/devicetree/bindings/sound/alc5632.txt
```
ALC5632 audio CODEC

This device supports I2C only.

Required properties:

  - compatible : "realtek,alc5632"

  - reg : the I2C address of the device.

  - gpio-controller : Indicates this device is a GPIO controller.

  - #gpio-cells : Should be two. The first cell is the pin number and the
    second cell is used to specify optional parameters (currently unused).

Pins on the device (for linking into audio routes):

  * SPK_OUTP
  * SPK_OUTN
  * HP_OUT_L
  * HP_OUT_R
  * AUX_OUT_P
  * AUX_OUT_N
  * LINE_IN_L
  * LINE_IN_R
  * PHONE_P
  * PHONE_N
  * MIC1_P
  * MIC1_N
  * MIC2_P
  * MIC2_N
  * MICBIAS1
  * DMICDAT

Example:

alc5632: alc5632@1e {
	compatible = "realtek,alc5632";
	reg = <0x1a>;

	gpio-controller;
	#gpio-cells = <2>;
};
```

## Documentation/devicetree/bindings/sound/allwinner,sun4i-a10-codec.yaml
```yaml
# SPDX-License-Identifier: GPL-2.0
%YAML 1.2
---
$id: http://devicetree.org/schemas/sound/allwinner,sun4i-a10-codec.yaml#
$schema: http://devicetree.org/meta-schemas/core.yaml#

title: Allwinner A10 Codec Device Tree Bindings

maintainers:
  - Chen-Yu Tsai <wens@csie.org>
  - Maxime Ripard <mripard@kernel.org>

properties:
  "#sound-dai-cells":
    const: 0

  compatible:
    enum:
      - allwinner,sun4i-a10-codec
      - allwinner,sun6i-a31-codec
      - allwinner,sun7i-a20-codec
      - allwinner,sun8i-a23-codec
      - allwinner,sun8i-h3-codec
      - allwinner,sun8i-v3s-codec

  reg:
    maxItems: 1

  interrupts:
    maxItems: 1

  clocks:
    items:
      - description: Bus Clock
      - description: Module Clock

  clock-names:
    items:
      - const: apb
      - const: codec

  dmas:
    items:
      - description: RX DMA Channel
      - description: TX DMA Channel

  dma-names:
    items:
      - const: rx
      - const: tx

  resets:
    maxItems: 1

  allwinner,audio-routing:
    description: |-
      A list of the connections between audio components.  Each entry
      is a pair of strings, the first being the connection's sink, the
      second being the connection's source.
    $ref: /schemas/types.yaml#definitions/non-unique-string-array
    minItems: 2
    maxItems: 18
    items:
      enum:
        # Audio Pins on the SoC
        - HP
        - HPCOM
        - LINEIN
        - LINEOUT
        - MIC1
        - MIC2
        - MIC3

        # Microphone Biases from the SoC
        - HBIAS
        - MBIAS

        # Board Connectors
        - Headphone
        - Headset Mic
        - Line In
        - Line Out
        - Mic
        - Speaker

  allwinner,codec-analog-controls:
    $ref: /schemas/types.yaml#/definitions/phandle
    description: Phandle to the codec analog controls in the PRCM

  allwinner,pa-gpios:
    description: GPIO to enable the external amplifier

required:
  - "#sound-dai-cells"
  - compatible
  - reg
  - interrupts
  - clocks
  - clock-names
  - dmas
  - dma-names

allOf:
  - if:
      properties:
        compatible:
          enum:
            - allwinner,sun6i-a31-codec
            - allwinner,sun8i-a23-codec
            - allwinner,sun8i-h3-codec
            - allwinner,sun8i-v3s-codec

    then:
      if:
        properties:
          compatible:
            const: allwinner,sun6i-a31-codec

      then:
        required:
          - resets
          - allwinner,audio-routing

      else:
        required:
          - resets
          - allwinner,audio-routing
          - allwinner,codec-analog-controls

  - if:
      properties:
        compatible:
          enum:
            - allwinner,sun6i-a31-codec

    then:
      properties:
        allwinner,audio-routing:
          items:
            enum:
              - HP
              - HPCOM
              - LINEIN
              - LINEOUT
              - MIC1
              - MIC2
              - MIC3
              - HBIAS
              - MBIAS
              - Headphone
              - Headset Mic
              - Line In
              - Line Out
              - Mic
              - Speaker

  - if:
      properties:
        compatible:
          enum:
            - allwinner,sun8i-a23-codec

    then:
      properties:
        allwinner,audio-routing:
          items:
            enum:
              - HP
              - HPCOM
              - LINEIN
              - MIC1
              - MIC2
              - HBIAS
              - MBIAS
              - Headphone
              - Headset Mic
              - Line In
              - Line Out
              - Mic
              - Speaker

  - if:
      properties:
        compatible:
          enum:
            - allwinner,sun8i-h3-codec

    then:
      properties:
        allwinner,audio-routing:
          items:
            enum:
              - HP
              - HPCOM
              - LINEIN
              - LINEOUT
              - MIC1
              - MIC2
              - HBIAS
              - MBIAS
              - Headphone
              - Headset Mic
              - Line In
              - Line Out
              - Mic
              - Speaker

  - if:
      properties:
        compatible:
          enum:
            - allwinner,sun8i-v3s-codec

    then:
      properties:
        allwinner,audio-routing:
          items:
            enum:
              - HP
              - HPCOM
              - MIC1
              - HBIAS
              - Headphone
              - Headset Mic
              - Line In
              - Line Out
              - Mic
              - Speaker

additionalProperties: false

examples:
  - |
    codec@1c22c00 {
        #sound-dai-cells = <0>;
        compatible = "allwinner,sun7i-a20-codec";
        reg = <0x01c22c00 0x40>;
        interrupts = <0 30 4>;
        clocks = <&apb0_gates 0>, <&codec_clk>;
        clock-names = "apb", "codec";
        dmas = <&dma 0 19>, <&dma 0 19>;
        dma-names = "rx", "tx";
    };

  - |
    codec@1c22c00 {
        #sound-dai-cells = <0>;
        compatible = "allwinner,sun6i-a31-codec";
        reg = <0x01c22c00 0x98>;
        interrupts = <0 29 4>;
        clocks = <&ccu 61>, <&ccu 135>;
        clock-names = "apb", "codec";
        resets = <&ccu 42>;
        dmas = <&dma 15>, <&dma 15>;
        dma-names = "rx", "tx";
        allwinner,audio-routing =
            "Headphone", "HP",
            "Speaker", "LINEOUT",
            "LINEIN", "Line In",
            "MIC1", "MBIAS",
            "MIC1", "Mic",
            "MIC2", "HBIAS",
            "MIC2", "Headset Mic";
    };

...
```

## Documentation/devicetree/bindings/sound/allwinner,sun4i-a10-i2s.yaml
```yaml
# SPDX-License-Identifier: (GPL-2.0+ OR BSD-2-Clause)
%YAML 1.2
---
$id: http://devicetree.org/schemas/sound/allwinner,sun4i-a10-i2s.yaml#
$schema: http://devicetree.org/meta-schemas/core.yaml#

title: Allwinner A10 I2S Controller

maintainers:
  - Chen-Yu Tsai <wens@csie.org>
  - Maxime Ripard <mripard@kernel.org>

properties:
  "#sound-dai-cells":
    const: 0

  compatible:
    oneOf:
      - const: allwinner,sun4i-a10-i2s
      - const: allwinner,sun6i-a31-i2s
      - const: allwinner,sun8i-a83t-i2s
      - const: allwinner,sun8i-h3-i2s
      - items:
          - const: allwinner,sun8i-r40-i2s
          - const: allwinner,sun8i-h3-i2s
      - items:
          - const: allwinner,sun8i-v3-i2s
          - const: allwinner,sun8i-h3-i2s
      - const: allwinner,sun50i-a64-codec-i2s
      - items:
          - const: allwinner,sun50i-a64-i2s
          - const: allwinner,sun8i-h3-i2s
      - const: allwinner,sun50i-h6-i2s
      - const: allwinner,sun50i-r329-i2s
      - items:
          - const: allwinner,sun20i-d1-i2s
          - const: allwinner,sun50i-r329-i2s

  reg:
    maxItems: 1

  interrupts:
    maxItems: 1

  clocks:
    items:
      - description: Bus Clock
      - description: Module Clock

  clock-names:
    items:
      - const: apb
      - const: mod

  # Even though it only applies to subschemas under the conditionals,
  # not listing them here will trigger a warning because of the
  # additionalsProperties set to false.
  dmas: true
  dma-names: true
  resets:
    maxItems: 1

allOf:
  - $ref: dai-common.yaml#
  - if:
      properties:
        compatible:
          contains:
            enum:
              - allwinner,sun6i-a31-i2s
              - allwinner,sun8i-a83t-i2s
              - allwinner,sun8i-h3-i2s
              - allwinner,sun50i-a64-codec-i2s
              - allwinner,sun50i-h6-i2s
              - allwinner,sun50i-r329-i2s

    then:
      required:
        - resets

  - if:
      properties:
        compatible:
          contains:
            enum:
              - allwinner,sun8i-a83t-i2s
              - allwinner,sun8i-h3-i2s

    then:
      properties:
        dmas:
          minItems: 1
          items:
            - description: RX DMA Channel
            - description: TX DMA Channel
          description:
            Some controllers cannot receive but can only transmit
            data. In such a case, the RX DMA channel is to be omitted.

        dma-names:
          oneOf:
            - items:
                - const: rx
                - const: tx
            - const: tx
          description:
            Some controllers cannot receive but can only transmit
            data. In such a case, the RX name is to be omitted.

    else:
      properties:
        dmas:
          items:
            - description: RX DMA Channel
            - description: TX DMA Channel

        dma-names:
          items:
            - const: rx
            - const: tx

required:
  - "#sound-dai-cells"
  - compatible
  - reg
  - interrupts
  - clocks
  - clock-names
  - dmas
  - dma-names

unevaluatedProperties: false

examples:
  - |
    i2s0: i2s@1c22400 {
        #sound-dai-cells = <0>;
        compatible = "allwinner,sun4i-a10-i2s";
        reg = <0x01c22400 0x400>;
        interrupts = <0 16 4>;
        clocks = <&apb0_gates 3>, <&i2s0_clk>;
        clock-names = "apb", "mod";
        dmas = <&dma 0 3>, <&dma 0 3>;
        dma-names = "rx", "tx";
    };

...
```

## Documentation/devicetree/bindings/sound/allwinner,sun4i-a10-spdif.yaml
```yaml
# SPDX-License-Identifier: GPL-2.0
%YAML 1.2
---
$id: http://devicetree.org/schemas/sound/allwinner,sun4i-a10-spdif.yaml#
$schema: http://devicetree.org/meta-schemas/core.yaml#

title: Allwinner A10 S/PDIF Controller Device Tree Bindings

maintainers:
  - Chen-Yu Tsai <wens@csie.org>
  - Liam Girdwood <lgirdwood@gmail.com>
  - Mark Brown <broonie@kernel.org>
  - Maxime Ripard <mripard@kernel.org>

properties:
  "#sound-dai-cells":
    const: 0

  compatible:
    oneOf:
      - const: allwinner,sun4i-a10-spdif
      - const: allwinner,sun6i-a31-spdif
      - const: allwinner,sun8i-h3-spdif
      - const: allwinner,sun50i-h6-spdif
      - items:
          - const: allwinner,sun8i-a83t-spdif
          - const: allwinner,sun8i-h3-spdif
      - items:
          - const: allwinner,sun50i-a64-spdif
          - const: allwinner,sun8i-h3-spdif

  reg:
    maxItems: 1

  interrupts:
    maxItems: 1

  clocks:
    items:
      - description: Bus Clock
      - description: Module Clock

  clock-names:
    items:
      - const: apb
      - const: spdif

  # Even though it only applies to subschemas under the conditionals,
  # not listing them here will trigger a warning because of the
  # additionalsProperties set to false.
  dmas: true
  dma-names: true
  resets:
    maxItems: 1

allOf:
  - if:
      properties:
        compatible:
          contains:
            enum:
              - allwinner,sun6i-a31-spdif
              - allwinner,sun8i-h3-spdif

    then:
      required:
        - resets

  - if:
      properties:
        compatible:
          contains:
            enum:
              - allwinner,sun8i-h3-spdif
              - allwinner,sun50i-h6-spdif

    then:
      properties:
        dmas:
          description: TX DMA Channel

        dma-names:
          const: tx

    else:
      properties:
        dmas:
          items:
            - description: RX DMA Channel
            - description: TX DMA Channel

        dma-names:
          items:
            - const: rx
            - const: tx

required:
  - "#sound-dai-cells"
  - compatible
  - reg
  - interrupts
  - clocks
  - clock-names
  - dmas
  - dma-names

additionalProperties: false

examples:
  - |
    spdif: spdif@1c21000 {
        #sound-dai-cells = <0>;
        compatible = "allwinner,sun4i-a10-spdif";
        reg = <0x01c21000 0x40>;
        interrupts = <13>;
        clocks = <&apb0_gates 1>, <&spdif_clk>;
        clock-names = "apb", "spdif";
        dmas = <&dma 0 2>, <&dma 0 2>;
        dma-names = "rx", "tx";
    };

...
```
