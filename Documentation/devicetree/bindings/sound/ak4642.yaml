## Documentation/devicetree/bindings/sound/amlogic,axg-sound-card.txt
```
Amlogic AXG sound card:

Required properties:

- compatible: "amlogic,axg-sound-card"
- model : User specified audio sound card name, one string

Optional properties:

- audio-aux-devs : List of phandles pointing to auxiliary devices
- audio-widgets : Please refer to widgets.txt.
- audio-routing : A list of the connections between audio components.

Subnodes:

- dai-link: Container for dai-link level properties and the CODEC
	    sub-nodes. There should be at least one (and probably more)
	    subnode of this type.

Required dai-link properties:

- sound-dai: phandle and port of the CPU DAI.

Required TDM Backend dai-link properties:
- dai-format : CPU/CODEC common audio format

Optional TDM Backend dai-link properties:
- dai-tdm-slot-rx-mask-{0,1,2,3}: Receive direction slot masks
- dai-tdm-slot-tx-mask-{0,1,2,3}: Transmit direction slot masks
				  When omitted, mask is assumed to have to no
				  slots. A valid must have at one slot, so at
				  least one these mask should be provided with
				  an enabled slot.
- dai-tdm-slot-num : Please refer to tdm-slot.txt.
		     If omitted, slot number is set to accommodate the largest
		     mask provided.
- dai-tdm-slot-width : Please refer to tdm-slot.txt. default to 32 if omitted.
- mclk-fs : Multiplication factor between stream rate and mclk

Backend dai-link subnodes:

- codec: dai-link representing backend links should have at least one subnode.
	 One subnode for each codec of the dai-link.
	 dai-link representing frontend links have no codec, therefore have no
	 subnodes

Required codec subnodes properties:

- sound-dai: phandle and port of the CODEC DAI.

Optional codec subnodes properties:

- dai-tdm-slot-tx-mask : Please refer to tdm-slot.txt.
- dai-tdm-slot-rx-mask : Please refer to tdm-slot.txt.

Example:

sound {
	compatible = "amlogic,axg-sound-card";
	model = "AXG-S420";
	audio-aux-devs = <&tdmin_a>, <&tdmout_c>;
	audio-widgets = "Line", "Lineout",
			"Line", "Linein",
			"Speaker", "Speaker1 Left",
			"Speaker", "Speaker1 Right";
			"Speaker", "Speaker2 Left",
			"Speaker", "Speaker2 Right";
	audio-routing = "TDMOUT_C IN 0", "FRDDR_A OUT 2",
			"SPDIFOUT IN 0", "FRDDR_A OUT 3",
			"TDM_C Playback", "TDMOUT_C OUT",
			"TDMIN_A IN 2", "TDM_C Capture",
			"TDMIN_A IN 5", "TDM_C Loopback",
			"TODDR_A IN 0", "TDMIN_A OUT",
			"Lineout", "Lineout AOUTL",
			"Lineout", "Lineout AOUTR",
			"Speaker1 Left", "SPK1 OUT_A",
			"Speaker2 Left", "SPK2 OUT_A",
			"Speaker1 Right", "SPK1 OUT_B",
			"Speaker2 Right", "SPK2 OUT_B",
			"Linein AINL", "Linein",
			"Linein AINR", "Linein";

	dai-link@0 {
		sound-dai = <&frddr_a>;
	};

	dai-link@1 {
		sound-dai = <&toddr_a>;
	};

	dai-link@2 {
		sound-dai = <&tdmif_c>;
		dai-format = "i2s";
		dai-tdm-slot-tx-mask-2 = <1 1>;
		dai-tdm-slot-tx-mask-3 = <1 1>;
		dai-tdm-slot-rx-mask-1 = <1 1>;
		mclk-fs = <256>;

		codec@0 {
			sound-dai = <&lineout>;
		};

		codec@1 {
			sound-dai = <&speaker_amp1>;
		};

		codec@2 {
			sound-dai = <&speaker_amp2>;
		};

		codec@3 {
			sound-dai = <&linein>;
		};

	};

	dai-link@3 {
		sound-dai = <&spdifout>;

		codec {
			sound-dai = <&spdif_dit>;
		};
	};
};
```

## Documentation/devicetree/bindings/sound/amlogic,axg-sound-card.yaml
```yaml
# SPDX-License-Identifier: (GPL-2.0-only OR BSD-2-Clause)
%YAML 1.2
---
$id: http://devicetree.org/schemas/sound/amlogic,axg-sound-card.yaml#
$schema: http://devicetree.org/meta-schemas/core.yaml#

title: Amlogic AXG sound card

maintainers:
  - Jerome Brunet <jbrunet@baylibre.com>

properties:
  compatible:
    const: amlogic,axg-sound-card

  audio-aux-devs:
    $ref: /schemas/types.yaml#/definitions/phandle-array
    description: list of auxiliary devices

  audio-routing:
    $ref: /schemas/types.yaml#/definitions/non-unique-string-array
    description:
      A list of the connections between audio components. Each entry is a
      pair of strings, the first being the connection's sink, the second
      being the connection's source.

  audio-widgets:
    $ref: /schemas/types.yaml#/definitions/non-unique-string-array
    description:
      A list off component DAPM widget. Each entry is a pair of strings,
      the first being the widget type, the second being the widget name

  model:
    $ref: /schemas/types.yaml#/definitions/string
    description: User specified audio sound card name

patternProperties:
  "^dai-link-[0-9]+$":
    type: object
    additionalProperties: false
    description:
      Container for dai-link level properties and the CODEC sub-nodes.
      There should be at least one (and probably more) subnode of this type

    properties:
      dai-format:
        $ref: /schemas/types.yaml#/definitions/string
        enum: [ i2s, left-j, dsp_a ]

      dai-tdm-slot-num:
        $ref: /schemas/types.yaml#/definitions/uint32
        description:
          Number of slots in use. If omitted, slot number is set to
          accommodate the largest mask provided.
        maximum: 32

      dai-tdm-slot-width:
        $ref: /schemas/types.yaml#/definitions/uint32
        description: Width in bits for each slot
        enum: [ 8, 16, 20, 24, 32 ]
        default: 32

      mclk-fs:
        $ref: /schemas/types.yaml#/definitions/uint32
        description:
          Multiplication factor between the frame rate and master clock
          rate

      sound-dai:
        maxItems: 1
        description: phandle of the CPU DAI

    patternProperties:
      "^dai-tdm-slot-(t|r)x-mask-[0-3]$":
        $ref: /schemas/types.yaml#/definitions/uint32-array
        minItems: 1
        maxItems: 32
        description:
          Transmit and receive cpu slot masks of each TDM lane
          When omitted, mask is assumed to have to no slots. A valid
          interface must have at least one slot, so at least one these
          mask should be provided with an enabled slot.

      "^codec(-[0-9]+)?$":
        type: object
        additionalProperties: false
        description:
          dai-link representing backend links should have at least one subnode.
          One subnode for each codec of the dai-link. dai-link representing
          frontend links have no codec, therefore have no subnodes

        properties:
          sound-dai:
            maxItems: 1
            description: phandle of the codec DAI

        patternProperties:
          "^dai-tdm-slot-(t|r)x-mask$":
            $ref: /schemas/types.yaml#/definitions/uint32-array
            minItems: 1
            maxItems: 32
            description: Transmit and receive codec slot masks

        required:
          - sound-dai

    required:
      - sound-dai

required:
  - model
  - dai-link-0

unevaluatedProperties: false

examples:
  - |
    sound {
        compatible = "amlogic,axg-sound-card";
        model = "AXG-S420";
        audio-aux-devs = <&tdmin_a>, <&tdmout_c>;
        audio-widgets = "Line", "Lineout",
                        "Line", "Linein",
                        "Speaker", "Speaker1 Left",
                        "Speaker", "Speaker1 Right",
                        "Speaker", "Speaker2 Left",
                        "Speaker", "Speaker2 Right";
        audio-routing = "TDMOUT_C IN 0", "FRDDR_A OUT 2",
                        "SPDIFOUT IN 0", "FRDDR_A OUT 3",
                        "TDM_C Playback", "TDMOUT_C OUT",
                        "TDMIN_A IN 2", "TDM_C Capture",
                        "TDMIN_A IN 5", "TDM_C Loopback",
                        "TODDR_A IN 0", "TDMIN_A OUT",
                        "Lineout", "Lineout AOUTL",
                        "Lineout", "Lineout AOUTR",
                        "Speaker1 Left", "SPK1 OUT_A",
                        "Speaker2 Left", "SPK2 OUT_A",
                        "Speaker1 Right", "SPK1 OUT_B",
                        "Speaker2 Right", "SPK2 OUT_B",
                        "Linein AINL", "Linein",
                        "Linein AINR", "Linein";

        dai-link-0 {
            sound-dai = <&frddr_a>;
        };

        dai-link-1 {
            sound-dai = <&toddr_a>;
        };

        dai-link-2 {
            sound-dai = <&tdmif_c>;
            dai-format = "i2s";
            dai-tdm-slot-tx-mask-2 = <1 1>;
            dai-tdm-slot-tx-mask-3 = <1 1>;
            dai-tdm-slot-rx-mask-1 = <1 1>;
            mclk-fs = <256>;

            codec-0 {
                sound-dai = <&lineout>;
            };

            codec-1 {
                sound-dai = <&speaker_amp1>;
            };

            codec-2 {
                sound-dai = <&speaker_amp2>;
            };

            codec-3 {
                sound-dai = <&linein>;
            };
        };

        dai-link-3 {
            sound-dai = <&spdifout>;

            codec {
                sound-dai = <&spdif_dit>;
            };
        };
    };
```

## Documentation/devicetree/bindings/sound/amlogic,axg-spdifin.txt
```
* Amlogic Audio SPDIF Input

Required properties:
- compatible: 'amlogic,axg-spdifin'
- interrupts: interrupt specifier for the spdif input.
- clocks: list of clock phandle, one for each entry clock-names.
- clock-names: should contain the following:
  * "pclk" : peripheral clock.
  * "refclk" : spdif input reference clock
- #sound-dai-cells: must be 0.

Example on the A113 SoC:

spdifin: audio-controller@400 {
	compatible = "amlogic,axg-spdifin";
	reg = <0x0 0x400 0x0 0x30>;
	#sound-dai-cells = <0>;
	interrupts = <GIC_SPI 87 IRQ_TYPE_EDGE_RISING>;
	clocks = <&clkc_audio AUD_CLKID_SPDIFIN>,
		 <&clkc_audio AUD_CLKID_SPDIFIN_CLK>;
	clock-names = "pclk", "refclk";
};
```

## Documentation/devicetree/bindings/sound/amlogic,axg-spdifin.yaml
```yaml
# SPDX-License-Identifier: (GPL-2.0-only OR BSD-2-Clause)
%YAML 1.2
---
$id: http://devicetree.org/schemas/sound/amlogic,axg-spdifin.yaml#
$schema: http://devicetree.org/meta-schemas/core.yaml#

title: Amlogic Audio AXG SPDIF Input

maintainers:
  - Jerome Brunet <jbrunet@baylibre.com>

properties:
  compatible:
    oneOf:
      - const: amlogic,axg-spdifin
      - items:
          - enum:
              - amlogic,g12a-spdifin
              - amlogic,sm1-spdifin
          - const: amlogic,axg-spdifin

  reg:
    maxItems: 1

  "#sound-dai-cells":
    const: 0

  clocks:
    items:
      - description: Peripheral clock
      - description: SPDIF input reference clock

  clock-names:
    items:
      - const: pclk
      - const: refclk

  interrupts:
    maxItems: 1

  resets:
    maxItems: 1

required:
  - compatible
  - reg
  - "#sound-dai-cells"
  - clocks
  - clock-names
  - interrupts

allOf:
  - $ref: dai-common.yaml#

  - if:
      properties:
        compatible:
          contains:
            enum:
              - amlogic,g12a-spdifin
              - amlogic,sm1-spdifin
    then:
      required:
        - resets

    else:
      properties:
        resets: false

unevaluatedProperties: false

examples:
  - |
    #include <dt-bindings/clock/axg-audio-clkc.h>
    #include <dt-bindings/interrupt-controller/irq.h>
    #include <dt-bindings/interrupt-controller/arm-gic.h>

    audio-controller@400 {
        compatible = "amlogic,axg-spdifin";
        reg = <0x400 0x30>;
        #sound-dai-cells = <0>;
        interrupts = <GIC_SPI 87 IRQ_TYPE_EDGE_RISING>;
        clocks = <&clkc_audio AUD_CLKID_SPDIFIN>,
                 <&clkc_audio AUD_CLKID_SPDIFIN_CLK>;
        clock-names = "pclk", "refclk";
    };
```

## Documentation/devicetree/bindings/sound/amlogic,axg-spdifout.txt
```
* Amlogic Audio SPDIF Output

Required properties:
- compatible: 'amlogic,axg-spdifout' or
	      'amlogic,g12a-spdifout' or
	      'amlogic,sm1-spdifout'
- clocks: list of clock phandle, one for each entry clock-names.
- clock-names: should contain the following:
  * "pclk" : peripheral clock.
  * "mclk" : master clock
- #sound-dai-cells: must be 0.

Optional property:
- resets: phandle to the dedicated reset line of the spdif output.

Example on the A113 SoC:

spdifout: audio-controller@480 {
	compatible = "amlogic,axg-spdifout";
	reg = <0x0 0x480 0x0 0x50>;
	#sound-dai-cells = <0>;
	clocks = <&clkc_audio AUD_CLKID_SPDIFOUT>,
		 <&clkc_audio AUD_CLKID_SPDIFOUT_CLK>;
	clock-names = "pclk", "mclk";
};
```

## Documentation/devicetree/bindings/sound/amlogic,axg-spdifout.yaml
```yaml
# SPDX-License-Identifier: (GPL-2.0-only OR BSD-2-Clause)
%YAML 1.2
---
$id: http://devicetree.org/schemas/sound/amlogic,axg-spdifout.yaml#
$schema: http://devicetree.org/meta-schemas/core.yaml#

title: Amlogic Audio AXG SPDIF Output

maintainers:
  - Jerome Brunet <jbrunet@baylibre.com>

properties:
  compatible:
    oneOf:
      - const: amlogic,axg-spdifout
      - items:
          - enum:
              - amlogic,g12a-spdifout
              - amlogic,sm1-spdifout
          - const: amlogic,axg-spdifout

  reg:
    maxItems: 1

  "#sound-dai-cells":
    const: 0

  clocks:
    items:
      - description: Peripheral clock
      - description: SPDIF output master clock

  clock-names:
    items:
      - const: pclk
      - const: mclk

  resets:
    maxItems: 1

required:
  - compatible
  - reg
  - "#sound-dai-cells"
  - clocks
  - clock-names

allOf:
  - $ref: dai-common.yaml#

  - if:
      properties:
        compatible:
          contains:
            enum:
              - amlogic,g12a-spdifout
              - amlogic,sm1-spdifout
    then:
      required:
        - resets

    else:
      properties:
        resets: false

unevaluatedProperties: false

examples:
  - |
    #include <dt-bindings/clock/axg-audio-clkc.h>

    audio-controller@480 {
        compatible = "amlogic,axg-spdifout";
        reg = <0x480 0x50>;
        #sound-dai-cells = <0>;
        clocks = <&clkc_audio AUD_CLKID_SPDIFOUT>,
                 <&clkc_audio AUD_CLKID_SPDIFOUT_CLK>;
        clock-names = "pclk", "mclk";
    };
```

## Documentation/devicetree/bindings/sound/amlogic,axg-tdm-formatters.txt
```
* Amlogic Audio TDM formatters

Required properties:
- compatible: 'amlogic,axg-tdmin' or
	      'amlogic,axg-tdmout' or
	      'amlogic,g12a-tdmin' or
	      'amlogic,g12a-tdmout'
- reg: physical base address of the controller and length of memory
       mapped region.
- clocks: list of clock phandle, one for each entry clock-names.
- clock-names: should contain the following:
  * "pclk"     : peripheral clock.
  * "sclk"     : bit clock.
  * "sclk_sel" : bit clock input multiplexer.
  * "lrclk"    : sample clock
  * "lrclk_sel": sample clock input multiplexer

Optional property:
- resets: phandle to the dedicated reset line of the tdm formatter.

Example of TDMOUT_A on the S905X2 SoC:

tdmout_a: audio-controller@500 {
	compatible = "amlogic,axg-tdmout";
	reg = <0x0 0x500 0x0 0x40>;
	resets = <&clkc_audio AUD_RESET_TDMOUT_A>;
	clocks = <&clkc_audio AUD_CLKID_TDMOUT_A>,
		 <&clkc_audio AUD_CLKID_TDMOUT_A_SCLK>,
		 <&clkc_audio AUD_CLKID_TDMOUT_A_SCLK_SEL>,
		 <&clkc_audio AUD_CLKID_TDMOUT_A_LRCLK>,
		 <&clkc_audio AUD_CLKID_TDMOUT_A_LRCLK>;
	clock-names = "pclk", "sclk", "sclk_sel",
		      "lrclk", "lrclk_sel";
};
```
