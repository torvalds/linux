## Documentation/devicetree/bindings/sound/allwinner,sun50i-a64-codec-analog.yaml
```yaml
# SPDX-License-Identifier: GPL-2.0
%YAML 1.2
---
$id: http://devicetree.org/schemas/sound/allwinner,sun50i-a64-codec-analog.yaml#
$schema: http://devicetree.org/meta-schemas/core.yaml#

title: Allwinner A64 Analog Codec Device Tree Bindings

maintainers:
  - Chen-Yu Tsai <wens@csie.org>
  - Maxime Ripard <mripard@kernel.org>

properties:
  compatible:
    const: allwinner,sun50i-a64-codec-analog

  reg:
    maxItems: 1

  cpvdd-supply:
    description:
      Regulator for the headphone amplifier

required:
  - compatible
  - reg
  - cpvdd-supply

additionalProperties: false

examples:
  - |
    codec_analog: codec-analog@1f015c0 {
      compatible = "allwinner,sun50i-a64-codec-analog";
      reg = <0x01f015c0 0x4>;
      cpvdd-supply = <&reg_eldo1>;
    };

...
```

## Documentation/devicetree/bindings/sound/allwinner,sun50i-h6-dmic.yaml
```yaml
# SPDX-License-Identifier: (GPL-2.0+ OR BSD-2-Clause)
%YAML 1.2
---
$id: http://devicetree.org/schemas/sound/allwinner,sun50i-h6-dmic.yaml#
$schema: http://devicetree.org/meta-schemas/core.yaml#

title: Allwinner H6 DMIC

maintainers:
  - Ban Tao <fengzheng923@gmail.com>

properties:
  compatible:
    const: allwinner,sun50i-h6-dmic

  "#sound-dai-cells":
    const: 0

  reg:
    maxItems: 1

  interrupts:
    maxItems: 1

  clocks:
    items:
      - description: Bus Clock
      - description: Module Clock

  clock-names:
    items:
      - const: bus
      - const: mod

  dmas:
    items:
      - description: RX DMA Channel

  dma-names:
    items:
      - const: rx

  resets:
    maxItems: 1

required:
  - "#sound-dai-cells"
  - compatible
  - reg
  - interrupts
  - clocks
  - clock-names
  - dmas
  - dma-names
  - resets

additionalProperties: false

examples:
  - |
    #include <dt-bindings/interrupt-controller/arm-gic.h>
    #include <dt-bindings/interrupt-controller/irq.h>

    #include <dt-bindings/clock/sun50i-h6-ccu.h>
    #include <dt-bindings/reset/sun50i-h6-ccu.h>

    dmic: dmic@5095000 {
      #sound-dai-cells = <0>;
      compatible = "allwinner,sun50i-h6-dmic";
      reg = <0x05095000 0x400>;
      interrupts = <GIC_SPI 22 IRQ_TYPE_LEVEL_HIGH>;
      clocks = <&ccu CLK_BUS_DMIC>, <&ccu CLK_DMIC>;
      clock-names = "bus", "mod";
      dmas = <&dma 7>;
      dma-names = "rx";
      resets = <&ccu RST_BUS_DMIC>;
    };

...
```

## Documentation/devicetree/bindings/sound/allwinner,sun8i-a23-codec-analog.yaml
```yaml
# SPDX-License-Identifier: GPL-2.0
%YAML 1.2
---
$id: http://devicetree.org/schemas/sound/allwinner,sun8i-a23-codec-analog.yaml#
$schema: http://devicetree.org/meta-schemas/core.yaml#

title: Allwinner A23 Analog Codec

maintainers:
  - Chen-Yu Tsai <wens@csie.org>
  - Maxime Ripard <mripard@kernel.org>

properties:
  compatible:
    oneOf:
      # FIXME: This is documented in the PRCM binding, but needs to be
      # migrated here at some point
      # - allwinner,sun8i-a23-codec-analog
      - const: allwinner,sun8i-h3-codec-analog
      - items:
          - const: allwinner,sun8i-v3-codec-analog
          - const: allwinner,sun8i-h3-codec-analog
      - const: allwinner,sun8i-v3s-codec-analog

  reg:
    maxItems: 1

required:
  - compatible
  - reg

additionalProperties: false

examples:
  - |
    codec_analog: codec-analog@1f015c0 {
      compatible = "allwinner,sun8i-h3-codec-analog";
      reg = <0x01f015c0 0x4>;
    };

...
```

## Documentation/devicetree/bindings/sound/allwinner,sun8i-a33-codec.yaml
```yaml
# SPDX-License-Identifier: GPL-2.0
%YAML 1.2
---
$id: http://devicetree.org/schemas/sound/allwinner,sun8i-a33-codec.yaml#
$schema: http://devicetree.org/meta-schemas/core.yaml#

title: Allwinner A33 Codec Device Tree Bindings

maintainers:
  - Chen-Yu Tsai <wens@csie.org>
  - Maxime Ripard <maxime.ripard@bootlin.com>

properties:
  "#sound-dai-cells":
    const: 0

  compatible:
    const: allwinner,sun8i-a33-codec

  reg:
    maxItems: 1

  interrupts:
    maxItems: 1

  clocks:
    items:
      - description: Bus Clock
      - description: Module Clock

  clock-names:
    items:
      - const: bus
      - const: mod

required:
  - "#sound-dai-cells"
  - compatible
  - reg
  - interrupts
  - clocks
  - clock-names

additionalProperties: false

examples:
  - |
    audio-codec@1c22e00 {
      #sound-dai-cells = <0>;
      compatible = "allwinner,sun8i-a33-codec";
      reg = <0x01c22e00 0x400>;
      interrupts = <0 29 4>;
      clocks = <&ccu 47>, <&ccu 92>;
      clock-names = "bus", "mod";
    };

...
```

## Documentation/devicetree/bindings/sound/amlogic,aiu.yaml
```yaml
# SPDX-License-Identifier: GPL-2.0
%YAML 1.2
---
$id: http://devicetree.org/schemas/sound/amlogic,aiu.yaml#
$schema: http://devicetree.org/meta-schemas/core.yaml#

title: Amlogic AIU audio output controller

maintainers:
  - Jerome Brunet <jbrunet@baylibre.com>

allOf:
  - $ref: dai-common.yaml#

properties:
  $nodename:
    pattern: "^audio-controller@.*"

  "#sound-dai-cells":
    const: 2

  compatible:
    items:
      - enum:
          - amlogic,aiu-gxbb
          - amlogic,aiu-gxl
          - amlogic,aiu-meson8
          - amlogic,aiu-meson8b
      - const: amlogic,aiu

  clocks:
    items:
      - description: AIU peripheral clock
      - description: I2S peripheral clock
      - description: I2S output clock
      - description: I2S master clock
      - description: I2S mixer clock
      - description: SPDIF peripheral clock
      - description: SPDIF output clock
      - description: SPDIF master clock
      - description: SPDIF master clock multiplexer

  clock-names:
    items:
      - const: pclk
      - const: i2s_pclk
      - const: i2s_aoclk
      - const: i2s_mclk
      - const: i2s_mixer
      - const: spdif_pclk
      - const: spdif_aoclk
      - const: spdif_mclk
      - const: spdif_mclk_sel

  interrupts:
    items:
      - description: I2S interrupt line
      - description: SPDIF interrupt line

  interrupt-names:
    items:
      - const: i2s
      - const: spdif

  reg:
    maxItems: 1

  resets:
    maxItems: 1

  sound-name-prefix: true

required:
  - "#sound-dai-cells"
  - compatible
  - clocks
  - clock-names
  - interrupts
  - interrupt-names
  - reg
  - resets

additionalProperties: false

examples:
  - |
    #include <dt-bindings/clock/gxbb-clkc.h>
    #include <dt-bindings/interrupt-controller/irq.h>
    #include <dt-bindings/interrupt-controller/arm-gic.h>
    #include <dt-bindings/reset/amlogic,meson-gxbb-reset.h>

    aiu: audio-controller@5400 {
        compatible = "amlogic,aiu-gxl", "amlogic,aiu";
        #sound-dai-cells = <2>;
        reg = <0x5400 0x2ac>;
        interrupts = <GIC_SPI 48 IRQ_TYPE_EDGE_RISING>,
                     <GIC_SPI 50 IRQ_TYPE_EDGE_RISING>;
        interrupt-names = "i2s", "spdif";
        clocks = <&clkc CLKID_AIU_GLUE>,
                 <&clkc CLKID_I2S_OUT>,
                 <&clkc CLKID_AOCLK_GATE>,
                 <&clkc CLKID_CTS_AMCLK>,
                 <&clkc CLKID_MIXER_IFACE>,
                 <&clkc CLKID_IEC958>,
                 <&clkc CLKID_IEC958_GATE>,
                 <&clkc CLKID_CTS_MCLK_I958>,
                 <&clkc CLKID_CTS_I958>;
        clock-names = "pclk",
                      "i2s_pclk",
                      "i2s_aoclk",
                      "i2s_mclk",
                      "i2s_mixer",
                      "spdif_pclk",
                      "spdif_aoclk",
                      "spdif_mclk",
                      "spdif_mclk_sel";
        resets = <&reset RESET_AIU>;
    };
```

## Documentation/devicetree/bindings/sound/amlogic,axg-fifo.txt
```
* Amlogic Audio FIFO controllers

Required properties:
- compatible: 'amlogic,axg-toddr' or
	      'amlogic,axg-toddr' or
	      'amlogic,g12a-frddr' or
	      'amlogic,g12a-toddr' or
	      'amlogic,sm1-frddr' or
	      'amlogic,sm1-toddr'
- reg: physical base address of the controller and length of memory
       mapped region.
- interrupts: interrupt specifier for the fifo.
- clocks: phandle to the fifo peripheral clock provided by the audio
	  clock controller.
- resets: list of reset phandle, one for each entry reset-names.
- reset-names: should contain the following:
  * "arb" : memory ARB line (required)
  * "rst" : dedicated device reset line (optional)
- #sound-dai-cells: must be 0.
- amlogic,fifo-depth: The size of the controller's fifo in bytes. This
  		      is useful for determining certain configuration such
		      as the flush threshold of the fifo

Example of FRDDR A on the A113 SoC:

frddr_a: audio-controller@1c0 {
	compatible = "amlogic,axg-frddr";
	reg = <0x0 0x1c0 0x0 0x1c>;
	#sound-dai-cells = <0>;
	interrupts = <GIC_SPI 88 IRQ_TYPE_EDGE_RISING>;
	clocks = <&clkc_audio AUD_CLKID_FRDDR_A>;
	resets = <&arb AXG_ARB_FRDDR_A>;
	fifo-depth = <512>;
};
```

## Documentation/devicetree/bindings/sound/amlogic,axg-fifo.yaml
```yaml
# SPDX-License-Identifier: (GPL-2.0-only OR BSD-2-Clause)
%YAML 1.2
---
$id: http://devicetree.org/schemas/sound/amlogic,axg-fifo.yaml#
$schema: http://devicetree.org/meta-schemas/core.yaml#

title: Amlogic AXG Audio FIFO controllers

maintainers:
  - Jerome Brunet <jbrunet@baylibre.com>

properties:
  compatible:
    oneOf:
      - enum:
          - amlogic,axg-toddr
          - amlogic,axg-frddr
      - items:
          - enum:
              - amlogic,g12a-toddr
              - amlogic,sm1-toddr
          - const: amlogic,axg-toddr
      - items:
          - enum:
              - amlogic,g12a-frddr
              - amlogic,sm1-frddr
          - const: amlogic,axg-frddr

  reg:
    maxItems: 1

  "#sound-dai-cells":
    const: 0

  clocks:
    items:
      - description: Peripheral clock

  interrupts:
    maxItems: 1

  resets:
    minItems: 1
    maxItems: 2

  reset-names:
    minItems: 1
    maxItems: 2

  amlogic,fifo-depth:
    $ref: /schemas/types.yaml#/definitions/uint32
    description: Size of the controller's fifo in bytes

required:
  - compatible
  - reg
  - "#sound-dai-cells"
  - clocks
  - interrupts
  - resets
  - amlogic,fifo-depth

allOf:
  - $ref: dai-common.yaml#
  - if:
      properties:
        compatible:
          contains:
            enum:
              - amlogic,g12a-toddr
              - amlogic,sm1-toddr
              - amlogic,g12a-frddr
              - amlogic,sm1-frddr

    then:
      properties:
        resets:
          minItems: 2
        reset-names:
          items:
            - const: arb
            - const: rst
      required:
        - reset-names

    else:
      properties:
        resets:
          maxItems: 1
        reset-names:
          const: arb

unevaluatedProperties: false

examples:
  - |
    #include <dt-bindings/clock/axg-audio-clkc.h>
    #include <dt-bindings/interrupt-controller/irq.h>
    #include <dt-bindings/interrupt-controller/arm-gic.h>
    #include <dt-bindings/reset/amlogic,meson-axg-audio-arb.h>
    #include <dt-bindings/reset/amlogic,meson-g12a-audio-reset.h>

    audio-controller@1c0 {
        compatible = "amlogic,g12a-frddr", "amlogic,axg-frddr";
        reg = <0x1c0 0x1c>;
        #sound-dai-cells = <0>;
        clocks = <&clkc_audio AUD_CLKID_FRDDR_A>;
        interrupts = <GIC_SPI 88 IRQ_TYPE_EDGE_RISING>;
        resets = <&arb>, <&clkc_audio AUD_RESET_FRDDR_A>;
        reset-names = "arb", "rst";
        amlogic,fifo-depth = <512>;
    };
```

## Documentation/devicetree/bindings/sound/amlogic,axg-pdm.txt
```
* Amlogic Audio PDM input

Required properties:
- compatible: 'amlogic,axg-pdm'
- reg: physical base address of the controller and length of memory
       mapped region.
- clocks: list of clock phandle, one for each entry clock-names.
- clock-names: should contain the following:
  * "pclk"   : peripheral clock.
  * "dclk"   : pdm digital clock
  * "sysclk" : dsp system clock
- #sound-dai-cells: must be 0.

Example of PDM on the A113 SoC:

pdm: audio-controller@ff632000 {
	compatible = "amlogic,axg-pdm";
	reg = <0x0 0xff632000 0x0 0x34>;
	#sound-dai-cells = <0>;
	clocks = <&clkc_audio AUD_CLKID_PDM>,
		 <&clkc_audio AUD_CLKID_PDM_DCLK>,
		 <&clkc_audio AUD_CLKID_PDM_SYSCLK>;
	clock-names = "pclk", "dclk", "sysclk";
};
```

## Documentation/devicetree/bindings/sound/amlogic,axg-pdm.yaml
```yaml
# SPDX-License-Identifier: (GPL-2.0-only OR BSD-2-Clause)
%YAML 1.2
---
$id: http://devicetree.org/schemas/sound/amlogic,axg-pdm.yaml#
$schema: http://devicetree.org/meta-schemas/core.yaml#

title: Amlogic Audio AXG PDM input

maintainers:
  - Jerome Brunet <jbrunet@baylibre.com>

properties:
  compatible:
    oneOf:
      - items:
          - enum:
              - amlogic,g12a-pdm
              - amlogic,sm1-pdm
          - const: amlogic,axg-pdm
      - const: amlogic,axg-pdm

  reg:
    maxItems: 1

  "#sound-dai-cells":
    const: 0

  clocks:
    items:
      - description: Peripheral clock
      - description: PDM digital clock
      - description: DSP system clock

  clock-names:
    items:
      - const: pclk
      - const: dclk
      - const: sysclk

  resets:
    maxItems: 1

required:
  - compatible
  - reg
  - "#sound-dai-cells"
  - clocks
  - clock-names

allOf:
  - $ref: dai-common.yaml#

  - if:
      properties:
        compatible:
          contains:
            enum:
              - amlogic,g12a-pdm
              - amlogic,sm1-pdm
    then:
      required:
        - resets

    else:
      properties:
        resets: false

unevaluatedProperties: false

examples:
  - |
    #include <dt-bindings/clock/axg-audio-clkc.h>

    audio-controller@ff632000 {
        compatible = "amlogic,axg-pdm";
        reg = <0xff632000 0x34>;
        #sound-dai-cells = <0>;
        clocks = <&clkc_audio AUD_CLKID_PDM>,
                 <&clkc_audio AUD_CLKID_PDM_DCLK>,
                 <&clkc_audio AUD_CLKID_PDM_SYSCLK>;
        clock-names = "pclk", "dclk", "sysclk";
    };
```
