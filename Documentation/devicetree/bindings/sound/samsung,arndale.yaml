## Documentation/devicetree/bindings/sound/samsung,tm2.yaml
```yaml
# SPDX-License-Identifier: (GPL-2.0-only OR BSD-2-Clause)
%YAML 1.2
---
$id: http://devicetree.org/schemas/sound/samsung,tm2.yaml#
$schema: http://devicetree.org/meta-schemas/core.yaml#

title: Samsung Exynos5433 TM2(E) audio complex with WM5110 codec

maintainers:
  - Krzysztof Kozlowski <krzk@kernel.org>
  - Sylwester Nawrocki <s.nawrocki@samsung.com>

allOf:
  - $ref: sound-card-common.yaml#

properties:
  compatible:
    const: samsung,tm2-audio

  audio-amplifier:
    description: Phandle to the MAX98504 amplifier.
    $ref: /schemas/types.yaml#/definitions/phandle

  audio-codec:
    description: Phandles to the codecs.
    $ref: /schemas/types.yaml#/definitions/phandle-array
    items:
      - description: Phandle to the WM5110 audio codec.
      - description: Phandle to the HDMI transmitter node.

  samsung,audio-routing:
    description: |
      List of the connections between audio components; each entry is
      a pair of strings, the first being the connection's sink, the second
      being the connection's source; valid names for sources and sinks are the
      WM5110's and MAX98504's pins and the jacks on the board: HP, SPK, Main
      Mic, Sub Mic, Third Mic, Headset Mic.
      Deprecated, use audio-routing.
    deprecated: true
    $ref: /schemas/types.yaml#/definitions/non-unique-string-array

  i2s-controller:
    description: Phandles to the I2S controllers.
    $ref: /schemas/types.yaml#/definitions/phandle-array
    items:
      - description: Phandle to I2S0.
      - description: Phandle to I2S1.

  mic-bias-gpios:
    description: GPIO pin that enables the Main Mic bias regulator.

required:
  - compatible
  - audio-amplifier
  - audio-codec
  - audio-routing
  - i2s-controller
  - mic-bias-gpios

unevaluatedProperties: false

examples:
  - |
    #include <dt-bindings/gpio/gpio.h>

    sound {
        compatible = "samsung,tm2-audio";
        audio-codec = <&wm5110>, <&hdmi>;
        i2s-controller = <&i2s0 0>, <&i2s1 0>;
        audio-amplifier = <&max98504>;
        mic-bias-gpios = <&gpr3 2 GPIO_ACTIVE_HIGH>;
        model = "wm5110";
        audio-routing = "HP", "HPOUT1L",
                                "HP", "HPOUT1R",
                                "SPK", "SPKOUT",
                                "SPKOUT", "HPOUT2L",
                                "SPKOUT", "HPOUT2R",
                                "RCV", "HPOUT3L",
                                "RCV", "HPOUT3R";
    };
```

## Documentation/devicetree/bindings/sound/samsung-i2s.txt
```
* Samsung I2S controller

Required SoC Specific Properties:

- compatible : should be one of the following.
   - samsung,s3c6410-i2s: for 8/16/24bit stereo I2S.
   - samsung,s5pv210-i2s: for 8/16/24bit multichannel(5.1) I2S with
     secondary fifo, s/w reset control and internal mux for root clk src.
   - samsung,exynos5420-i2s: for 8/16/24bit multichannel(5.1) I2S for
     playback, sterio channel capture, secondary fifo using internal
     or external dma, s/w reset control, internal mux for root clk src
     and 7.1 channel TDM support for playback. TDM (Time division multiplexing)
     is to allow transfer of multiple channel audio data on single data line.
   - samsung,exynos7-i2s: with all the available features of exynos5 i2s,
     exynos7 I2S has 7.1 channel TDM support for capture, secondary fifo
     with only external dma and more no.of root clk sampling frequencies.
   - samsung,exynos7-i2s1: I2S1 on previous samsung platforms supports
     stereo channels. exynos7 i2s1 upgraded to 5.1 multichannel with
     slightly modified bit offsets.

- reg: physical base address of the controller and length of memory mapped
  region.
- dmas: list of DMA controller phandle and DMA request line ordered pairs.
- dma-names: identifier string for each DMA request line in the dmas property.
  These strings correspond 1:1 with the ordered pairs in dmas.
- clocks: Handle to iis clock and RCLK source clk.
- clock-names:
  i2s0 uses some base clks from CMU and some are from audio subsystem internal
  clock controller. The clock names for i2s0 should be "iis", "i2s_opclk0" and
  "i2s_opclk1" as shown in the example below.
  i2s1 and i2s2 uses clocks from CMU. The clock names for i2s1 and i2s2 should
  be "iis" and "i2s_opclk0".
  "iis" is the i2s bus clock and i2s_opclk0, i2s_opclk1 are sources of the root
  clk. i2s0 has internal mux to select the source of root clk and i2s1 and i2s2
  doesn't have any such mux.
- #clock-cells: should be 1, this property must be present if the I2S device
  is a clock provider in terms of the common clock bindings, described in
  ../clock/clock-bindings.txt.
- clock-output-names: from the common clock bindings, names of the CDCLK
  I2S output clocks, suggested values are "i2s_cdclk0", "i2s_cdclk1",
  "i2s_cdclk3" for the I2S0, I2S1, I2S2 devices recpectively.

There are following clocks available at the I2S device nodes:
 CLK_I2S_CDCLK    - the CDCLK (CODECLKO) gate clock,
 CLK_I2S_RCLK_PSR - the RCLK prescaler divider clock (corresponding to the
		    IISPSR register),
 CLK_I2S_RCLK_SRC - the RCLKSRC mux clock (corresponding to RCLKSRC bit in
		    IISMOD register).

Refer to the SoC datasheet for availability of the above clocks.
The CLK_I2S_RCLK_PSR and CLK_I2S_RCLK_SRC clocks are usually only available
in the IIS Multi Audio Interface (I2S0).
Note: Old DTs may not have the #clock-cells, clock-output-names properties
and then not use the I2S node as a clock supplier.

Optional SoC Specific Properties:

- samsung,idma-addr: Internal DMA register base address of the audio
  sub system(used in secondary sound source).
- pinctrl-0: Should specify pin control groups used for this controller.
- pinctrl-names: Should contain only one value - "default".


Example:

i2s0: i2s@3830000 {
	compatible = "samsung,s5pv210-i2s";
	reg = <0x03830000 0x100>;
	dmas = <&pdma0 10
		&pdma0 9
		&pdma0 8>;
	dma-names = "tx", "rx", "tx-sec";
	clocks = <&clock_audss EXYNOS_I2S_BUS>,
		<&clock_audss EXYNOS_I2S_BUS>,
		<&clock_audss EXYNOS_SCLK_I2S>;
	clock-names = "iis", "i2s_opclk0", "i2s_opclk1";
	#clock-cells;
	clock-output-names = "i2s_cdclk0";
	samsung,idma-addr = <0x03000000>;
	pinctrl-names = "default";
	pinctrl-0 = <&i2s0_bus>;
};
```

## Documentation/devicetree/bindings/sound/samsung-i2s.yaml
```yaml
# SPDX-License-Identifier: GPL-2.0
%YAML 1.2
---
$id: http://devicetree.org/schemas/sound/samsung-i2s.yaml#
$schema: http://devicetree.org/meta-schemas/core.yaml#

title: Samsung SoC I2S controller

maintainers:
  - Krzysztof Kozlowski <krzk@kernel.org>
  - Sylwester Nawrocki <s.nawrocki@samsung.com>

properties:
  compatible:
    description: |
      samsung,s3c6410-i2s: for 8/16/24bit stereo I2S.

      samsung,s5pv210-i2s: for 8/16/24bit multichannel (5.1) I2S with
      secondary FIFO, s/w reset control and internal mux for root clock
      source.

      samsung,exynos5420-i2s: for 8/16/24bit multichannel (5.1) I2S for
      playback, stereo channel capture, secondary FIFO using internal
      or external DMA, s/w reset control, internal mux for root clock
      source and 7.1 channel TDM support for playback; TDM (Time division
      multiplexing) is to allow transfer of multiple channel audio data on
      single data line.

      samsung,exynos7-i2s: with all the available features of Exynos5 I2S.
      Exynos7 I2S has 7.1 channel TDM support for capture, secondary FIFO
      with only external DMA and more number of root clock sampling
      frequencies.

      samsung,exynos7-i2s1: I2S1 on previous samsung platforms supports
      stereo channels. Exynos7 I2S1 upgraded to 5.1 multichannel with
      slightly modified bit offsets.
    enum:
      - samsung,s3c6410-i2s
      - samsung,s5pv210-i2s
      - samsung,exynos5420-i2s
      - samsung,exynos7-i2s
      - samsung,exynos7-i2s1

  '#address-cells':
    const: 1

  '#size-cells':
    const: 0

  reg:
    maxItems: 1

  dmas:
    minItems: 2
    maxItems: 3

  dma-names:
    oneOf:
      - items:
          - const: tx
          - const: rx
      - items:
          - const: tx
          - const: rx
          - const: tx-sec

  assigned-clock-parents: true
  assigned-clocks: true

  clocks:
    minItems: 1
    maxItems: 3

  clock-names:
    oneOf:
      - items:
          - const: iis
      - items: # for I2S0
          - const: iis
          - const: i2s_opclk0
          - const: i2s_opclk1
      - items: # for I2S1 and I2S2
          - const: iis
          - const: i2s_opclk0
    description: |
      "iis" is the I2S bus clock and i2s_opclk0, i2s_opclk1 are sources
      of the root clock. I2S0 has internal mux to select the source
      of root clock and I2S1 and I2S2 doesn't have any such mux.

  "#clock-cells":
    const: 1

  clock-output-names:
    deprecated: true
    oneOf:
      - items: # for I2S0
          - const: i2s_cdclk0
      - items: # for I2S1
          - const: i2s_cdclk1
      - items: # for I2S2
          - const: i2s_cdclk2
    description: Names of the CDCLK I2S output clocks.

  interrupts:
    maxItems: 1

  samsung,idma-addr:
    $ref: /schemas/types.yaml#/definitions/uint32
    description: |
      Internal DMA register base address of the audio
      subsystem (used in secondary sound source).

  power-domains:
    maxItems: 1

  "#sound-dai-cells":
    const: 1

required:
  - compatible
  - reg
  - dmas
  - dma-names
  - clocks
  - clock-names

additionalProperties: false

examples:
  - |
    #include <dt-bindings/clock/exynos-audss-clk.h>

    i2s0: i2s@3830000 {
        compatible = "samsung,s5pv210-i2s";
        reg = <0x03830000 0x100>;
        dmas = <&pdma0 10>,
                <&pdma0 9>,
                <&pdma0 8>;
        dma-names = "tx", "rx", "tx-sec";
        clocks = <&clock_audss EXYNOS_I2S_BUS>,
                <&clock_audss EXYNOS_I2S_BUS>,
                <&clock_audss EXYNOS_SCLK_I2S>;
        clock-names = "iis", "i2s_opclk0", "i2s_opclk1";
        #clock-cells = <1>;
        samsung,idma-addr = <0x03000000>;
        pinctrl-names = "default";
        pinctrl-0 = <&i2s0_bus>;
        #sound-dai-cells = <1>;
    };
```

## Documentation/devicetree/bindings/sound/serial-midi.yaml
```yaml
# SPDX-License-Identifier: GPL-2.0-only OR BSD-2-Clause

%YAML 1.2
---
$id: http://devicetree.org/schemas/sound/serial-midi.yaml#
$schema: http://devicetree.org/meta-schemas/core.yaml#

title: Generic Serial MIDI Interface

maintainers:
  - Daniel Kaehn <kaehndan@gmail.com>

description:
  Generic MIDI interface using a serial device. This denotes that a serial device is
  dedicated to MIDI communication, either to an external MIDI device through a DIN5
  or other connector, or to a known hardwired MIDI controller. This device must be a
  child node of a serial node.

  Can only be set to use standard baud rates corresponding to supported rates of the
  parent serial device. If the standard MIDI baud of 31.25 kBaud is needed
  (as would be the case if interfacing with arbitrary external MIDI devices),
  configure the clocks of the parent serial device so that a requested baud of 38.4 kBaud
  results in the standard MIDI baud rate, and set the 'current-speed' property to 38400 (default)

properties:
  compatible:
    const: serial-midi

  current-speed:
    description: Baudrate to set the serial port to when this MIDI device is opened.
    default: 38400

required:
  - compatible

additionalProperties: false

examples:
  - |
    serial {
        midi {
            compatible = "serial-midi";
        };
    };
  - |
    serial {
        midi {
            compatible = "serial-midi";
            current-speed = <115200>;
        };
    };
```

## Documentation/devicetree/bindings/sound/sgtl5000.txt
```
* Freescale SGTL5000 Stereo Codec

Required properties:
- compatible : "fsl,sgtl5000".

- reg : the I2C address of the device

- #sound-dai-cells: must be equal to 0

- clocks : the clock provider of SYS_MCLK

- VDDA-supply : the regulator provider of VDDA

- VDDIO-supply: the regulator provider of VDDIO

Optional properties:

- VDDD-supply : the regulator provider of VDDD

- micbias-resistor-k-ohms : the bias resistor to be used in kOmhs
	The resistor can take values of 2k, 4k or 8k.
	If set to 0 it will be off.
	If this node is not mentioned or if the value is unknown, then
	micbias	resistor is set to 4K.

- micbias-voltage-m-volts : the bias voltage to be used in mVolts
	The voltage can take values from 1.25V to 3V by 250mV steps
	If this node is not mentioned or the value is unknown, then
	the value is set to 1.25V.

- lrclk-strength: the LRCLK pad strength. Possible values are:
0, 1, 2 and 3 as per the table below:

VDDIO		1.8V		2.5V		3.3V
0 = 		Disable
1 =		1.66 mA		2.87 mA		4.02  mA
2 =		3.33 mA		5.74 mA		8.03  mA
3 =		4.99 mA		8.61 mA		12.05 mA

Example:

sgtl5000: codec@a {
	compatible = "fsl,sgtl5000";
	reg = <0x0a>;
	#sound-dai-cells = <0>;
	clocks = <&clks 150>;
	micbias-resistor-k-ohms = <2>;
	micbias-voltage-m-volts = <2250>;
	VDDA-supply = <&reg_3p3v>;
	VDDIO-supply = <&reg_3p3v>;
};
```

## Documentation/devicetree/bindings/sound/sgtl5000.yaml
```yaml
# SPDX-License-Identifier: GPL-2.0-only
%YAML 1.2
---
$id: http://devicetree.org/schemas/sound/sgtl5000.yaml#
$schema: http://devicetree.org/meta-schemas/core.yaml#

title: Freescale SGTL5000 Stereo Codec

maintainers:
  - Fabio Estevam <festevam@gmail.com>

allOf:
  - $ref: dai-common.yaml#

properties:
  compatible:
    const: fsl,sgtl5000

  reg:
    maxItems: 1

  "#sound-dai-cells":
    const: 0

  assigned-clock-parents: true
  assigned-clock-rates: true
  assigned-clocks: true

  clocks:
    items:
      - description: the clock provider of SYS_MCLK

  VDDA-supply:
    description: the regulator provider of VDDA

  VDDIO-supply:
    description: the regulator provider of VDDIO

  VDDD-supply:
    description: the regulator provider of VDDD

  micbias-resistor-k-ohms:
    description: The bias resistor to be used in kOhms. The resistor can take
      values of 2k, 4k or 8k. If set to 0 it will be off. If this node is not
      mentioned or if the value is unknown, then micbias resistor is set to
      4k.
    enum: [ 0, 2, 4, 8 ]

  micbias-voltage-m-volts:
    description: The bias voltage to be used in mVolts. The voltage can take
      values from 1.25V to 3V by 250mV steps. If this node is not mentioned
      or the value is unknown, then the value is set to 1.25V.
    $ref: /schemas/types.yaml#/definitions/uint32
    enum: [ 1250, 1500, 1750, 2000, 2250, 2500, 2750, 3000 ]

  lrclk-strength:
    description: |
      The LRCLK pad strength. Possible values are: 0, 1, 2 and 3 as per the
      table below:

        VDDIO		1.8V		2.5V		3.3V
        0 =		Disable
        1 =		1.66 mA		2.87 mA		4.02  mA
        2 =		3.33 mA		5.74 mA		8.03  mA
        3 =		4.99 mA		8.61 mA		12.05 mA
    $ref: /schemas/types.yaml#/definitions/uint32
    enum: [ 0, 1, 2, 3 ]

  sclk-strength:
    description: |
      The SCLK pad strength. Possible values are: 0, 1, 2 and 3 as per the
      table below:

        VDDIO		1.8V		2.5V		3.3V
        0 =		Disable
        1 =		1.66 mA		2.87 mA		4.02  mA
        2 =		3.33 mA		5.74 mA		8.03  mA
        3 =		4.99 mA		8.61 mA		12.05 mA
    $ref: /schemas/types.yaml#/definitions/uint32
    enum: [ 0, 1, 2, 3 ]

  port:
    $ref: audio-graph-port.yaml#
    unevaluatedProperties: false

required:
  - compatible
  - reg
  - "#sound-dai-cells"
  - clocks
  - VDDA-supply
  - VDDIO-supply

unevaluatedProperties: false

examples:
  - |
    i2c {
        #address-cells = <1>;
        #size-cells = <0>;

        codec@a {
            compatible = "fsl,sgtl5000";
            reg = <0x0a>;
            #sound-dai-cells = <0>;
            clocks = <&clks 150>;
            micbias-resistor-k-ohms = <2>;
            micbias-voltage-m-volts = <2250>;
            VDDA-supply = <&reg_3p3v>;
            VDDIO-supply = <&reg_3p3v>;
        };
    };
...
```
