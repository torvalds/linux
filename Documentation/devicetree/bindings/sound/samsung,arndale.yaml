## Documentation/devicetree/bindings/sound/simple-scu-card.txt
```
ASoC Simple SCU Sound Card

Simple SCU Sound Card is "Simple Sound Card" + "ALSA DPCM".
For example, you can use this driver if you want to exchange sampling rate convert,
Mixing, etc...

Required properties:

- compatible				: "simple-scu-audio-card"
					  "renesas,rsrc-card"
Optional properties:

- simple-audio-card,name		: see simple-audio-card.txt
- simple-audio-card,cpu			: see simple-audio-card.txt
- simple-audio-card,codec		: see simple-audio-card.txt

Optional subnode properties:

- simple-audio-card,format		: see simple-audio-card.txt
- simple-audio-card,frame-master	: see simple-audio-card.txt
- simple-audio-card,bitclock-master	: see simple-audio-card.txt
- simple-audio-card,bitclock-inversion	: see simple-audio-card.txt
- simple-audio-card,frame-inversion	: see simple-audio-card.txt
- simple-audio-card,convert-rate	: platform specified sampling rate convert
- simple-audio-card,convert-channels	: platform specified converted channel size (2 - 8 ch)
- simple-audio-card,prefix		: see routing
- simple-audio-card,widgets		: Please refer to widgets.txt.
- simple-audio-card,routing		: A list of the connections between audio components.
					  Each entry is a pair of strings, the first being the connection's sink,
					  the second being the connection's source. Valid names for sources.
					  use audio-prefix if some components is using same sink/sources naming.
					  it can be used if compatible was "renesas,rsrc-card";

Required CPU/CODEC subnodes properties:

- sound-dai				: see simple-audio-card.txt

Optional CPU/CODEC subnodes properties:

- clocks / system-clock-frequency	: see simple-audio-card.txt

Example 1. Sampling Rate Conversion

sound {
	compatible = "simple-scu-audio-card";

	simple-audio-card,name = "rsnd-ak4643";
	simple-audio-card,format = "left_j";
	simple-audio-card,bitclock-master = <&sndcodec>;
	simple-audio-card,frame-master = <&sndcodec>;

	simple-audio-card,convert-rate = <48000>;

	simple-audio-card,prefix = "ak4642";
	simple-audio-card,routing = "ak4642 Playback", "DAI0 Playback",
			"DAI0 Capture", "ak4642 Capture";

	sndcpu: simple-audio-card,cpu {
		sound-dai = <&rcar_sound>;
	};

	sndcodec: simple-audio-card,codec {
		sound-dai = <&ak4643>;
		system-clock-frequency = <11289600>;
	};
};

Example 2. 2 CPU 1 Codec (Mixing)

sound {
	compatible = "simple-scu-audio-card";

	simple-audio-card,name = "rsnd-ak4643";
	simple-audio-card,format = "left_j";
	simple-audio-card,bitclock-master = <&dpcmcpu>;
	simple-audio-card,frame-master = <&dpcmcpu>;

	simple-audio-card,routing = "ak4642 Playback", "DAI0 Playback",
			"ak4642 Playback", "DAI1 Playback";

	dpcmcpu: cpu@0 {
		sound-dai = <&rcar_sound 0>;
	};

	cpu@1 {
		sound-dai = <&rcar_sound 1>;
	};

	codec {
		prefix = "ak4642";
		sound-dai = <&ak4643>;
		clocks = <&audio_clock>;
	};
};
```

## Documentation/devicetree/bindings/sound/sirf-audio-codec.txt
```
SiRF internal audio CODEC

Required properties:

  - compatible : "sirf,atlas6-audio-codec" or "sirf,prima2-audio-codec"

  - reg : the register address of the device.

  - clocks: the clock of SiRF internal audio codec

Example:

audiocodec: audiocodec@b0040000 {
	compatible = "sirf,atlas6-audio-codec";
	reg = <0xb0040000 0x10000>;
	clocks = <&clks 27>;
};
```

## Documentation/devicetree/bindings/sound/sirf-audio-port.txt
```
* SiRF SoC audio port

Required properties:
- compatible: "sirf,audio-port"
- reg: Base address and size entries:
- dmas: List of DMA controller phandle and DMA request line ordered pairs.
- dma-names: Identifier string for each DMA request line in the dmas property.
  These strings correspond 1:1 with the ordered pairs in dmas.

  One of the DMA channels will be responsible for transmission (should be
  named "tx") and one for reception (should be named "rx").

Example:

audioport: audioport@b0040000 {
	compatible = "sirf,audio-port";
	reg = <0xb0040000 0x10000>;
	dmas = <&dmac1 3>, <&dmac1 8>;
	dma-names = "rx", "tx";
};
```

## Documentation/devicetree/bindings/sound/sirf-audio.txt
```
* SiRF atlas6 and prima2 internal audio codec and port based audio setups

Required properties:
- compatible: "sirf,sirf-audio-card"
- sirf,audio-platform: phandle for the platform node
- sirf,audio-codec: phandle for the SiRF internal codec node

Optional properties:
- hp-pa-gpios: Need to be present if the board need control external
  headphone amplifier.
- spk-pa-gpios: Need to be present if the board need control external
  speaker amplifier.
- hp-switch-gpios: Need to be present if the board capable to detect jack
  insertion, removal.

Available audio endpoints for the audio-routing table:

Board connectors:
 * Headset Stereophone
 * Ext Spk
 * Line In
 * Mic

SiRF internal audio codec pins:
 * HPOUTL
 * HPOUTR
 * SPKOUT
 * Ext Mic
 * Mic Bias

Example:

sound {
		compatible = "sirf,sirf-audio-card";
		sirf,audio-codec = <&audiocodec>;
		sirf,audio-platform = <&audioport>;
		hp-pa-gpios = <&gpio 44 0>;
		spk-pa-gpios = <&gpio 46 0>;
		hp-switch-gpios = <&gpio 45 0>;
};
```

## Documentation/devicetree/bindings/sound/sirf-usp.txt
```
* SiRF SoC USP module

Required properties:
- compatible: "sirf,prima2-usp-pcm"
- reg: Base address and size entries:
- dmas: List of DMA controller phandle and DMA request line ordered pairs.
- dma-names: Identifier string for each DMA request line in the dmas property.
  These strings correspond 1:1 with the ordered pairs in dmas.

  One of the DMA channels will be responsible for transmission (should be
  named "tx") and one for reception (should be named "rx").

- clocks: USP controller clock source
- pinctrl-names: Must contain a "default" entry.
- pinctrl-NNN: One property must exist for each entry in pinctrl-names.

Example:
usp0: usp@b0080000 {
	compatible = "sirf,prima2-usp-pcm";
	reg = <0xb0080000 0x10000>;
	clocks = <&clks 28>;
	dmas = <&dmac1 1>, <&dmac1 2>;
	dma-names = "rx", "tx";
	pinctrl-names = "default";
	pinctrl-0 = <&usp0_only_utfs_pins_a>;
};
```
