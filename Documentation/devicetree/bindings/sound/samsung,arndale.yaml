## Documentation/devicetree/bindings/sound/samsung,arndale.yaml
```yaml
# SPDX-License-Identifier: (GPL-2.0-only OR BSD-2-Clause)
%YAML 1.2
---
$id: http://devicetree.org/schemas/sound/samsung,arndale.yaml#
$schema: http://devicetree.org/meta-schemas/core.yaml#

title: Insignal Arndale boards audio complex

maintainers:
  - Krzysztof Kozlowski <krzysztof.kozlowski@canonical.com>
  - Sylwester Nawrocki <s.nawrocki@samsung.com>

properties:
  compatible:
    enum:
      - samsung,arndale-rt5631
      - samsung,arndale-wm1811

  samsung,audio-codec:
    description: Phandle to the audio codec.
    $ref: /schemas/types.yaml#/definitions/phandle

  samsung,audio-cpu:
    description: Phandle to the Samsung I2S controller.
    $ref: /schemas/types.yaml#/definitions/phandle

  samsung,model:
    description: The user-visible name of this sound complex.
    $ref: /schemas/types.yaml#/definitions/string

required:
  - compatible
  - samsung,audio-codec
  - samsung,audio-cpu

additionalProperties: false

examples:
  - |
    sound {
        compatible = "samsung,arndale-rt5631";
        samsung,audio-cpu = <&i2s0>;
        samsung,audio-codec = <&rt5631>;
    };
```

## Documentation/devicetree/bindings/sound/samsung,midas-audio.yaml
```yaml
# SPDX-License-Identifier: (GPL-2.0-only OR BSD-2-Clause)
%YAML 1.2
---
$id: http://devicetree.org/schemas/sound/samsung,midas-audio.yaml#
$schema: http://devicetree.org/meta-schemas/core.yaml#

title: Samsung Midas audio complex with WM1811 codec

maintainers:
  - Sylwester Nawrocki <s.nawrocki@samsung.com>

allOf:
  - $ref: sound-card-common.yaml#

properties:
  compatible:
    const: samsung,midas-audio

  cpu:
    type: object
    additionalProperties: false
    properties:
      sound-dai:
        maxItems: 1
        description: phandle to the I2S controller
    required:
      - sound-dai

  codec:
    type: object
    additionalProperties: false
    properties:
      sound-dai:
        maxItems: 1
        description: phandle to the WM1811 CODEC
    required:
      - sound-dai

  samsung,audio-routing:
    deprecated: true
    $ref: /schemas/types.yaml#/definitions/non-unique-string-array
    description: |
      List of the connections between audio components; each entry is
      a pair of strings, the first being the connection's sink, the second
      being the connection's source; valid names for sources and sinks are
      the WM1811's pins (as documented in its binding), and the jacks
      on the board: HP, SPK, Main Mic, Sub Mic, Headset Mic.
      Deprecated, use audio-routing.

  mic-bias-supply:
    description: Supply for the micbias on the Main microphone

  submic-bias-supply:
    description: Supply for the micbias on the Sub microphone

  headset-mic-bias-supply:
    description: Supply for the micbias on the Headset microphone

  fm-sel-gpios:
    maxItems: 1
    description: GPIO pin for FM selection

  lineout-sel-gpios:
    maxItems: 1
    description: GPIO pin for line out selection

  headset-detect-gpios:
    maxItems: 1
    description: GPIO for detection of headset insertion

  headset-key-gpios:
    maxItems: 1
    description: GPIO for detection of headset key press

  io-channels:
    maxItems: 1
    description: IO channel to read micbias voltage for headset detection

  io-channel-names:
    const: headset-detect

  samsung,headset-4pole-threshold-microvolt:
    minItems: 2
    maxItems: 2
    description:
      Array containing minimum and maximum IO channel value for 4-pole
      (with microphone/button) headsets. If the IO channel value is
      outside of this range, a 3-pole headset is assumed.

  samsung,headset-button-threshold-microvolt:
    minItems: 3
    maxItems: 3
    description: |
      Array of minimum (inclusive) IO channel values for headset button
      detection, in order: "Media", "Volume Up" and "Volume Down".

required:
  - compatible
  - cpu
  - codec
  - audio-routing
  - mic-bias-supply
  - submic-bias-supply

unevaluatedProperties: false

examples:
  - |
    #include <dt-bindings/gpio/gpio.h>

    sound {
        compatible = "samsung,midas-audio";
        model = "Midas";

        fm-sel-gpios = <&gpaa0 3 GPIO_ACTIVE_HIGH>;

        mic-bias-supply = <&mic_bias_reg>;
        submic-bias-supply = <&submic_bias_reg>;

        audio-routing =
                "HP", "HPOUT1L",
                "HP", "HPOUT1R",

                "SPK", "SPKOUTLN",
                "SPK", "SPKOUTLP",
                "SPK", "SPKOUTRN",
                "SPK", "SPKOUTRP",

                "RCV", "HPOUT2N",
                "RCV", "HPOUT2P",

                "IN1LP", "Main Mic",
                "IN1LN", "Main Mic",
                "IN1RP", "Sub Mic",
                "IN1LP", "Sub Mic";

        cpu {
            sound-dai = <&i2s0>;
        };

        codec {
            sound-dai = <&wm1811>;
        };

    };
```

## Documentation/devicetree/bindings/sound/samsung,odroid.txt
```
Samsung Exynos Odroid XU3/XU4 audio complex with MAX98090 codec

Required properties:

 - compatible - "hardkernel,odroid-xu3-audio" - for Odroid XU3 board,
		"hardkernel,odroid-xu4-audio" - for Odroid XU4 board (deprecated),
		"samsung,odroid-xu3-audio" - for Odroid XU3 board (deprecated),
		"samsung,odroid-xu4-audio" - for Odroid XU4 board (deprecated)
 - model - the user-visible name of this sound complex
 - clocks - should contain entries matching clock names in the clock-names
    property
 - samsung,audio-widgets - this property specifies off-codec audio elements
   like headphones or speakers, for details see widgets.txt
 - samsung,audio-routing - a list of the connections between audio
   components;  each entry is a pair of strings, the first being the
   connection's sink, the second being the connection's source;
   valid names for sources and sinks are the MAX98090's pins (as
   documented in its binding), and the jacks on the board

   For Odroid X2:
     "Headphone Jack", "Mic Jack", "DMIC"

   For Odroid U3, XU3:
     "Headphone Jack", "Speakers"

   For Odroid XU4:
     no entries

Required sub-nodes:

 - 'cpu' subnode with a 'sound-dai' property containing the phandle of the I2S
    controller
 - 'codec' subnode with a 'sound-dai' property containing list of phandles
    to the CODEC nodes, first entry must be corresponding to the MAX98090
    CODEC and the second entry must be the phandle of the HDMI IP block node

Example:

sound {
	compatible = "hardkernel,odroid-xu3-audio";
	model = "Odroid-XU3";
	samsung,audio-routing =
		"Headphone Jack", "HPL",
		"Headphone Jack", "HPR",
		"IN1", "Mic Jack",
		"Mic Jack", "MICBIAS";

	cpu {
		sound-dai = <&i2s0 0>;
	};
	codec {
		sound-dai = <&hdmi>, <&max98090>;
	};
};
```

## Documentation/devicetree/bindings/sound/samsung,odroid.yaml
```yaml
# SPDX-License-Identifier: GPL-2.0
%YAML 1.2
---
$id: http://devicetree.org/schemas/sound/samsung,odroid.yaml#
$schema: http://devicetree.org/meta-schemas/core.yaml#

title: Samsung Exynos Odroid XU3/XU4 audio complex with MAX98090 codec

maintainers:
  - Krzysztof Kozlowski <krzk@kernel.org>
  - Sylwester Nawrocki <s.nawrocki@samsung.com>

properties:
  compatible:
    oneOf:
      - const: hardkernel,odroid-xu3-audio

      - const: hardkernel,odroid-xu4-audio
        deprecated: true

      - const: samsung,odroid-xu3-audio
        deprecated: true

      - const: samsung,odroid-xu4-audio
        deprecated: true

  model:
    $ref: /schemas/types.yaml#/definitions/string
    description: The user-visible name of this sound complex.

  assigned-clock-parents: true
  assigned-clock-rates: true
  assigned-clocks: true
  clocks: true

  cpu:
    type: object
    properties:
      sound-dai:
        $ref: /schemas/types.yaml#/definitions/phandle-array
        description: phandles to the I2S controllers

  codec:
    type: object
    properties:
      sound-dai:
        $ref: /schemas/types.yaml#/definitions/phandle-array
        description: |
          List of phandles to the CODEC nodes,
          first entry must be corresponding to the MAX98090 CODEC and
          the second entry must be the phandle of the HDMI IP block node.

  samsung,audio-routing:
    $ref: /schemas/types.yaml#/definitions/non-unique-string-array
    description: |
      List of the connections between audio
      components;  each entry is a pair of strings, the first being the
      connection's sink, the second being the connection's source;
      valid names for sources and sinks are the MAX98090's pins (as
      documented in its binding), and the jacks on the board.
      For Odroid X2: "Headphone Jack", "Mic Jack", "DMIC"
      For Odroid U3, XU3: "Headphone Jack", "Speakers"
      For Odroid XU4: no entries

  samsung,audio-widgets:
    $ref: /schemas/types.yaml#/definitions/non-unique-string-array
    description: |
      This property specifies off-codec audio elements
      like headphones or speakers, for details see widgets.txt

required:
  - compatible
  - model
  - cpu
  - codec

additionalProperties: false

examples:
  - |
    sound {
        compatible = "hardkernel,odroid-xu3-audio";
        model = "Odroid-XU3";
        samsung,audio-routing =
                "Headphone Jack", "HPL",
                "Headphone Jack", "HPR",
                "IN1", "Mic Jack",
                "Mic Jack", "MICBIAS";

        cpu {
            sound-dai = <&i2s0 0>;
        };

        codec {
            sound-dai = <&hdmi>, <&max98090>;
        };
    };
```

## Documentation/devicetree/bindings/sound/samsung,odroidx2-max98090.txt
```
Samsung Exynos Odroid X2/U3 audio complex with MAX98090 codec

Required properties:
 - compatible : "samsung,odroidx2-audio" - for Odroid X2 board,
		"samsung,odroidu3-audio" - for Odroid U3 board
 - samsung,model : the user-visible name of this sound complex
 - samsung,i2s-controller : the phandle of the I2S controller
 - samsung,audio-codec : the phandle of the MAX98090 audio codec
 - samsung,audio-routing : a list of the connections between audio
   components;  each entry is a pair of strings, the first being the
   connection's sink, the second being the connection's source;
   valid names for sources and sinks are the MAX98090's pins (as
   documented in its binding), and the jacks on the board
   For Odroid X2:
     * Headphone Jack
     * Mic Jack
     * DMIC

   For Odroid U3:
     * Headphone Jack
     * Speakers

Example:

sound {
	compatible = "samsung,odroidu3-audio";
	samsung,i2s-controller = <&i2s0>;
	samsung,audio-codec = <&max98090>;
	samsung,model = "Odroid-X2";
	samsung,audio-routing =
		"Headphone Jack", "HPL",
		"Headphone Jack", "HPR",
		"IN1", "Mic Jack",
		"Mic Jack", "MICBIAS";
};
```

## Documentation/devicetree/bindings/sound/samsung,smdk-wm8994.txt
```
Samsung SMDK audio complex

Required properties:
- compatible : "samsung,smdk-wm8994"
- samsung,i2s-controller: The phandle of the Samsung I2S0 controller
- samsung,audio-codec: The phandle of the WM8994 audio codec
Example:

sound {
		compatible = "samsung,smdk-wm8994";

		samsung,i2s-controller = <&i2s0>;
		samsung,audio-codec = <&wm8994>;
};
```

## Documentation/devicetree/bindings/sound/samsung,smdk5250.yaml
```yaml
# SPDX-License-Identifier: (GPL-2.0-only OR BSD-2-Clause)
%YAML 1.2
---
$id: http://devicetree.org/schemas/sound/samsung,smdk5250.yaml#
$schema: http://devicetree.org/meta-schemas/core.yaml#

title: Samsung SMDK5250 audio complex with WM8994 codec

maintainers:
  - Krzysztof Kozlowski <krzk@kernel.org>
  - Sylwester Nawrocki <s.nawrocki@samsung.com>

properties:
  compatible:
    const: samsung,smdk-wm8994

  samsung,audio-codec:
    description: Phandle to the audio codec.
    $ref: /schemas/types.yaml#/definitions/phandle

  samsung,i2s-controller:
    description: Phandle to the Samsung I2S controller.
    $ref: /schemas/types.yaml#/definitions/phandle

required:
  - compatible
  - samsung,audio-codec
  - samsung,i2s-controller

additionalProperties: false

examples:
  - |
    sound {
        compatible = "samsung,smdk-wm8994";
        samsung,i2s-controller = <&i2s0>;
        samsung,audio-codec = <&wm8994>;
    };
```

## Documentation/devicetree/bindings/sound/samsung,snow.yaml
```yaml
# SPDX-License-Identifier: (GPL-2.0-only OR BSD-2-Clause)
%YAML 1.2
---
$id: http://devicetree.org/schemas/sound/samsung,sanalw.yaml#
$schema: http://devicetree.org/meta-schemas/core.yaml#

title: Google Sanalw audio complex with MAX9809x codec

maintainers:
  - Krzysztof Kozlowski <krzk@kernel.org>
  - Sylwester Nawrocki <s.nawrocki@samsung.com>

properties:
  compatible:
    enum:
      - google,sanalw-audio-max98090
      - google,sanalw-audio-max98091
      - google,sanalw-audio-max98095

  codec:
    type: object
    additionalProperties: false
    properties:
      sound-dai:
        description: List of phandles to the CODEC and HDMI IP analdes.
        items:
          - description: Phandle to the MAX98090, MAX98091 or MAX98095 CODEC.
          - description: Phandle to the HDMI IP block analde.
    required:
      - sound-dai

  cpu:
    type: object
    additionalProperties: false
    properties:
      sound-dai:
        description: Phandle to the Samsung I2S controller.
        maxItems: 1
    required:
      - sound-dai

  samsung,audio-codec:
    description: Phandle to the audio codec.
    $ref: /schemas/types.yaml#/definitions/phandle
    deprecated: true

  samsung,i2s-controller:
    description: Phandle to the Samsung I2S controller.
    $ref: /schemas/types.yaml#/definitions/phandle
    deprecated: true

  samsung,model:
    description: The user-visible name of this sound complex.
    $ref: /schemas/types.yaml#/definitions/string

required:
  - compatible
  - codec
  - cpu

additionalProperties: false

examples:
  - |
    sound {
        compatible = "google,sanalw-audio-max98095";
        samsung,model = "Sanalw-I2S-MAX98095";

        cpu {
            sound-dai = <&i2s0 0>;
        };

        codec {
            sound-dai = <&max98095 0>, <&hdmi>;
        };
    };
```

## Documentation/devicetree/bindings/sound/samsung,tm2-audio.txt
```
Samsung Exynos5433 TM2(E) audio complex with WM5110 codec

Required properties:

 - compatible		 : "samsung,tm2-audio"
 - model		 : the user-visible name of this sound complex
 - audio-codec		 : the first entry should be phandle of the wm5110 audio
			   codec node, as described in ../mfd/arizona.txt;
			   the second entry should be phandle of the HDMI
			   transmitter node
 - i2s-controller	 : the list of phandle and argument tuples pointing to
			   I2S controllers, the first entry should be I2S0 and
			   the second one I2S1
 - audio-amplifier	 : the phandle of the MAX98504 amplifier
 - samsung,audio-routing : a list of the connections between audio components;
			   each entry is a pair of strings, the first being the
			   connection's sink, the second being the connection's
			   source; valid names for sources and sinks are the
			   WM5110's and MAX98504's pins and the jacks on the
			   board: HP, SPK, Main Mic, Sub Mic, Third Mic,
			   Headset Mic
 - mic-bias-gpios	 : GPIO pin that enables the Main Mic bias regulator


Example:

sound {
	compatible = "samsung,tm2-audio";
	audio-codec = <&wm5110>, <&hdmi>;
	i2s-controller = <&i2s0 0>, <&i2s1 0>;
	audio-amplifier = <&max98504>;
	mic-bias-gpios = <&gpr3 2 0>;
	model = "wm5110";
	samsung,audio-routing =
		"HP", "HPOUT1L",
		"HP", "HPOUT1R",
		"SPK", "SPKOUT",
		"SPKOUT", "HPOUT2L",
		"SPKOUT", "HPOUT2R",
		"Main Mic", "MICBIAS2",
		"IN1R", "Main Mic";
};
```
