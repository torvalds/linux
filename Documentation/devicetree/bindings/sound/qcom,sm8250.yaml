## Documentation/devicetree/bindings/sound/realtek,rt1015.yaml
```yaml
# SPDX-License-Identifier: (GPL-2.0-only OR BSD-2-Clause)
%YAML 1.2
---
$id: http://devicetree.org/schemas/sound/realtek,rt1015.yaml#
$schema: http://devicetree.org/meta-schemas/core.yaml#

title: RT1015 Mono Class D Audio Amplifier

maintainers:
  - Jack Yu <jack.yu@realtek.com>

properties:
  compatible:
    enum:
      - realtek,rt1015

  reg:
    maxItems: 1

  realtek,power-up-delay-ms:
    description: Set a delay time for flush work to be completed,
      this vlaue is adjustable depending on platform.
    maxItems: 1

required:
  - compatible
  - reg

additionalProperties: false

examples:
  - |
    i2c {
        #address-cells = <1>;
        #size-cells = <0>;
        codec@28 {
            compatible = "realtek,rt1015";
            reg = <0x28>;
            realtek,power-up-delay-ms = <50>;
        };
    };
```

## Documentation/devicetree/bindings/sound/realtek,rt1015p.yaml
```yaml
# SPDX-License-Identifier: GPL-2.0
%YAML 1.2
---
$id: http://devicetree.org/schemas/sound/realtek,rt1015p.yaml#
$schema: http://devicetree.org/meta-schemas/core.yaml#

title: Realtek rt1015p codec devicetree bindings

maintainers:
  - Tzung-Bi Shih <tzungbi@google.com>

description: |
  Rt1015p is a rt1015 variant which does not support I2C and
  only supports S24, 48kHz, 64FS.

properties:
  compatible:
    enum:
      - realtek,rt1015p
      - realtek,rt1019p

  sdb-gpios:
    description:
      GPIO used for shutdown control.
      0 means shut down; 1 means power on.
    maxItems: 1

required:
  - compatible

additionalProperties: false

examples:
  - |
    #include <dt-bindings/gpio/gpio.h>

    rt1015p: rt1015p {
        compatible = "realtek,rt1015p";
        sdb-gpios = <&pio 175 GPIO_ACTIVE_HIGH>;
    };
```

## Documentation/devicetree/bindings/sound/realtek,rt1016.yaml
```yaml
# SPDX-License-Identifier: (GPL-2.0 OR BSD-2-Clause)
%YAML 1.2
---
$id: http://devicetree.org/schemas/sound/realtek,rt1016.yaml#
$schema: http://devicetree.org/meta-schemas/core.yaml#

title: Reaktek RT1016 Stereo Class D Audio Amplifier

maintainers:
  - oder_chiou@realtek.com

allOf:
  - $ref: dai-common.yaml#

properties:
  compatible:
    const: realtek,rt1016

  reg:
    maxItems: 1

  "#sound-dai-cells":
    const: 0

required:
  - compatible
  - reg

unevaluatedProperties: false

examples:
  - |
    i2c {
        #address-cells = <1>;
        #size-cells = <0>;
        codec@1a {
            compatible = "realtek,rt1016";
            reg = <0x1a>;
        };
    };
```

## Documentation/devicetree/bindings/sound/realtek,rt5514.yaml
```yaml
# SPDX-License-Identifier: GPL-2.0-only OR BSD-2-Clause
%YAML 1.2
---
$id: http://devicetree.org/schemas/sound/realtek,rt5514.yaml#
$schema: http://devicetree.org/meta-schemas/core.yaml#

title: RT5514 audio CODEC

maintainers:
  - Animesh Agarwal <animeshagarwal28@gmail.com>

description: |
  This device supports both I2C and SPI.

  Pins on the device (for linking into audio routes) for I2C:
    * DMIC1L
    * DMIC1R
    * DMIC2L
    * DMIC2R
    * AMICL
    * AMICR

allOf:
  - $ref: /schemas/spi/spi-peripheral-props.yaml#
  - $ref: dai-common.yaml#

properties:
  compatible:
    const: realtek,rt5514

  reg:
    maxItems: 1

  clocks:
    items:
      - description: Master clock to the CODEC

  clock-names:
    items:
      - const: mclk

  interrupts:
    maxItems: 1
    description: The interrupt number to the cpu.

  realtek,dmic-init-delay-ms:
    description: Set the DMIC initial delay (ms) to wait it ready for I2C.

  spi-max-frequency: true

  wakeup-source:
    type: boolean
    description: Flag to indicate this device can wake system (suspend/resume).

required:
  - compatible
  - reg

unevaluatedProperties: false

examples:
  - |
    i2c {
        #address-cells = <1>;
        #size-cells = <0>;
        codec@57 {
            compatible = "realtek,rt5514";
            reg = <0x57>;
        };
    };
```

## Documentation/devicetree/bindings/sound/realtek,rt5575.yaml
```yaml
# SPDX-License-Identifier: GPL-2.0-only OR BSD-2-Clause
%YAML 1.2
---
$id: http://devicetree.org/schemas/sound/realtek,rt5575.yaml#
$schema: http://devicetree.org/meta-schemas/core.yaml#

title: ALC5575 audio CODEC

maintainers:
  - Oder Chiou <oder_chiou@realtek.com>

description:
  The device supports both I2C and SPI. I2C is mandatory, while SPI is
  optional depending on the hardware configuration. SPI is used for
  firmware loading if present.

allOf:
  - $ref: dai-common.yaml#

properties:
  compatible:
    const: realtek,rt5575

  reg:
    maxItems: 1

  spi-parent:
    description:
      Optional phandle reference to the SPI controller used for firmware
      loading. The argument specifies the chip select.
    $ref: /schemas/types.yaml#/definitions/phandle-array

required:
  - compatible
  - reg

unevaluatedProperties: false

examples:
  # I2C-only node
  - |
    i2c {
        #address-cells = <1>;
        #size-cells = <0>;
        codec@57 {
            compatible = "realtek,rt5575";
            reg = <0x57>;
        };
    };

  # I2C + optional SPI node
  - |
    i2c {
        #address-cells = <1>;
        #size-cells = <0>;
        codec@57 {
            compatible = "realtek,rt5575";
            reg = <0x57>;
            spi-parent = <&spi0 0>; /* chip-select 0 */
        };
    };
```

## Documentation/devicetree/bindings/sound/realtek,rt5616.yaml
```yaml
# SPDX-License-Identifier: (GPL-2.0 OR BSD-2-Clause)
%YAML 1.2
---
$id: http://devicetree.org/schemas/sound/realtek,rt5616.yaml#
$schema: http://devicetree.org/meta-schemas/core.yaml#

title: Realtek rt5616 ALSA SoC audio codec driver

description: |
  Pins on the device (for linking into audio routes) for RT5616:

      * IN1P
      * IN2P
      * IN2N
      * LOUTL
      * LOUTR
      * HPOL
      * HPOR

maintainers:
  - Bard Liao <bardliao@realtek.com>

allOf:
  - $ref: dai-common.yaml#

properties:
  compatible:
    const: realtek,rt5616

  reg:
    maxItems: 1

  clocks:
    items:
      - description: Master clock to the CODEC

  clock-names:
    items:
      - const: mclk

  port:
    $ref: audio-graph-port.yaml#
    unevaluatedProperties: false

required:
  - compatible
  - reg

unevaluatedProperties: false

examples:
  - |
    i2c {
        #address-cells = <1>;
        #size-cells = <0>;

        audio-codec@1b {
            compatible = "realtek,rt5616";
            reg = <0x1b>;
        };
    };
```

## Documentation/devicetree/bindings/sound/realtek,rt5631.yaml
```yaml
# SPDX-License-Identifier: GPL-2.0-only OR BSD-2-Clause
%YAML 1.2
---
$id: http://devicetree.org/schemas/sound/realtek,rt5631.yaml#
$schema: http://devicetree.org/meta-schemas/core.yaml#

title: ALC5631/RT5631 audio CODEC

maintainers:
  - Animesh Agarwal <animeshagarwal28@gmail.com>

description: |
  This device supports I2C only.

  Pins on the device (for linking into audio routes):
      * SPK_OUT_R_P
      * SPK_OUT_R_N
      * SPK_OUT_L_P
      * SPK_OUT_L_N
      * HP_OUT_L
      * HP_OUT_R
      * AUX_OUT2_LP
      * AUX_OUT2_RN
      * AUX_OUT1_LP
      * AUX_OUT1_RN
      * AUX_IN_L_JD
      * AUX_IN_R_JD
      * MONO_IN_P
      * MONO_IN_N
      * MIC1_P
      * MIC1_N
      * MIC2_P
      * MIC2_N
      * MONO_OUT_P
      * MONO_OUT_N
      * MICBIAS1
      * MICBIAS2

properties:
  compatible:
    enum:
      - realtek,alc5631
      - realtek,rt5631

  reg:
    maxItems: 1

  port:
    $ref: audio-graph-port.yaml#
    unevaluatedProperties: false

required:
  - compatible
  - reg

additionalProperties: false

examples:
  - |
    i2c {
        #address-cells = <1>;
        #size-cells = <0>;
        codec@1a {
            compatible = "realtek,alc5631";
            reg = <0x1a>;
        };
    };
```

## Documentation/devicetree/bindings/sound/realtek,rt5640.yaml
```yaml
# SPDX-License-Identifier: GPL-2.0-only OR BSD-2-Clause
%YAML 1.2
---
$id: http://devicetree.org/schemas/sound/realtek,rt5640.yaml#
$schema: http://devicetree.org/meta-schemas/core.yaml#

title: RT5640/RT5639 audio CODEC

maintainers:
  - Neil Armstrong <neil.armstrong@linaro.org>

description: |
  This device supports I2C only.

  Pins on the device (for linking into audio routes) for RT5639/RT5640:
    * DMIC1
    * DMIC2
    * MICBIAS1
    * IN1P
    * IN1N
    * IN2P
    * IN2N
    * IN3P
    * IN3N
    * HPOL
    * HPOR
    * LOUTL
    * LOUTR
    * SPOLP
    * SPOLN
    * SPORP
    * SPORN

  Additional pins on the device for RT5640:
    * MONOP
    * MONON

allOf:
  - $ref: dai-common.yaml#

properties:
  compatible:
    enum:
      - realtek,rt5640
      - realtek,rt5639

  reg:
    maxItems: 1

  interrupts:
    maxItems: 1
    description: The CODEC's interrupt output.

  realtek,in1-differential:
    description:
      Indicate MIC1 input is differential, rather than single-ended.
    type: boolean

  realtek,in2-differential:
    description:
      Indicate MIC2 input is differential, rather than single-ended.
    type: boolean

  realtek,in3-differential:
    description:
      Indicate MIC3 input is differential, rather than single-ended.
    type: boolean

  realtek,lout-differential:
    description:
      Indicate LOUT output is differential, rather than single-ended.
    type: boolean

  realtek,dmic1-data-pin:
    description: Specify which pin to be used as DMIC1 data pin.
    $ref: /schemas/types.yaml#/definitions/uint32
    enum:
      - 0 # dmic1 is not used
      - 1 # using IN2P pin as dmic1 data pin
      - 2 # using GPIO3 pin as dmic1 data pin

  realtek,dmic2-data-pin:
    description: Specify which pin to be used as DMIC2 data pin.
    $ref: /schemas/types.yaml#/definitions/uint32
    enum:
      - 0 # dmic2 is not used
      - 1 # using IN2N pin as dmic2 data pin
      - 2 # using GPIO4 pin as dmic2 data pin

  realtek,jack-detect-source:
    description: The Jack Detect source.
    $ref: /schemas/types.yaml#/definitions/uint32
    enum:
      - 0 # Jack Detect function is not used
      - 1 # Use GPIO1 for jack-detect
      - 2 # Use JD1_IN4P for jack-detect
      - 3 # Use JD2_IN4N for jack-detect
      - 4 # Use GPIO2 for jack-detect
      - 5 # Use GPIO3 for jack-detect
      - 6 # Use GPIO4 for jack-detect

  realtek,jack-detect-not-inverted:
    description:
      Normal jack-detect switches give an inverted signal, set this bool
      in the rare case you've a jack-detect switch which is not inverted.
    type: boolean

  realtek,over-current-threshold-microamp:
    description: micbias over-current detection threshold in µA
    enum:
      - 600
      - 1500
      - 2000

  realtek,over-current-scale-factor:
    description: micbias over-current detection scale-factor
    $ref: /schemas/types.yaml#/definitions/uint32
    enum:
      - 0 # Scale current by 0.5
      - 1 # Scale current by 0.75
      - 2 # Scale current by 1.0
      - 3 # Scale current by 1.5

required:
  - compatible
  - reg
  - interrupts

unevaluatedProperties: false

examples:
  - |
    #include <dt-bindings/gpio/gpio.h>
    #include <dt-bindings/interrupt-controller/irq.h>

    i2c {
        #address-cells = <1>;
        #size-cells = <0>;

        codec@1a {
            compatible = "realtek,rt5640";
            reg = <0x1a>;
            interrupt-parent = <&gpio>;
            interrupts = <7 IRQ_TYPE_EDGE_FALLING>;
        };
    };
```
