## Documentation/devicetree/bindings/sound/qcom,wcd939x-sdw.yaml
```yaml
# SPDX-License-Identifier: (GPL-2.0-only OR BSD-2-Clause)
%YAML 1.2
---
$id: http://devicetree.org/schemas/sound/qcom,wcd939x-sdw.yaml#
$schema: http://devicetree.org/meta-schemas/core.yaml#

title: Qualcomm SoundWire devices on WCD9390/WCD9395

maintainers:
  - Srinivas Kandagatla <srinivas.kandagatla@linaro.org>

description: |
  Qualcomm WCD9390/WCD9395 Codec is a standalone Hi-Fi audio codec IC.
  It has RX and TX Soundwire devices. This bindings is for the devices.

properties:
  compatible:
    const: sdw20217010e00

  reg:
    maxItems: 1

  qcom,tx-port-mapping:
    description: |
      Specifies static port mapping between device and host tx ports.
      In the order of the device port index.
    $ref: /schemas/types.yaml#/definitions/uint32-array
    minItems: 4
    maxItems: 4

  qcom,rx-port-mapping:
    description: |
      Specifies static port mapping between device and host rx ports.
      In the order of device port index.
    $ref: /schemas/types.yaml#/definitions/uint32-array
    minItems: 6
    maxItems: 6

required:
  - compatible
  - reg

additionalProperties: false

examples:
  - |
    soundwire@3210000 {
        #address-cells = <2>;
        #size-cells = <0>;
        reg = <0x03210000 0x2000>;
        wcd938x_rx: codec@0,4 {
            compatible = "sdw20217010e00";
            reg = <0 4>;
            qcom,rx-port-mapping = <1 2 3 4 5 6>;
        };
    };

    soundwire@3230000 {
        #address-cells = <2>;
        #size-cells = <0>;
        reg = <0x03230000 0x2000>;
        wcd938x_tx: codec@0,3 {
            compatible = "sdw20217010e00";
            reg = <0 3>;
            qcom,tx-port-mapping = <2 3 4 5>;
        };
    };

...
```

## Documentation/devicetree/bindings/sound/qcom,wcd939x.yaml
```yaml
# SPDX-License-Identifier: (GPL-2.0-only OR BSD-2-Clause)
%YAML 1.2
---
$id: http://devicetree.org/schemas/sound/qcom,wcd939x.yaml#
$schema: http://devicetree.org/meta-schemas/core.yaml#

title: Qualcomm WCD9380/WCD9385 Audio Codec

maintainers:
  - Srinivas Kandagatla <srinivas.kandagatla@linaro.org>

description: |
  Qualcomm WCD9390/WCD9395 Codec is a standalone Hi-Fi audio codec IC.
  It has RX and TX Soundwire devices.
  The WCD9390/WCD9395 IC has a functionally separate USB-C Mux subsystem
  accessible over an I2C interface.
  The Audio Headphone and Microphone data path between the Codec and the USB-C Mux
  subsystems are external to the IC, thus requiring DT port-endpoint graph description
  to handle USB-C altmode & orientation switching for Audio Accessory Mode.

allOf:
  - $ref: dai-common.yaml#
  - $ref: qcom,wcd93xx-common.yaml#

properties:
  compatible:
    oneOf:
      - const: qcom,wcd9390-codec
      - items:
          - const: qcom,wcd9395-codec
          - const: qcom,wcd9390-codec

  mode-switch:
    description: Flag the port as possible handler of altmode switching
    type: boolean

  orientation-switch:
    description: Flag the port as possible handler of orientation switching
    type: boolean

  port:
    $ref: /schemas/graph.yaml#/properties/port
    description:
      A port node to link the WCD939x Codec node to USB MUX subsystems for the
      purpose of handling altmode muxing and orientation switching to detect and
      enable Audio Accessory Mode.

  vdd-px-supply:
    description: A reference to the 1.2V PX supply

required:
  - compatible

unevaluatedProperties: false

examples:
  - |
    #include <dt-bindings/gpio/gpio.h>
    codec {
        compatible = "qcom,wcd9390-codec";
        reset-gpios = <&tlmm 32 GPIO_ACTIVE_LOW>;
        #sound-dai-cells = <1>;
        qcom,tx-device = <&wcd939x_tx>;
        qcom,rx-device = <&wcd939x_rx>;
        qcom,micbias1-microvolt = <1800000>;
        qcom,micbias2-microvolt = <1800000>;
        qcom,micbias3-microvolt = <1800000>;
        qcom,micbias4-microvolt = <1800000>;
        qcom,hphl-jack-type-normally-closed;
        qcom,ground-jack-type-normally-closed;
        qcom,mbhc-buttons-vthreshold-microvolt = <75000 150000 237000 500000 500000 500000 500000 500000>;
        qcom,mbhc-headphone-vthreshold-microvolt = <50000>;
    };

    /* ... */

    soundwire@3210000 {
        #address-cells = <2>;
        #size-cells = <0>;
        reg = <0x03210000 0x2000>;
        wcd939x_rx: codec@0,4 {
            compatible = "sdw20217010e00";
            reg = <0 4>;
            qcom,rx-port-mapping = <1 2 3 4 5 6>;
        };
    };

    soundwire@3230000 {
        #address-cells = <2>;
        #size-cells = <0>;
        reg = <0x03230000 0x2000>;
        wcd938x_tx: codec@0,3 {
            compatible = "sdw20217010e00";
            reg = <0 3>;
            qcom,tx-port-mapping = <2 3 4 5>;
        };
    };

...
```

## Documentation/devicetree/bindings/sound/qcom,wcd93xx-common.yaml
```yaml
# SPDX-License-Identifier: (GPL-2.0-only OR BSD-2-Clause)
%YAML 1.2
---
$id: http://devicetree.org/schemas/sound/qcom,wcd93xx-common.yaml#
$schema: http://devicetree.org/meta-schemas/core.yaml#

title: Common properties for Qualcomm WCD93xx Audio Codec

maintainers:
  - Srinivas Kandagatla <srinivas.kandagatla@linaro.org>

properties:
  reset-gpios:
    description: GPIO spec for reset line to use
    maxItems: 1

  vdd-buck-supply:
    description: A reference to the 1.8V buck supply

  vdd-rxtx-supply:
    description: A reference to the 1.8V rx supply

  vdd-io-supply:
    description: A reference to the 1.8V I/O supply

  vdd-mic-bias-supply:
    description: A reference to the 3.8V mic bias supply

  qcom,tx-device:
    $ref: /schemas/types.yaml#/definitions/phandle-array
    description: A reference to Soundwire tx device phandle

  qcom,rx-device:
    $ref: /schemas/types.yaml#/definitions/phandle-array
    description: A reference to Soundwire rx device phandle

  qcom,micbias1-microvolt:
    description: micbias1 voltage
    minimum: 1800000
    maximum: 2850000

  qcom,micbias2-microvolt:
    description: micbias2 voltage
    minimum: 1800000
    maximum: 2850000

  qcom,micbias3-microvolt:
    description: micbias3 voltage
    minimum: 1800000
    maximum: 2850000

  qcom,micbias4-microvolt:
    description: micbias4 voltage
    minimum: 1800000
    maximum: 2850000

  qcom,hphl-jack-type-normally-closed:
    description: Indicates that HPHL jack switch type is normally closed
    type: boolean

  qcom,ground-jack-type-normally-closed:
    description: Indicates that Headset Ground switch type is normally closed
    type: boolean

  qcom,mbhc-headset-vthreshold-microvolt:
    description: Voltage threshold value for headset detection
    minimum: 0
    maximum: 2850000

  qcom,mbhc-headphone-vthreshold-microvolt:
    description: Voltage threshold value for headphone detection
    minimum: 0
    maximum: 2850000

  qcom,mbhc-buttons-vthreshold-microvolt:
    description:
      Array of 8 Voltage threshold values corresponding to headset
      button0 - button7
    minItems: 8
    maxItems: 8

  '#sound-dai-cells':
    const: 1

required:
  - reset-gpios
  - qcom,tx-device
  - qcom,rx-device
  - qcom,micbias1-microvolt
  - qcom,micbias2-microvolt
  - qcom,micbias3-microvolt
  - qcom,micbias4-microvolt
  - "#sound-dai-cells"

additionalProperties: true
```

## Documentation/devicetree/bindings/sound/qcom,wsa881x.yaml
```yaml
# SPDX-License-Identifier: (GPL-2.0-only OR BSD-2-Clause)
%YAML 1.2
---
$id: http://devicetree.org/schemas/sound/qcom,wsa881x.yaml#
$schema: http://devicetree.org/meta-schemas/core.yaml#

title: Qualcomm WSA8810/WSA8815 Class-D Smart Speaker Amplifier

maintainers:
  - Srinivas Kandagatla <srinivas.kandagatla@linaro.org>

description: |
  WSA8810 is a class-D smart speaker amplifier and WSA8815
  is a high-output power class-D smart speaker amplifier.
  Their primary operating mode uses a SoundWire digital audio
  interface. This binding is for SoundWire interface.

allOf:
  - $ref: dai-common.yaml#

properties:
  compatible:
    const: sdw10217201000

  reg:
    maxItems: 1

  powerdown-gpios:
    description: GPIO spec for Powerdown/Shutdown line to use
    maxItems: 1

  '#thermal-sensor-cells':
    const: 0

  '#sound-dai-cells':
    const: 0

required:
  - compatible
  - reg
  - powerdown-gpios
  - "#thermal-sensor-cells"
  - "#sound-dai-cells"

unevaluatedProperties: false

examples:
  - |
    soundwire@c2d0000 {
        #address-cells = <2>;
        #size-cells = <0>;
        reg = <0x0c2d0000 0x2000>;

        speaker@0,1 {
            compatible = "sdw10217201000";
            reg = <0 1>;
            powerdown-gpios = <&wcdpinctrl 2 0>;
            #thermal-sensor-cells = <0>;
            #sound-dai-cells = <0>;
        };

        speaker@0,2 {
            compatible = "sdw10217201000";
            reg = <0 2>;
            powerdown-gpios = <&wcdpinctrl 2 0>;
            #thermal-sensor-cells = <0>;
            #sound-dai-cells = <0>;
        };
    };

...
```

## Documentation/devicetree/bindings/sound/qcom,wsa883x.yaml
```yaml
# SPDX-License-Identifier: (GPL-2.0-only OR BSD-2-Clause)
%YAML 1.2
---
$id: http://devicetree.org/schemas/sound/qcom,wsa883x.yaml#
$schema: http://devicetree.org/meta-schemas/core.yaml#

title: Bindings for The Qualcomm WSA8830/WSA8832/WSA8835
  smart speaker amplifier

maintainers:
  - Srinivas Kandagatla <srinivas.kandagatla@linaro.org>

description: |
  WSA883X is the Qualcomm Aqstic smart speaker amplifier
  Their primary operating mode uses a SoundWire digital audio
  interface. This binding is for SoundWire interface.

properties:
  compatible:
    const: sdw10217020200

  reg:
    maxItems: 1

  powerdown-gpios:
    description: GPIO spec for Powerdown/Shutdown line to use
    maxItems: 1

  vdd-supply:
    description: VDD Supply for the Codec

  '#thermal-sensor-cells':
    const: 0

  '#sound-dai-cells':
    const: 0

required:
  - compatible
  - reg
  - vdd-supply
  - powerdown-gpios
  - "#thermal-sensor-cells"
  - "#sound-dai-cells"

additionalProperties: false

examples:
  - |
    soundwire-controller@3250000 {
        #address-cells = <2>;
        #size-cells = <0>;
        reg = <0x3250000 0x2000>;

        speaker@0,1 {
            compatible = "sdw10217020200";
            reg = <0 1>;
            powerdown-gpios = <&tlmm 1 0>;
            vdd-supply = <&vreg_s10b_1p8>;
            #thermal-sensor-cells = <0>;
            #sound-dai-cells = <0>;
        };

        speaker@0,2 {
            compatible = "sdw10217020200";
            reg = <0 2>;
            powerdown-gpios = <&tlmm 89 0>;
            vdd-supply = <&vreg_s10b_1p8>;
            #thermal-sensor-cells = <0>;
            #sound-dai-cells = <0>;
        };
    };

...
```

## Documentation/devicetree/bindings/sound/qcom,wsa8840.yaml
```yaml
# SPDX-License-Identifier: (GPL-2.0-only OR BSD-2-Clause)
%YAML 1.2
---
$id: http://devicetree.org/schemas/sound/qcom,wsa8840.yaml#
$schema: http://devicetree.org/meta-schemas/core.yaml#

title: Qualcomm WSA8840/WSA8845/WSA8845H smart speaker amplifier

maintainers:
  - Krzysztof Kozlowski <krzysztof.kozlowski@linaro.org>
  - Srinivas Kandagatla <srinivas.kandagatla@linaro.org>

description:
  WSA884X is a family of Qualcomm Aqstic smart speaker amplifiers using
  SoundWire digital audio interface.

allOf:
  - $ref: dai-common.yaml#

properties:
  compatible:
    const: sdw20217020400

  reg:
    maxItems: 1

  powerdown-gpios:
    description: Powerdown/Shutdown line to use (pin SD_N)
    maxItems: 1

  reset-gpios:
    description: Powerdown/Shutdown line to use (pin SD_N)
    maxItems: 1

  qcom,port-mapping:
    description: |
      Specifies static port mapping between slave and master ports.
      In the order of slave port index.
    $ref: /schemas/types.yaml#/definitions/uint32-array
    minItems: 6
    maxItems: 6

  '#sound-dai-cells':
    const: 0

  vdd-1p8-supply: true
  vdd-io-supply: true

required:
  - compatible
  - reg
  - '#sound-dai-cells'
  - vdd-1p8-supply
  - vdd-io-supply

oneOf:
  - required:
      - powerdown-gpios
  - required:
      - reset-gpios

unevaluatedProperties: false

examples:
  - |
    #include <dt-bindings/gpio/gpio.h>

    soundwire {
        #address-cells = <2>;
        #size-cells = <0>;

        speaker@0,1 {
            compatible = "sdw20217020400";
            reg = <0 1>;
            pinctrl-names = "default";
            pinctrl-0 = <&spkr_2_sd_n_active>;
            powerdown-gpios = <&lpass_tlmm 18 GPIO_ACTIVE_LOW>;
            #sound-dai-cells = <0>;
            sound-name-prefix = "SpkrRight";
            vdd-1p8-supply = <&vreg_l15b_1p8>;
            vdd-io-supply = <&vreg_l3g_1p2>;
        };
    };
```

## Documentation/devicetree/bindings/sound/realtek,alc203.yaml
```yaml
# SPDX-License-Identifier: (GPL-2.0-only OR BSD-2-Clause)
%YAML 1.2
---
$id: http://devicetree.org/schemas/sound/realtek,alc203.yaml#
$schema: http://devicetree.org/meta-schemas/core.yaml#

title: Realtek ALC203 AC97 Audio Codec

maintainers:
  - Keguang Zhang <keguang.zhang@gmail.com>

description:
  ALC203 is a full duplex AC97 2.3 compatible stereo audio codec.

allOf:
  - $ref: dai-common.yaml#

properties:
  compatible:
    const: realtek,alc203

  '#sound-dai-cells':
    const: 0

required:
  - compatible
  - '#sound-dai-cells'

unevaluatedProperties: false

examples:
  - |
    audio-codec {
        compatible = "realtek,alc203";
        #sound-dai-cells = <0>;
    };
```

## Documentation/devicetree/bindings/sound/realtek,alc5623.yaml
```yaml
# SPDX-License-Identifier: (GPL-2.0-only OR BSD-2-Clause)
%YAML 1.2
---
$id: http://devicetree.org/schemas/sound/realtek,alc5623.yaml#
$schema: http://devicetree.org/meta-schemas/core.yaml#

title: ALC5621/ALC5623 Audio Codec

maintainers:
  - Mahdi Khosravi <mmk1776@gmail.com>

allOf:
  - $ref: dai-common.yaml#

properties:
  compatible:
    enum:
      - realtek,alc5621
      - realtek,alc5623

  reg:
    maxItems: 1

  add-ctrl:
    description:
      Default register value for Reg-40h, Additional Control Register.
      If absent or zero, the register is left untouched.
    $ref: /schemas/types.yaml#/definitions/uint32

  jack-det-ctrl:
    description:
      Default register value for Reg-5Ah, Jack Detect Control Register.
      If absent or zero, the register is left untouched.
    $ref: /schemas/types.yaml#/definitions/uint32

required:
  - compatible
  - reg

unevaluatedProperties: false

examples:
  - |
    i2c {
        #address-cells = <1>;
        #size-cells = <0>;

        codec@1a {
            compatible = "realtek,alc5623";
            reg = <0x1a>;
            add-ctrl = <0x3700>;
            jack-det-ctrl = <0x4810>;
        };
    };
```

## Documentation/devicetree/bindings/sound/realtek,alc5632.yaml
```yaml
# SPDX-License-Identifier: GPL-2.0-only OR BSD-2-Clause
%YAML 1.2
---
$id: http://devicetree.org/schemas/sound/realtek,alc5632.yaml#
$schema: http://devicetree.org/meta-schemas/core.yaml#

title: ALC5632 audio CODEC

description: |
  Pins on the device (for linking into audio routes):
      * SPK_OUTP
      * SPK_OUTN
      * HP_OUT_L
      * HP_OUT_R
      * AUX_OUT_P
      * AUX_OUT_N
      * LINE_IN_L
      * LINE_IN_R
      * PHONE_P
      * PHONE_N
      * MIC1_P
      * MIC1_N
      * MIC2_P
      * MIC2_N
      * MICBIAS1
      * DMICDAT

maintainers:
  - Leon Romanovsky <leon@leon.nu>

properties:
  compatible:
    const: realtek,alc5632

  reg:
    maxItems: 1

  '#gpio-cells':
    const: 2

  gpio-controller: true

required:
  - compatible
  - reg
  - '#gpio-cells'
  - gpio-controller

additionalProperties: false

examples:
  - |
    #include <dt-bindings/gpio/gpio.h>
    i2c {
        #address-cells = <1>;
        #size-cells = <0>;
        codec@1a {
            compatible = "realtek,alc5632";
            reg = <0x1a>;
            gpio-controller;
            #gpio-cells = <2>;
        };
    };
```
