## Documentation/devicetree/bindings/sound/qcom,sm8250.yaml
```yaml
# SPDX-License-Identifier: (GPL-2.0-only OR BSD-2-Clause)
%YAML 1.2
---
$id: http://devicetree.org/schemas/sound/qcom,sm8250.yaml#
$schema: http://devicetree.org/meta-schemas/core.yaml#

title: Qualcomm Technologies Inc. ASoC sound card drivers

maintainers:
  - Srinivas Kandagatla <srinivas.kandagatla@linaro.org>

description:
  This bindings describes Qualcomm SoC based sound cards
  which uses LPASS internal codec for audio.

properties:
  compatible:
    oneOf:
      - items:
          - enum:
              - lenovo,yoga-c630-sndcard
              - qcom,db845c-sndcard
          - const: qcom,sdm845-sndcard
      - items:
          - enum:
              - qcom,sm8550-sndcard
              - qcom,sm8650-sndcard
              - qcom,sm8750-sndcard
          - const: qcom,sm8450-sndcard
      - enum:
          - fairphone,fp5-sndcard
          - qcom,apq8096-sndcard
          - qcom,qcm6490-idp-sndcard
          - qcom,qcs6490-rb3gen2-sndcard
          - qcom,qcs9075-sndcard
          - qcom,qcs9100-sndcard
          - qcom,qrb4210-rb2-sndcard
          - qcom,qrb5165-rb5-sndcard
          - qcom,sc7180-qdsp6-sndcard
          - qcom,sc8280xp-sndcard
          - qcom,sdm845-sndcard
          - qcom,sm8250-sndcard
          - qcom,sm8450-sndcard
          - qcom,x1e80100-sndcard

  audio-routing:
    $ref: /schemas/types.yaml#/definitions/non-unique-string-array
    description:
      A list of the connections between audio components. Each entry is a
      pair of strings, the first being the connection's sink, the second
      being the connection's source. Valid names could be power supplies,
      MicBias of codec and the jacks on the board.

  aux-devs:
    $ref: /schemas/types.yaml#/definitions/phandle-array
    description: |
      List of phandles pointing to auxiliary devices, such
      as amplifiers, to be added to the sound card.

  model:
    $ref: /schemas/types.yaml#/definitions/string
    description: User visible long sound card name

patternProperties:
  ".*-dai-link$":
    description:
      Each subnode represents a dai link. Subnodes of each dai links would be
      cpu/codec dais.

    type: object

    properties:
      link-name:
        description: Indicates dai-link name and PCM stream name.
        $ref: /schemas/types.yaml#/definitions/string
        maxItems: 1

      cpu:
        description: Holds subnode which indicates cpu dai.
        type: object
        additionalProperties: false

        properties:
          sound-dai:
            maxItems: 1

      platform:
        description: Holds subnode which indicates platform dai.
        type: object
        additionalProperties: false

        properties:
          sound-dai:
            maxItems: 1

      codec:
        description: Holds subnode which indicates codec dai.
        type: object
        additionalProperties: false

        properties:
          sound-dai:
            minItems: 1
            maxItems: 8

    required:
      - link-name
      - cpu

    additionalProperties: false

required:
  - compatible
  - model

additionalProperties: false

examples:

  - |
    #include <dt-bindings/sound/qcom,q6afe.h>
    #include <dt-bindings/sound/qcom,q6asm.h>
    sound {
        compatible = "qcom,qrb5165-rb5-sndcard";
        model = "Qualcomm-qrb5165-RB5-WSA8815-Speakers-DMIC0";
        audio-routing = "SpkrLeft IN", "WSA_SPK1 OUT",
                    "SpkrRight IN", "WSA_SPK2 OUT",
                    "VA DMIC0", "vdd-micb",
                    "VA DMIC1", "vdd-micb";

        mm1-dai-link {
            link-name = "MultiMedia0";
            cpu {
                sound-dai = <&q6asmdai  MSM_FRONTEND_DAI_MULTIMEDIA1>;
            };
        };

        mm2-dai-link {
            link-name = "MultiMedia2";
            cpu {
                sound-dai = <&q6asmdai  MSM_FRONTEND_DAI_MULTIMEDIA2>;
            };
        };

        mm3-dai-link {
            link-name = "MultiMedia3";
            cpu {
                sound-dai = <&q6asmdai  MSM_FRONTEND_DAI_MULTIMEDIA3>;
            };
        };

        hdmi-dai-link {
            link-name = "HDMI Playback";
            cpu {
                sound-dai = <&q6afedai TERTIARY_MI2S_RX>;
            };

            platform {
                sound-dai = <&q6routing>;
            };

            codec {
                sound-dai = <&lt9611_codec 0>;
            };
        };

        wsa-dai-link {
            link-name = "WSA Playback";
            cpu {
                sound-dai = <&q6afedai WSA_CODEC_DMA_RX_0>;
            };

            platform {
                sound-dai = <&q6routing>;
            };

            codec {
                sound-dai = <&left_spkr>, <&right_spkr>, <&swr0 0>, <&wsamacro>;
            };
        };

        va-dai-link {
            link-name = "VA Capture";
            cpu {
                sound-dai = <&q6afedai VA_CODEC_DMA_TX_0>;
            };

            platform {
                sound-dai = <&q6routing>;
            };

            codec {
                sound-dai = <&vamacro 0>;
            };
        };

        usb-dai-link {
            link-name = "USB Playback";
            cpu {
                sound-dai = <&q6afedai USB_RX>;
            };

            codec {
                sound-dai = <&usbdai USB_RX>;
            };

            platform {
                sound-dai = <&q6routing>;
            };
        };
    };
```

## Documentation/devicetree/bindings/sound/qcom,wcd9335.txt
```
QCOM WCD9335 Codec

Qualcomm WCD9335 Codec is a standalone Hi-Fi audio codec IC, supports
Qualcomm Technologies, Inc. (QTI) multimedia solutions, including
the MSM8996, MSM8976, and MSM8956 chipsets. It has in-built
Soundwire controller, interrupt mux. It supports both I2S/I2C and
SLIMbus audio interfaces.

Required properties with SLIMbus Interface:

- compatible:
	Usage: required
	Value type: <stringlist>
	Definition: For SLIMbus interface it should be "slimMID,PID",
		    textual representation of Manufacturer ID, Product Code,
		    shall be in lower case hexadecimal with leading zeroes
		    suppressed.  Refer to slimbus/bus.txt for details.
		    Should be:
		    "slim217,1a0" for MSM8996 and APQ8096 SoCs with SLIMbus.

- reg
	Usage: required
	Value type: <u32 u32>
	Definition: Should be ('Device index', 'Instance ID')

- interrupts
	Usage: required
	Value type: <prop-encoded-array>
	Definition: Interrupts via WCD INTR1 and INTR2 pins

- interrupt-names:
	Usage: required
	Value type: <String array>
	Definition: Interrupt names of WCD INTR1 and INTR2
	Should be: "intr1", "intr2"

- reset-gpio:
	Usage: required
	Value type: <String Array>
	Definition: Reset gpio line

- qcom,ifd:
	Usage: required
	Value type: <phandle>
	Definition: SLIM interface device

- clocks:
	Usage: required
	Value type: <prop-encoded-array>
	Definition: See clock-bindings.txt section "consumers". List of
                three clock specifiers for mclk, mclk2 and slimbus clock.

- clock-names:
	Usage: required
	Value type: <string>
	Definition: Must contain "mclk", "mclk2" and "slimbus" strings.

- vdd-buck-supply:
	Usage: required
	Value type: <phandle>
	Definition: Should contain a reference to the 1.8V buck supply

- vdd-buck-sido-supply:
	Usage: required
	Value type: <phandle>
	Definition: Should contain a reference to the 1.8V SIDO buck supply

- vdd-rx-supply:
	Usage: required
	Value type: <phandle>
	Definition: Should contain a reference to the 1.8V rx supply

- vdd-tx-supply:
	Usage: required
	Value type: <phandle>
	Definition: Should contain a reference to the 1.8V tx supply

- vdd-vbat-supply:
	Usage: Optional
	Value type: <phandle>
	Definition: Should contain a reference to the vbat supply

- vdd-micbias-supply:
	Usage: required
	Value type: <phandle>
	Definition: Should contain a reference to the micbias supply

- vdd-io-supply:
	Usage: required
	Value type: <phandle>
	Definition: Should contain a reference to the 1.8V io supply

- interrupt-controller:
	Usage: required
	Definition: Indicating that this is a interrupt controller

- #interrupt-cells:
	Usage: required
	Value type: <int>
	Definition: should be 1

#sound-dai-cells
	Usage: required
	Value type: <u32>
	Definition: Must be 1

codec@1{
	compatible = "slim217,1a0";
	reg  = <1 0>;
	interrupts = <&msmgpio 54 IRQ_TYPE_LEVEL_HIGH>;
	interrupt-names = "intr2"
	reset-gpio = <&msmgpio 64 0>;
	qcom,ifd  = <&wc9335_ifd>;
	clock-names = "mclk", "native";
	clocks = <&rpmcc RPM_SMD_DIV_CLK1>,
		 <&rpmcc RPM_SMD_BB_CLK1>;
	vdd-buck-supply = <&pm8994_s4>;
	vdd-rx-supply = <&pm8994_s4>;
	vdd-buck-sido-supply = <&pm8994_s4>;
	vdd-tx-supply = <&pm8994_s4>;
	vdd-io-supply = <&pm8994_s4>;
	#sound-dai-cells = <1>;
}
```

## Documentation/devicetree/bindings/sound/qcom,wcd9335.yaml
```yaml
# SPDX-License-Identifier: GPL-2.0-only OR BSD-2-Clause
%YAML 1.2
---
$id: http://devicetree.org/schemas/sound/qcom,wcd9335.yaml#
$schema: http://devicetree.org/meta-schemas/core.yaml#

title: Qualcomm WCD9335 Audio Codec

maintainers:
  - Srinivas Kandagatla <srinivas.kandagatla@linaro.org>

description:
  Qualcomm WCD9335 Codec is a standalone Hi-Fi audio codec IC with in-built
  Soundwire controller and interrupt mux. It supports both I2S/I2C and SLIMbus
  audio interfaces.

properties:
  compatible:
    const: slim217,1a0

  reg:
    maxItems: 1

  clocks:
    maxItems: 2

  clock-names:
    items:
      - const: mclk
      - const: slimbus

  interrupts:
    maxItems: 2

  interrupt-names:
    items:
      - const: intr1
      - const: intr2

  interrupt-controller: true

  '#interrupt-cells':
    const: 1

  reset-gpios:
    maxItems: 1

  slim-ifc-dev:
    description: SLIM IFC device interface
    $ref: /schemas/types.yaml#/definitions/phandle

  '#sound-dai-cells':
    const: 1

  vdd-buck-supply:
    description: 1.8V buck supply

  vdd-buck-sido-supply:
    description: 1.8V SIDO buck supply

  vdd-io-supply:
    description: 1.8V I/O supply

  vdd-micbias-supply:
    description: micbias supply

  vdd-rx-supply:
    description: 1.8V rx supply

  vdd-tx-supply:
    description: 1.8V tx supply

  vdd-vbat-supply:
    description: vbat supply

required:
  - compatible
  - reg

allOf:
  - $ref: dai-common.yaml#
  - if:
      required:
        - slim-ifc-dev
    then:
      required:
        - clocks
        - clock-names
        - interrupts
        - interrupt-names
        - interrupt-controller
        - '#interrupt-cells'
        - reset-gpios
        - slim-ifc-dev
        - '#sound-dai-cells'
        - vdd-buck-supply
        - vdd-buck-sido-supply
        - vdd-io-supply
        - vdd-rx-supply
        - vdd-tx-supply
    else:
      properties:
        clocks: false
        clock-names: false
        interrupts: false
        interrupt-names: false
        interrupt-controller: false
        '#interrupt-cells': false
        reset-gpios: false
        slim-ifc-dev: false
        '#sound-dai-cells': false
        vdd-buck-supply: false
        vdd-buck-sido-supply: false
        vdd-io-supply: false
        vdd-micbias-supply: false
        vdd-rx-supply: false
        vdd-tx-supply: false
        vdd-vbat-supply: false

additionalProperties: false

examples:
  - |
    #include <dt-bindings/clock/qcom,rpmcc.h>
    #include <dt-bindings/gpio/gpio.h>
    #include <dt-bindings/interrupt-controller/irq.h>

    tasha_ifd: codec@0,0 {
        compatible = "slim217,1a0";
        reg = <0 0>;
    };

    codec@1,0 {
        compatible = "slim217,1a0";
        reg = <1 0>;

        clock-names = "mclk", "slimbus";
        clocks = <&div1_mclk>, <&rpmcc RPM_SMD_BB_CLK1>;

        interrupt-parent = <&tlmm>;
        interrupts = <54 IRQ_TYPE_LEVEL_HIGH>,
                     <53 IRQ_TYPE_LEVEL_HIGH>;
        interrupt-names = "intr1", "intr2";
        interrupt-controller;
        #interrupt-cells = <1>;

        reset-gpios = <&tlmm 64 GPIO_ACTIVE_LOW>;
        slim-ifc-dev = <&tasha_ifd>;
        #sound-dai-cells = <1>;

        vdd-buck-supply = <&vreg_s4a_1p8>;
        vdd-buck-sido-supply = <&vreg_s4a_1p8>;
        vdd-tx-supply = <&vreg_s4a_1p8>;
        vdd-rx-supply = <&vreg_s4a_1p8>;
        vdd-io-supply = <&vreg_s4a_1p8>;
    };
```
