## Documentation/devicetree/bindings/sound/qcom,wcd934x.yaml
```yaml
# SPDX-License-Identifier: (GPL-2.0-only OR BSD-2-Clause)
%YAML 1.2
---
$id: http://devicetree.org/schemas/sound/qcom,wcd934x.yaml#
$schema: http://devicetree.org/meta-schemas/core.yaml#

title: Bindings for Qualcomm WCD9340/WCD9341 Audio Codec

maintainers:
  - Srinivas Kandagatla <srinivas.kandagatla@linaro.org>

description: |
  Qualcomm WCD9340/WCD9341 Codec is a standalone Hi-Fi audio codec IC.
  It has in-built Soundwire controller, pin controller, interrupt mux and
  supports both I2S/I2C and SLIMbus audio interfaces.

properties:
  compatible:
    const: slim217,250

  reg:
    maxItems: 1

  interrupts:
    maxItems: 1

  reset-gpios:
    description: GPIO spec for reset line to use
    maxItems: 1

  slim-ifc-dev: true

  clocks:
    maxItems: 1

  clock-names:
    const: extclk

  vdd-buck-supply:
    description: A reference to the 1.8V buck supply

  vdd-buck-sido-supply:
    description: A reference to the 1.8V SIDO buck supply

  vdd-rx-supply:
    description: A reference to the 1.8V rx supply

  vdd-tx-supply:
    description: A reference to the 1.8V tx supply

  vdd-vbat-supply:
    description: A reference to the vbat supply

  vdd-io-supply:
    description: A reference to the 1.8V I/O supply

  vdd-micbias-supply:
    description: A reference to the micbias supply

  qcom,micbias1-microvolt:
    description: micbias1 voltage
    minimum: 1800000
    maximum: 2850000

  qcom,micbias2-microvolt:
    description: micbias2 voltage
    minimum: 1800000
    maximum: 2850000

  qcom,micbias3-microvolt:
    description: micbias3 voltage
    minimum: 1800000
    maximum: 2850000

  qcom,micbias4-microvolt:
    description: micbias4 voltage
    minimum: 1800000
    maximum: 2850000

  qcom,hphl-jack-type-normally-closed:
    description: Indicates that HPHL jack switch type is normally closed
    type: boolean

  qcom,ground-jack-type-normally-closed:
    description: Indicates that Headset Ground switch type is normally closed
    type: boolean

  qcom,mbhc-headset-vthreshold-microvolt:
    description: Voltage threshold value for headset detection
    minimum: 0
    maximum: 2850000

  qcom,mbhc-headphone-vthreshold-microvolt:
    description: Voltage threshold value for headphone detection
    minimum: 0
    maximum: 2850000

  qcom,mbhc-buttons-vthreshold-microvolt:
    description:
      Array of 8 Voltage threshold values corresponding to headset
      button0 - button7
    minItems: 8
    maxItems: 8

  clock-output-names:
    const: mclk

  clock-frequency:
    description: Clock frequency of output clk in Hz

  interrupt-controller: true

  '#interrupt-cells':
    const: 1

  '#clock-cells':
    const: 0

  '#sound-dai-cells':
    const: 1

  "#address-cells":
    const: 1

  "#size-cells":
    const: 1

  gpio@42:
    type: object
    $ref: /schemas/gpio/qcom,wcd934x-gpio.yaml#

patternProperties:
  "^.*@[0-9a-f]+$":
    type: object
    description: |
      WCD934x subnode for each slave devices. Bindings of each subnodes
      depends on the specific driver providing the functionality and
      documented in their respective bindings.

    properties:
      reg:
        maxItems: 1

    required:
      - reg

required:
  - compatible
  - reg
  - reset-gpios
  - slim-ifc-dev
  - interrupts
  - interrupt-controller
  - clock-frequency
  - clock-output-names
  - qcom,micbias1-microvolt
  - qcom,micbias2-microvolt
  - qcom,micbias3-microvolt
  - qcom,micbias4-microvolt
  - "#interrupt-cells"
  - "#clock-cells"
  - "#sound-dai-cells"
  - "#address-cells"
  - "#size-cells"

additionalProperties: false

examples:
  - |
    codec@1,0{
        compatible = "slim217,250";
        reg  = <1 0>;
        reset-gpios = <&tlmm 64 0>;
        slim-ifc-dev  = <&wcd9340_ifd>;
        #sound-dai-cells = <1>;
        interrupt-parent = <&tlmm>;
        interrupts = <54 4>;
        interrupt-controller;
        #interrupt-cells = <1>;
        #clock-cells = <0>;
        clock-frequency = <9600000>;
        clock-output-names = "mclk";
        qcom,micbias1-microvolt = <1800000>;
        qcom,micbias2-microvolt = <1800000>;
        qcom,micbias3-microvolt = <1800000>;
        qcom,micbias4-microvolt = <1800000>;
        qcom,hphl-jack-type-normally-closed;
        qcom,ground-jack-type-normally-closed;
        qcom,mbhc-buttons-vthreshold-microvolt = <75000 150000 237000 500000 500000 500000 500000 500000>;
        qcom,mbhc-headset-vthreshold-microvolt = <1700000>;
        qcom,mbhc-headphone-vthreshold-microvolt = <50000>;
        clock-names = "extclk";
        clocks = <&rpmhcc 2>;

        #address-cells = <1>;
        #size-cells = <1>;

        gpio@42 {
            compatible = "qcom,wcd9340-gpio";
            reg = <0x42 0x2>;
            gpio-controller;
            #gpio-cells = <2>;
        };
    };

...
```

## Documentation/devicetree/bindings/sound/qcom,wcd937x-sdw.yaml
```yaml
# SPDX-License-Identifier: (GPL-2.0-only OR BSD-2-Clause)
%YAML 1.2
---
$id: http://devicetree.org/schemas/sound/qcom,wcd937x-sdw.yaml#
$schema: http://devicetree.org/meta-schemas/core.yaml#

title: Qualcomm SoundWire Slave devices on WCD9370/WCD9375

maintainers:
  - Srinivas Kandagatla <srinivas.kandagatla@linaro.org>

description: |
  Qualcomm WCD9370/WCD9375 Codec is a standalone Hi-Fi audio codec IC.
  It has RX and TX Soundwire slave devices. This bindings is for the
  slave devices.

properties:
  compatible:
    const: sdw20217010a00

  reg:
    maxItems: 1

  qcom,tx-port-mapping:
    description: |
      Specifies static port mapping between device and host tx ports.
      In the order of the device port index which are adc1_port, adc23_port,
      dmic03_mbhc_port, dmic46_port.
      Supports maximum 4 tx soundwire ports.

      WCD9370 TX Port 1 (ADC1)               <=> SWR2 Port 2
      WCD9370 TX Port 2 (ADC2, 3)            <=> SWR2 Port 2
      WCD9370 TX Port 3 (DMIC0,1,2,3 & MBHC) <=> SWR2 Port 3
      WCD9370 TX Port 4 (DMIC4,5,6,7)        <=> SWR2 Port 4

    $ref: /schemas/types.yaml#/definitions/uint32-array
    minItems: 4
    maxItems: 4
    items:
      enum: [1, 2, 3, 4]

  qcom,rx-port-mapping:
    description: |
      Specifies static port mapping between device and host rx ports.
      In the order of device port index which are hph_port, clsh_port,
      comp_port, lo_port, dsd port.
      Supports maximum 5 rx soundwire ports.

      WCD9370 RX Port 1 (HPH_L/R)       <==>    SWR1 Port 1 (HPH_L/R)
      WCD9370 RX Port 2 (CLSH)          <==>    SWR1 Port 2 (CLSH)
      WCD9370 RX Port 3 (COMP_L/R)      <==>    SWR1 Port 3 (COMP_L/R)
      WCD9370 RX Port 4 (LO)            <==>    SWR1 Port 4 (LO)
      WCD9370 RX Port 5 (DSD_L/R)       <==>    SWR1 Port 5 (DSD)

    $ref: /schemas/types.yaml#/definitions/uint32-array
    minItems: 5
    maxItems: 5
    items:
      enum: [1, 2, 3, 4, 5]

  qcom,tx-channel-mapping:
    description: |
      Specifies static channel mapping between slave and master tx port
      channels.
      In the order of slave port channels which is adc1, adc2, adc3,
      dmic0, dmic1, mbhc, dmic2, dmic3, dmci4, dmic5, dmic6, dmic7.
    $ref: /schemas/types.yaml#/definitions/uint8-array
    minItems: 12
    maxItems: 12
    additionalItems: false
    items:
      enum:
        - 1  # WCD9370_SWRM_CH1
        - 2  # WCD9370_SWRM_CH2
        - 3  # WCD9370_SWRM_CH3
        - 4  # WCD9370_SWRM_CH4

  qcom,rx-channel-mapping:
    description: |
      Specifies static channels mapping between slave and master rx port
      channels.
      In the order of slave port channels, which is
      hph_l, hph_r, clsh, comp_l, comp_r, lo, dsd_r, dsd_l.
    $ref: /schemas/types.yaml#/definitions/uint8-array
    minItems: 8
    maxItems: 8
    additionalItems: false
    items:
      enum:
        - 1  # WCD9370_SWRM_CH1
        - 2  # WCD9370_SWRM_CH2
        - 3  # WCD9370_SWRM_CH3
        - 4  # WCD9370_SWRM_CH4

required:
  - compatible
  - reg

additionalProperties: false

examples:
  - |
    soundwire@3210000 {
        reg = <0x03210000 0x2000>;
        #address-cells = <2>;
        #size-cells = <0>;
        wcd937x_rx: codec@0,4 {
            compatible = "sdw20217010a00";
            reg = <0 4>;
            qcom,rx-port-mapping = <1 2 3 4 5>;
            qcom,rx-channel-mapping = /bits/ 8 <1 2 1 1 2 1 1 2>;
        };
    };

    soundwire@3230000 {
        reg = <0x03230000 0x2000>;
        #address-cells = <2>;
        #size-cells = <0>;
        wcd937x_tx: codec@0,3 {
            compatible = "sdw20217010a00";
            reg = <0 3>;
            qcom,tx-port-mapping = <2 2 3 4>;
            qcom,tx-channel-mapping = /bits/ 8 <1 2 1 1 2 3 3 4 1 2 3 4>;
        };
    };

...
```

## Documentation/devicetree/bindings/sound/qcom,wcd937x.yaml
```yaml
# SPDX-License-Identifier: (GPL-2.0-only OR BSD-2-Clause)
%YAML 1.2
---
$id: http://devicetree.org/schemas/sound/qcom,wcd937x.yaml#
$schema: http://devicetree.org/meta-schemas/core.yaml#

title: Qualcomm WCD9370/WCD9375 Audio Codec

maintainers:
  - Srinivas Kandagatla <srinivas.kandagatla@linaro.org>

description:
  Qualcomm WCD9370/WCD9375 Codec is a standalone Hi-Fi audio codec IC.
  It has RX and TX Soundwire slave devices.

allOf:
  - $ref: dai-common.yaml#
  - $ref: qcom,wcd93xx-common.yaml#

properties:
  compatible:
    oneOf:
      - const: qcom,wcd9370-codec
      - items:
          - const: qcom,wcd9375-codec
          - const: qcom,wcd9370-codec

  vdd-px-supply:
    description: A reference to the 1.8V I/O supply

required:
  - compatible
  - vdd-px-supply

unevaluatedProperties: false

examples:
  - |
    #include <dt-bindings/gpio/gpio.h>
    codec {
        compatible = "qcom,wcd9370-codec";
        pinctrl-names = "default", "sleep";
        pinctrl-0 = <&wcd_reset_n>;
        pinctrl-1 = <&wcd_reset_n_sleep>;
        reset-gpios = <&tlmm 83 GPIO_ACTIVE_LOW>;
        vdd-buck-supply = <&vreg_l17b_1p8>;
        vdd-rxtx-supply = <&vreg_l18b_1p8>;
        vdd-px-supply = <&vreg_l18b_1p8>;
        vdd-mic-bias-supply = <&vreg_bob>;
        qcom,micbias1-microvolt = <1800000>;
        qcom,micbias2-microvolt = <1800000>;
        qcom,micbias3-microvolt = <1800000>;
        qcom,micbias4-microvolt = <1800000>;
        qcom,rx-device = <&wcd937x_rx>;
        qcom,tx-device = <&wcd937x_tx>;
        #sound-dai-cells = <1>;
    };

    /* ... */

    soundwire@3210000 {
        reg = <0x03210000 0x2000>;
        #address-cells = <2>;
        #size-cells = <0>;
        wcd937x_rx: codec@0,4 {
            compatible = "sdw20217010a00";
            reg = <0 4>;
            qcom,rx-port-mapping = <1 2 3 4 5>;
        };
    };

    soundwire@3230000 {
        reg = <0x03230000 0x2000>;
        #address-cells = <2>;
        #size-cells = <0>;
        wcd937x_tx: codec@0,3 {
            compatible = "sdw20217010a00";
            reg = <0 3>;
            qcom,tx-port-mapping = <1 2 3 4>;
        };
    };
...
```

## Documentation/devicetree/bindings/sound/qcom,wcd938x-sdw.yaml
```yaml
# SPDX-License-Identifier: (GPL-2.0-only OR BSD-2-Clause)
%YAML 1.2
---
$id: http://devicetree.org/schemas/sound/qcom,wcd938x-sdw.yaml#
$schema: http://devicetree.org/meta-schemas/core.yaml#

title: Qualcomm SoundWire Slave devices on WCD9380/WCD9385

maintainers:
  - Srinivas Kandagatla <srinivas.kandagatla@linaro.org>

description: |
  Qualcomm WCD9380/WCD9385 Codec is a standalone Hi-Fi audio codec IC.
  It has RX and TX Soundwire slave devices. This bindings is for the
  slave devices.

properties:
  compatible:
    const: sdw20217010d00

  reg:
    maxItems: 1

  qcom,tx-port-mapping:
    description: |
      Specifies static port mapping between slave and master tx ports.
      In the order of slave port index.
    $ref: /schemas/types.yaml#/definitions/uint32-array
    minItems: 4
    maxItems: 4

  qcom,rx-port-mapping:
    description: |
      Specifies static port mapping between slave and master rx ports.
      In the order of slave port index.
    $ref: /schemas/types.yaml#/definitions/uint32-array
    minItems: 5
    maxItems: 5

required:
  - compatible
  - reg

additionalProperties: false

examples:
  - |
    soundwire@3210000 {
        #address-cells = <2>;
        #size-cells = <0>;
        reg = <0x03210000 0x2000>;
        wcd938x_rx: codec@0,4 {
            compatible = "sdw20217010d00";
            reg = <0 4>;
            qcom,rx-port-mapping = <1 2 3 4 5>;
        };
    };

    soundwire@3230000 {
        #address-cells = <2>;
        #size-cells = <0>;
        reg = <0x03230000 0x2000>;
        wcd938x_tx: codec@0,3 {
            compatible = "sdw20217010d00";
            reg = <0 3>;
            qcom,tx-port-mapping = <2 3 4 5>;
        };
    };

...
```

## Documentation/devicetree/bindings/sound/qcom,wcd938x.yaml
```yaml
# SPDX-License-Identifier: (GPL-2.0-only OR BSD-2-Clause)
%YAML 1.2
---
$id: http://devicetree.org/schemas/sound/qcom,wcd938x.yaml#
$schema: http://devicetree.org/meta-schemas/core.yaml#

title: Qualcomm WCD9380/WCD9385 Audio Codec

maintainers:
  - Srinivas Kandagatla <srinivas.kandagatla@linaro.org>

description: |
  Qualcomm WCD9380/WCD9385 Codec is a standalone Hi-Fi audio codec IC.
  It has RX and TX Soundwire slave devices.

allOf:
  - $ref: dai-common.yaml#
  - $ref: qcom,wcd93xx-common.yaml#

properties:
  compatible:
    enum:
      - qcom,wcd9380-codec
      - qcom,wcd9385-codec

  us-euro-gpios:
    description: GPIO spec for swapping gnd and mic segments
    maxItems: 1

required:
  - compatible

unevaluatedProperties: false

examples:
  - |
    #include <dt-bindings/gpio/gpio.h>
    codec {
        compatible = "qcom,wcd9380-codec";
        reset-gpios = <&tlmm 32 GPIO_ACTIVE_LOW>;
        #sound-dai-cells = <1>;
        qcom,tx-device = <&wcd938x_tx>;
        qcom,rx-device = <&wcd938x_rx>;
        qcom,micbias1-microvolt = <1800000>;
        qcom,micbias2-microvolt = <1800000>;
        qcom,micbias3-microvolt = <1800000>;
        qcom,micbias4-microvolt = <1800000>;
        qcom,hphl-jack-type-normally-closed;
        qcom,ground-jack-type-normally-closed;
        qcom,mbhc-buttons-vthreshold-microvolt = <75000 150000 237000 500000 500000 500000 500000 500000>;
        qcom,mbhc-headphone-vthreshold-microvolt = <50000>;
    };

    /* ... */

    soundwire@3210000 {
        #address-cells = <2>;
        #size-cells = <0>;
        reg = <0x03210000 0x2000>;
        wcd938x_rx: codec@0,4 {
            compatible = "sdw20217010d00";
            reg = <0 4>;
            qcom,rx-port-mapping = <1 2 3 4 5>;
        };
    };

    soundwire@3230000 {
        #address-cells = <2>;
        #size-cells = <0>;
        reg = <0x03230000 0x2000>;
        wcd938x_tx: codec@0,3 {
            compatible = "sdw20217010d00";
            reg = <0 3>;
            qcom,tx-port-mapping = <2 3 4 5>;
        };
    };

...
```
