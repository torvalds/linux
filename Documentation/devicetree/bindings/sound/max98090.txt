## Documentation/devicetree/bindings/sound/max98090.txt
```
MAX98090 audio CODEC

This device supports I2C only.

Required properties:

- compatible : "maxim,max98090" or "maxim,max98091".

- reg : The I2C address of the device.

- interrupts : The CODEC's interrupt output.

Optional properties:

- clocks: The phandle of the master clock to the CODEC

- clock-names: Should be "mclk"

- maxim,dmic-freq: Frequency at which to clock DMIC

Pins on the device (for linking into audio routes):

  * MIC1
  * MIC2
  * DMICL
  * DMICR
  * IN1
  * IN2
  * IN3
  * IN4
  * IN5
  * IN6
  * IN12
  * IN34
  * IN56
  * HPL
  * HPR
  * SPKL
  * SPKR
  * RCVL
  * RCVR
  * MICBIAS

Example:

audio-codec@10 {
	compatible = "maxim,max98090";
	reg = <0x10>;
	interrupt-parent = <&gpio>;
	interrupts = <TEGRA_GPIO(H, 4) GPIO_ACTIVE_HIGH>;
};
```

## Documentation/devicetree/bindings/sound/max98095.txt
```
MAX98095 audio CODEC

This device supports I2C only.

Required properties:

- compatible : "maxim,max98095".

- reg : The I2C address of the device.

Optional properties:

- clocks: The phandle of the master clock to the CODEC

- clock-names: Should be "mclk"

Example:

max98095: codec@11 {
	compatible = "maxim,max98095";
	reg = <0x11>;
};
```

## Documentation/devicetree/bindings/sound/max98357a.txt
```
Maxim MAX98357A/MAX98360A audio DAC

This node models the Maxim MAX98357A/MAX98360A DAC.

Required properties:
- compatible   : "maxim,max98357a" for MAX98357A.
                 "maxim,max98360a" for MAX98360A.

Optional properties:
- sdmode-gpios : GPIO specifier for the chip's SD_MODE pin.
        If this option is not specified then driver does not manage
        the pin state (e.g. chip is always on).
- sdmode-delay : specify delay time for SD_MODE pin.
        If this option is specified, which means it's required i2s clocks
        ready before SD_MODE is unmuted in order to avoid the speaker pop noise.
        It's observed that 5ms is sufficient.

Example:

max98357a {
	compatible = "maxim,max98357a";
	sdmode-gpios = <&qcom_pinmux 25 0>;
};

max98360a {
	compatible = "maxim,max98360a";
	sdmode-gpios = <&qcom_pinmux 25 0>;
};
```

## Documentation/devicetree/bindings/sound/max98371.txt
```
max98371 codec

This device supports I2C mode only.

Required properties:

- compatible : "maxim,max98371"
- reg : The chip select number on the I2C bus

Example:

&i2c {
	max98371: max98371@0x31 {
		compatible = "maxim,max98371";
		reg = <0x31>;
	};
};
```

## Documentation/devicetree/bindings/sound/max98373.txt
```
Maxim Integrated MAX98373 Speaker Amplifier

This device supports I2C.

Required properties:

 - compatible : "maxim,max98373"

 - reg : the I2C address of the device.

Optional properties:

  - maxim,vmon-slot-no : slot number used to send voltage information
                   or in inteleave mode this will be used as
                   interleave slot.
                   slot range : 0 ~ 15,  Default : 0

  - maxim,imon-slot-no : slot number used to send current information
                   slot range : 0 ~ 15,  Default : 0

  - maxim,spkfb-slot-no : slot number used to send speaker feedback information
                   slot range : 0 ~ 15,  Default : 0

  - maxim,interleave-mode : For cases where a single combined channel
		   for the I/V sense data is not sufficient, the device can also be configured
		   to share a single data output channel on alternating frames.
		   In this configuration, the current and voltage data will be frame interleaved
		   on a single output channel.
                   Boolean, define to enable the interleave mode, Default : false

Example:

codec: max98373@31 {
   compatible = "maxim,max98373";
   reg = <0x31>;
   maxim,vmon-slot-no = <0>;
   maxim,imon-slot-no = <1>;
   maxim,spkfb-slot-no = <2>;
   maxim,interleave-mode;
};
```

## Documentation/devicetree/bindings/sound/max98504.txt
```
Maxim MAX98504 class D moyes speaker amplifier

This device supports I2C control interface and an IRQ output signal. It features
a PCM and PDM digital audio interface (DAI) and a differential analog input.

Required properties:

 - compatible : "maxim,max98504"
 - reg : should contain the I2C slave device address
 - DVDD-supply, DIOVDD-supply, PVDD-supply: power supplies for the device,
   as covered in ../regulator/regulator.txt
 - interrupts : should specify the interrupt line the device is connected to,
   as described in ../interrupt-controller/interrupts.txt

Optional properties:

 - maxim,browyesut-threshold - the PVDD browyesut threshold, the value must be
   from 0, 1...21 range, corresponding to 2.6V, 2.65V...3.65V voltage range
 - maxim,browyesut-attenuation - the browyesut attenuation to the speaker gain
   applied during the "attack hold" and "timed hold" phase, the value must be
   from 0...6 (dB) range
 - maxim,browyesut-attack-hold-ms - the browyesut attack hold phase time in ms,
   0...255 (VBATBROWN_ATTK_HOLD, register 0x0018)
 - maxim,browyesut-timed-hold-ms - the browyesut timed hold phase time in ms,
   0...255 (VBATBROWN_TIME_HOLD, register 0x0019)
 - maxim,browyesut-release-rate-ms - the browyesut release phase step time in ms,
   0...255 (VBATBROWN_RELEASE, register 0x001A)

The default value when the above properties are yest specified is 0,
the maxim,browyesut-threshold property must be specified to actually enable
the PVDD browyesut protection.

Example:

 max98504@31 {
	compatible = "maxim,max98504";
	reg = <0x31>;
	interrupt-parent = <&gpio_bank_0>;
	interrupts = <2 0>;

	DVDD-supply = <&regulator>;
	DIOVDD-supply = <&regulator>;
	PVDD-supply = <&regulator>;
};
```

## Documentation/devicetree/bindings/sound/max9860.txt
```
MAX9860 Mono Audio Voice Codec

Required properties:

  - compatible : "maxim,max9860"

  - reg : the I2C address of the device

  - AVDD-supply, DVDD-supply and DVDDIO-supply : power supplies for
    the device, as covered in bindings/regulator/regulator.txt

  - clock-names : Required element: "mclk".

  - clocks : A clock specifier for the clock connected as MCLK.

Examples:

	max9860: max9860@10 {
		compatible = "maxim,max9860";
		reg = <0x10>;

		AVDD-supply = <&reg_1v8>;
		DVDD-supply = <&reg_1v8>;
		DVDDIO-supply = <&reg_3v0>;

		clock-names = "mclk";
		clocks = <&pck2>;
	};
```

## Documentation/devicetree/bindings/sound/max9867.txt
```
max9867 codec

This device supports I2C mode only.

Required properties:

- compatible : "maxim,max9867"
- reg : The chip select number on the I2C bus

Example:

&i2c {
	max9867: max9867@0x18 {
		compatible = "maxim,max9867";
		reg = <0x18>;
	};
};
```

## Documentation/devicetree/bindings/sound/max98925.txt
```
max98925 audio CODEC

This device supports I2C.

Required properties:

  - compatible : "maxim,max98925"

  - vmon-slot-no : slot number used to send voltage information

  - imon-slot-no : slot number used to send current information

  - reg : the I2C address of the device for I2C

Example:

codec: max98925@1a {
	compatible = "maxim,max98925";
	vmon-slot-no = <0>;
	imon-slot-no = <2>;
	reg = <0x1a>;
};
```

## Documentation/devicetree/bindings/sound/max98926.txt
```
max98926 audio CODEC

This device supports I2C.

Required properties:

  - compatible : "maxim,max98926"

  - vmon-slot-no : slot number used to send voltage information
                   or in inteleave mode this will be used as
                   interleave slot.

  - imon-slot-no : slot number used to send current information

  - interleave-mode : When using two MAX98926 in a system it is
                      possible to create ADC data that that will
                      overflow the frame size. Digital Audio Interleave
                      mode provides a means to output VMON and IMON data
                      from two devices on a single DOUT line when running
                      smaller frames sizes such as 32 BCLKS per LRCLK or
                      48 BCLKS per LRCLK.

  - reg : the I2C address of the device for I2C

Example:

codec: max98926@1a {
   compatible = "maxim,max98926";
   vmon-slot-no = <0>;
   imon-slot-no = <2>;
   reg = <0x1a>;
};
```

## Documentation/devicetree/bindings/sound/max9892x.txt
```
Maxim Integrated MAX98925/MAX98926/MAX98927 Speaker Amplifier

This device supports I2C.

Required properties:

  - compatible : should be one of the following
    - "maxim,max98925"
    - "maxim,max98926"
    - "maxim,max98927"

  - vmon-slot-no : slot number used to send voltage information
                   or in inteleave mode this will be used as
                   interleave slot.
                   MAX98925/MAX98926 slot range : 0 ~ 30,  Default : 0
                   MAX98927 slot range : 0 ~ 15,  Default : 0

  - imon-slot-no : slot number used to send current information
                   MAX98925/MAX98926 slot range : 0 ~ 30,  Default : 0
                   MAX98927 slot range : 0 ~ 15,  Default : 0

  - interleave-mode : When using two MAX9892X in a system it is
                   possible to create ADC data that that will
                   overflow the frame size. Digital Audio Interleave
                   mode provides a means to output VMON and IMON data
                   from two devices on a single DOUT line when running
                   smaller frames sizes such as 32 BCLKS per LRCLK or
                   48 BCLKS per LRCLK.
                   Range : 0 (off), 1 (on),  Default : 0

  - reg : the I2C address of the device for I2C

Optional properties:
  - reset-gpios : GPIO to reset the device

Example:

codec: max98927@3a {
   compatible = "maxim,max98927";
   vmon-slot-no = <0>;
   imon-slot-no = <1>;
   interleave-mode = <0>;
   reg = <0x3a>;
};
```

## Documentation/devicetree/bindings/sound/maxim,max9759.txt
```
Maxim MAX9759 Speaker Amplifier
===============================

Required properties:
- compatible : "maxim,max9759"
- shutdown-gpios : the gpio connected to the shutdown pin
- mute-gpios : the gpio connected to the mute pin
- gain-gpios : the 2 gpios connected to the g1 and g2 pins

Example:

max9759: analog-amplifier {
	compatible = "maxim,max9759";
	shutdown-gpios = <&gpio3 20 GPIO_ACTIVE_LOW>;
	mute-gpios = <&gpio3 19 GPIO_ACTIVE_LOW>;
	gain-gpios = <&gpio3 23 GPIO_ACTIVE_LOW>,
		     <&gpio3 25 GPIO_ACTIVE_LOW>;
};
```

## Documentation/devicetree/bindings/sound/maxim,max9759.yaml
```yaml
# SPDX-License-Identifier: (GPL-2.0-only OR BSD-2-Clause)
%YAML 1.2
---
$id: http://devicetree.org/schemas/sound/maxim,max9759.yaml#
$schema: http://devicetree.org/meta-schemas/core.yaml#

title: Maxim MAX9759 Speaker Amplifier

maintainers:
  - Otabek Nazrullaev <otabeknazrullaev1998@gmail.com>

properties:
  compatible:
    const: maxim,max9759

  shutdown-gpios:
    maxItems: 1
    description: the gpio connected to the shutdown pin

  mute-gpios:
    maxItems: 1
    description: the gpio connected to the mute pin

  gain-gpios:
    maxItems: 2
    description: the 2 gpios connected to the g1 and g2 pins

required:
  - compatible
  - shutdown-gpios
  - mute-gpios
  - gain-gpios

additionalProperties: false

examples:
  - |
    #include <dt-bindings/gpio/gpio.h>
    amplifier {
      compatible = "maxim,max9759";
      shutdown-gpios = <&gpio3 20 GPIO_ACTIVE_LOW>;
      mute-gpios = <&gpio3 19 GPIO_ACTIVE_LOW>;
      gain-gpios = <&gpio3 23 GPIO_ACTIVE_LOW>,
             <&gpio3 25 GPIO_ACTIVE_LOW>;
    };
```

## Documentation/devicetree/bindings/sound/maxim,max98088.txt
```
MAX98088 audio CODEC

This device supports I2C only.

Required properties:

- compatible: "maxim,max98088" or "maxim,max98089".
- reg: The I2C address of the device.

Optional properties:

- clocks: the clock provider of MCLK, see ../clock/clock-bindings.txt section
  "consumer" for more information.
- clock-names: must be set to "mclk"

Example:

max98089: codec@10 {
	compatible = "maxim,max98089";
	reg = <0x10>;
	clocks = <&clks IMX6QDL_CLK_CKO2>;
	clock-names = "mclk";
};
```

## Documentation/devicetree/bindings/sound/maxim,max98088.yaml
```yaml
# SPDX-License-Identifier: GPL-2.0-only OR BSD-2-Clause
%YAML 1.2
---
$id: http://devicetree.org/schemas/sound/maxim,max98088.yaml#
$schema: http://devicetree.org/meta-schemas/core.yaml#

title: MAX98088 audio CODEC

maintainers:
  - Abdulrasaq Lawani <abdulrasaqolawani@gmail.com>

properties:
  compatible:
    enum:
      - maxim,max98088
      - maxim,max98089

  reg:
    maxItems: 1

  clocks:
    items:
      - description: master clock

  clock-names:
    items:
      - const: mclk

required:
  - compatible
  - reg

additionalProperties: false

examples:
  - |
    i2c {
        #address-cells = <1>;
        #size-cells = <0>;

        audio-codec@10 {
            compatible = "maxim,max98089";
            reg = <0x10>;
            clocks = <&clks 0>;
            clock-names = "mclk";
        };
    };
```

## Documentation/devicetree/bindings/sound/maxim,max98090.yaml
```yaml
# SPDX-License-Identifier: GPL-2.0-only OR BSD-2-Clause
%YAML 1.2
---
$id: http://devicetree.org/schemas/sound/maxim,max98090.yaml#
$schema: http://devicetree.org/meta-schemas/core.yaml#

title: Maxim Integrated MAX98090/MAX98091 audio codecs

maintainers:
  - Krzysztof Kozlowski <krzysztof.kozlowski@linaro.org>

description: |
  Pins on the device (for linking into audio routes):
  MIC1, MIC2, DMICL, DMICR, IN1, IN2, IN3, IN4, IN5, IN6, IN12, IN34, IN56,
  HPL, HPR, SPKL, SPKR, RCVL, RCVR, MICBIAS

allOf:
  - $ref: dai-common.yaml#

properties:
  compatible:
    enum:
      - maxim,max98090
      - maxim,max98091

  reg:
    maxItems: 1

  clocks:
    items:
      - description: master clock

  clock-names:
    items:
      - const: mclk

  interrupts:
    maxItems: 1

  maxim,dmic-freq:
    $ref: /schemas/types.yaml#/definitions/uint32
    default: 2500000
    description:
      DMIC clock frequency

  maxim,micbias:
    $ref: /schemas/types.yaml#/definitions/uint32
    enum: [ 0, 1, 2, 3 ]
    default: 3
    description: |
      Micbias voltage applied to the analog mic, valid voltages value are:
        0 - 2.2v
        1 - 2.55v
        2 - 2.4v
        3 - 2.8v

  '#sound-dai-cells':
    const: 0

required:
  - compatible
  - reg
  - interrupts

unevaluatedProperties: false

examples:
  - |
    #include <dt-bindings/interrupt-controller/irq.h>

    i2c {
        #address-cells = <1>;
        #size-cells = <0>;

        audio-codec@10 {
            compatible = "maxim,max98090";
            reg = <0x10>;
            interrupt-parent = <&gpx3>;
            interrupts = <2 IRQ_TYPE_EDGE_FALLING>;
            clocks = <&i2s0 0>;
            clock-names = "mclk";
            #sound-dai-cells = <0>;
        };
    };
```

## Documentation/devicetree/bindings/sound/maxim,max98095.yaml
```yaml
# SPDX-License-Identifier: GPL-2.0-only OR BSD-2-Clause
%YAML 1.2
---
$id: http://devicetree.org/schemas/sound/maxim,max98095.yaml#
$schema: http://devicetree.org/meta-schemas/core.yaml#

title: Maxim Integrated MAX98095 audio codec

maintainers:
  - Krzysztof Kozlowski <krzysztof.kozlowski@linaro.org>

allOf:
  - $ref: dai-common.yaml#

properties:
  compatible:
    enum:
      - maxim,max98095

  reg:
    maxItems: 1

  clocks:
    items:
      - description: master clock

  clock-names:
    items:
      - const: mclk

  '#sound-dai-cells':
    const: 1

required:
  - compatible
  - reg

unevaluatedProperties: false

examples:
  - |
    #include <dt-bindings/interrupt-controller/irq.h>

    i2c {
        #address-cells = <1>;
        #size-cells = <0>;

        audio-codec@11 {
            compatible = "maxim,max98095";
            reg = <0x11>;
            clocks = <&i2s0 0>;
            clock-names = "mclk";
        };
    };
```
