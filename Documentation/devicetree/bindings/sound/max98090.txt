## Documentation/devicetree/bindings/sound/maxim,max98357a.yaml
```yaml
# SPDX-License-Identifier: GPL-2.0-only OR BSD-2-Clause
%YAML 1.2
---
$id: http://devicetree.org/schemas/sound/maxim,max98357a.yaml#
$schema: http://devicetree.org/meta-schemas/core.yaml#

title: Maxim Integrated MAX98357A/MAX98360A amplifier

maintainers:
  - Tzung-Bi Shih <tzungbi@kernel.org>

description:
  Maxim Integrated MAX98357A/MAX98360A is a digital pulse-code modulation (PCM)
  input Class D amplifier.

allOf:
  - $ref: dai-common.yaml#

properties:
  compatible:
    enum:
      - maxim,max98357a
      - maxim,max98360a

  '#sound-dai-cells':
    const: 0

  sdmode-gpios:
    maxItems: 1
    description:
      Chip's SD_MODE pin.  If missing the chip is always on.

  sdmode-delay:
    $ref: /schemas/types.yaml#/definitions/uint32
    description:
      Delay time for SD_MODE pin changes intended to make I2S clocks ready
      before SD_MODE is unmuted in order to avoid the speaker pop noise.

required:
  - compatible

unevaluatedProperties: false

examples:
  - |
    #include <dt-bindings/gpio/gpio.h>

    amplifier {
        compatible = "maxim,max98360a";
        #sound-dai-cells = <0>;
        sdmode-gpios = <&qcom_pinmux 25 GPIO_ACTIVE_HIGH>;
    };
```

## Documentation/devicetree/bindings/sound/maxim,max98371.yaml
```yaml
# SPDX-License-Identifier: GPL-2.0-only OR BSD-2-Clause
%YAML 1.2
---
$id: http://devicetree.org/schemas/sound/maxim,max98371.yaml#
$schema: http://devicetree.org/meta-schemas/core.yaml#

title: Maxim MAX98371 audio codec

maintainers:
  - anish kumar <yesanishhere@gmail.com>

allOf:
  - $ref: dai-common.yaml#

properties:
  compatible:
    const: maxim,max98371

  '#sound-dai-cells':
    const: 0

  reg:
    maxItems: 1

required:
  - compatible
  - reg

unevaluatedProperties: false

examples:
  - |
    i2c {
        #address-cells = <1>;
        #size-cells = <0>;

        codec@31 {
            compatible = "maxim,max98371";
            reg = <0x31>;
            #sound-dai-cells = <0>;
        };
    };
```

## Documentation/devicetree/bindings/sound/maxim,max98390.yaml
```yaml
# SPDX-License-Identifier: (GPL-2.0-only OR BSD-2-Clause)
%YAML 1.2
---
$id: http://devicetree.org/schemas/sound/maxim,max98390.yaml#
$schema: http://devicetree.org/meta-schemas/core.yaml#

title: Maxim Integrated MAX98390 Speaker Amplifier with Integrated Dynamic Speaker Management

maintainers:
  - Steve Lee <steves.lee@maximintegrated.com>

properties:
  compatible:
    const: maxim,max98390

  reg:
    maxItems: 1
    description: I2C address of the device.

  maxim,temperature_calib:
    description: The calculated temperature data was measured while doing the calibration.
    $ref: /schemas/types.yaml#/definitions/uint32
    minimum: 0
    maximum: 65535

  maxim,r0_calib:
    description: This is r0 calibration data which was measured in factory mode.
    $ref: /schemas/types.yaml#/definitions/uint32
    minimum: 1
    maximum: 8388607

  reset-gpios:
    maxItems: 1

required:
  - compatible
  - reg

additionalProperties: false

examples:
  - |
    #include <dt-bindings/gpio/gpio.h>
    i2c {
      #address-cells = <1>;
      #size-cells = <0>;
      max98390: amplifier@38 {
        compatible = "maxim,max98390";
        reg = <0x38>;
        maxim,temperature_calib = <1024>;
        maxim,r0_calib = <100232>;
        reset-gpios = <&gpio 9 GPIO_ACTIVE_LOW>;
      };
    };
```

## Documentation/devicetree/bindings/sound/maxim,max98504.yaml
```yaml
# SPDX-License-Identifier: GPL-2.0-only OR BSD-2-Clause
%YAML 1.2
---
$id: http://devicetree.org/schemas/sound/maxim,max98504.yaml#
$schema: http://devicetree.org/meta-schemas/core.yaml#

title: Maxim Integrated MAX98504 class D moanal speaker amplifier

maintainers:
  - Krzysztof Kozlowski <krzysztof.kozlowski@linaro.org>

description:
  Maxim Integrated MAX98504 speaker amplifier supports I2C control interface
  with an IRQ output signal, PCM and PDM digital audio interface (DAI) and a
  differential analog input.

properties:
  compatible:
    const: maxim,max98504

  reg:
    maxItems: 1

  interrupts:
    maxItems: 1

  DIOVDD-supply: true
  DVDD-supply: true
  PVDD-supply: true

  maxim,browanalut-threshold:
    $ref: /schemas/types.yaml#/definitions/uint32
    maximum: 21
    default: 0
    description:
      PVDD browanalut threshold, where values correspond to 2.6V, 2.65V...3.65V
      voltage range.  Property also enables the PVDD browanalut protection.

  maxim,browanalut-attenuation:
    $ref: /schemas/types.yaml#/definitions/uint32
    maximum: 6
    default: 0
    description:
      Browanalut attenuation to the speaker gain applied during the "attack hold"
      and "timed hold" phase, the value must be from 0...6 (dB) range.

  maxim,browanalut-attack-hold-ms:
    maximum: 255
    default: 0
    description:
      Browanalut attack hold phase time in ms, VBATBROWN_ATTK_HOLD, register 0x0018.

  maxim,browanalut-timed-hold-ms:
    maximum: 255
    default: 0
    description:
      Browanalut timed hold phase time in ms, VBATBROWN_TIME_HOLD, register 0x0019.

  maxim,browanalut-release-rate-ms:
    maximum: 255
    default: 0
    description:
      Browanalut release phase step time in ms, VBATBROWN_RELEASE, register 0x001A.

required:
  - compatible
  - reg

additionalProperties: false

examples:
  - |
    #include <dt-bindings/gpio/gpio.h>

    i2c {
        #address-cells = <1>;
        #size-cells = <0>;

        amplifier@31 {
            compatible = "maxim,max98504";
            reg = <0x31>;

            DIOVDD-supply = <&ldo3_reg>;
            DVDD-supply = <&ldo3_reg>;
        };
    };
```

## Documentation/devicetree/bindings/sound/maxim,max98520.yaml
```yaml
# SPDX-License-Identifier: (GPL-2.0-only OR BSD-2-Clause)
%YAML 1.2
---
$id: http://devicetree.org/schemas/sound/maxim,max98520.yaml#
$schema: http://devicetree.org/meta-schemas/core.yaml#

title: Maxim Integrated MAX98520 Speaker Amplifier Driver

maintainers:
  - George Song <george.song@maximintegrated.com>

properties:
  compatible:
    const: maxim,max98520

  reg:
    maxItems: 1
    description: I2C address of the device.

required:
  - compatible
  - reg

additionalProperties: false

examples:
  - |
    i2c {
      #address-cells = <1>;
      #size-cells = <0>;
      max98520: amplifier@38 {
        compatible = "maxim,max98520";
        reg = <0x38>;
      };
    };
```

## Documentation/devicetree/bindings/sound/maxim,max9867.yaml
```yaml
# SPDX-License-Identifier: (GPL-2.0-only OR BSD-2-Clause)
%YAML 1.2
---
$id: http://devicetree.org/schemas/sound/maxim,max9867.yaml#
$schema: http://devicetree.org/meta-schemas/core.yaml#

title: Maxim Integrated MAX9867 CODEC

description: |
  This device supports I2C only.
  Pins on the device (for linking into audio routes):
      * LOUT
      * ROUT
      * LINL
      * LINR
      * MICL
      * MICR
      * DMICL
      * DMICR

maintainers:
  - Ladislav Michl <ladis@linux-mips.org>

allOf:
  - $ref: dai-common.yaml#

properties:
  compatible:
    enum:
      - maxim,max9867

  '#sound-dai-cells':
    const: 0

  reg:
    maxItems: 1

  clocks:
    maxItems: 1

required:
  - compatible
  - reg
  - clocks

additionalProperties: false

examples:
  - |
    i2c {
        #address-cells = <1>;
        #size-cells = <0>;
        codec@18 {
            compatible = "maxim,max9867";
            #sound-dai-cells = <0>;
            reg = <0x18>;
            clocks = <&codec_clk>;
        };
    };
...
```

## Documentation/devicetree/bindings/sound/maxim,max98925.yaml
```yaml
# SPDX-License-Identifier: GPL-2.0-only OR BSD-2-Clause
%YAML 1.2
---
$id: http://devicetree.org/schemas/sound/maxim,max98925.yaml#
$schema: http://devicetree.org/meta-schemas/core.yaml#

title: Maxim Integrated MAX98925/MAX98926/MAX98927 speaker amplifier

maintainers:
  - Ryan Lee <ryans.lee@maximintegrated.com>

properties:
  compatible:
    enum:
      - maxim,max98925
      - maxim,max98926
      - maxim,max98927

  reg:
    maxItems: 1

  reset-gpios:
    maxItems: 1

  '#sound-dai-cells':
    const: 0

  vmon-slot-no:
    $ref: /schemas/types.yaml#/definitions/uint32
    minimum: 0
    maximum: 30
    default: 0
    description:
      Slot number used to send voltage information or in inteleave mode this
      will be used as interleave slot.

  imon-slot-no:
    $ref: /schemas/types.yaml#/definitions/uint32
    minimum: 0
    maximum: 30
    default: 0
    description:
      Slot number used to send current information.

  maxim,interleave-mode:
    type: boolean
    description:
      When using two MAX9892X in a system it is possible to create ADC data
      that will overflow the frame size. When enabled, the Digital Audio
      Interleave mode provides a means to output VMON and IMON data from two
      devices on a single DOUT line when running smaller frames sizes such as
      32 BCLKS per LRCLK or 48 BCLKS per LRCLK.

required:
  - compatible
  - reg

allOf:
  - $ref: dai-common.yaml#
  - if:
      properties:
        compatible:
          contains:
            enum:
              - maxim,max98927
    then:
      properties:
        vmon-slot-no:
          minimum: 0
          maximum: 15

        imon-slot-no:
          minimum: 0
          maximum: 15

additionalProperties: false

examples:
  - |
    #include <dt-bindings/gpio/gpio.h>
    i2c {
        #address-cells = <1>;
        #size-cells = <0>;

        audio-codec@3a {
            compatible = "maxim,max98927";
            reg = <0x3a>;
            #sound-dai-cells = <0>;

            pinctrl-0 = <&speaker_default>;
            pinctrl-names = "default";

            reset-gpios = <&tlmm 69 GPIO_ACTIVE_LOW>;

            vmon-slot-no = <1>;
            imon-slot-no = <0>;
        };
    };
```

## Documentation/devicetree/bindings/sound/mchp,i2s-mcc.yaml
```yaml
# SPDX-License-Identifier: (GPL-2.0 OR BSD-2-Clause)
%YAML 1.2
---
$id: http://devicetree.org/schemas/sound/mchp,i2s-mcc.yaml#
$schema: http://devicetree.org/meta-schemas/core.yaml#

title: Microchip I2S Multi-Channel Controller

maintainers:
  - Codrin Ciubotariu <codrin.ciubotariu@microchip.com>

description:
  The I2SMCC complies with the Inter-IC Sound (I2S) bus specification and
  supports a Time Division Multiplexed (TDM) interface with external
  multi-channel audio codecs. It consists of a receiver, a transmitter and a
  common clock generator that can be enabled separately to provide Adapter,
  Client or Controller modes with receiver and/or transmitter active.
  On later I2SMCC versions (starting with Microchip's SAMA7G5) I2S
  multi-channel is supported by using multiple data pins, output and
  input, without TDM.

properties:
  "#sound-dai-cells":
    const: 0

  compatible:
    enum:
      - microchip,sam9x60-i2smcc
      - microchip,sama7g5-i2smcc

  reg:
    maxItems: 1

  interrupts:
    maxItems: 1

  clocks:
    items:
      - description: Peripheral Bus Clock
      - description: Generic Clock (Optional). Should be set mostly when Master
          Mode is required.
    minItems: 1

  clock-names:
    items:
      - const: pclk
      - const: gclk
    minItems: 1

  dmas:
    items:
      - description: TX DMA Channel
      - description: RX DMA Channel

  dma-names:
    items:
      - const: tx
      - const: rx

  microchip,tdm-data-pair:
    description:
      Represents the DIN/DOUT pair pins that are used to receive/send
      TDM data. It is optional and it is only needed if the controller
      uses the TDM mode.
    $ref: /schemas/types.yaml#/definitions/uint8
    enum: [0, 1, 2, 3]
    default: 0

allOf:
  - $ref: dai-common.yaml#
  - if:
      properties:
        compatible:
          const: microchip,sam9x60-i2smcc
    then:
      properties:
        microchip,tdm-data-pair: false

required:
  - "#sound-dai-cells"
  - compatible
  - reg
  - interrupts
  - clocks
  - clock-names
  - dmas
  - dma-names

unevaluatedProperties: false

examples:
  - |
    #include <dt-bindings/dma/at91.h>
    #include <dt-bindings/interrupt-controller/arm-gic.h>

    i2s@f001c000 {
        #sound-dai-cells = <0>;
        compatible = "microchip,sam9x60-i2smcc";
        reg = <0xf001c000 0x100>;
        interrupts = <34 IRQ_TYPE_LEVEL_HIGH 7>;
        dmas = <&dma0 (AT91_XDMAC_DT_MEM_IF(0) | AT91_XDMAC_DT_PER_IF(1) |
                       AT91_XDMAC_DT_PERID(36))>,
               <&dma0 (AT91_XDMAC_DT_MEM_IF(0) | AT91_XDMAC_DT_PER_IF(1) |
                       AT91_XDMAC_DT_PERID(37))>;
        dma-names = "tx", "rx";
        clocks = <&i2s_clk>, <&i2s_gclk>;
        clock-names = "pclk", "gclk";
        pinctrl-names = "default";
        pinctrl-0 = <&pinctrl_i2s_default>;
    };
```
