## Documentation/devicetree/bindings/usb/st,stm32mp25-dwc3.yaml
```yaml
# SPDX-License-Identifier: (GPL-2.0 OR BSD-2-Clause)
%YAML 1.2
---
$id: http://devicetree.org/schemas/usb/st,stm32mp25-dwc3.yaml#
$schema: http://devicetree.org/meta-schemas/core.yaml#

title: STMicroelectronics STM32 MPU DWC3 USB SoC controller

description:
  The STM32 MPU DWC3 USB SoC controller block supports both
  Host(SS/HS/FS/LS) and Device(SS/HS/FS) mode operation

maintainers:
  - Fabrice Gasnier <fabrice.gasnier@foss.st.com>
  - Marek Vasut <marex@nabladev.com>

allOf:
  - $ref: snps,dwc3-common.yaml#

properties:
  compatible:
    const: st,stm32mp25-dwc3

  reg:
    maxItems: 1

  access-controllers:
    maxItems: 1

  clocks:
    minItems: 3
    maxItems: 3

  clock-names:
    items:
      - const: ref
      - const: bus_early
      - const: suspend

  interrupts:
    maxItems: 1

  resets:
    maxItems: 1

  over-current-active-low:
    type: boolean
    description: Over-Current signal polarity is active-low

  st,syscfg:
    $ref: /schemas/types.yaml#/definitions/phandle-array
    description: Phandle to system configuration controller.
    items:
      - items:
          - description: phandle to syscfg
          - description: USB3DR control offset within syscfg

  st,enable-port-power-control:
    type: boolean
    description: Enable Host-Mode Port Power Control (bit-3 of capability param HCCPARAMS)

  st,vbusen-active-low:
    type: boolean
    description: VBUS-ENABLE signal polarity is active-low

required:
  - compatible
  - reg
  - clocks
  - clock-names
  - interrupts
  - phys
  - phy-names
  - resets
  - st,syscfg

unevaluatedProperties: false

examples:
  - |
    #include <dt-bindings/clock/st,stm32mp25-rcc.h>
    #include <dt-bindings/interrupt-controller/arm-gic.h>
    #include <dt-bindings/reset/st,stm32mp25-rcc.h>

    usb@48300000 {
        compatible = "st,stm32mp25-dwc3";
        reg = <0x48300000 0x100000>;
        clocks = <&rcc CK_KER_USB2PHY2>, <&rcc CK_BUS_USB3DR>, <&rcc CK_KER_USB2PHY2>;
        clock-names = "ref", "bus_early", "suspend";
        interrupts = <GIC_SPI 228 IRQ_TYPE_LEVEL_HIGH>;
        phys = <&usb2_phy>, <&usb3_phy>;
        phy-names = "usb2-phy", "usb3-phy";
        resets = <&rcc USB3DR_R>;
        over-current-active-low;
        st,syscfg = <&syscfg 0x4800>;
        st,vbusen-active-low;
    };
```

## Documentation/devicetree/bindings/usb/ti,am335x-usb-ctrl-module.yaml
```yaml
# SPDX-License-Identifier: (GPL-2.0-only OR BSD-2-Clause)
%YAML 1.2
---
$id: http://devicetree.org/schemas/usb/ti,am335x-usb-ctrl-module.yaml#
$schema: http://devicetree.org/meta-schemas/core.yaml#

title: TI AM335x USB Control Module

maintainers:
  - Sebastian Andrzej Siewior <bigeasy@linutronix.de>

properties:
  compatible:
    const: ti,am335x-usb-ctrl-module

  reg:
    maxItems: 2

  reg-names:
    items:
      - const: phy_ctrl
      - const: wakeup

required:
  - compatible
  - reg
  - reg-names

additionalProperties: false

examples:
  - |
    control@44e10000 {
        compatible = "ti,am335x-usb-ctrl-module";
        reg = <0x44e10620 0x10>,
              <0x44e10648 0x4>;
        reg-names = "phy_ctrl", "wakeup";
    };
```

## Documentation/devicetree/bindings/usb/ti,am33xx-usb.yaml
```yaml
# SPDX-License-Identifier: (GPL-2.0-only OR BSD-2-Clause)
%YAML 1.2
---
$id: http://devicetree.org/schemas/usb/ti,am33xx-usb.yaml#
$schema: http://devicetree.org/meta-schemas/core.yaml#

title: TI AM33xx USB Wrapper

description:
  The glue layer contains multiple child nodes. It is required to have at least
  a USB node and a PHY node. The second USB node and its PHY node are optional.
  The DMA node is also optional.

maintainers:
  - Sebastian Andrzej Siewior <bigeasy@linutronix.de>

properties:
  compatible:
    const: ti,am33xx-usb

  reg:
    maxItems: 1

  ranges: true

  "#address-cells":
    const: 1

  "#size-cells":
    const: 1

  ti,hwmods:
    $ref: /schemas/types.yaml#/definitions/string
    description: Name of the hwmod associated with the USB module.
    const: usb_otg_hs
    deprecated: true

patternProperties:
  "^(usb-)?phy@[0-9a-f]+$":
    $ref: /schemas/phy/ti,am335x-usb-phy.yaml#

  "^usb@[0-9a-f]+$":
    $ref: /schemas/usb/ti,musb-am33xx.yaml#

  "^dma-controller@[0-9a-f]+$":
    $ref: /schemas/dma/ti/ti,cppi41.yaml#

required:
  - compatible
  - reg
  - ranges
  - "#address-cells"
  - "#size-cells"

additionalProperties: false

examples:
  - |
    usb@47400000 {
        compatible = "ti,am33xx-usb";
        reg = <0x47400000 0x1000>;
        ranges;
        #address-cells = <1>;
        #size-cells = <1>;
        ti,hwmods = "usb_otg_hs";

        usb-phy@47401300 {
            compatible = "ti,am335x-usb-phy";
            reg = <0x47401300 0x100>;
            reg-names = "phy";
            ti,ctrl_mod = <&ctrl_mod>;
            #phy-cells = <0>;
        };

        usb@47401000 {
            compatible = "ti,musb-am33xx";
            reg = <0x47401400 0x400>,
                  <0x47401000 0x200>;
            reg-names = "mc", "control";
            interrupts = <18>;
            interrupt-names = "mc";
            dr_mode = "otg";
            mentor,multipoint = <1>;
            mentor,num-eps = <16>;
            mentor,ram-bits = <12>;
            mentor,power = <500>;
            phys = <&usb0_phy>;
        };

        dma-controller@7402000 {
            compatible = "ti,am3359-cppi41";
            reg = <0x47400000 0x1000>,
                  <0x47402000 0x1000>,
                  <0x47403000 0x1000>,
                  <0x47404000 0x4000>;
            reg-names = "glue", "controller", "scheduler", "queuemgr";
            interrupts = <17>;
            interrupt-names = "glue";
            #dma-cells = <2>;
            dma-channels = <30>;
            dma-requests = <256>;
        };
    };
```
