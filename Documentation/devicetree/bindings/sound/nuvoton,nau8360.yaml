## Documentation/devicetree/bindings/sound/qcom,q6apm-lpass-dais.yaml
```yaml
# SPDX-License-Identifier: GPL-2.0 OR BSD-2-Clause
%YAML 1.2
---
$id: http://devicetree.org/schemas/sound/qcom,q6apm-lpass-dais.yaml#
$schema: http://devicetree.org/meta-schemas/core.yaml#

title: Qualcomm DSP LPASS (Low Power Audio SubSystem) Audio Ports

maintainers:
  - Krzysztof Kozlowski <krzk@kernel.org>
  - Srinivas Kandagatla <srinivas.kandagatla@linaro.org>

allOf:
  - $ref: dai-common.yaml#

properties:
  compatible:
    enum:
      - qcom,q6apm-lpass-dais

  '#sound-dai-cells':
    const: 1

  '#address-cells':
    const: 1

  '#size-cells':
    const: 0

# Digital Audio Interfaces
patternProperties:
  '^dai@[0-9a-f]+$':
    type: object
    description:
      Q6DSP Digital Audio Interfaces.

    properties:
      reg:
        maxItems: 1
        description:
          Digital Audio Interface ID

      clocks:
        minItems: 1
        maxItems: 2

      clock-names:
        minItems: 1
        items:
          - enum: [bclk, mclk]
          - const: mclk

    dependencies:
      clocks: [clock-names]

    required:
      - reg

    additionalProperties: false

required:
  - compatible
  - '#sound-dai-cells'

unevaluatedProperties: false

examples:
  - |
    #include <dt-bindings/sound/qcom,q6afe.h>

    dais {
        compatible = "qcom,q6apm-lpass-dais";
        #sound-dai-cells = <1>;
        #address-cells = <1>;
        #size-cells = <0>;

        dai@10 {
           reg = <PRIMARY_MI2S_RX>;
           clocks = <&q6prmcc LPASS_CLK_ID_PRI_MI2S_IBIT
                              LPASS_CLK_ATTRIBUTE_COUPLE_NO>,
                    <&q6prmcc LPASS_CLK_ID_MCLK_1
                              LPASS_CLK_ATTRIBUTE_COUPLE_NO>;
           clock-names = "bclk", "mclk";
        };
    };
```

## Documentation/devicetree/bindings/sound/qcom,shikra-qaif-cpu.yaml
```yaml
# SPDX-License-Identifier: (GPL-2.0-only OR BSD-2-Clause)
%YAML 1.2
---
$id: http://devicetree.org/schemas/sound/qcom,shikra-qaif-cpu.yaml#
$schema: http://devicetree.org/meta-schemas/core.yaml#

title: Qualcomm Audio Interface (QAIF) CPU DAI Controller

maintainers:
  - Harendra Gautam <harendra.gautam@oss.qualcomm.com>

description: |
  The Qualcomm Audio Interface (QAIF) is a fully configurable DMA-based
  audio subsystem controller. It serialises and deserialises PCM audio
  between system memory and external serial audio peripherals (PCM, TDM,
  I2S, MI2S) through the AIF path, and transfers parallel audio between
  memory and an internal WCD codec through the CIF path.

  AIF (Audio Interface): up to 13 multi-lane Unified Audio Interfaces,
  each supporting up to 8 independent data lanes. Each lane is individually
  configurable as TX (output/speaker) or RX (input/mic). All lanes of an
  interface share a single bit clock and frame sync. Supported modes are
  PCM (short/long sync), TDM, and MI2S (stereo/mono). Per-interface
  configuration includes sync source (master/slave), sync mode, sync delay,
  sync inversion, slot width (8/16/24/32-bit), sample width, active slot
  masks (up to 32 slots), bits-per-lane frame size, lane enable/direction
  masks, loopback, output-enable control, and full-cycle path support for
  long chip-to-chip connections.

  CIF (Codec Interface): up to 10 RDDMA (playback) and 10 WRDMA (capture)
  channels connecting to an internal codec over a parallel bus. Each channel
  supports active-channel enable mask (up to 16 channels), frame-sync
  selection, frame-sync delay, frame-sync output gating, dynamic clock
  gating, and 16-bit packing/unpacking.

  Note on RX/TX naming convention: in QAIF, TX refers to the output
  (speaker/playback) direction and RX refers to the input (mic/capture)
  direction. This applies to both AIF lane directions and CIF slot/mask
  properties.

  DMA engine: RDDMA fetches audio from DDR/TCM/LPM into a shared SRAM
  latency buffer (SHRAM) and drains it to the interface. WRDMA collects
  data from the interface into SHRAM and writes it to memory. Each DMA
  owns a private SHRAM region defined by start address and length registers.
  Burst sizes of 1/2/4/8/16 beats (64-bit) are supported with up to 4
  outstanding transactions per DMA. Two QSB master ports (QXM0 for TCM,
  QXM1 for DDR/LPM) provide the memory interface.

  Resources are partitioned among up to 5 Execution Engines (EEs) via
  EE map registers. Each EE owns a set of DMAs, audio interfaces, and
  interface groups, and receives its own independent interrupt output.
  The interrupt hierarchy has a two-level structure: a summary register
  identifies the event class (DMA period, underflow/overflow, error
  response, audio interface underflow/overflow, group done, rate detector,
  VFR), and per-resource status registers identify the specific channel.

  Interface grouping (bonding) allows up to 6 groups of audio and codec
  interfaces to start synchronously and align their DMA period interrupts
  within half a frame duration using the RDDMA padding feature.

  Two rate detector blocks measure the frequency of incoming frame sync or
  word select signals and generate interrupts on rate change, undetected
  rate, or sync timeout.

  Block diagram::

    System Memory (DDR / LPM / TCM)
    +---------------------------------+
    |  Circular Buffers (ping-pong)   |
    +----------+----------+-----------+
               |          ^
         64-bit AXI  64-bit AXI
               |          |
    +----------v----------+-----------+
    |        QSB Master Ports         |
    |  +----------+  +----------+     |
    |  |   QXM0   |  |   QXM1   |     |
    |  +----+-----+  +-----+----+     |
    +-------|--------------|----------+
            |              |
    +-------v--------------v----------+
    |         Shared RAM (SHRAM)       |
    |  +------------+  +------------+ |
    |  | QXM0 Read  |  | QXM0 Write | |
    |  | SHRAM      |  | SHRAM      | |
    |  +------------+  +------------+ |
    |  +------------+  +------------+ |
    |  | QXM1 Read  |  | QXM1 Write | |
    |  | SHRAM      |  | SHRAM      | |
    |  +------------+  +------------+ |
    +---+--------+--------+-------+---+
        |        |        |       |
    +---v--+  +--v---+ +--v---+ +-v----+
    |RDDMA |  |RDDMA | |WRDMA | |WRDMA |
    | AIF  |  | CIF  | | AIF  | | CIF  |
    |[0..n]|  |[0..n]| |[0..n]| |[0..n]|
    +--+---+  +--+---+ +--+---+ +-+----+
       |         |       ^          ^
       | TX      | TX    | RX       | RX
       v         v       |          |
    +--+--------------------+  +----+----------+
    |  Unified Audio Intf   |  | Codec DMA     |
    |  (AIF 0..12)          |  | Interface     |
    |                       |  | (CIF)         |
    |  AUD_INTFa block:     |  |               |
    |  - Serializer (TX)    |  | RDDMA: DDR -> |
    |  - De-serializer (RX) |  |   internal    |
    |  - Sync gen/detect    |  |   codec       |
    |  - Up to 8 data lanes |  | WRDMA: codec  |
    |  - PCM / TDM / MI2S   |  |   -> DDR      |
    |  - Near Pad Logic     |  | Up to 16 ch   |
    +--+--------------------+  +----+----------+
       |  Lane 0..7 (TX/RX)       |  Parallel bus
       |  Bit clk + Frame sync    |  + Frame sync
       v                          v
    +--+--------+          +------+------+
    | External  |          | Internal    |
    | Serial    |          | Digital     |
    | Peripherals|         | Codec       |
    | (PCM/TDM/ |          | (Bolero/    |
    |  MI2S)    |          |  WCD)       |
    +-----------+          +-------------+

allOf:
  - $ref: dai-common.yaml#

properties:
  compatible:
    const: qcom,shikra-qaif-cpu

  reg:
    maxItems: 1

  interrupts:
    maxItems: 1
    description:
      QAIF summary interrupt for this Execution Engine.

  iommus:
    maxItems: 1

  dma-coherent: true

  clocks:
    maxItems: 9

  clock-names:
    description:
      Core clocks for register access and DMA, followed by one bit
      clock per AIF interface.
    items:
      - const: lpass_config
      - const: lpass_core_axim
      - const: aud_dma
      - const: aud_dma_mem
      - const: bus
      - const: aif_if0_ibit
      - const: aif_if1_ibit
      - const: aif_if2_ibit
      - const: aif_if3_ibit

  '#sound-dai-cells':
    const: 1

  '#address-cells':
    const: 1

  '#size-cells':
    const: 0

patternProperties:
  '^aif@[0-9a-f]+$':
    type: object
    description:
      QAIF AIF interface child node for PCM, TDM or MI2S configuration.

    allOf:
      - $ref: /schemas/sound/tdm-slot.yaml#

    properties:
      reg:
        maxItems: 1
        description:
          DAI ID of the AIF interface (QAIF_MI2S_AIF* or QAIF_TDM_AIF*).

      dai-format:
        description: Serial audio interface format (MI2S, TDM or PCM).
        enum: [i2s, dsp_a, dsp_b]

      dai-tdm-slot-width:
        enum: [8, 16, 24, 32]

      dai-tdm-slot-num:
        minimum: 1
        maximum: 32

      dai-tdm-slot-rx-mask:
        minItems: 1
        maxItems: 32

      dai-tdm-slot-tx-mask:
        minItems: 1
        maxItems: 32

      qcom,qaif-aif-lane-map:
        $ref: /schemas/types.yaml#/definitions/uint32-array
        description:
          Per-lane direction map, one entry per lane starting from lane 0.
          Use 0 for TX (output/speaker) and 1 for RX (input/mic).
        minItems: 1
        maxItems: 8
        items:
          enum: [0, 1]

    required:
      - reg
      - dai-format
      - qcom,qaif-aif-lane-map

    if:
      properties:
        dai-format:
          enum: [dsp_a, dsp_b]
    then:
      required:
        - dai-tdm-slot-width
        - dai-tdm-slot-num
        - dai-tdm-slot-rx-mask
        - dai-tdm-slot-tx-mask

    unevaluatedProperties: false

required:
  - compatible
  - reg
  - interrupts
  - iommus
  - clocks
  - clock-names
  - '#sound-dai-cells'
  - '#address-cells'
  - '#size-cells'

unevaluatedProperties: false

examples:
  - |
    #include <dt-bindings/interrupt-controller/arm-gic.h>
    soc {
        #address-cells = <2>;
        #size-cells = <2>;

        qaif_cpu: audio-controller@a000000 {
            compatible = "qcom,shikra-qaif-cpu";
            reg = <0x0 0x0a000000 0x0 0x20000>;
            interrupts = <GIC_SPI 331 IRQ_TYPE_LEVEL_HIGH>;
            iommus = <&apps_smmu 0x1c0 0x0>;
            clocks = <&gcc 213>,
                     <&gcc 214>,
                     <&audiocorecc 15>,
                     <&audiocorecc 17>,
                     <&audiocorecc 18>,
                     <&audiocorecc 5>,
                     <&audiocorecc 8>,
                     <&audiocorecc 11>,
                     <&audiocorecc 14>;
            clock-names = "lpass_config",
                          "lpass_core_axim",
                          "aud_dma",
                          "aud_dma_mem",
                          "bus",
                          "aif_if0_ibit",
                          "aif_if1_ibit",
                          "aif_if2_ibit",
                          "aif_if3_ibit";
            #sound-dai-cells = <1>;
            #address-cells = <1>;
            #size-cells = <0>;

            aif@b5 {
                reg = <181>;
                dai-format = "dsp_a";
                dai-tdm-slot-width = <32>;
                dai-tdm-slot-num = <2>;
                dai-tdm-slot-rx-mask = <1 1>;
                dai-tdm-slot-tx-mask = <1 1>;
                qcom,qaif-aif-lane-map = <1 0>;
            };
        };
    };
```

## Documentation/devicetree/bindings/sound/qcom,wcd9378-sdw.yaml
```yaml
# SPDX-License-Identifier: (GPL-2.0-only OR BSD-2-Clause)
%YAML 1.2
---
$id: http://devicetree.org/schemas/sound/qcom,wcd9378-sdw.yaml#
$schema: http://devicetree.org/meta-schemas/core.yaml#

title: Qualcomm WCD9378 (Tambora) SoundWire codec

maintainers:
  - Srinivas Kandagatla <srinivas.kandagatla@oss.qualcomm.com>

description:
  Qualcomm WCD9378 (Tambora) SoundWire codec. The same silicon can be
  fused for a mobile (non-SDCA) mode or an SDCA-compliant mode; the
  qcom,sdca-compliant property selects the latter and is required by
  this driver.

allOf:
  - $ref: dai-common.yaml#

properties:
  compatible:
    const: sdw20217011000

  reg:
    maxItems: 1

  qcom,sdca-compliant:
    description:
      Present when the codec is fused as SDCA-compliant. The mobile
      (non-SDCA) variant carries the same class-ID compatible and is
      handled by a different driver.
    type: boolean

  qcom,port-mapping:
    description:
      Each entry maps a slave data port to a master data port.
      Entries are in order starting from slave port 1; slave port 0
      is reserved and not represented. SDCA-compliant mode uses 8
      entries covering DP1..DP8.
    $ref: /schemas/types.yaml#/definitions/uint32-array
    minItems: 8
    maxItems: 8

  reset-gpios:
    description: GPIO used to release the codec from reset.
    maxItems: 1

  vdd-buck-supply:
    description: 1.8 V analog buck supply.

  vdd-rxtx-supply:
    description: 1.8 V RX/TX supply.

  vdd-io-supply:
    description: Digital I/O supply.

  vdd-mic-bias-supply:
    description: Mic bias supply.

  '#sound-dai-cells':
    const: 1

required:
  - compatible
  - reg
  - qcom,sdca-compliant
  - qcom,port-mapping
  - reset-gpios
  - vdd-buck-supply
  - vdd-rxtx-supply
  - vdd-io-supply
  - vdd-mic-bias-supply
  - '#sound-dai-cells'

unevaluatedProperties: false

examples:
  - |
    #include <dt-bindings/gpio/gpio.h>

    soundwire@7630000 {
        reg = <0x07630000 0x10000>;
        #address-cells = <2>;
        #size-cells = <0>;

        wcd9378c_sdw: audio-codec@0,3 {
            compatible = "sdw20217011000";
            reg = <0 3>;

            qcom,sdca-compliant;

            qcom,port-mapping = <2 2 3 4 5 6 7 8>;

            reset-gpios = <&tlmm 191 GPIO_ACTIVE_LOW>;

            vdd-buck-supply = <&vreg_l15b_1p8>;
            vdd-rxtx-supply = <&vreg_l15b_1p8>;
            vdd-io-supply = <&vreg_l18b_1p2>;
            vdd-mic-bias-supply = <&vreg_bob1>;

            #sound-dai-cells = <1>;
        };
    };
...
```
