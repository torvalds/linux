## Documentation/devicetree/bindings/sound/qcom,wsa8855.yaml
```yaml
# SPDX-License-Identifier: (GPL-2.0-only OR BSD-2-Clause)
%YAML 1.2
---
$id: http://devicetree.org/schemas/sound/qcom,wsa8855.yaml#
$schema: http://devicetree.org/meta-schemas/core.yaml#

title: Qualcomm WSA8855 stereo smart speaker amplifier

maintainers:
  - Srinivas Kandagatla <srinivas.kandagatla@oss.qualcomm.com>
  - Prasad Kumpatla <prasad.kumpatla@oss.qualcomm.com>

description:
  WSA885X is a Qualcomm Aqstic stereo smart speaker amplifier. It uses a PCM
  audio interface, an I2C control interface, and a Class-H amplifier path for
  high efficiency, low output noise, and low idle power consumption.

allOf:
  - $ref: dai-common.yaml#

properties:
  compatible:
    const: qcom,wsa8855

  reg:
    maxItems: 1

  '#sound-dai-cells':
    const: 0

  powerdown-gpios:
    description: GPIO controlling the SD_N powerdown pin.
    maxItems: 1

  reset-gpios:
    description: GPIO controlling the SD_N powerdown pin.
    maxItems: 1

  interrupts:
    maxItems: 1

  vdd-1p8-supply: true

  vdd-io-supply: true

  qcom,battery-config:
    description:
      Battery topology connected to the speaker amplifier. 1S indicates one
      battery cell in series, while 2S indicates two battery cells in series.
    $ref: /schemas/types.yaml#/definitions/string
    default: 1s
    enum:
      - 1s
      - 2s

required:
  - compatible
  - reg
  - '#sound-dai-cells'
  - interrupts
  - vdd-1p8-supply
  - vdd-io-supply

oneOf:
  - required:
      - powerdown-gpios
  - required:
      - reset-gpios

unevaluatedProperties: false

examples:
  - |
    #include <dt-bindings/gpio/gpio.h>
    #include <dt-bindings/interrupt-controller/irq.h>

    i2c {
        #address-cells = <1>;
        #size-cells = <0>;

        speaker@c {
            compatible = "qcom,wsa8855";
            reg = <0x0c>;
            #sound-dai-cells = <0>;
            powerdown-gpios = <&tlmm 11 GPIO_ACTIVE_LOW>;
            interrupt-parent = <&tlmm>;
            interrupts = <77 IRQ_TYPE_EDGE_FALLING>;
            vdd-1p8-supply = <&vreg_l2g_1p8>;
            vdd-io-supply = <&vreg_l1g_1p2>;
            qcom,battery-config = "1s";
        };
    };
...
```

## Documentation/devicetree/bindings/sound/stericsson,ux500-msp-i2s.yaml
```yaml
# SPDX-License-Identifier: (GPL-2.0-only OR BSD-2-Clause)
%YAML 1.2
---
$id: http://devicetree.org/schemas/sound/stericsson,ux500-msp-i2s.yaml#
$schema: http://devicetree.org/meta-schemas/core.yaml#

title: ST-Ericsson Ux500 Multichannel Serial Port

maintainers:
  - Linus Walleij <linusw@kernel.org>

description:
  The Ux500 Multichannel Serial Port (MSP) is a synchronous serial audio
  interface supporting I2S and PCM/TDM protocols. Data is transferred to and
  from memory using the Ux500 DMA controller.

allOf:
  - $ref: dai-common.yaml#

properties:
  compatible:
    const: stericsson,ux500-msp-i2s

  reg:
    maxItems: 1

  interrupts:
    maxItems: 1

  v-ape-supply:
    description: Analog power engine supply

  dmas:
    minItems: 1
    maxItems: 2

  dma-names:
    minItems: 1
    maxItems: 2
    items:
      enum: [ rx, tx ]

  clocks:
    items:
      - description: MSP functional clock
      - description: MSP APB bus clock

  clock-names:
    items:
      - const: msp
      - const: apb_pclk

  resets:
    maxItems: 1

  '#sound-dai-cells':
    const: 0

  port:
    $ref: audio-graph-port.yaml#
    unevaluatedProperties: false

required:
  - compatible
  - reg
  - interrupts
  - v-ape-supply
  - dmas
  - dma-names
  - clocks
  - clock-names
  - resets
  - '#sound-dai-cells'

unevaluatedProperties: false

examples:
  - |
    #include <dt-bindings/interrupt-controller/arm-gic.h>
    #include <dt-bindings/interrupt-controller/irq.h>
    #include <dt-bindings/reset/stericsson,db8500-prcc-reset.h>

    msp@80123000 {
        compatible = "stericsson,ux500-msp-i2s";
        reg = <0x80123000 0x1000>;
        interrupts = <GIC_SPI 31 IRQ_TYPE_LEVEL_HIGH>;
        v-ape-supply = <&db8500_vape_reg>;
        dmas = <&dma 31 0 0x12>, <&dma 31 0 0x10>;
        dma-names = "rx", "tx";
        clocks = <&prcc_kclk 1 3>, <&prcc_pclk 1 3>;
        clock-names = "msp", "apb_pclk";
        resets = <&prcc_reset DB8500_PRCC_1 DB8500_PRCC_1_RESET_MSP0>;
        #sound-dai-cells = <0>;
    };

...
```

## Documentation/devicetree/bindings/sound/ti,da830-evm-audio.yaml
```yaml
# SPDX-License-Identifier: (GPL-2.0-only OR BSD-2-Clause)
%YAML 1.2
---
$id: http://devicetree.org/schemas/sound/ti,da830-evm-audio.yaml#
$schema: http://devicetree.org/meta-schemas/core.yaml#

title: Texas Instruments SoC audio setups with TLV320AIC3X Codec

maintainers:
  - Eduard Bostina <egbostina@gmail.com>

properties:
  compatible:
    const: ti,da830-evm-audio

  ti,model:
    $ref: /schemas/types.yaml#/definitions/string
    description: The user-visible name of this sound complex.

  ti,audio-codec:
    $ref: /schemas/types.yaml#/definitions/phandle
    description: The phandle of the TLV320AIC3x audio codec

  ti,mcasp-controller:
    $ref: /schemas/types.yaml#/definitions/phandle
    description: The phandle of the McASP controller

  ti,audio-routing:
    $ref: /schemas/types.yaml#/definitions/non-unique-string-array
    description:
      A list of the connections between audio components. Each entry is a
      pair of strings, the first being the connection's sink, the second
      being the connection's source. Valid names for sources and sinks
      are the codec's pins, and the jacks on the board (Headphone Jack,
      Line Out, Mic Jack, Line In).

  ti,codec-clock-rate:
    $ref: /schemas/types.yaml#/definitions/uint32
    description: The Codec Clock rate (in Hz) applied to the Codec.

  clocks:
    maxItems: 1
    description: Reference to the master clock

  clock-names:
    const: mclk

required:
  - compatible
  - ti,model
  - ti,audio-codec
  - ti,mcasp-controller
  - ti,audio-routing

anyOf:
  - required:
      - ti,codec-clock-rate
  - required:
      - clocks

additionalProperties: false

examples:
  - |
    sound {
        compatible = "ti,da830-evm-audio";
        ti,model = "DA830 EVM";
        ti,audio-codec = <&tlv320aic3x>;
        ti,mcasp-controller = <&mcasp1>;
        ti,codec-clock-rate = <12000000>;
        ti,audio-routing =
            "Headphone Jack",       "HPLOUT",
            "Headphone Jack",       "HPROUT",
            "Line Out",             "LLOUT",
            "Line Out",             "RLOUT",
            "MIC3L",                "Mic Bias 2V",
            "MIC3R",                "Mic Bias 2V",
            "Mic Bias 2V",          "Mic Jack",
            "LINE1L",               "Line In",
            "LINE2L",               "Line In",
            "LINE1R",               "Line In",
            "LINE2R",               "Line In";
    };
```

## Documentation/devicetree/bindings/sound/ti,omap4-dmic.yaml
```yaml
# SPDX-License-Identifier: GPL-2.0-only OR BSD-2-Clause
%YAML 1.2
---
$id: http://devicetree.org/schemas/sound/ti,omap4-dmic.yaml#
$schema: http://devicetree.org/meta-schemas/core.yaml#

title: Texas Instruments OMAP4+ Digital Microphone Module

maintainers:
  - Peter Ujfalusi <peter.ujfalusi@ti.com>

properties:
  compatible:
    const: ti,omap4-dmic

  reg:
    items:
      - description: MPU access base address
      - description: L3 interconnect address

  reg-names:
    items:
      - const: mpu
      - const: dma

  interrupts:
    maxItems: 1

  dmas:
    maxItems: 1

  dma-names:
    items:
      - const: up_link

required:
  - compatible
  - reg
  - reg-names
  - interrupts
  - dmas
  - dma-names

additionalProperties: false

examples:
  - |
    #include <dt-bindings/interrupt-controller/arm-gic.h>

    dmic@0 {
      compatible = "ti,omap4-dmic";
      reg = <0x0 0x7f>, /* MPU private access */
            <0x4902e000 0x7f>; /* L3 Interconnect */
      reg-names = "mpu", "dma";
      interrupts = <GIC_SPI 114 IRQ_TYPE_LEVEL_HIGH>;
      dmas = <&sdma 67>;
      dma-names = "up_link";
    };
```

## Documentation/devicetree/bindings/spi/amlogic,a4-spisg.yaml
```yaml
# SPDX-License-Identifier: (GPL-2.0-only OR BSD-2-Clause)
# Copyright (C) 2025 Amlogic, Inc. All rights reserved
%YAML 1.2
---
$id: http://devicetree.org/schemas/spi/amlogic,a4-spisg.yaml#
$schema: http://devicetree.org/meta-schemas/core.yaml#

title: Amlogic SPI Scatter-Gather Controller

maintainers:
  - Xianwei Zhao <xianwei.zhao@amlogic.com>
  - Sunny Luo <sunny.luo@amlogic.com>

properties:
  compatible:
    enum:
      - amlogic,a4-spisg
      - amlogic,a9-spisg

  reg:
    maxItems: 1

  interrupts:
    maxItems: 1

  clocks:
    maxItems: 2

  clock-names:
    items:
      - const: core
      - const: pclk

  resets:
    maxItems: 1

  amlogic,mo-idle-output:
    description: |
      Controls the MOSI output level when the controller is idle.
      0 - Drive MOSI low
      1 - Drive MOSI high
      2 - Follow the last transmitted bit
    $ref: /schemas/types.yaml#/definitions/uint32
    enum: [0, 1, 2]
    default: 0

required:
  - compatible
  - reg
  - interrupts
  - clocks
  - clock-names

allOf:
  - $ref: spi-controller.yaml#
  - if:
      not:
        properties:
          compatible:
            contains:
              enum:
                - amlogic,a9-spisg
    then:
      properties:
        amlogic,mo-idle-output: false

unevaluatedProperties: false

examples:
  - |
    #include <dt-bindings/interrupt-controller/arm-gic.h>
    spi@50000 {
        compatible = "amlogic,a4-spisg";
        reg = <0x50000 0x38>;
        interrupts = <GIC_SPI 183 IRQ_TYPE_LEVEL_HIGH>;
        clocks = <&clkc 37>,
                 <&clkc 93>;
        clock-names = "core", "pclk";
        #address-cells = <1>;
        #size-cells = <0>;
    };
```

## Documentation/devicetree/bindings/spi/microchip,pic32mzda-spi.yaml
```yaml
# SPDX-License-Identifier: (GPL-2.0-only OR BSD-2-Clause)
%YAML 1.2
---
$id: http://devicetree.org/schemas/spi/microchip,pic32mzda-spi.yaml#
$schema: http://devicetree.org/meta-schemas/core.yaml#

title: Microchip PIC32MZDA SPI Controller

maintainers:
  - Thomas Bogendoerfer <tsbogend@alpha.franken.de>

allOf:
  - $ref: spi-controller.yaml#

properties:
  compatible:
    const: microchip,pic32mzda-spi

  reg:
    maxItems: 1

  interrupts:
    items:
      - description: Fault interrupt
      - description: Receive interrupt
      - description: Transmit interrupt

  interrupt-names:
    items:
      - const: fault
      - const: rx
      - const: tx

  clocks:
    maxItems: 1

  clock-names:
    items:
      - const: mck0

  cs-gpios:
    maxItems: 1

  dmas:
    items:
      - description: RX DMA channel
      - description: TX DMA channel

  dma-names:
    items:
      - const: spi-rx
      - const: spi-tx

required:
  - compatible
  - reg
  - interrupts
  - interrupt-names
  - clocks
  - clock-names
  - cs-gpios

unevaluatedProperties: false

examples:
  - |
    #include <dt-bindings/interrupt-controller/irq.h>
    #include <dt-bindings/gpio/gpio.h>

    spi@1f821000 {
        compatible = "microchip,pic32mzda-spi";
        reg = <0x1f821000 0x200>;
        interrupts = <109 IRQ_TYPE_LEVEL_HIGH>,
                     <110 IRQ_TYPE_LEVEL_HIGH>,
                     <111 IRQ_TYPE_LEVEL_HIGH>;
        interrupt-names = "fault", "rx", "tx";
        clocks = <&PBCLK2>;
        clock-names = "mck0";
        cs-gpios = <&gpio3 4 GPIO_ACTIVE_LOW>;
        dmas = <&dma 134>, <&dma 135>;
        dma-names = "spi-rx", "spi-tx";
    };
```

## Documentation/devicetree/bindings/spi/nuvoton,ma35d1-qspi.yaml
```yaml
# SPDX-License-Identifier: (GPL-2.0-only OR BSD-2-Clause)
%YAML 1.2
---
$id: http://devicetree.org/schemas/spi/nuvoton,ma35d1-qspi.yaml#
$schema: http://devicetree.org/meta-schemas/core.yaml#

title: Nuvoton MA35D1 SPI and Quad SPI Controllers

description: |
  The Nuvoton MA35D1 SoC contains separate SPI and QSPI controller IPs.
  Both controllers expose the same Devicetree-visible resources and provide
  two native chip-select signals. GPIO chip selects are supported through the
  generic SPI controller binding.

  The QSPI controller additionally supports dual, quad and DTR transfers and
  a target-mode timeout function. These capability differences do not require
  additional controller properties.

maintainers:
  - Chi-Wen Weng <cwweng@nuvoton.com>

allOf:
  - $ref: /schemas/spi/spi-controller.yaml#

properties:
  compatible:
    enum:
      - nuvoton,ma35d1-spi
      - nuvoton,ma35d1-qspi

  reg:
    maxItems: 1

  interrupts:
    maxItems: 1

  clocks:
    maxItems: 1

  resets:
    maxItems: 1

  num-cs:
    minimum: 1
    maximum: 2
    default: 2

required:
  - compatible
  - reg
  - clocks
  - resets

unevaluatedProperties: false

examples:
  - |
    #include <dt-bindings/interrupt-controller/arm-gic.h>
    #include <dt-bindings/clock/nuvoton,ma35d1-clk.h>
    #include <dt-bindings/reset/nuvoton,ma35d1-reset.h>

    soc {
        #address-cells = <2>;
        #size-cells = <2>;

        spi@40680000 {
            compatible = "nuvoton,ma35d1-qspi";
            reg = <0 0x40680000 0 0x100>;
            interrupts = <GIC_SPI 57 IRQ_TYPE_LEVEL_HIGH>;
            clocks = <&clk QSPI0_GATE>;
            resets = <&sys MA35D1_RESET_QSPI0>;

            #address-cells = <1>;
            #size-cells = <0>;
        };
    };

...
```

## Documentation/devicetree/bindings/spi/realtek,rtd1625-nor.yaml
```yaml
# SPDX-License-Identifier: GPL-2.0-only OR BSD-2-Clause
%YAML 1.2
---
$id: http://devicetree.org/schemas/spi/realtek,rtd1625-nor.yaml#
$schema: http://devicetree.org/meta-schemas/core.yaml#

title: Realtek RTD1625 SPI NOR Flash Controller

maintainers:
  - Jyan Chou <jyanchou@realtek.com>
  - Yu-Chun Lin <eleanor.lin@realtek.com>

properties:
  compatible:
    enum:
      - realtek,rtd1625-nor

  reg:
    maxItems: 3

  reg-names:
    items:
      - const: ctrl
      - const: dma
      - const: dirmap

  clocks:
    maxItems: 1

  resets:
    maxItems: 1

  "#address-cells":
    const: 1

  "#size-cells":
    const: 0

required:
  - compatible
  - reg
  - reg-names
  - clocks
  - resets
  - "#address-cells"
  - "#size-cells"

allOf:
  - $ref: /schemas/spi/spi-controller.yaml#

unevaluatedProperties: false

examples:
  - |
    spi@14b000 {
      compatible = "realtek,rtd1625-nor";
      reg = <0x14b000 0x50>, <0x14bf00 0x30>, <0x88100000 0x2000000>;
      reg-names = "ctrl", "dma", "dirmap";
      clocks = <&cc 18>;
      resets = <&cc 26>;
      pinctrl-0 = <&spi_pins>;
      pinctrl-names = "default";
      #address-cells = <1>;
      #size-cells = <0>;
    };
```

## Documentation/devicetree/bindings/spi/ti,davinci-spi-peripheral-props.yaml
```yaml
# SPDX-License-Identifier: (GPL-2.0-only OR BSD-2-Clause)
%YAML 1.2
---
$id: http://devicetree.org/schemas/spi/ti,davinci-spi-peripheral-props.yaml#
$schema: http://devicetree.org/meta-schemas/core.yaml#

title: TI DaVinci/Keystone SPI Peripheral Properties

maintainers:
  - Bartosz Golaszewski <brgl@kernel.org>

description:
  Peripheral-specific properties for SPI devices attached to a TI
  DaVinci/Keystone SPI controller.

properties:
  ti,spi-wdelay:
    $ref: /schemas/types.yaml#/definitions/uint32
    minimum: 0
    maximum: 63
    description:
      delay between transmission of words (SPIFMTn.WDELAY, SPIDAT1.WDEL)
      must be specified in number of SPI module clock periods.

additionalProperties: true
```
