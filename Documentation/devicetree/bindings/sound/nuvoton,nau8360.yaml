## Documentation/devicetree/bindings/spi/ti,davinci-spi.yaml
```yaml
# SPDX-License-Identifier: (GPL-2.0-only OR BSD-2-Clause)
%YAML 1.2
---
$id: http://devicetree.org/schemas/spi/ti,davinci-spi.yaml#
$schema: http://devicetree.org/meta-schemas/core.yaml#

title: TI DaVinci/Keystone SPI Controller

maintainers:
  - Bartosz Golaszewski <brgl@kernel.org>

properties:
  compatible:
    oneOf:
      - enum:
          - ti,da830-spi
          - ti,keystone-spi
          - ti,dm6441-spi
      - items:
          - const: ti,keystone-spi
          - const: ti,dm6441-spi

  reg:
    maxItems: 1

  interrupts:
    maxItems: 1

  clocks:
    maxItems: 1

  power-domains:
    maxItems: 1
    description:
      Should contain a phandle to a PM domain provider node
      and an args specifier containing the SPI device id
      value.

  num-cs:
    minimum: 1
    default: 1
    description:
      Number of chip selects supported by the controller. This
      includes both internal and GPIO chip selects.

  ti,davinci-spi-intr-line:
    $ref: /schemas/types.yaml#/definitions/uint32
    enum: [0, 1]
    description:
      Interrupt line used to connect the SPI IP to the interrupt
      controller within the SoC.  The SPI peripheral can route its
      interrupt output to one of two lines (INT0 or INT1). Set
      this based on the SoC-specific wiring to the interrupt
      controller.

  dmas:
    items:
      - description: RX DMA channel
      - description: TX DMA channel

  dma-names:
    items:
      - const: rx
      - const: tx

  "#address-cells":
    const: 1

required:
  - compatible
  - reg
  - interrupts
  - clocks
  - ti,davinci-spi-intr-line
  - num-cs
  - "#address-cells"
  - "#size-cells"

allOf:
  - $ref: spi-controller.yaml#
  - if:
      properties:
        compatible:
          items:
            - const: ti,keystone-spi
    then:
      required:
        - power-domains

unevaluatedProperties: false

examples:
  - |
    spi@20bf0000 {
        compatible = "ti,keystone-spi", "ti,dm6441-spi";
        reg = <0x20bf0000 0x1000>;
        num-cs = <4>;
        ti,davinci-spi-intr-line = <0>;
        interrupts = <338>;
        clocks = <&clkspi>;
        #address-cells = <1>;
        #size-cells = <0>;

        flash@0 {
            compatible = "jedec,spi-nor";
            spi-max-frequency = <25000000>;
            reg = <0>;
            ti,spi-wdelay = <8>;
        };
    };

  - |
    spi@41000 {
        compatible = "ti,da830-spi";
        reg = <0x41000 0x1000>;
        num-cs = <6>;
        ti,davinci-spi-intr-line = <1>;
        interrupts = <20>;
        dmas = <&edma0 14 0>, <&edma0 15 0>;
        dma-names = "rx", "tx";
        clocks = <&psc0 4>;
        power-domains = <&psc0 4>;
        #address-cells = <1>;
        #size-cells = <0>;
    };
```

## Documentation/devicetree/bindings/thermal/google,gs101-tmu-top.yaml
```yaml
# SPDX-License-Identifier: (GPL-2.0-only OR BSD-2-Clause)
%YAML 1.2
---
$id: http://devicetree.org/schemas/thermal/google,gs101-tmu-top.yaml#
$schema: http://devicetree.org/meta-schemas/core.yaml#

title: Samsung Exynos ACPM Thermal Management Unit (TMU)

maintainers:
  - Tudor Ambarus <tudor.ambarus@linaro.org>

description:
  The Samsung Exynos ACPM TMU is a thermal sensor block found on Exynos
  based platforms (such as Google GS101 and Exynos850). It supports
  both direct register-level access and firmware-mediated management
  via the ACPM (Alive Clock and Power Manager) firmware.

  On these platforms, the hardware is managed in a hybrid fashion. The
  Application Processor (AP) maintains direct memory-mapped access
  exclusively to the interrupt pending registers to identify thermal
  events. All other functional aspects - including sensor
  initialization, threshold configuration, and temperature acquisition
  - are handled by the ACPM firmware. The AP coordinates these
  operations through the ACPM IPC protocol.

properties:
  compatible:
    const: google,gs101-tmu-top

  reg:
    maxItems: 1

  clocks:
    items:
      - description: APB peripheral clock (PCLK) for TMU register access.

  interrupts:
    maxItems: 1

  "#thermal-sensor-cells":
    const: 1

  samsung,acpm-ipc:
    $ref: /schemas/types.yaml#/definitions/phandle
    description: Phandle to the ACPM IPC node.

required:
  - compatible
  - reg
  - clocks
  - interrupts
  - "#thermal-sensor-cells"
  - samsung,acpm-ipc

additionalProperties: false

examples:
  - |
    #include <dt-bindings/interrupt-controller/arm-gic.h>
    #include <dt-bindings/clock/google,gs101.h>

    thermal-sensor@100a0000 {
        compatible = "google,gs101-tmu-top";
        reg = <0x100a0000 0x800>;
        clocks = <&cmu_misc CLK_GOUT_MISC_TMU_TOP_PCLK>;
        interrupts = <GIC_SPI 769 IRQ_TYPE_LEVEL_HIGH 0>;
        #thermal-sensor-cells = <1>;
        samsung,acpm-ipc = <&acpm_ipc>;
    };
```

## Documentation/devicetree/bindings/thermal/qcom,pm8775-mbg-tm.yaml
```yaml
# SPDX-License-Identifier: (GPL-2.0-only OR BSD-2-Clause)
%YAML 1.2
---
$id: http://devicetree.org/schemas/thermal/qcom,pm8775-mbg-tm.yaml#
$schema: http://devicetree.org/meta-schemas/core.yaml#

title: Qualcomm's SPMI PMIC MBG Thermal Monitoring

maintainers:
  - Jishnu Prakash <jishnu.prakash@oss.qualcomm.com>
  - Kamal Wadhwa <kamal.wadhwa@oss.qualcomm.com>

description:
  Qualcomm's MBG(Master Bandgap) temperature alarm monitors the die
  temperature and generates an interrupt if the PMIC die temperature is
  over a set of programmable temperature thresholds. It allows monitoring
  for both hot and cold, LVL1 and LVL2 thresholds, which makes it different
  from the existing temp alarm peripheral. The interrupt comes over SPMI
  and the MBG's fault status register gives details to understand whether
  it is a hot/cold and LVL1/LVL2 violation.

properties:
  compatible:
    const: qcom,pm8775-mbg-tm

  reg:
    maxItems: 1

  interrupts:
    maxItems: 1

  io-channels:
    items:
      - description: ADC channel, which reports chip die temperature.

  io-channel-names:
    items:
      - const: thermal

  '#thermal-sensor-cells':
    const: 0

required:
  - compatible
  - reg
  - interrupts
  - io-channels
  - io-channel-names

allOf:
  - $ref: thermal-sensor.yaml#

unevaluatedProperties: false

examples:
  - |
    #include <dt-bindings/interrupt-controller/irq.h>

    pmic {
        #address-cells = <1>;
        #size-cells = <0>;

        temperature-sensor@d700 {
            compatible = "qcom,pm8775-mbg-tm";
            reg = <0xd700>;
            interrupts = <0x1 0xd7 0x0 IRQ_TYPE_EDGE_RISING>;
            io-channels = <&pm8775_adc 0x3>;
            io-channel-names = "thermal";
            #thermal-sensor-cells = <0>;
        };
    };
...
```

## Documentation/devicetree/bindings/thermal/ti,omap-bandgap.yaml
```yaml
# SPDX-License-Identifier: (GPL-2.0-only OR BSD-2-Clause)
%YAML 1.2
---
$id: http://devicetree.org/schemas/thermal/ti,omap-bandgap.yaml#
$schema: http://devicetree.org/meta-schemas/core.yaml#

title: Texas Instruments OMAP SCM bandgap

maintainers:
  - Eduardo Valentin <edubezval@gmail.com>

description:
  In the System Control Module, OMAP supplies a voltage reference and a
  temperature sensor feature that are gathered in the band gap voltage and
  temperature sensor (VBGAPTS) module. The band gap provides current and
  voltage reference for its internal circuits and other analog IP blocks. The
  analog-to-digital converter (ADC) produces an output value that is
  proportional to the silicon temperature.

properties:
  compatible:
    enum:
      - ti,omap34xx-bandgap
      - ti,omap36xx-bandgap
      - ti,omap4430-bandgap
      - ti,omap4460-bandgap
      - ti,omap4470-bandgap
      - ti,omap5430-bandgap
      - ti,dra752-bandgap

  reg:
    minItems: 1
    maxItems: 6

  interrupts:
    maxItems: 1

  gpios:
    maxItems: 1
    description:
      used to inform which GPIO line the tshut signal is routed to. The
      informed GPIO will be treated as an IRQ;

  "#thermal-sensor-cells":
    enum: [0, 1]

required:
  - compatible
  - reg

allOf:
  - $ref: thermal-sensor.yaml#

  - if:
      properties:
        compatible:
          contains:
            enum:
              - ti,omap34xx-bandgap
              - ti,omap36xx-bandgap

    then:
      properties:
        reg:
          minItems: 1
          maxItems: 1

        interrupts: false

        gpios: false

        "#thermal-sensor-cells":
          const: 0

  - if:
      properties:
        compatible:
          contains:
            const: ti,omap4430-bandgap

    then:
      properties:
        reg:
          minItems: 2
          maxItems: 2

        interrupts: false

        "#thermal-sensor-cells":
          const: 0

      required:
        - gpios

  - if:
      properties:
        compatible:
          contains:
            enum:
              - ti,omap4460-bandgap
              - ti,omap4470-bandgap

    then:
      properties:
        reg:
          minItems: 3
          maxItems: 3

        "#thermal-sensor-cells":
          const: 0

      required:
        - interrupts
        - gpios

  - if:
      properties:
        compatible:
          contains:
            const: ti,omap5430-bandgap

    then:
      properties:
        reg:
          minItems: 4
          maxItems: 4

        gpios: false

        "#thermal-sensor-cells":
          const: 1

      required:
        - interrupts

  - if:
      properties:
        compatible:
          contains:
            const: ti,dra752-bandgap

    then:
      properties:
        reg:
          minItems: 6
          maxItems: 6

        gpios: false

        "#thermal-sensor-cells":
          const: 1

      required:
        - interrupts

unevaluatedProperties: false

examples:
  - |
    bandgap@48002524 {
        compatible = "ti,omap34xx-bandgap";
        reg = <0x48002524 0x4>;
        #thermal-sensor-cells = <0>;
    };

  - |
    #include <dt-bindings/interrupt-controller/arm-gic.h>
    #include <dt-bindings/interrupt-controller/irq.h>

    bandgap@4a0021e0 {
        compatible = "ti,dra752-bandgap";
        reg = <0x4a0021e0 0xc>, <0x4a00232c 0xc>,
              <0x4a002380 0x2c>, <0x4a0023c0 0x3c>,
              <0x4a002564 0x8>, <0x4a002574 0x50>;
        interrupts = <GIC_SPI 121 IRQ_TYPE_LEVEL_HIGH>; /* talert */
        #thermal-sensor-cells = <1>;
    };
```

## Documentation/devicetree/bindings/timer/renesas,rzn1-timer.yaml
```yaml
# SPDX-License-Identifier: (GPL-2.0-only OR BSD-2-Clause)
%YAML 1.2
---
$id: http://devicetree.org/schemas/timer/renesas,rzn1-timer.yaml#
$schema: http://devicetree.org/meta-schemas/core.yaml#

title: Renesas RZ/N1 timers

maintainers:
  - Herve Codina <herve.codina@bootlin.com>

description: |
  The Renesas RZ/N1 SoCs timers block controller is composed of 8 independent
  timers.
    - 6 are 16-bit timers
    - 2 are 32-bit timers

  Each timer has its own interrupt line and can work in either one-shot or
  periodic mode.

properties:
  compatible:
    items:
      - const: renesas,r9a06g032-timer   # RZ/N1D
      - const: renesas,rzn1-timer

  reg:
    maxItems: 1

  clocks:
    items:
      - description: APB internal bus clock

  clock-names:
    items:
      - const: pclk

  power-domains:
    maxItems: 1

  interrupts:
    maxItems: 8

required:
  - compatible
  - reg
  - clocks
  - clock-names
  - power-domains
  - interrupts

additionalProperties: false

examples:
  - |
    #include <dt-bindings/interrupt-controller/arm-gic.h>
    #include <dt-bindings/clock/r9a06g032-sysctrl.h>

    timer@51001000 {
        compatible = "renesas,r9a06g032-timer", "renesas,rzn1-timer";
        reg = <0x51001000 0x200>;
        clocks = <&sysctrl R9A06G032_HCLK_TIMER0>;
        clock-names = "pclk";
        power-domains = <&sysctrl>;
        interrupts = <GIC_SPI 112 IRQ_TYPE_LEVEL_HIGH>,
                     <GIC_SPI 113 IRQ_TYPE_LEVEL_HIGH>,
                     <GIC_SPI 114 IRQ_TYPE_LEVEL_HIGH>,
                     <GIC_SPI 115 IRQ_TYPE_LEVEL_HIGH>,
                     <GIC_SPI 116 IRQ_TYPE_LEVEL_HIGH>,
                     <GIC_SPI 117 IRQ_TYPE_LEVEL_HIGH>,
                     <GIC_SPI 118 IRQ_TYPE_LEVEL_HIGH>,
                     <GIC_SPI 119 IRQ_TYPE_LEVEL_HIGH>;
    };
...
```

## Documentation/devicetree/bindings/usb/altr,agilex5-dwc3.yaml
```yaml
# SPDX-License-Identifier: (GPL-2.0-only OR BSD-2-Clause)
%YAML 1.2
---
$id: http://devicetree.org/schemas/usb/altr,agilex5-dwc3.yaml#
$schema: http://devicetree.org/meta-schemas/core.yaml#

title: Altera Agilex5 DWC3 USB SoC Controller

maintainers:
  - Adrian Ng Ho Yin <adrian.ho.yin.ng@altera.com>

description:
  The Altera Agilex5 SoCFPGA integrates a Synopsys DesignWare USB3 (DWC3)
  controller that supports host, device and DRD modes.

allOf:
  - $ref: snps,dwc3-common.yaml#

properties:
  compatible:
    const: altr,agilex5-dwc3

  reg:
    maxItems: 1

  clocks:
    items:
      - description: Master/Core bus clock
      - description: Controller reference clock
      - description: Controller suspend clock

  clock-names:
    items:
      - const: bus_early
      - const: ref
      - const: suspend

  interrupts:
    maxItems: 1

  phys:
    minItems: 2
    maxItems: 2

  phy-names:
    items:
      - const: usb2-phy
      - const: usb3-phy

  iommus:
    maxItems: 1

  resets:
    items:
      - description: DWC3 core reset
      - description: DWC3 ECC reset

  reset-names:
    items:
      - const: core
      - const: ecc

  dr_mode: true

  maximum-speed: true

  snps,dis_u2_susphy_quirk: true

  snps,dis_u3_susphy_quirk: true

required:
  - compatible
  - reg
  - clocks
  - clock-names
  - interrupts
  - phys
  - phy-names
  - resets
  - reset-names
  - snps,dis_u2_susphy_quirk
  - snps,dis_u3_susphy_quirk

additionalProperties: false

examples:
  - |
    #include <dt-bindings/interrupt-controller/arm-gic.h>
    #include <dt-bindings/reset/altr,rst-mgr-s10.h>
    #include <dt-bindings/clock/intel,agilex5-clkmgr.h>

    soc {
        #address-cells = <1>;
        #size-cells = <1>;

        usb@11000000 {
            compatible = "altr,agilex5-dwc3";
            reg = <0x11000000 0x100000>;
            interrupts = <GIC_SPI 94 IRQ_TYPE_LEVEL_HIGH>;
            clocks = <&clkmgr AGILEX5_USB31_BUS_CLK_EARLY>,
                     <&clkmgr AGILEX5_USB31_SUSPEND_CLK>,
                     <&clkmgr AGILEX5_USB31_SUSPEND_CLK>;
            clock-names = "bus_early", "ref", "suspend";
            phys = <&usbphy0>, <&usbphy1>;
            phy-names = "usb2-phy", "usb3-phy";
            resets = <&rst USB1_RESET>, <&rst USB1_OCP_RESET>;
            reset-names = "core", "ecc";
            iommus = <&smmu 7>;
            snps,dis_u2_susphy_quirk;
            snps,dis_u3_susphy_quirk;
        };
    };
```
