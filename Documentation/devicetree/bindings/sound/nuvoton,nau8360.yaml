## Documentation/devicetree/bindings/sound/nuvoton,nau8360.yaml
```yaml
# SPDX-License-Identifier: GPL-2.0-only OR BSD-2-Clause
%YAML 1.2
---
$id: http://devicetree.org/schemas/sound/nuvoton,nau8360.yaml#
$schema: http://devicetree.org/meta-schemas/core.yaml#

title: Nuvoton NAU83G60 Stereo Class-D Amplifier with DSP

description:
  Stereo Class-D Amplifier with DSP and I/V-sense.
  This device supports I2C.

maintainers:
  - Neo Chang <YLCHANG2@nuvoton.com>

properties:
  compatible:
    enum:
      - nuvoton,nau8360

  reg:
    description: The I2C address is determined by the hardware pins.
    enum: [0x1a, 0x1b, 0x4a, 0x4b]

  "#sound-dai-cells":
    const: 0

  clocks:
    maxItems: 1

  clock-names:
    const: mclk

  firmware-name:
    description:
      List of DSP core firmware filenames. Both Left and Right DSP firmware
      must be provided and loaded. In PBTL mode, the Left DSP must use the
      same binary file as the Right DSP.
    items:
      - description: Left DSP core firmware filename.
      - description: Right DSP core firmware filename.

  nuvoton,pbtl-enable:
    type: boolean
    description: NAU83G60 supports PBTL mode for mono output.

  nuvoton,dac-cur-enable:
    type: boolean
    description:
      Adjust DAC output current to match speaker impedance and prevent
      hardware damage. +3.2dB when present, 0dB by default.

  nuvoton,dsp-rx-slot-mapping:
    description:
      Configures the TDM slot routing for DSP RX functions.
      Each integer assigns a specific DSP internal function to a TDM slot.
      The indices of the array correspond to the following hardware functions
        (0) DACL
        (1) DACR
        (2) ANCL
        (3) ANCR
      Assigned slots must be unique, except 255 which disables the function.
    $ref: /schemas/types.yaml#/definitions/uint32-array
    minItems: 4
    maxItems: 4
    items:
      enum: [ 0, 1, 2, 3, 4, 5, 6, 7, 255 ]

  nuvoton,dsp-tx-slot-mapping:
    description:
      Configures the TDM slot routing for DSP TX functions.
      Each integer assigns a specific DSP internal function to a TDM slot.
      The indices of the array correspond to the following hardware functions
        (0) AECL (Acoustic echo cancellation left)
        (1) AECR (Acoustic echo cancellation right)
        (2) ISNSL (Current sense left)
        (3) ISNSR (Current sense right)
        (4) VSNSL (Voltage sense left)
        (5) VSNSR (Voltage sense right)
        (6) TJ (Junction temperature)
        (7) VBAT (Battery voltage)
      Assigned slots must be unique, except 255 which disables the function.
    $ref: /schemas/types.yaml#/definitions/uint32-array
    minItems: 8
    maxItems: 8
    items:
      enum: [ 0, 1, 2, 3, 4, 5, 6, 7, 255 ]

required:
  - compatible
  - reg
  - firmware-name

allOf:
  - $ref: dai-common.yaml#

unevaluatedProperties: false

examples:
  - |
    i2c {
        #address-cells = <1>;
        #size-cells = <0>;

        codec@1a {
            compatible = "nuvoton,nau8360";
            reg = <0x1a>;
            #sound-dai-cells = <0>;
            firmware-name = "NAU83G60.kcs.bin.l", "NAU83G60.kcs.bin.r";
            nuvoton,dac-cur-enable;
            nuvoton,pbtl-enable;
            nuvoton,dsp-rx-slot-mapping = <0 1 2 3>;
            nuvoton,dsp-tx-slot-mapping = <0 1 2 3 4 5 6 7>;
        };
    };
```

## Documentation/devicetree/bindings/sound/nvidia,tegra-audio-wm8994.yaml
```yaml
# SPDX-License-Identifier: (GPL-2.0-only OR BSD-2-Clause)
%YAML 1.2
---
$id: http://devicetree.org/schemas/sound/nvidia,tegra-audio-wm8994.yaml#
$schema: http://devicetree.org/meta-schemas/core.yaml#

title: NVIDIA Tegra audio complex with WM8994 CODEC

maintainers:
  - Svyatoslav Ryhel <clamor95@gmail.com>

allOf:
  - $ref: nvidia,tegra-audio-common.yaml#

properties:
  compatible:
    items:
      - pattern: '^[a-z0-9]+,tegra-audio-wm8994(-[a-z0-9]+)+$'
      - const: nvidia,tegra-audio-wm8994

  nvidia,audio-routing:
    $ref: /schemas/types.yaml#/definitions/non-unique-string-array
    description: |
      A list of the connections between audio components.
      Each entry is a pair of strings, the first being the connection's sink,
      the second being the connection's source. Valid names for sources and
      sinks are the pins (documented in the binding document),
      and the jacks on the board.
    minItems: 2
    items:
      enum:
        # Board Connectors
        - Headphone Jack
        - Int Spk
        - Earpiece
        - Line Out
        - Mic Jack
        - Int Mic
        - Internal Mic 1
        - Internal Mic 2
        - FM Radio

        # CODEC Pins
        - SPKOUTLP
        - SPKOUTLN
        - SPKOUTRP
        - SPKOUTRN
        - HPOUT1L
        - HPOUT1R
        - HPOUT2P
        - HPOUT2N
        - LINEOUT1P
        - LINEOUT1N
        - LINEOUT2P
        - LINEOUT2N
        - IN1LN
        - IN1LP
        - IN2LN
        - IN2LP:VXRN
        - IN1RN
        - IN1RP
        - IN2RN
        - IN2RP:VXRP
        - DMIC1DAT
        - DMIC2DAT
        - MICBIAS1
        - MICBIAS2

required:
  - nvidia,i2s-controller

unevaluatedProperties: false

examples:
  - |
    #include <dt-bindings/clock/tegra20-car.h>
    #include <dt-bindings/gpio/gpio.h>

    sound {
        compatible = "lg,tegra-audio-wm8994-star",
                     "nvidia,tegra-audio-wm8994";
        nvidia,model = "LG Optimus 2X WM8994";

        nvidia,audio-routing =
                "Headphone Jack", "HPOUT1L",
                "Headphone Jack", "HPOUT1R",
                "Int Spk", "SPKOUTLN",
                "Int Spk", "SPKOUTLP",
                "Earpiece", "HPOUT2N",
                "Earpiece", "HPOUT2P",
                "IN2RN", "MICBIAS2",
                "IN2RN", "Mic Jack",
                "IN1LN", "MICBIAS1",
                "IN1LN", "Internal Mic 1",
                "IN1RN", "MICBIAS1",
                "IN1RN", "Internal Mic 2";

        nvidia,i2s-controller = <&tegra_i2s1>;
        nvidia,audio-codec = <&wm8994>;

        nvidia,hp-det-gpios = <&gpio 51 GPIO_ACTIVE_HIGH>;
        nvidia,mic-det-gpios = <&gpio 27 GPIO_ACTIVE_HIGH>;
        nvidia,ext-mic-en-gpios = <&gpio 57 GPIO_ACTIVE_HIGH>;
        nvidia,coupled-mic-hp-det;

        clocks = <&tegra_car TEGRA20_CLK_PLL_A>,
                 <&tegra_car TEGRA20_CLK_PLL_A_OUT0>,
                 <&tegra_car TEGRA20_CLK_CDEV1>;
        clock-names = "pll_a", "pll_a_out0", "mclk";
    };
```

## Documentation/devicetree/bindings/sound/nvidia,tegra30-ahub.yaml
```yaml
# SPDX-License-Identifier: (GPL-2.0-only OR BSD-2-Clause)
%YAML 1.2
---
$id: http://devicetree.org/schemas/sound/nvidia,tegra30-ahub.yaml#
$schema: http://devicetree.org/meta-schemas/core.yaml#

title: NVIDIA Tegra30 AHUB (Audio Hub)

maintainers:
  - Thierry Reding <thierry.reding@gmail.com>
  - Jon Hunter <jonathanh@nvidia.com>

description:
  AHUB client modules need to specify the IDs of their CIFs (Client
  InterFaces). For RX CIFs, the numbers indicate the register number within
  AHUB routing register space (APBIF 0..3 RX, I2S 0..5 RX, DAM 0..2 RX 0..1,
  SPDIF RX 0..1). For TX CIFs, the numbers indicate the bit position within
  the AHUB routing registers (APBIF 0..3 TX, I2S 0..5 TX, DAM 0..2 TX, SPDIF
  TX 0..1).

properties:
  compatible:
    oneOf:
      - const: nvidia,tegra30-ahub
      - const: nvidia,tegra114-ahub
      - const: nvidia,tegra124-ahub
      - items:
          - const: nvidia,tegra132-ahub
          - const: nvidia,tegra124-ahub

  reg:
    minItems: 2
    maxItems: 3

  interrupts:
    maxItems: 1

  clocks:
    items:
      - description: digital audio clock
      - description: module clock

  clock-names:
    items:
      - const: d_audio
      - const: apbif

  resets:
    minItems: 11
    maxItems: 21

  reset-names:
    minItems: 11
    maxItems: 21

  ranges: true

  dmas:
    minItems: 8
    maxItems: 20

  dma-names:
    minItems: 8
    maxItems: 20

  "#address-cells":
    enum: [1, 2]

  "#size-cells":
    enum: [1, 2]

patternProperties:
  "^i2s@[0-9a-f]+$":
    type: object
    required:
      - compatible

required:
  - compatible
  - reg
  - interrupts
  - clocks
  - clock-names
  - resets
  - reset-names
  - ranges
  - dmas
  - dma-names
  - "#address-cells"
  - "#size-cells"

allOf:
  - if:
      properties:
        compatible:
          const: nvidia,tegra30-ahub
    then:
      properties:
        reg:
          items:
            - description: APBIF registers
            - description: AHUB/AUDIO registers

        resets:
          maxItems: 11

        reset-names:
          items:
            - const: d_audio
            - const: apbif
            - const: i2s0
            - const: i2s1
            - const: i2s2
            - const: i2s3
            - const: i2s4
            - const: dam0
            - const: dam1
            - const: dam2
            - const: spdif

        dmas:
          maxItems: 8

        dma-names:
          items:
            - const: rx0
            - const: tx0
            - const: rx1
            - const: tx1
            - const: rx2
            - const: tx2
            - const: rx3
            - const: tx3

  - if:
      properties:
        compatible:
          const: nvidia,tegra114-ahub
    then:
      properties:
        reg:
          items:
            - description: APBIF registers
            - description: AHUB/AUDIO registers
            - description: APBIF2 registers

        resets:
          minItems: 13
          maxItems: 13

        reset-names:
          items:
            - const: d_audio
            - const: apbif
            - const: i2s0
            - const: i2s1
            - const: i2s2
            - const: i2s3
            - const: i2s4
            - const: dam0
            - const: dam1
            - const: dam2
            - const: spdif
            - const: amx
            - const: adx

        dmas:
          minItems: 20

        dma-names:
          items:
            - const: rx0
            - const: tx0
            - const: rx1
            - const: tx1
            - const: rx2
            - const: tx2
            - const: rx3
            - const: tx3
            - const: rx4
            - const: tx4
            - const: rx5
            - const: tx5
            - const: rx6
            - const: tx6
            - const: rx7
            - const: tx7
            - const: rx8
            - const: tx8
            - const: rx9
            - const: tx9

  - if:
      properties:
        compatible:
          contains:
            const: nvidia,tegra124-ahub
    then:
      properties:
        reg:
          items:
            - description: APBIF registers
            - description: AHUB/AUDIO registers
            - description: APBIF2 registers

        resets:
          minItems: 21

        reset-names:
          items:
            - const: d_audio
            - const: apbif
            - const: i2s0
            - const: i2s1
            - const: i2s2
            - const: i2s3
            - const: i2s4
            - const: dam0
            - const: dam1
            - const: dam2
            - const: spdif
            - const: amx
            - const: amx1
            - const: adx
            - const: adx1
            - const: afc0
            - const: afc1
            - const: afc2
            - const: afc3
            - const: afc4
            - const: afc5

        dmas:
          minItems: 20

        dma-names:
          items:
            - const: rx0
            - const: tx0
            - const: rx1
            - const: tx1
            - const: rx2
            - const: tx2
            - const: rx3
            - const: tx3
            - const: rx4
            - const: tx4
            - const: rx5
            - const: tx5
            - const: rx6
            - const: tx6
            - const: rx7
            - const: tx7
            - const: rx8
            - const: tx8
            - const: rx9
            - const: tx9

additionalProperties: false

examples:
  - |
    #include <dt-bindings/clock/tegra30-car.h>
    #include <dt-bindings/interrupt-controller/arm-gic.h>

    ahub@70080000 {
        compatible = "nvidia,tegra30-ahub";
        reg = <0x70080000 0x200>,
              <0x70080200 0x100>;
        interrupts = <GIC_SPI 103 IRQ_TYPE_LEVEL_HIGH>;
        clocks = <&tegra_car TEGRA30_CLK_D_AUDIO>,
                 <&tegra_car TEGRA30_CLK_APBIF>;
        clock-names = "d_audio", "apbif";
        resets = <&tegra_car 106>, <&tegra_car 107>, <&tegra_car 30>,
                 <&tegra_car 11>, <&tegra_car 18>, <&tegra_car 101>,
                 <&tegra_car 102>, <&tegra_car 108>, <&tegra_car 109>,
                 <&tegra_car 110>, <&tegra_car 10>;
        reset-names = "d_audio", "apbif", "i2s0", "i2s1", "i2s2",
                "i2s3", "i2s4", "dam0", "dam1", "dam2",
                "spdif";
        dmas = <&apbdma 1>, <&apbdma 1>,
               <&apbdma 2>, <&apbdma 2>,
               <&apbdma 3>, <&apbdma 3>,
               <&apbdma 4>, <&apbdma 4>;
        dma-names = "rx0", "tx0", "rx1", "tx1", "rx2", "tx2", "rx3", "tx3";
        ranges;
        #address-cells = <1>;
        #size-cells = <1>;
    };
```

## Documentation/devicetree/bindings/sound/qcom,q6apm-dai.yaml
```yaml
# SPDX-License-Identifier: (GPL-2.0 OR BSD-2-Clause)
%YAML 1.2
---
$id: http://devicetree.org/schemas/sound/qcom,q6apm-dai.yaml#
$schema: http://devicetree.org/meta-schemas/core.yaml#

title: Qualcomm Audio Process Manager Digital Audio Interfaces

maintainers:
  - Srinivas Kandagatla <srinivas.kandagatla@linaro.org>

description: |
  This binding describes the Qualcomm APM DAIs in DSP

properties:
  compatible:
    const: qcom,q6apm-dais

  iommus:
    minItems: 1
    maxItems: 2

  memory-region:
    minItems: 1
    items:
      - description:
          Control-path buffer (audio_heap_mem) for platforms where the DSP
          runs in a stage-2 protected context (e.g. modem-DSP).
      - description:
          Data-path buffer pool from which per-stream DMA buffers are
          allocated.

required:
  - compatible

oneOf:
  - required:
      - iommus
  - required:
      - memory-region

additionalProperties: false

examples:
  - |
    dais {
        compatible = "qcom,q6apm-dais";
        iommus = <&apps_smmu 0x1801 0x0>;
    };
```
