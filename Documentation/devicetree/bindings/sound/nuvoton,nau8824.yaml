## Documentation/devicetree/bindings/sound/nvidia,tegra-audio-common.yaml
```yaml
# SPDX-License-Identifier: (GPL-2.0-only OR BSD-2-Clause)
%YAML 1.2
---
$id: http://devicetree.org/schemas/sound/nvidia,tegra-audio-common.yaml#
$schema: http://devicetree.org/meta-schemas/core.yaml#

title: Common properties for NVIDIA Tegra audio complexes

maintainers:
  - Jon Hunter <jonathanh@nvidia.com>
  - Thierry Reding <thierry.reding@gmail.com>

properties:
  clocks:
    items:
      - description: PLL A clock
      - description: PLL A OUT0 clock
      - description: The Tegra cdev1/extern1 clock, which feeds the card's mclk

  clock-names:
    items:
      - const: pll_a
      - const: pll_a_out0
      - const: mclk

  nvidia,model:
    $ref: /schemas/types.yaml#/definitions/string
    description: The user-visible name of this sound complex.

  nvidia,audio-routing:
    $ref: /schemas/types.yaml#/definitions/non-unique-string-array
    description: |
      A list of the connections between audio components.
      Each entry is a pair of strings, the first being the connection's sink,
      the second being the connection's source. Valid names for sources and
      sinks are the pins (documented in the binding document),
      and the jacks on the board.

  nvidia,ac97-controller:
    $ref: /schemas/types.yaml#/definitions/phandle
    description: The phandle of the AC97 controller

  nvidia,i2s-controller:
    $ref: /schemas/types.yaml#/definitions/phandle
    description: The phandle of the Tegra I2S controller

  nvidia,audio-codec:
    $ref: /schemas/types.yaml#/definitions/phandle
    description: The phandle of audio codec

  nvidia,spkr-en-gpios:
    maxItems: 1
    description: The GPIO that enables the speakers

  nvidia,hp-mute-gpios:
    maxItems: 1
    description: The GPIO that mutes the headphones

  nvidia,hp-det-gpios:
    maxItems: 1
    description: The GPIO that detect headphones are plugged in

  nvidia,mic-det-gpios:
    maxItems: 1
    description: The GPIO that detect microphone is plugged in

  nvidia,ear-sel-gpios:
    maxItems: 1
    description: The GPIO that switch between the microphones

  nvidia,int-mic-en-gpios:
    maxItems: 1
    description: The GPIO that enables the internal microphone

  nvidia,ext-mic-en-gpios:
    maxItems: 1
    description: The GPIO that enables the external microphone

  nvidia,headset:
    type: boolean
    description: The Mic Jack represents state of the headset microphone pin

  nvidia,coupled-mic-hp-det:
    type: boolean
    description: The Mic detect GPIO is viable only if HP detect GPIO is active

additionalProperties: true
```

## Documentation/devicetree/bindings/sound/nvidia,tegra-audio-cpcap.yaml
```yaml
# SPDX-License-Identifier: (GPL-2.0-only OR BSD-2-Clause)
%YAML 1.2
---
$id: http://devicetree.org/schemas/sound/nvidia,tegra-audio-cpcap.yaml#
$schema: http://devicetree.org/meta-schemas/core.yaml#

title: NVIDIA Tegra audio complex with CPCAP CODEC

maintainers:
  - Svyatoslav Ryhel <clamor95@gmail.com>

allOf:
  - $ref: nvidia,tegra-audio-common.yaml#

properties:
  compatible:
    items:
      - pattern: '^motorola,tegra-audio-cpcap(-[a-z0-9]+)+$'
      - const: nvidia,tegra-audio-cpcap

  nvidia,audio-routing:
    $ref: /schemas/types.yaml#/definitions/non-unique-string-array
    description:
      A list of the connections between audio components. Each entry is a
      pair of strings, the first being the connection's sink, the second
      being the connection's source. Valid names for sources and sinks are
      the pins (documented in the binding document), and the jacks on the
      board.
    minItems: 2
    items:
      enum:
        # Board Connectors
        - Speakers
        - Int Spk
        - Earpiece
        - Int Mic
        - Headset Mic
        - Internal Mic 1
        - Internal Mic 2
        - Headphone
        - Headphones
        - Headphone Jack
        - Mic Jack

        # CODEC Pins
        - MICR
        - HSMIC
        - EMUMIC
        - MICL
        - EXTR
        - EXTL
        - EP
        - SPKR
        - SPKL
        - LINER
        - LINEL
        - HSR
        - HSL
        - EMUR
        - EMUL

unevaluatedProperties: false

examples:
  - |
    #include <dt-bindings/clock/tegra20-car.h>
    #include <dt-bindings/soc/tegra-pmc.h>
    sound {
        compatible = "motorola,tegra-audio-cpcap-olympus",
                     "nvidia,tegra-audio-cpcap";
        nvidia,model = "Motorola Atrix 4G (MB860) CPCAP";

        nvidia,audio-routing =
                "Headphones", "HSR",
                "Headphones", "HSL",
                "Int Spk", "SPKR",
                "Int Spk", "SPKL",
                "Earpiece", "EP",
                "HSMIC", "Mic Jack",
                "MICR", "Internal Mic 1",
                "MICL", "Internal Mic 2";

        nvidia,i2s-controller = <&tegra_i2s1>;
        nvidia,audio-codec = <&cpcap_audio>;

        clocks = <&tegra_car TEGRA20_CLK_PLL_A>,
                 <&tegra_car TEGRA20_CLK_PLL_A_OUT0>,
                 <&tegra_car TEGRA20_CLK_CDEV1>;
        clock-names = "pll_a", "pll_a_out0", "mclk";
    };
```

## Documentation/devicetree/bindings/sound/nvidia,tegra-audio-graph-card.yaml
```yaml
# SPDX-License-Identifier: (GPL-2.0-only OR BSD-2-Clause)
%YAML 1.2
---
$id: http://devicetree.org/schemas/sound/nvidia,tegra-audio-graph-card.yaml#
$schema: http://devicetree.org/meta-schemas/core.yaml#

title: Audio Graph based Tegra sound card driver

description: |
  This is based on generic audio graph card driver along with additional
  customizations for Tegra platforms. It uses the same bindings with
  additional standard clock DT bindings required for Tegra.

maintainers:
  - Jon Hunter <jonathanh@nvidia.com>
  - Sameer Pujar <spujar@nvidia.com>

allOf:
  - $ref: audio-graph.yaml#

properties:
  compatible:
    enum:
      - nvidia,tegra210-audio-graph-card
      - nvidia,tegra186-audio-graph-card

  clocks:
    minItems: 2

  clock-names:
    items:
      - const: pll_a
      - const: plla_out0

  assigned-clocks:
    minItems: 1
    maxItems: 3

  assigned-clock-parents:
    minItems: 1
    maxItems: 3

  assigned-clock-rates:
    minItems: 1
    maxItems: 3

  iommus:
    maxItems: 1

required:
  - clocks
  - clock-names
  - assigned-clocks
  - assigned-clock-parents

unevaluatedProperties: false

examples:
  - |
    #include<dt-bindings/clock/tegra210-car.h>

    tegra_sound {
        compatible = "nvidia,tegra210-audio-graph-card";

        clocks = <&tegra_car TEGRA210_CLK_PLL_A>,
                 <&tegra_car TEGRA210_CLK_PLL_A_OUT0>;
        clock-names = "pll_a", "plla_out0";

        assigned-clocks = <&tegra_car TEGRA210_CLK_PLL_A>,
                          <&tegra_car TEGRA210_CLK_PLL_A_OUT0>,
                          <&tegra_car TEGRA210_CLK_EXTERN1>;
        assigned-clock-parents = <0>, <0>, <&tegra_car TEGRA210_CLK_PLL_A_OUT0>;
        assigned-clock-rates = <368640000>, <49152000>, <12288000>;

        dais = /* FE */
               <&admaif1_port>,
               /* Router */
               <&xbar_i2s1_port>,
               /* I/O DAP Ports */
               <&i2s1_port>;

        label = "jetson-tx1-ape";
    };

    // The ports are defined for AHUB and its child devices.
    ahub@702d0800 {
        compatible = "nvidia,tegra210-ahub";
        reg = <0x702d0800 0x800>;
        clocks = <&tegra_car TEGRA210_CLK_D_AUDIO>;
        clock-names = "ahub";
        assigned-clocks = <&tegra_car TEGRA210_CLK_D_AUDIO>;
        assigned-clock-parents = <&tegra_car TEGRA210_CLK_PLL_A_OUT0>;
        #address-cells = <1>;
        #size-cells = <1>;
        ranges = <0x702d0000 0x702d0000 0x0000e400>;

        ports {
            #address-cells = <1>;
            #size-cells = <0>;

            port@0 {
                reg = <0x0>;
                xbar_admaif1_ep: endpoint {
                    remote-endpoint = <&admaif1_ep>;
                };
            };

            // ...

            xbar_i2s1_port: port@a {
                reg = <0xa>;
                xbar_i2s1_ep: endpoint {
                    remote-endpoint = <&i2s1_cif_ep>;
                };
            };
        };

        admaif@702d0000 {
            compatible = "nvidia,tegra210-admaif";
            reg = <0x702d0000 0x800>;
            dmas = <&adma 1>,  <&adma 1>,
                   <&adma 2>,  <&adma 2>,
                   <&adma 3>,  <&adma 3>,
                   <&adma 4>,  <&adma 4>,
                   <&adma 5>,  <&adma 5>,
                   <&adma 6>,  <&adma 6>,
                   <&adma 7>,  <&adma 7>,
                   <&adma 8>,  <&adma 8>,
                   <&adma 9>,  <&adma 9>,
                   <&adma 10>, <&adma 10>;
            dma-names = "rx1",  "tx1",
                        "rx2",  "tx2",
                        "rx3",  "tx3",
                        "rx4",  "tx4",
                        "rx5",  "tx5",
                        "rx6",  "tx6",
                        "rx7",  "tx7",
                        "rx8",  "tx8",
                        "rx9",  "tx9",
                        "rx10", "tx10";

            ports {
                #address-cells = <1>;
                #size-cells = <0>;

                admaif1_port: port@0 {
                    reg = <0x0>;
                    admaif1_ep: endpoint {
                        remote-endpoint = <&xbar_admaif1_ep>;
                    };
                };

                // More ADMAIF ports to follow
            };
        };

        i2s@702d1000 {
            compatible = "nvidia,tegra210-i2s";
            clocks = <&tegra_car TEGRA210_CLK_I2S0>;
            clock-names = "i2s";
            assigned-clocks = <&tegra_car TEGRA210_CLK_I2S0>;
            assigned-clock-parents = <&tegra_car TEGRA210_CLK_PLL_A_OUT0>;
            assigned-clock-rates = <1536000>;
            reg = <0x702d1000 0x100>;

            ports {
                #address-cells = <1>;
                #size-cells = <0>;

                port@0 {
                    reg = <0x0>;

                    i2s1_cif_ep: endpoint {
                        remote-endpoint = <&xbar_i2s1_ep>;
                    };
                };

                i2s1_port: port@1 {
                    reg = <0x1>;

                    i2s1_dap: endpoint {
                        dai-format = "i2s";
                    };
                };
            };
        };
    };

...
```

## Documentation/devicetree/bindings/sound/nvidia,tegra-audio-max9808x.yaml
```yaml
# SPDX-License-Identifier: (GPL-2.0-only OR BSD-2-Clause)
%YAML 1.2
---
$id: http://devicetree.org/schemas/sound/nvidia,tegra-audio-max9808x.yaml#
$schema: http://devicetree.org/meta-schemas/core.yaml#

title: NVIDIA Tegra audio complex with MAX9808x CODEC

maintainers:
  - Jon Hunter <jonathanh@nvidia.com>
  - Thierry Reding <thierry.reding@gmail.com>

allOf:
  - $ref: nvidia,tegra-audio-common.yaml#

properties:
  compatible:
    oneOf:
      - items:
          - pattern: '^[a-z0-9]+,tegra-audio-max98088(-[a-z0-9]+)+$'
          - const: nvidia,tegra-audio-max98088
      - items:
          - pattern: '^[a-z0-9]+,tegra-audio-max98089(-[a-z0-9]+)+$'
          - const: nvidia,tegra-audio-max98089

  nvidia,audio-routing:
    $ref: /schemas/types.yaml#/definitions/non-unique-string-array
    description: |
      A list of the connections between audio components.
      Each entry is a pair of strings, the first being the connection's sink,
      the second being the connection's source. Valid names for sources and
      sinks are the pins (documented in the binding document),
      and the jacks on the board.
    minItems: 2
    items:
      enum:
        # Board Connectors
        - Int Spk
        - Headphone Jack
        - Earpiece
        - Headset Mic
        - Internal Mic 1
        - Internal Mic 2

        # CODEC Pins
        - HPL
        - HPR
        - SPKL
        - SPKR
        - RECL
        - RECR
        - INA1
        - INA2
        - INB1
        - INB2
        - MIC1
        - MIC2
        - MICBIAS

unevaluatedProperties: false

examples:
  - |
    #include <dt-bindings/clock/tegra30-car.h>
    #include <dt-bindings/soc/tegra-pmc.h>
    sound {
        compatible = "lge,tegra-audio-max98089-p895",
                     "nvidia,tegra-audio-max98089";
        nvidia,model = "LG Optimus Vu MAX98089";

        nvidia,audio-routing =
            "Headphone Jack", "HPL",
            "Headphone Jack", "HPR",
            "Int Spk", "SPKL",
            "Int Spk", "SPKR",
            "Earpiece", "RECL",
            "Earpiece", "RECR",
            "INA1", "Headset Mic",
            "MIC1", "MICBIAS",
            "MICBIAS", "Internal Mic 1",
            "MIC2", "Internal Mic 2";

        nvidia,i2s-controller = <&tegra_i2s0>;
        nvidia,audio-codec = <&codec>;

        clocks = <&tegra_car TEGRA30_CLK_PLL_A>,
                 <&tegra_car TEGRA30_CLK_PLL_A_OUT0>,
                 <&tegra_pmc TEGRA_PMC_CLK_OUT_1>;
        clock-names = "pll_a", "pll_a_out0", "mclk";
    };
```

## Documentation/devicetree/bindings/sound/nvidia,tegra-audio-max98090.txt
```
NVIDIA Tegra audio complex, with MAX98090 CODEC

Required properties:
- compatible : "nvidia,tegra-audio-max98090"
- clocks : Must contain an entry for each entry in clock-names.
  See ../clocks/clock-bindings.txt for details.
- clock-names : Must include the following entries:
  - pll_a
  - pll_a_out0
  - mclk (The Tegra cdev1/extern1 clock, which feeds the CODEC's mclk)
- nvidia,model : The user-visible name of this sound complex.
- nvidia,audio-routing : A list of the connections between audio components.
  Each entry is a pair of strings, the first being the connection's sink,
  the second being the connection's source. Valid names for sources and
  sinks are the MAX98090's pins (as documented in its binding), and the jacks
  on the board:

  * Headphones
  * Speakers
  * Mic Jack

- nvidia,i2s-controller : The phandle of the Tegra I2S controller that's
  connected to the CODEC.
- nvidia,audio-codec : The phandle of the MAX98090 audio codec.

Optional properties:
- nvidia,hp-det-gpios : The GPIO that detect headphones are plugged in
- nvidia,mic-det-gpios : The GPIO that detect microphones are plugged in

Example:

sound {
	compatible = "nvidia,tegra-audio-max98090-venice2",
		     "nvidia,tegra-audio-max98090";
	nvidia,model = "NVIDIA Tegra Venice2";

	nvidia,audio-routing =
		"Headphones", "HPR",
		"Headphones", "HPL",
		"Speakers", "SPKR",
		"Speakers", "SPKL",
		"Mic Jack", "MICBIAS",
		"IN34", "Mic Jack";

	nvidia,i2s-controller = <&tegra_i2s1>;
	nvidia,audio-codec = <&acodec>;

	clocks = <&tegra_car TEGRA124_CLK_PLL_A>,
		 <&tegra_car TEGRA124_CLK_PLL_A_OUT0>,
		 <&tegra_car TEGRA124_CLK_EXTERN1>;
	clock-names = "pll_a", "pll_a_out0", "mclk";
};
```
