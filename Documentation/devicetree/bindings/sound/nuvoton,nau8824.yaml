## Documentation/devicetree/bindings/sound/nvidia,tegra-audio-sgtl5000.yaml
```yaml
# SPDX-License-Identifier: (GPL-2.0-only OR BSD-2-Clause)
%YAML 1.2
---
$id: http://devicetree.org/schemas/sound/nvidia,tegra-audio-sgtl5000.yaml#
$schema: http://devicetree.org/meta-schemas/core.yaml#

title: NVIDIA Tegra audio complex with SGTL5000 CODEC

maintainers:
  - Jon Hunter <jonathanh@nvidia.com>
  - Thierry Reding <thierry.reding@gmail.com>

allOf:
  - $ref: nvidia,tegra-audio-common.yaml#

properties:
  compatible:
    items:
      - pattern: '^[a-z0-9]+,tegra-audio-sgtl5000([-_][a-z0-9]+)+$'
      - const: nvidia,tegra-audio-sgtl5000

  nvidia,audio-routing:
    $ref: /schemas/types.yaml#/definitions/non-unique-string-array
    description: |
      A list of the connections between audio components.
      Each entry is a pair of strings, the first being the connection's sink,
      the second being the connection's source. Valid names for sources and
      sinks are the pins (documented in the binding document),
      and the jacks on the board.
    minItems: 2
    items:
      enum:
        # Board Connectors
        - "Headphone Jack"
        - "Line In Jack"
        - "Mic Jack"

        # CODEC Pins
        - HP_OUT
        - LINE_OUT
        - LINE_IN
        - MIC_IN

required:
  - nvidia,i2s-controller

unevaluatedProperties: false

examples:
  - |
    #include <dt-bindings/clock/tegra30-car.h>

    sound {
      compatible = "toradex,tegra-audio-sgtl5000-apalis_t30",
                   "nvidia,tegra-audio-sgtl5000";
      nvidia,model = "Toradex Apalis T30 SGTL5000";
      nvidia,audio-routing =
              "Headphone Jack", "HP_OUT",
              "LINE_IN", "Line In Jack",
              "MIC_IN", "Mic Jack";
      nvidia,i2s-controller = <&tegra_i2s2>;
      nvidia,audio-codec = <&codec>;
      clocks = <&tegra_car TEGRA30_CLK_PLL_A>,
               <&tegra_car TEGRA30_CLK_PLL_A_OUT0>,
               <&tegra_car TEGRA30_CLK_EXTERN1>;
      clock-names = "pll_a", "pll_a_out0", "mclk";
    };
```

## Documentation/devicetree/bindings/sound/nvidia,tegra-audio-trimslice.txt
```
NVIDIA Tegra audio complex for TrimSlice

Required properties:
- compatible : "nvidia,tegra-audio-trimslice"
- clocks : Must contain an entry for each entry in clock-names.
- clock-names : Must include the following entries:
  "pll_a" (The Tegra clock of that name),
  "pll_a_out0" (The Tegra clock of that name),
  "mclk" (The Tegra cdev1/extern1 clock, which feeds the CODEC's mclk)
- nvidia,i2s-controller : The phandle of the Tegra I2S1 controller
- nvidia,audio-codec : The phandle of the WM8903 audio codec

Example:

sound {
	compatible = "nvidia,tegra-audio-trimslice";
	nvidia,i2s-controller = <&tegra_i2s1>;
	nvidia,audio-codec = <&codec>;
	clocks = <&tegra_car 112>, <&tegra_car 113>, <&tegra_car 93>;
	clock-names = "pll_a", "pll_a_out0", "mclk";
};
```

## Documentation/devicetree/bindings/sound/nvidia,tegra-audio-trimslice.yaml
```yaml
# SPDX-License-Identifier: (GPL-2.0-only OR BSD-2-Clause)
%YAML 1.2
---
$id: http://devicetree.org/schemas/sound/nvidia,tegra-audio-trimslice.yaml#
$schema: http://devicetree.org/meta-schemas/core.yaml#

title: NVIDIA Tegra audio complex with TrimSlice CODEC

maintainers:
  - Jon Hunter <jonathanh@nvidia.com>
  - Thierry Reding <thierry.reding@gmail.com>

allOf:
  - $ref: nvidia,tegra-audio-common.yaml#

properties:
  compatible:
    const: nvidia,tegra-audio-trimslice

required:
  - nvidia,i2s-controller

unevaluatedProperties: false

examples:
  - |
    sound {
        compatible = "nvidia,tegra-audio-trimslice";
        nvidia,i2s-controller = <&tegra_i2s1>;
        nvidia,audio-codec = <&codec>;
        clocks = <&tegra_car 112>, <&tegra_car 113>, <&tegra_car 93>;
        clock-names = "pll_a", "pll_a_out0", "mclk";
    };
```

## Documentation/devicetree/bindings/sound/nvidia,tegra-audio-wm8753.txt
```
NVIDIA Tegra audio complex

Required properties:
- compatible : "nvidia,tegra-audio-wm8753"
- clocks : Must contain an entry for each entry in clock-names.
- clock-names : Must include the following entries:
  "pll_a" (The Tegra clock of that name),
  "pll_a_out0" (The Tegra clock of that name),
  "mclk" (The Tegra cdev1/extern1 clock, which feeds the CODEC's mclk)
- nvidia,model : The user-visible name of this sound complex.
- nvidia,audio-routing : A list of the connections between audio components.
  Each entry is a pair of strings, the first being the connection's sink,
  the second being the connection's source. Valid names for sources and
  sinks are the WM8753's pins, and the jacks on the board:

  WM8753 pins:

  * LOUT1
  * LOUT2
  * ROUT1
  * ROUT2
  * MONO1
  * MONO2
  * OUT3
  * OUT4
  * LINE1
  * LINE2
  * RXP
  * RXN
  * ACIN
  * ACOP
  * MIC1N
  * MIC1
  * MIC2N
  * MIC2
  * Mic Bias

  Board connectors:

  * Headphone Jack
  * Mic Jack

- nvidia,i2s-controller : The phandle of the Tegra I2S1 controller
- nvidia,audio-codec : The phandle of the WM8753 audio codec
Example:

sound {
	compatible = "nvidia,tegra-audio-wm8753-whistler",
		     "nvidia,tegra-audio-wm8753"
	nvidia,model = "tegra-wm8753-harmony";

	nvidia,audio-routing =
		"Headphone Jack", "LOUT1",
		"Headphone Jack", "ROUT1";

	nvidia,i2s-controller = <&i2s1>;
	nvidia,audio-codec = <&wm8753>;

	clocks = <&tegra_car 112>, <&tegra_car 113>, <&tegra_car 93>;
	clock-names = "pll_a", "pll_a_out0", "mclk";
};
```

## Documentation/devicetree/bindings/sound/nvidia,tegra-audio-wm8753.yaml
```yaml
# SPDX-License-Identifier: (GPL-2.0-only OR BSD-2-Clause)
%YAML 1.2
---
$id: http://devicetree.org/schemas/sound/nvidia,tegra-audio-wm8753.yaml#
$schema: http://devicetree.org/meta-schemas/core.yaml#

title: NVIDIA Tegra audio complex with WM8753 CODEC

maintainers:
  - Jon Hunter <jonathanh@nvidia.com>
  - Thierry Reding <thierry.reding@gmail.com>

allOf:
  - $ref: nvidia,tegra-audio-common.yaml#

properties:
  compatible:
    items:
      - pattern: '^[a-z0-9]+,tegra-audio-wm8753(-[a-z0-9]+)+$'
      - const: nvidia,tegra-audio-wm8753

  nvidia,audio-routing:
    $ref: /schemas/types.yaml#/definitions/non-unique-string-array
    description: |
      A list of the connections between audio components.
      Each entry is a pair of strings, the first being the connection's sink,
      the second being the connection's source. Valid names for sources and
      sinks are the pins (documented in the binding document),
      and the jacks on the board.
    minItems: 2
    items:
      enum:
        # Board Connectors
        - "Headphone Jack"
        - "Mic Jack"

        # CODEC Pins
        - LOUT1
        - LOUT2
        - ROUT1
        - ROUT2
        - MONO1
        - MONO2
        - OUT3
        - OUT4
        - LINE1
        - LINE2
        - RXP
        - RXN
        - ACIN
        - ACOP
        - MIC1N
        - MIC1
        - MIC2N
        - MIC2
        - "Mic Bias"

required:
  - nvidia,i2s-controller

unevaluatedProperties: false

examples:
  - |
    sound {
        compatible = "nvidia,tegra-audio-wm8753-whistler",
                     "nvidia,tegra-audio-wm8753";
        nvidia,model = "tegra-wm8753-harmony";

        nvidia,audio-routing =
                "Headphone Jack", "LOUT1",
                "Headphone Jack", "ROUT1";

        nvidia,i2s-controller = <&i2s1>;
        nvidia,audio-codec = <&wm8753>;

        clocks = <&clk 112>, <&clk 113>, <&clk 93>;
        clock-names = "pll_a", "pll_a_out0", "mclk";
    };
```

## Documentation/devicetree/bindings/sound/nvidia,tegra-audio-wm8903.txt
```
NVIDIA Tegra audio complex

Required properties:
- compatible : "nvidia,tegra-audio-wm8903"
- clocks : Must contain an entry for each entry in clock-names.
- clock-names : Must include the following entries:
  "pll_a" (The Tegra clock of that name),
  "pll_a_out0" (The Tegra clock of that name),
  "mclk" (The Tegra cdev1/extern1 clock, which feeds the CODEC's mclk)
- nvidia,model : The user-visible name of this sound complex.
- nvidia,audio-routing : A list of the connections between audio components.
  Each entry is a pair of strings, the first being the connection's sink,
  the second being the connection's source. Valid names for sources and
  sinks are the WM8903's pins (documented in the WM8903 binding document),
  and the jacks on the board:

  * Headphone Jack
  * Int Spk
  * Mic Jack

- nvidia,i2s-controller : The phandle of the Tegra I2S1 controller
- nvidia,audio-codec : The phandle of the WM8903 audio codec

Optional properties:
- nvidia,spkr-en-gpios : The GPIO that enables the speakers
- nvidia,hp-mute-gpios : The GPIO that mutes the headphones
- nvidia,hp-det-gpios : The GPIO that detect headphones are plugged in
- nvidia,int-mic-en-gpios : The GPIO that enables the internal microphone
- nvidia,ext-mic-en-gpios : The GPIO that enables the external microphone

Example:

sound {
	compatible = "nvidia,tegra-audio-wm8903-harmony",
		     "nvidia,tegra-audio-wm8903"
	nvidia,model = "tegra-wm8903-harmony";

	nvidia,audio-routing =
		"Headphone Jack", "HPOUTR",
		"Headphone Jack", "HPOUTL",
		"Int Spk", "ROP",
		"Int Spk", "RON",
		"Int Spk", "LOP",
		"Int Spk", "LON",
		"Mic Jack", "MICBIAS",
		"IN1L", "Mic Jack";

	nvidia,i2s-controller = <&i2s1>;
	nvidia,audio-codec = <&wm8903>;

	nvidia,spkr-en-gpios = <&codec 2 0>;
	nvidia,hp-det-gpios = <&gpio 178 0>; /* gpio PW2 */
	nvidia,int-mic-en-gpios = <&gpio 184 0>; /*gpio PX0 */
	nvidia,ext-mic-en-gpios = <&gpio 185 0>; /* gpio PX1 */

	clocks = <&tegra_car 112>, <&tegra_car 113>, <&tegra_car 93>;
	clock-names = "pll_a", "pll_a_out0", "mclk";
};
```

## Documentation/devicetree/bindings/sound/nvidia,tegra-audio-wm8903.yaml
```yaml
# SPDX-License-Identifier: (GPL-2.0-only OR BSD-2-Clause)
%YAML 1.2
---
$id: http://devicetree.org/schemas/sound/nvidia,tegra-audio-wm8903.yaml#
$schema: http://devicetree.org/meta-schemas/core.yaml#

title: NVIDIA Tegra audio complex with WM8903 CODEC

maintainers:
  - Jon Hunter <jonathanh@nvidia.com>
  - Thierry Reding <thierry.reding@gmail.com>

allOf:
  - $ref: nvidia,tegra-audio-common.yaml#

properties:
  compatible:
    oneOf:
      - items:
          - pattern: '^[a-z0-9]+,tegra-audio-wm8903(-[a-z0-9]+)+$'
          - const: nvidia,tegra-audio-wm8903
      - items:
          - pattern: ad,tegra-audio-plutux
          - const: nvidia,tegra-audio-wm8903

  nvidia,audio-routing:
    $ref: /schemas/types.yaml#/definitions/non-unique-string-array
    description: |
      A list of the connections between audio components.
      Each entry is a pair of strings, the first being the connection's sink,
      the second being the connection's source. Valid names for sources and
      sinks are the pins (documented in the binding document),
      and the jacks on the board.
    minItems: 2
    items:
      enum:
        # Board Connectors
        - "Headphone Jack"
        - "Int Spk"
        - "Mic Jack"
        - "Int Mic"

        # CODEC Pins
        - IN1L
        - IN1R
        - IN2L
        - IN2R
        - IN3L
        - IN3R
        - DMICDAT
        - HPOUTL
        - HPOUTR
        - LINEOUTL
        - LINEOUTR
        - LOP
        - LON
        - ROP
        - RON
        - MICBIAS

required:
  - nvidia,i2s-controller

unevaluatedProperties: false

examples:
  - |
    sound {
        compatible = "nvidia,tegra-audio-wm8903-harmony",
                     "nvidia,tegra-audio-wm8903";
        nvidia,model = "tegra-wm8903-harmony";

        nvidia,audio-routing =
                "Headphone Jack", "HPOUTR",
                "Headphone Jack", "HPOUTL",
                "Int Spk", "ROP",
                "Int Spk", "RON",
                "Int Spk", "LOP",
                "Int Spk", "LON",
                "Mic Jack", "MICBIAS",
                "IN1L", "Mic Jack";

        nvidia,i2s-controller = <&i2s1>;
        nvidia,audio-codec = <&wm8903>;

        nvidia,spkr-en-gpios = <&codec 2 0>;
        nvidia,hp-det-gpios = <&gpio 178 0>;
        nvidia,int-mic-en-gpios = <&gpio 184 0>;
        nvidia,ext-mic-en-gpios = <&gpio 185 0>;

        clocks = <&clk 112>, <&clk 113>, <&clk 93>;
        clock-names = "pll_a", "pll_a_out0", "mclk";
    };
```

## Documentation/devicetree/bindings/sound/nvidia,tegra-audio-wm8962.yaml
```yaml
# SPDX-License-Identifier: (GPL-2.0-only OR BSD-2-Clause)
%YAML 1.2
---
$id: http://devicetree.org/schemas/sound/nvidia,tegra-audio-wm8962.yaml#
$schema: http://devicetree.org/meta-schemas/core.yaml#

title: NVIDIA Tegra audio complex with WM8962 CODEC

maintainers:
  - Svyatoslav Ryhel <clamor95@gmail.com>

allOf:
  - $ref: nvidia,tegra-audio-common.yaml#

properties:
  compatible:
    items:
      - pattern: '^[a-z0-9]+,tegra-audio-wm8962(-[a-z0-9]+)+$'
      - const: nvidia,tegra-audio-wm8962

  nvidia,audio-routing:
    $ref: /schemas/types.yaml#/definitions/non-unique-string-array
    description:
      A list of the connections between audio components. Each entry is a
      pair of strings, the first being the connection's sink, the second
      being the connection's source. Valid names for sources and sinks are
      the pins (documented in the binding document), and the jacks on the
      board.
    minItems: 2
    items:
      enum:
        # Board Connectors
        - Speakers
        - Int Spk
        - Earpiece
        - Int Mic
        - Headset Mic
        - Internal Mic 1
        - Internal Mic 2
        - Headphone
        - Headphones
        - Headphone Jack
        - Mic Jack

        # CODEC Pins
        - IN1L
        - IN1R
        - IN2L
        - IN2R
        - IN3L
        - IN3R
        - IN4L
        - IN4R
        - DMICDAT
        - HPOUTL
        - HPOUTR
        - SPKOUT
        - SPKOUTL
        - SPKOUTR

required:
  - nvidia,i2s-controller

unevaluatedProperties: false

examples:
  - |
    #include <dt-bindings/clock/tegra30-car.h>
    #include <dt-bindings/soc/tegra-pmc.h>
    sound {
        compatible = "microsoft,tegra-audio-wm8962-surface-rt",
                     "nvidia,tegra-audio-wm8962";
        nvidia,model = "Microsoft Surface RT WM8962";

        nvidia,audio-routing =
                "Headphone Jack", "HPOUTR",
                "Headphone Jack", "HPOUTL",
                "Int Spk", "SPKOUTR",
                "Int Spk", "SPKOUTL";

        nvidia,i2s-controller = <&tegra_i2s1>;
        nvidia,audio-codec = <&wm8962>;

        clocks = <&tegra_car TEGRA30_CLK_PLL_A>,
                 <&tegra_car TEGRA30_CLK_PLL_A_OUT0>,
                 <&tegra_pmc TEGRA_PMC_CLK_OUT_1>;
        clock-names = "pll_a", "pll_a_out0", "mclk";
    };
```
