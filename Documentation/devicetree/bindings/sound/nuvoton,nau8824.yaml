## Documentation/devicetree/bindings/sound/nvidia,tegra-audio-max98090.yaml
```yaml
# SPDX-License-Identifier: (GPL-2.0-only OR BSD-2-Clause)
%YAML 1.2
---
$id: http://devicetree.org/schemas/sound/nvidia,tegra-audio-max98090.yaml#
$schema: http://devicetree.org/meta-schemas/core.yaml#

title: NVIDIA Tegra audio complex with MAX98090 CODEC

maintainers:
  - Jon Hunter <jonathanh@nvidia.com>
  - Thierry Reding <thierry.reding@gmail.com>

allOf:
  - $ref: nvidia,tegra-audio-common.yaml#

properties:
  compatible:
    oneOf:
      - items:
          - pattern: '^[a-z0-9]+,tegra-audio-max98090(-[a-z0-9]+)+$'
          - const: nvidia,tegra-audio-max98090
      - items:
          - enum:
              - nvidia,tegra-audio-max98090-nyan-big
              - nvidia,tegra-audio-max98090-nyan-blaze
          - const: nvidia,tegra-audio-max98090-nyan
          - const: nvidia,tegra-audio-max98090

  nvidia,audio-routing:
    $ref: /schemas/types.yaml#/definitions/non-unique-string-array
    description: |
      A list of the connections between audio components.
      Each entry is a pair of strings, the first being the connection's sink,
      the second being the connection's source. Valid names for sources and
      sinks are the pins (documented in the binding document),
      and the jacks on the board.
    minItems: 2
    items:
      enum:
        # Board Connectors
        - Headphones
        - Speakers
        - Mic Jack
        - Int Mic

        # CODEC Pins
        - MIC1
        - MIC2
        - DMICL
        - DMICR
        - IN1
        - IN2
        - IN3
        - IN4
        - IN5
        - IN6
        - IN12
        - IN34
        - IN56
        - HPL
        - HPR
        - SPKL
        - SPKR
        - RCVL
        - RCVR
        - MICBIAS

required:
  - nvidia,i2s-controller

unevaluatedProperties: false

examples:
  - |
    #include <dt-bindings/clock/tegra124-car.h>

    sound {
        compatible = "nvidia,tegra-audio-max98090-venice2",
                     "nvidia,tegra-audio-max98090";
        nvidia,model = "NVIDIA Tegra Venice2";

        nvidia,audio-routing =
                "Headphones", "HPR",
                "Headphones", "HPL",
                "Speakers", "SPKR",
                "Speakers", "SPKL",
                "Mic Jack", "MICBIAS",
                "IN34", "Mic Jack";

        nvidia,i2s-controller = <&tegra_i2s1>;
        nvidia,audio-codec = <&acodec>;

        clocks = <&tegra_car TEGRA124_CLK_PLL_A>,
                 <&tegra_car TEGRA124_CLK_PLL_A_OUT0>,
                 <&tegra_car TEGRA124_CLK_EXTERN1>;
        clock-names = "pll_a", "pll_a_out0", "mclk";
    };
```

## Documentation/devicetree/bindings/sound/nvidia,tegra-audio-rt5631.yaml
```yaml
# SPDX-License-Identifier: (GPL-2.0-only OR BSD-2-Clause)
%YAML 1.2
---
$id: http://devicetree.org/schemas/sound/nvidia,tegra-audio-rt5631.yaml#
$schema: http://devicetree.org/meta-schemas/core.yaml#

title: NVIDIA Tegra audio complex with RT5631 CODEC

maintainers:
  - Jon Hunter <jonathanh@nvidia.com>
  - Thierry Reding <thierry.reding@gmail.com>

allOf:
  - $ref: nvidia,tegra-audio-common.yaml#

properties:
  compatible:
    items:
      - pattern: '^[a-z0-9]+,tegra-audio-rt5631(-[a-z0-9]+)+$'
      - const: nvidia,tegra-audio-rt5631

  nvidia,audio-routing:
    $ref: /schemas/types.yaml#/definitions/non-unique-string-array
    description: |
      A list of the connections between audio components.
      Each entry is a pair of strings, the first being the connection's sink,
      the second being the connection's source. Valid names for sources and
      sinks are the pins (documented in the binding document),
      and the jacks on the board.
    minItems: 2
    items:
      enum:
        # Board Connectors
        - Int Spk
        - Headphone Jack
        - Mic Jack
        - Int Mic

        # CODEC Pins
        - MIC1
        - MIC2
        - AXIL
        - AXIR
        - MONOIN_RXN
        - MONOIN_RXP
        - DMIC
        - MIC Bias1
        - MIC Bias2
        - MONO_IN
        - AUXO1
        - AUXO2
        - SPOL
        - SPOR
        - HPOL
        - HPOR
        - MONO

unevaluatedProperties: false

examples:
  - |
    #include <dt-bindings/clock/tegra30-car.h>
    #include <dt-bindings/soc/tegra-pmc.h>
    sound {
        compatible = "asus,tegra-audio-rt5631-tf700t",
                     "nvidia,tegra-audio-rt5631";
        nvidia,model = "Asus Transformer Infinity TF700T RT5631";

        nvidia,audio-routing =
                "Headphone Jack", "HPOL",
                "Headphone Jack", "HPOR",
                "Int Spk", "SPOL",
                "Int Spk", "SPOR",
                "MIC1", "MIC Bias1",
                "MIC Bias1", "Mic Jack",
                "DMIC", "Int Mic";

        nvidia,i2s-controller = <&tegra_i2s1>;
        nvidia,audio-codec = <&rt5631>;

        clocks = <&tegra_car TEGRA30_CLK_PLL_A>,
                 <&tegra_car TEGRA30_CLK_PLL_A_OUT0>,
                 <&tegra_pmc TEGRA_PMC_CLK_OUT_1>;
        clock-names = "pll_a", "pll_a_out0", "mclk";
    };
```

## Documentation/devicetree/bindings/sound/nvidia,tegra-audio-rt5640.txt
```
NVIDIA Tegra audio complex, with RT5640 CODEC

Required properties:
- compatible : "nvidia,tegra-audio-rt5640"
- clocks : Must contain an entry for each entry in clock-names.
- clock-names : Must include the following entries:
  "pll_a" (The Tegra clock of that name),
  "pll_a_out0" (The Tegra clock of that name),
  "mclk" (The Tegra cdev1/extern1 clock, which feeds the CODEC's mclk)
- nvidia,model : The user-visible name of this sound complex.
- nvidia,audio-routing : A list of the connections between audio components.
  Each entry is a pair of strings, the first being the connection's sink,
  the second being the connection's source. Valid names for sources and
  sinks are the RT5640's pins, and the jacks on the board:

  RT5640 pins:

  * DMIC1
  * DMIC2
  * MICBIAS1
  * IN1P
  * IN1R
  * IN2P
  * IN2R
  * HPOL
  * HPOR
  * LOUTL
  * LOUTR
  * MONOP
  * MONON
  * SPOLP
  * SPOLN
  * SPORP
  * SPORN

  Board connectors:

  * Headphones
  * Speakers

- nvidia,i2s-controller : The phandle of the Tegra I2S controller that's
  connected to the CODEC.
- nvidia,audio-codec : The phandle of the RT5640 audio codec. This binding
  assumes that AIF1 on the CODEC is connected to Tegra.

Optional properties:
- nvidia,hp-det-gpios : The GPIO that detects headphones are plugged in

Example:

sound {
	compatible = "nvidia,tegra-audio-rt5640-dalmore",
			"nvidia,tegra-audio-rt5640";
	nvidia,model = "NVIDIA Tegra Dalmore";

	nvidia,audio-routing =
		"Headphones", "HPOR",
		"Headphones", "HPOL",
		"Speakers", "SPORP",
		"Speakers", "SPORN",
		"Speakers", "SPOLP",
		"Speakers", "SPOLN";

	nvidia,i2s-controller = <&tegra_i2s1>;
	nvidia,audio-codec = <&rt5640>;

	nvidia,hp-det-gpios = <&gpio 143 0>; /* GPIO PR7 */

	clocks = <&tegra_car 216>, <&tegra_car 217>, <&tegra_car 120>;
	clock-names = "pll_a", "pll_a_out0", "mclk";
};
```

## Documentation/devicetree/bindings/sound/nvidia,tegra-audio-rt5640.yaml
```yaml
# SPDX-License-Identifier: (GPL-2.0-only OR BSD-2-Clause)
%YAML 1.2
---
$id: http://devicetree.org/schemas/sound/nvidia,tegra-audio-rt5640.yaml#
$schema: http://devicetree.org/meta-schemas/core.yaml#

title: NVIDIA Tegra audio complex with RT5639 or RT5640 CODEC

maintainers:
  - Jon Hunter <jonathanh@nvidia.com>
  - Thierry Reding <thierry.reding@gmail.com>

allOf:
  - $ref: nvidia,tegra-audio-common.yaml#

properties:
  compatible:
    items:
      - pattern: '^[a-z0-9]+,tegra-audio-rt56(39|40)(-[a-z0-9]+)+$'
      - const: nvidia,tegra-audio-rt5640

  nvidia,audio-routing:
    $ref: /schemas/types.yaml#/definitions/non-unique-string-array
    description: |
      A list of the connections between audio components.
      Each entry is a pair of strings, the first being the connection's sink,
      the second being the connection's source. Valid names for sources and
      sinks are the pins (documented in the binding document),
      and the jacks on the board.
    minItems: 2
    items:
      enum:
        # Board Connectors
        - "Headphones"
        - "Speakers"
        - "Mic Jack"

        # CODEC Pins
        - DMIC1
        - DMIC2
        - MICBIAS1
        - IN1P
        - IN1R
        - IN2P
        - IN2R
        - HPOL
        - HPOR
        - LOUTL
        - LOUTR
        - MONOP
        - MONON
        - SPOLP
        - SPOLN
        - SPORP
        - SPORN

required:
  - nvidia,i2s-controller

unevaluatedProperties: false

examples:
  - |
    sound {
        compatible = "nvidia,tegra-audio-rt5640-dalmore",
                     "nvidia,tegra-audio-rt5640";
        nvidia,model = "NVIDIA Tegra Dalmore";

        nvidia,audio-routing =
                "Headphones", "HPOR",
                "Headphones", "HPOL",
                "Speakers", "SPORP",
                "Speakers", "SPORN",
                "Speakers", "SPOLP",
                "Speakers", "SPOLN";

        nvidia,i2s-controller = <&tegra_i2s1>;
        nvidia,audio-codec = <&rt5640>;

        nvidia,hp-det-gpios = <&gpio 143 0>;

        clocks = <&clk 216>, <&clk 217>, <&clk 120>;
        clock-names = "pll_a", "pll_a_out0", "mclk";
    };
```

## Documentation/devicetree/bindings/sound/nvidia,tegra-audio-rt5677.txt
```
NVIDIA Tegra audio complex, with RT5677 CODEC

Required properties:
- compatible : "nvidia,tegra-audio-rt5677"
- clocks : Must contain an entry for each entry in clock-names.
  See ../clocks/clock-bindings.txt for details.
- clock-names : Must include the following entries:
  - pll_a
  - pll_a_out0
  - mclk (The Tegra cdev1/extern1 clock, which feeds the CODEC's mclk)
- nvidia,model : The user-visible name of this sound complex.
- nvidia,audio-routing : A list of the connections between audio components.
  Each entry is a pair of strings, the first being the connection's sink,
  the second being the connection's source. Valid names for sources and
  sinks are the RT5677's pins (as documented in its binding), and the jacks
  on the board:

  * Headphone
  * Speaker
  * Headset Mic
  * Internal Mic 1
  * Internal Mic 2

- nvidia,i2s-controller : The phandle of the Tegra I2S controller that's
  connected to the CODEC.
- nvidia,audio-codec : The phandle of the RT5677 audio codec. This binding
  assumes that AIF1 on the CODEC is connected to Tegra.

Optional properties:
- nvidia,hp-det-gpios : The GPIO that detects headphones are plugged in
- nvidia,hp-en-gpios : The GPIO that enables headphone amplifier
- nvidia,mic-present-gpios: The GPIO that mic jack is plugged in
- nvidia,dmic-clk-en-gpios : The GPIO that gates DMIC clock signal

Example:

sound {
	compatible = "nvidia,tegra-audio-rt5677-ryu",
	        "nvidia,tegra-audio-rt5677";
	nvidia,model = "NVIDIA Tegra Ryu";

	nvidia,audio-routing =
		"Headphone", "LOUT2",
		"Headphone", "LOUT1",
		"Headset Mic", "MICBIAS1",
		"IN1P", "Headset Mic",
		"IN1N", "Headset Mic",
		"DMIC L1", "Internal Mic 1",
		"DMIC R1", "Internal Mic 1",
		"DMIC L2", "Internal Mic 2",
		"DMIC R2", "Internal Mic 2",
		"Speaker", "PDM1L",
		"Speaker", "PDM1R";

	nvidia,i2s-controller = <&tegra_i2s1>;
	nvidia,audio-codec = <&rt5677>;

	nvidia,hp-det-gpios = <&gpio TEGRA_GPIO(R, 7) GPIO_ACTIVE_HIGH>;
	nvidia,mic-present-gpios = <&gpio TEGRA_GPIO(O, 5) GPIO_ACTIVE_LOW>;
	nvidia,hp-en-gpios = <&rt5677 1 GPIO_ACTIVE_HIGH>;
	nvidia,dmic-clk-en-gpios = <&rt5677 2 GPIO_ACTIVE_HIGH>;

	clocks = <&tegra_car TEGRA124_CLK_PLL_A>,
	         <&tegra_car TEGRA124_CLK_PLL_A_OUT0>,
	         <&tegra_car TEGRA124_CLK_EXTERN1>;
	clock-names = "pll_a", "pll_a_out0", "mclk";
};
```

## Documentation/devicetree/bindings/sound/nvidia,tegra-audio-rt5677.yaml
```yaml
# SPDX-License-Identifier: (GPL-2.0-only OR BSD-2-Clause)
%YAML 1.2
---
$id: http://devicetree.org/schemas/sound/nvidia,tegra-audio-rt5677.yaml#
$schema: http://devicetree.org/meta-schemas/core.yaml#

title: NVIDIA Tegra audio complex with RT5677 CODEC

maintainers:
  - Jon Hunter <jonathanh@nvidia.com>
  - Thierry Reding <thierry.reding@gmail.com>

allOf:
  - $ref: nvidia,tegra-audio-common.yaml#

properties:
  compatible:
    items:
      - pattern: '^[a-z0-9]+,tegra-audio-rt5677(-[a-z0-9]+)+$'
      - const: nvidia,tegra-audio-rt5677

  nvidia,audio-routing:
    $ref: /schemas/types.yaml#/definitions/non-unique-string-array
    description: |
      A list of the connections between audio components.
      Each entry is a pair of strings, the first being the connection's sink,
      the second being the connection's source. Valid names for sources and
      sinks are the pins (documented in the binding document),
      and the jacks on the board.
    minItems: 2
    items:
      enum:
        # Board Connectors
        - "Headphone"
        - "Speaker"
        - "Headset Mic"
        - "Internal Mic 1"
        - "Internal Mic 2"

        # CODEC Pins
        - IN1P
        - IN1N
        - IN2P
        - IN2N
        - MICBIAS1
        - DMIC1
        - DMIC2
        - DMIC3
        - DMIC4
        - "DMIC L1"
        - "DMIC L2"
        - "DMIC L3"
        - "DMIC L4"
        - "DMIC R1"
        - "DMIC R2"
        - "DMIC R3"
        - "DMIC R4"
        - LOUT1
        - LOUT2
        - LOUT3
        - PDM1L
        - PDM1R
        - PDM2L
        - PDM2R

required:
  - nvidia,i2s-controller

unevaluatedProperties: false

examples:
  - |
    sound {
        compatible = "nvidia,tegra-audio-rt5677-ryu",
                     "nvidia,tegra-audio-rt5677";
        nvidia,model = "NVIDIA Tegra Ryu";

        nvidia,audio-routing =
                "Headphone", "LOUT2",
                "Headphone", "LOUT1",
                "Headset Mic", "MICBIAS1",
                "IN1P", "Headset Mic",
                "IN1N", "Headset Mic",
                "DMIC L1", "Internal Mic 1",
                "DMIC R1", "Internal Mic 1",
                "DMIC L2", "Internal Mic 2",
                "DMIC R2", "Internal Mic 2",
                "Speaker", "PDM1L",
                "Speaker", "PDM1R";

        nvidia,i2s-controller = <&tegra_i2s1>;
        nvidia,audio-codec = <&rt5677>;

        nvidia,hp-det-gpios = <&gpio 143 0>;

        clocks = <&clk 216>,
                 <&clk 217>,
                 <&clk 121>;
        clock-names = "pll_a", "pll_a_out0", "mclk";
    };
```

## Documentation/devicetree/bindings/sound/nvidia,tegra-audio-sgtl5000.txt
```
NVIDIA Tegra audio complex, with SGTL5000 CODEC

Required properties:
- compatible : "nvidia,tegra-audio-sgtl5000"
- clocks : Must contain an entry for each entry in clock-names.
  See ../clocks/clock-bindings.txt for details.
- clock-names : Must include the following entries:
  - pll_a
  - pll_a_out0
  - mclk (The Tegra cdev1/extern1 clock, which feeds the CODEC's mclk)
- nvidia,model : The user-visible name of this sound complex.
- nvidia,audio-routing : A list of the connections between audio components.
  Each entry is a pair of strings, the first being the connection's sink,
  the second being the connection's source. Valid names for sources and
  sinks are the SGTL5000's pins (as documented in its binding), and the jacks
  on the board:

  * Headphone Jack
  * Line In Jack
  * Mic Jack

- nvidia,i2s-controller : The phandle of the Tegra I2S controller that's
  connected to the CODEC.
- nvidia,audio-codec : The phandle of the SGTL5000 audio codec.

Example:

sound {
	compatible = "toradex,tegra-audio-sgtl5000-apalis_t30",
		     "nvidia,tegra-audio-sgtl5000";
	nvidia,model = "Toradex Apalis T30";
	nvidia,audio-routing =
		"Headphone Jack", "HP_OUT",
		"LINE_IN", "Line In Jack",
		"MIC_IN", "Mic Jack";
	nvidia,i2s-controller = <&tegra_i2s2>;
	nvidia,audio-codec = <&sgtl5000>;
	clocks = <&tegra_car TEGRA30_CLK_PLL_A>,
		 <&tegra_car TEGRA30_CLK_PLL_A_OUT0>,
		 <&tegra_car TEGRA30_CLK_EXTERN1>;
	clock-names = "pll_a", "pll_a_out0", "mclk";
};
```
