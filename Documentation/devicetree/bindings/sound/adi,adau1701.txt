## Documentation/devicetree/bindings/sound/adi,adau1701.txt
```
Analog Devices ADAU1701

Required properties:

 - compatible:		Should contain "adi,adau1701"
 - reg:			The i2c address. Value depends on the state of ADDR0
			and ADDR1, as wired in hardware.

Optional properties:

 - reset-gpio: 		A GPIO spec to define which pin is connected to the
			chip's !RESET pin. If specified, the driver will
			assert a hardware reset at probe time.
 - adi,pll-mode-gpios:	An array of two GPIO specs to describe the GPIOs
			the ADAU's PLL config pins are connected to.
			The state of the pins are set according to the
			configured clock divider on ASoC side before the
			firmware is loaded.
 - adi,pin-config:	An array of 12 numerical values selecting one of the
			pin configurations as described in the datasheet,
			table 53. Note that the value of this property has
			to be prefixed with '/bits/ 8'.
 - avdd-supply: 	Power supply for AVDD, providing 3.3V
 - dvdd-supply: 	Power supply for DVDD, providing 3.3V

Examples:

	i2c_bus {
		adau1701@34 {
			compatible = "adi,adau1701";
			reg = <0x34>;
			reset-gpio = <&gpio 23 0>;
			avdd-supply = <&vdd_3v3_reg>;
			dvdd-supply = <&vdd_3v3_reg>;
			adi,pll-mode-gpios = <&gpio 24 0 &gpio 25 0>;
			adi,pin-config = /bits/ 8 <0x4 0x7 0x5 0x5 0x4 0x4
                                                   0x4 0x4 0x4 0x4 0x4 0x4>;
		};
	};
```

## Documentation/devicetree/bindings/sound/adi,adau17x1.txt
```
Analog Devices ADAU1361/ADAU1461/ADAU1761/ADAU1961/ADAU1381/ADAU1781

Required properties:

 - compatible:		Should contain one of the following:
			"adi,adau1361"
			"adi,adau1461"
			"adi,adau1761"
			"adi,adau1961"
			"adi,adau1381"
			"adi,adau1781"

 - reg:			The i2c address. Value depends on the state of ADDR0
			and ADDR1, as wired in hardware.

Examples:
#include <dt-bindings/sound/adau17x1.h>

	i2c_bus {
		adau1361@38 {
			compatible = "adi,adau1761";
			reg = <0x38>;
		};
	};
```

## Documentation/devicetree/bindings/sound/adi,adau17x1.yaml
```yaml
# SPDX-License-Identifier: (GPL-2.0-only OR BSD-2-Clause)
%YAML 1.2
---
$id: http://devicetree.org/schemas/sound/adi,adau17x1.yaml#
$schema: http://devicetree.org/meta-schemas/core.yaml#

title: Analog Devices ADAU1361/ADAU1461/ADAU1761/ADAU1961/ADAU1381/ADAU1781 Codec

maintainers:
  - Lars-Peter Clausen <lars@metafoo.de>

properties:
  compatible:
    enum:
      - adi,adau1361
      - adi,adau1381
      - adi,adau1461
      - adi,adau1761
      - adi,adau1781
      - adi,adau1961

  reg:
    maxItems: 1
    description:
      The i2c address. Value depends on the state of ADDR0 and ADDR1,
      as wired in hardware.

  clock-names:
    const: mclk

  clocks:
    items:
      - description: provides the audio master clock for the device.

required:
  - compatible
  - reg

additionalProperties: false

examples:
  - |
    i2c {
      #address-cells = <1>;
      #size-cells = <0>;
      audio-codec@38 {
        compatible = "adi,adau1761";
        reg = <0x38>;
        clock-names = "mclk";
        clocks = <&audio_clock>;
      };
    };
```

## Documentation/devicetree/bindings/sound/adi,adau1977.txt
```
Analog Devices ADAU1977/ADAU1978/ADAU1979

Datasheets:
https://www.analog.com/media/en/technical-documentation/data-sheets/ADAU1977.pdf
https://www.analog.com/media/en/technical-documentation/data-sheets/ADAU1978.pdf
https://www.analog.com/media/en/technical-documentation/data-sheets/ADAU1979.pdf

This driver supports both the I2C and SPI bus.

Required properties:
 - compatible: Should contain one of the following:
               "adi,adau1977"
               "adi,adau1978"
               "adi,adau1979"

 - AVDD-supply: analog power supply for the device, please consult
                Documentation/devicetree/bindings/regulator/regulator.txt

Optional properties:
 - reset-gpios: the reset pin for the chip, for more details consult
                Documentation/devicetree/bindings/gpio/gpio.txt

 - DVDD-supply: supply voltage for the digital core, please consult
                Documentation/devicetree/bindings/regulator/regulator.txt

- adi,micbias: configures the voltage setting for the MICBIAS pin.
		Select 0/1/2/3/4/5/6/7/8 to specify MICBIAS voltage
		5V/5.5V/6V/6.5V/7V/7.5V/8V/8.5V/9V
		If not specified the default value will be "7" meaning 8.5 Volts.
		This property is only valid for the ADAU1977

For required properties on SPI, please consult
Documentation/devicetree/bindings/spi/spi-bus.txt

Required properties on I2C:

 - reg:         The i2c address. Value depends on the state of ADDR0
                and ADDR1, as wired in hardware.

Examples:

	adau1977_spi: adau1977@0 {
		compatible = "adi,adau1977";
		spi-max-frequency = <600000>;

		AVDD-supply = <&regulator>;
		DVDD-supply = <&regulator_digital>;

		adi,micbias = <3>;
		reset-gpios = <&gpio 10 GPIO_ACTIVE_LOW>;
	};

	adau1977_i2c: adau1977@11 {
		compatible = "adi,adau1977";
		reg = <0x11>;

		AVDD-supply = <&regulator>;
		DVDD-supply = <&regulator_digital>;

		reset-gpios = <&gpio 10 GPIO_ACTIVE_LOW>;
	};
```

## Documentation/devicetree/bindings/sound/adi,adau1977.yaml
```yaml
# SPDX-License-Identifier: (GPL-2.0-only OR BSD-2-Clause)
%YAML 1.2
---
$id: http://devicetree.org/schemas/sound/adi,adau1977.yaml#
$schema: http://devicetree.org/meta-schemas/core.yaml#

title: Analog Devices ADAU1977/ADAU1978/ADAU1979 Quad ADC with Diagnostics

maintainers:
  - Lars-Peter Clausen <lars@metafoo.de>
  - Bogdan Togorean <bogdan.togorean@analog.com>

description: |
  Analog Devices ADAU1977 and similar quad ADC with Diagnostics
  https://www.analog.com/media/en/technical-documentation/data-sheets/ADAU1977.pdf
  https://www.analog.com/media/en/technical-documentation/data-sheets/ADAU1978.pdf
  https://www.analog.com/media/en/technical-documentation/data-sheets/ADAU1979.pdf

properties:
  compatible:
    enum:
      - adi,adau1977
      - adi,adau1978
      - adi,adau1979

  reg:
    maxItems: 1

  "#sound-dai-cells":
    const: 0

  reset-gpios:
    maxItems: 1

  spi-max-frequency: true

  AVDD-supply:
    description: Analog power support for the device.

  DVDD-supply:
    description: Supply voltage for digital core.

  adi,micbias:
    description: |
      Configures the voltage setting for the MICBIAS pin.
    $ref: /schemas/types.yaml#/definitions/uint32
    enum: [0, 1, 2, 3, 4, 5, 6, 7, 8]
    default: 7

required:
  - reg
  - compatible
  - AVDD-supply

additionalProperties: false

examples:
  - |
    #include <dt-bindings/gpio/gpio.h>

    spi {
        #address-cells = <1>;
        #size-cells = <0>;
        adau1977_spi: adau1977@0 {
            compatible = "adi,adau1977";
            reg = <0>;
            spi-max-frequency = <600000>;

            AVDD-supply = <&regulator>;
            DVDD-supply = <&regulator_digital>;

            reset-gpios = <&gpio 10 GPIO_ACTIVE_LOW>;

            adi,micbias = <3>;
        };
    };
  - |
    #include <dt-bindings/gpio/gpio.h>

    i2c {
        #address-cells = <1>;
        #size-cells = <0>;
        adau1977_i2c: adau1977@11 {
            compatible = "adi,adau1977";
            reg = <0x11>;

            AVDD-supply = <&regulator>;
            DVDD-supply = <&regulator_digital>;

            reset-gpios = <&gpio 10 GPIO_ACTIVE_LOW>;
        };
    };
```

## Documentation/devicetree/bindings/sound/adi,adau7002.txt
```
Analog Devices ADAU7002 Stereo PDM-to-I2S/TDM Converter

Required properties:

 - compatible: Must be "adi,adau7002"

Optional properties:

 - IOVDD-supply: Phandle and specifier for the power supply providing the IOVDD
	supply as covered in Documentation/devicetree/bindings/regulator/regulator.txt

	If this property is not present it is assumed that the supply pin is
	hardwired to always on.

Example:
	adau7002: pdm-to-i2s {
		compatible = "adi,adau7002";
		IOVDD-supply = <&supply>;
	};
```

## Documentation/devicetree/bindings/sound/adi,adau7002.yaml
```yaml
# SPDX-License-Identifier: GPL-2.0-only OR BSD-2-Clause
%YAML 1.2
---
$id: http://devicetree.org/schemas/sound/adi,adau7002.yaml#
$schema: http://devicetree.org/meta-schemas/core.yaml#

title: Analog Devices ADAU7002 Stereo PDM-to-I2S/TDM Converter

maintainers:
  - Krzysztof Kozlowski <krzysztof.kozlowski@linaro.org>

allOf:
  - $ref: dai-common.yaml#

properties:
  compatible:
    const: adi,adau7002

  IOVDD-supply:
    description:
      IOVDD power supply, if skipped then it is assumed that the supply pin is
      hardwired to always on.

  wakeup-delay-ms:
    description:
      Delay after power up needed for device to settle.

required:
  - compatible

unevaluatedProperties: false

examples:
  - |
    audio-codec {
        compatible = "adi,adau7002";
        IOVDD-supply = <&pp1800_l15a>;
        #sound-dai-cells = <0>;
        wakeup-delay-ms = <80>;
    };
```

## Documentation/devicetree/bindings/sound/adi,adau7118.yaml
```yaml
# SPDX-License-Identifier: (GPL-2.0-only OR BSD-2-Clause)
%YAML 1.2
---
$id: http://devicetree.org/schemas/sound/adi,adau7118.yaml#
$schema: http://devicetree.org/meta-schemas/core.yaml#


title: Analog Devices ADAU7118 8 Channel PDM to I2S/TDM Converter

maintainers:
  - Nuno Sá <nuno.sa@analog.com>

description: |
  Analog Devices ADAU7118 8 Channel PDM to I2S/TDM Converter over I2C or HW
  standalone mode.
  https://www.analog.com/media/en/technical-documentation/data-sheets/ADAU7118.pdf

properties:
  compatible:
    enum:
      - adi,adau7118

  reg:
    maxItems: 1

  "#sound-dai-cells":
    const: 0

  iovdd-supply:
    description: Digital Input/Output Power Supply.

  dvdd-supply:
    description: Internal Core Digital Power Supply.

  adi,decimation-ratio:
    description: |
      This property set's the decimation ratio of PDM to PCM audio data.
    $ref: /schemas/types.yaml#/definitions/uint32
    enum: [64, 32, 16]
    default: 64

  adi,pdm-clk-map:
    description: |
      The ADAU7118 has two PDM clocks for the four Inputs. Each input must be
      assigned to one of these two clocks. This property set's the mapping
      between the clocks and the inputs.
    $ref: /schemas/types.yaml#/definitions/uint32-array
    minItems: 4
    maxItems: 4
    items:
      maximum: 1
    default: [0, 0, 1, 1]

required:
  - "#sound-dai-cells"
  - compatible
  - iovdd-supply
  - dvdd-supply

additionalProperties: false

examples:
  - |
    i2c {
        /* example with i2c support */
        #address-cells = <1>;
        #size-cells = <0>;
        adau7118_codec: audio-codec@14 {
                compatible = "adi,adau7118";
                reg = <0x14>;
                #sound-dai-cells = <0>;
                iovdd-supply = <&supply>;
                dvdd-supply = <&supply>;
                adi,pdm-clk-map = <1 1 0 0>;
                adi,decimation-ratio = <16>;
        };
    };

    /* example with hw standalone mode */
    adau7118_codec_hw: adau7118-codec-hw {
            compatible = "adi,adau7118";
            #sound-dai-cells = <0>;
            iovdd-supply = <&supply>;
            dvdd-supply = <&supply>;
    };
```

## Documentation/devicetree/bindings/sound/adi,axi-i2s.txt
```
ADI AXI-I2S controller

Required properties:
 - compatible : Must be "adi,axi-i2s-1.00.a"
 - reg : Must contain I2S core's registers location and length
 - clocks : Pairs of phandle and specifier referencing the controller's clocks.
   The controller expects two clocks, the clock used for the AXI interface and
   the clock used as the sampling rate reference clock sample.
 - clock-names : "axi" for the clock to the AXI interface, "ref" for the sample
   rate reference clock.
 - dmas: Pairs of phandle and specifier for the DMA channels that are used by
   the core. The core expects two dma channels, one for transmit and one for
   receive.
 - dma-names : "tx" for the transmit channel, "rx" for the receive channel.

For more details on the 'dma', 'dma-names', 'clock' and 'clock-names' properties
please check:
	* resource-names.txt
	* clock/clock-bindings.txt
	* dma/dma.txt

Example:

	i2s: i2s@77600000 {
		compatible = "adi,axi-i2s-1.00.a";
		reg = <0x77600000 0x1000>;
		clocks = <&clk 15>, <&audio_clock>;
		clock-names = "axi", "ref";
		dmas = <&ps7_dma 0>, <&ps7_dma 1>;
		dma-names = "tx", "rx";
	};
```

## Documentation/devicetree/bindings/sound/adi,axi-spdif-tx.txt
```
ADI AXI-SPDIF controller

Required properties:
 - compatible : Must be "adi,axi-spdif-tx-1.00.a"
 - reg : Must contain SPDIF core's registers location and length
 - clocks : Pairs of phandle and specifier referencing the controller's clocks.
   The controller expects two clocks, the clock used for the AXI interface and
   the clock used as the sampling rate reference clock sample.
 - clock-names: "axi" for the clock to the AXI interface, "ref" for the sample
   rate reference clock.
 - dmas: Pairs of phandle and specifier for the DMA channel that is used by
   the core. The core expects one dma channel for transmit.
 - dma-names : Must be "tx"

For more details on the 'dma', 'dma-names', 'clock' and 'clock-names' properties
please check:
	* resource-names.txt
	* clock/clock-bindings.txt
	* dma/dma.txt

Example:

	spdif: spdif@77400000 {
		compatible = "adi,axi-spdif-tx-1.00.a";
		reg = <0x77600000 0x1000>;
		clocks = <&clk 15>, <&audio_clock>;
		clock-names = "axi", "ref";
		dmas = <&ps7_dma 0>;
		dma-names = "tx";
	};
```

## Documentation/devicetree/bindings/sound/adi,max98363.yaml
```yaml
# SPDX-License-Identifier: (GPL-2.0-only OR BSD-2-Clause)
%YAML 1.2
---
$id: http://devicetree.org/schemas/sound/adi,max98363.yaml#
$schema: http://devicetree.org/meta-schemas/core.yaml#

title: Analog Devices MAX98363 SoundWire Amplifier

maintainers:
  - Ryan Lee <ryans.lee@analog.com>

description:
  The MAX98363 is a SoundWire input Class D mono amplifier that
  supports MIPI SoundWire v1.2-compatible digital interface for
  audio and control data.
  SoundWire peripheral device ID of MAX98363 is 0x3*019f836300
  where * is the peripheral device unique ID decoded from pin.
  It supports up to 10 peripheral devices(0x0 to 0x9).

allOf:
  - $ref: dai-common.yaml#

properties:
  compatible:
    const: sdw3019f836300

  reg:
    maxItems: 1

  '#sound-dai-cells':
    const: 0

required:
  - compatible
  - reg
  - "#sound-dai-cells"

unevaluatedProperties: false

examples:
  - |
    soundwire-controller@3250000 {
        #address-cells = <2>;
        #size-cells = <0>;
        reg = <0x3250000 0x2000>;

        speaker@0,0 {
            compatible = "sdw3019f836300";
            reg = <0 0>;
            #sound-dai-cells = <0>;
            sound-name-prefix = "Speaker Left";
        };

        speaker@0,1 {
            compatible = "sdw3019f836300";
            reg = <0 1>;
            #sound-dai-cells = <0>;
            sound-name-prefix = "Speaker Right";
        };
    };
```
