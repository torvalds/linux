## Documentation/devicetree/bindings/sound/adi,max98388.yaml
```yaml
# SPDX-License-Identifier: (GPL-2.0-only OR BSD-2-Clause)
%YAML 1.2
---
$id: http://devicetree.org/schemas/sound/adi,max98388.yaml#
$schema: http://devicetree.org/meta-schemas/core.yaml#

title: Analog Devices MAX98388 Speaker Amplifier

maintainers:
  - Ryan Lee <ryans.lee@analog.com>

description:
  The MAX98388 is a mono Class-D speaker amplifier with I/V feedback.
  The device provides a PCM interface for audio data and a standard
  I2C interface for control data communication.

allOf:
  - $ref: dai-common.yaml#

properties:
  compatible:
    enum:
      - adi,max98388

  reg:
    maxItems: 1

  '#sound-dai-cells':
    const: 0

  adi,vmon-slot-no:
    description: slot number of the voltage feedback monitor
    $ref: /schemas/types.yaml#/definitions/uint32
    minimum: 0
    maximum: 15
    default: 0

  adi,imon-slot-no:
    description: slot number of the current feedback monitor
    $ref: /schemas/types.yaml#/definitions/uint32
    minimum: 0
    maximum: 15
    default: 1

  adi,interleave-mode:
    description:
      For cases where a single combined channel for the I/V feedback data
      is not sufficient, the device can also be configured to share
      a single data output channel on alternating frames.
      In this configuration, the current and voltage data will be frame
      interleaved on a single output channel.
    type: boolean

  reset-gpios:
    maxItems: 1

required:
  - compatible
  - reg
  - '#sound-dai-cells'

unevaluatedProperties: false

examples:
  - |
    #include <dt-bindings/gpio/gpio.h>
    i2c {
        #address-cells = <1>;
        #size-cells = <0>;
        max98388: amplifier@39 {
            compatible = "adi,max98388";
            reg = <0x39>;
            #sound-dai-cells = <0>;
            adi,vmon-slot-no = <0>;
            adi,imon-slot-no = <1>;
            adi,interleave-mode;
            reset-gpios = <&gpio 4 GPIO_ACTIVE_LOW>;
        };
    };
```

## Documentation/devicetree/bindings/sound/adi,max98396.yaml
```yaml
# SPDX-License-Identifier: (GPL-2.0-only OR BSD-2-Clause)
%YAML 1.2
---
$id: http://devicetree.org/schemas/sound/adi,max98396.yaml#
$schema: http://devicetree.org/meta-schemas/core.yaml#

title: Analog Devices MAX98396 Speaker Amplifier

maintainers:
  - Ryan Lee <ryans.lee@analog.com>

description:
  The MAX98396 is a mono Class-DG speaker amplifier with I/V sense.
  The device provides a PCM interface for audio data and a standard
  I2C interface for control data communication.
  The MAX98397 is a variant of MAX98396 with wide input supply range.

properties:
  compatible:
    enum:
      - adi,max98396
      - adi,max98397
  reg:
    maxItems: 1
    description: I2C address of the device.

  avdd-supply:
    description: A 1.8V supply that powers up the AVDD pin.

  dvdd-supply:
    description: A 1.2V supply that powers up the DVDD pin.

  dvddio-supply:
    description: A 1.2V or 1.8V supply that powers up the VDDIO pin.

  pvdd-supply:
    description: A 3.0V to 20V supply that powers up the PVDD pin.

  vbat-supply:
    description: A 3.3V to 5.5V supply that powers up the VBAT pin.

  adi,vmon-slot-no:
    description: slot number of the voltage sense monitor
    $ref: /schemas/types.yaml#/definitions/uint32
    minimum: 0
    maximum: 15
    default: 0

  adi,imon-slot-no:
    description: slot number of the current sense monitor
    $ref: /schemas/types.yaml#/definitions/uint32
    minimum: 0
    maximum: 15
    default: 1

  adi,spkfb-slot-no:
    description: slot number of speaker DSP monitor
    $ref: /schemas/types.yaml#/definitions/uint32
    minimum: 0
    maximum: 15
    default: 2

  adi,bypass-slot-no:
    description:
      Selects the PCM data input channel that is routed to the speaker
      audio processing bypass path.
    $ref: /schemas/types.yaml#/definitions/uint32
    minimum: 0
    maximum: 15
    default: 0

  adi,interleave-mode:
    description:
      For cases where a single combined channel for the I/V sense data
      is not sufficient, the device can also be configured to share
      a single data output channel on alternating frames.
      In this configuration, the current and voltage data will be frame
      interleaved on a single output channel.
    type: boolean

  adi,dmon-stuck-enable:
    description:
      Enables the "data monitor stuck" feature. Once the data monitor is
      enabled, it actively monitors the selected input data (from DIN) to the
      speaker amplifier. Once a data error is detected, the data monitor
      automatically places the device into software shutdown.
    type: boolean

  adi,dmon-stuck-threshold-bits:
    description:
      Sets the threshold for the "data monitor stuck" feature, in bits.
    enum: [9, 11, 13, 15]
    default: 15

  adi,dmon-magnitude-enable:
    description:
      Enables the "data monitor magnitude" feature. Once the data monitor is
      enabled, it actively monitors the selected input data (from DIN) to the
      speaker amplifier. Once a data error is detected, the data monitor
      automatically places the device into software shutdown.
    type: boolean

  adi,dmon-magnitude-threshold-bits:
    description:
      Sets the threshold for the "data monitor magnitude" feature, in bits.
    enum: [2, 3, 4, 5]
    default: 5

  adi,dmon-duration-ms:
    description:
      Sets the duration for the "data monitor" feature, in milliseconds.
    enum: [64, 256, 1024, 4096]
    default: 64

  reset-gpios:
    maxItems: 1

required:
  - compatible
  - reg

additionalProperties: false

examples:
  - |
    #include <dt-bindings/gpio/gpio.h>
    i2c {
        #address-cells = <1>;
        #size-cells = <0>;
        max98396: amplifier@39 {
            compatible = "adi,max98396";
            reg = <0x39>;
            dvdd-supply = <&regulator_1v2>;
            dvddio-supply = <&regulator_1v8>;
            avdd-supply = <&regulator_1v8>;
            pvdd-supply = <&regulator_pvdd>;
            adi,vmon-slot-no = <0>;
            adi,imon-slot-no = <1>;
            reset-gpios = <&gpio 4 GPIO_ACTIVE_LOW>;
        };
    };
```

## Documentation/devicetree/bindings/sound/adi,ssm2305.txt
```
Analog Devices SSM2305 Speaker Amplifier
========================================

Required properties:
  - compatible : "adi,ssm2305"
  - shutdown-gpios : The gpio connected to the shutdown pin.
                     The gpio signal is ACTIVE_LOW.

Example:

ssm2305: analog-amplifier {
	compatible = "adi,ssm2305";
	shutdown-gpios = <&gpio3 20 GPIO_ACTIVE_LOW>;
};
```

## Documentation/devicetree/bindings/sound/adi,ssm2305.yaml
```yaml
# SPDX-License-Identifier: (GPL-2.0-only OR BSD-2-Clause)
%YAML 1.2
---
$id: http://devicetree.org/schemas/sound/adi,ssm2305.yaml#
$schema: http://devicetree.org/meta-schemas/core.yaml#

title: Analog Devices SSM2305 Class-D Speaker Amplifier

maintainers:
  - Lars-Peter Clausen <lars@metafoo.de>

description:
  The SSM2305 is a filterless, high efficiency, mono 2.8 W Class-D
  audio amplifier with a micropower shutdown mode controlled via a
  dedicated active-low GPIO pin.

allOf:
  - $ref: dai-common.yaml#

properties:
  compatible:
    const: adi,ssm2305

  shutdown-gpios:
    maxItems: 1
    description:
      GPIO connected to the shutdown pin (SD) of the SSM2305.
      The pin is active-low; asserting it puts the device into
      micropower shutdown mode.

required:
  - compatible
  - shutdown-gpios

unevaluatedProperties: false

examples:
  - |
    #include <dt-bindings/gpio/gpio.h>

    analog-amplifier {
        compatible = "adi,ssm2305";
        shutdown-gpios = <&gpio3 20 GPIO_ACTIVE_LOW>;
    };

...
```

## Documentation/devicetree/bindings/sound/adi,ssm2518.yaml
```yaml
# SPDX-License-Identifier: GPL-2.0-only OR BSD-2-Clause
%YAML 1.2
---
$id: http://devicetree.org/schemas/sound/adi,ssm2518.yaml#
$schema: http://devicetree.org/meta-schemas/core.yaml#

title: Analog Devices SSM2518 audio amplifier

maintainers:
  - Lars-Peter Clausen <lars@metafoo.de>

allOf:
  - $ref: dai-common.yaml#

properties:
  compatible:
    const: adi,ssm2518

  reg:
    maxItems: 1
    description: |
       I2C address of the device. This will either be 0x34 (ADDR pin low)
       or 0x35 (ADDR pin high)

  gpios:
    maxItems: 1
    description: |
       GPIO connected to the nSD pin. If the property is not present
       it is assumed that the nSD pin is hardwired to always on.

required:
  - compatible
  - reg

unevaluatedProperties: false

examples:
  - |
    #include <dt-bindings/gpio/gpio.h>

    i2c {
        #address-cells = <1>;
        #size-cells = <0>;
        codec@34 {
            compatible = "adi,ssm2518";
            reg = <0x34>;
            gpios = <&gpio 5 GPIO_ACTIVE_HIGH>;
        };
    };
```

## Documentation/devicetree/bindings/sound/adi,ssm2602.txt
```
Analog Devices SSM2602, SSM2603 and SSM2604 I2S audio CODEC devices

SSM2602 support both I2C and SPI as the configuration interface,
the selection is made by the MODE strap-in pin.
SSM2603 and SSM2604 only support I2C as the configuration interface.

Required properties:

  - compatible : One of "adi,ssm2602", "adi,ssm2603" or "adi,ssm2604"

  - reg : the I2C address of the device for I2C, the chip select
          number for SPI.

 Example:

	ssm2602: ssm2602@1a {
		compatible = "adi,ssm2602";
		reg = <0x1a>;
	};
```

## Documentation/devicetree/bindings/sound/adi,ssm3515.yaml
```yaml
# SPDX-License-Identifier: (GPL-2.0-only OR BSD-2-Clause)
%YAML 1.2
---
$id: http://devicetree.org/schemas/sound/adi,ssm3515.yaml#
$schema: http://devicetree.org/meta-schemas/core.yaml#

title: Analog Devices SSM3515 Audio Amplifier

maintainers:
  - Martin Povišer <povik+lin@cutebit.org>

description: |
  SSM3515 is a mono Class-D audio amplifier with digital input.

  https://www.analog.com/media/en/technical-documentation/data-sheets/SSM3515.pdf

allOf:
  - $ref: dai-common.yaml#

properties:
  compatible:
    enum:
      - adi,ssm3515

  reg:
    maxItems: 1

  '#sound-dai-cells':
    const: 0

required:
  - compatible
  - reg

unevaluatedProperties: false

examples:
  - |
    i2c {
      #address-cells = <1>;
      #size-cells = <0>;

      codec@14 {
        compatible = "adi,ssm3515";
        reg = <0x14>;
        #sound-dai-cells = <0>;
        sound-name-prefix = "Left Tweeter";
      };
    };
```

## Documentation/devicetree/bindings/sound/ak4104.txt
```
AK4104 S/PDIF transmitter

This device supports SPI mode only.

Required properties:

  - compatible : "asahi-kasei,ak4104"

  - reg : The chip select number on the SPI bus

  - vdd-supply : A regulator node, providing 2.7V - 3.6V

Optional properties:

  - reset-gpio : a GPIO spec for the reset pin. If specified, it will be
		 deasserted before communication to the device starts.

Example:

spdif: ak4104@0 {
	compatible = "asahi-kasei,ak4104";
	reg = <0>;
	spi-max-frequency = <5000000>;
	vdd-supply = <&vdd_3v3_reg>;
};
```

## Documentation/devicetree/bindings/sound/ak4118.txt
```
AK4118 S/PDIF transceiver

This device supports I2C mode.

Required properties:

- compatible : "asahi-kasei,ak4118"
- reg : The I2C address of the device for I2C
- reset-gpios: A GPIO specifier for the reset pin
- irq-gpios: A GPIO specifier for the IRQ pin

Example:

&i2c {
	ak4118: ak4118@13 {
		#sound-dai-cells = <0>;
		compatible = "asahi-kasei,ak4118";
		reg = <0x13>;
		reset-gpios = <&gpio 0 GPIO_ACTIVE_LOW>
		irq-gpios = <&gpio 1 GPIO_ACTIVE_HIGH>;
	};
};
```

## Documentation/devicetree/bindings/sound/ak4458.txt
```
AK4458 audio DAC

This device supports I2C mode.

Required properties:

- compatible : "asahi-kasei,ak4458" or "asahi-kasei,ak4497"
- reg : The I2C address of the device for I2C

Optional properties:
- reset-gpios: A GPIO specifier for the power down & reset pin
- mute-gpios: A GPIO specifier for the soft mute pin
- AVDD-supply: Analog power supply
- DVDD-supply: Digital power supply
- dsd-path: Select DSD input pins for ak4497
            0: select #16, #17, #19 pins
            1: select #3, #4, #5 pins

Example:

&i2c {
	ak4458: dac@10 {
		compatible = "asahi-kasei,ak4458";
		reg = <0x10>;
		reset-gpios = <&gpio1 10 GPIO_ACTIVE_LOW>
		mute-gpios = <&gpio1 11 GPIO_ACTIVE_HIGH>
	};
};
```

## Documentation/devicetree/bindings/sound/ak4554.txt
```
AK4554 ADC/DAC

Required properties:

  - compatible : "asahi-kasei,ak4554"

Example:

ak4554-adc-dac {
	compatible = "asahi-kasei,ak4554";
};
```

## Documentation/devicetree/bindings/sound/ak4613.txt
```
AK4613 I2C transmitter

This device supports I2C mode only.

Required properties:

- compatible : "asahi-kasei,ak4613"
- reg : The chip select number on the I2C bus

Optional properties:
- asahi-kasei,in1-single-end	: Boolean. Indicate input / output pins are single-ended.
- asahi-kasei,in2-single-end	  rather than differential.
- asahi-kasei,out1-single-end
- asahi-kasei,out2-single-end
- asahi-kasei,out3-single-end
- asahi-kasei,out4-single-end
- asahi-kasei,out5-single-end
- asahi-kasei,out6-single-end

Example:

&i2c {
	ak4613: ak4613@0x10 {
		compatible = "asahi-kasei,ak4613";
		reg = <0x10>;
	};
};
```

## Documentation/devicetree/bindings/sound/ak4613.yaml
```yaml
# SPDX-License-Identifier: GPL-2.0
%YAML 1.2
---
$id: http://devicetree.org/schemas/sound/ak4613.yaml#
$schema: http://devicetree.org/meta-schemas/core.yaml#

title: AK4613 I2C transmitter Device Tree Bindings

maintainers:
  - Kuninori Morimoto <kuninori.morimoto.gx@renesas.com>

properties:
  compatible:
    const: asahi-kasei,ak4613

  reg:
    maxItems: 1

  clocks:
    maxItems: 1

  "#sound-dai-cells":
    const: 0

  # for OF-graph
  port:
    $ref: "audio-graph-card.yaml#definitions/port"
  ports:
    $ref: "audio-graph-card.yaml#definitions/ports"

# use patternProperties to avoid naming "xxx,yyy" issue
patternProperties:
  "^asahi-kasei,in1-single-end$":
    $ref: /schemas/types.yaml#/definitions/flag
  "^asahi-kasei,in2-single-end$":
    $ref: /schemas/types.yaml#/definitions/flag
  "^asahi-kasei,out1-single-end$":
    $ref: /schemas/types.yaml#/definitions/flag
  "^asahi-kasei,out2-single-end$":
    $ref: /schemas/types.yaml#/definitions/flag
  "^asahi-kasei,out3-single-end$":
    $ref: /schemas/types.yaml#/definitions/flag
  "^asahi-kasei,out4-single-end$":
    $ref: /schemas/types.yaml#/definitions/flag
  "^asahi-kasei,out5-single-end$":
    $ref: /schemas/types.yaml#/definitions/flag
  "^asahi-kasei,out6-single-end$":
    $ref: /schemas/types.yaml#/definitions/flag

required:
  - compatible
  - reg

additionalProperties: false

examples:
  - |
    i2c {
        #address-cells = <1>;
        #size-cells = <0>;
        ak4613: codec@10 {
            compatible = "asahi-kasei,ak4613";
            reg = <0x10>;
        };
    };
```

## Documentation/devicetree/bindings/sound/ak4642.txt
```
AK4642 I2C transmitter

This device supports I2C mode only.

Required properties:

  - compatible : "asahi-kasei,ak4642" or "asahi-kasei,ak4643" or "asahi-kasei,ak4648"
  - reg : The chip select number on the I2C bus

Optional properties:

  - #clock-cells :		common clock binding; shall be set to 0
  - clocks :			common clock binding; MCKI clock
  - clock-frequency :		common clock binding; frequency of MCKO
  - clock-output-names :	common clock binding; MCKO clock name

Example 1:

&i2c {
	ak4648: ak4648@12 {
		compatible = "asahi-kasei,ak4642";
		reg = <0x12>;
	};
};

Example 2:

&i2c {
	ak4643: codec@12 {
		compatible = "asahi-kasei,ak4643";
		reg = <0x12>;
		#clock-cells = <0>;
		clocks = <&audio_clock>;
		clock-frequency = <12288000>;
		clock-output-names = "ak4643_mcko";
	};
};
```
