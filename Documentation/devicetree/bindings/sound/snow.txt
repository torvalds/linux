## Documentation/devicetree/bindings/sound/st,stm32-adfsdm.txt
```
STMicroelectronics Audio Digital Filter Sigma Delta modulators(DFSDM)

The DFSDM allows PDM microphones capture through SPI interface. The Audio
interface is seems as a sub block of the DFSDM device.
For details on DFSDM bindings refer to ../iio/adc/st,stm32-dfsdm-adc.txt

Required properties:
  - compatible: "st,stm32h7-dfsdm-dai".

  - #sound-dai-cells : Must be equal to 0

  - io-channels : phandle to iio dfsdm instance node.

Example of a sound card using audio DFSDM node.

	sound_card {
		compatible = "audio-graph-card";

		dais = <&cpu_port>;
	};

	dfsdm: dfsdm@40017000 {
		compatible = "st,stm32h7-dfsdm";
		reg = <0x40017000 0x400>;
		clocks = <&rcc DFSDM1_CK>;
		clock-names = "dfsdm";
		#interrupt-cells = <1>;
		#address-cells = <1>;
		#size-cells = <0>;

		dfsdm_adc0: filter@0 {
			compatible = "st,stm32-dfsdm-dmic";
			reg = <0>;
			interrupts = <110>;
			dmas = <&dmamux1 101 0x400 0x00>;
			dma-names = "rx";
			st,adc-channels = <1>;
			st,adc-channel-names = "dmic0";
			st,adc-channel-types = "SPI_R";
			st,adc-channel-clk-src = "CLKOUT";
			st,filter-order = <5>;

			dfsdm_dai0: dfsdm-dai {
				compatible = "st,stm32h7-dfsdm-dai";
				#sound-dai-cells = <0>;
				io-channels = <&dfsdm_adc0 0>;
				cpu_port: port {
				dfsdm_endpoint: endpoint {
					remote-endpoint = <&dmic0_endpoint>;
				};
			};
		};
	};

	dmic0: dmic@0 {
		compatible = "dmic-codec";
		#sound-dai-cells = <0>;
		port {
			dmic0_endpoint: endpoint {
				remote-endpoint = <&dfsdm_endpoint>;
			};
		};
	};
```

## Documentation/devicetree/bindings/sound/st,stm32-i2s.txt
```
STMicroelectronics STM32 SPI/I2S Controller

The SPI/I2S block supports I2S/PCM protocols when configured on I2S mode.
Only some SPI instances support I2S.

Required properties:
  - compatible: Must be "st,stm32h7-i2s"
  - reg: Offset and length of the device's register set.
  - interrupts: Must contain the interrupt line id.
  - clocks: Must contain phandle and clock specifier pairs for each entry
	in clock-names.
  - clock-names: Must contain "i2sclk", "pclk", "x8k" and "x11k".
	"i2sclk": clock which feeds the internal clock generator
	"pclk": clock which feeds the peripheral bus interface
	"x8k": I2S parent clock for sampling rates multiple of 8kHz.
	"x11k": I2S parent clock for sampling rates multiple of 11.025kHz.
  - dmas: DMA specifiers for tx and rx dma.
    See Documentation/devicetree/bindings/dma/stm32-dma.txt.
  - dma-names: Identifier for each DMA request line. Must be "tx" and "rx".
  - pinctrl-names: should contain only value "default"
  - pinctrl-0: see Documentation/devicetree/bindings/pinctrl/st,stm32-pinctrl.yaml

Optional properties:
  - resets: Reference to a reset controller asserting the reset controller

The device node should contain one 'port' child node with one child 'endpoint'
node, according to the bindings defined in Documentation/devicetree/bindings/
graph.txt.

Example:
sound_card {
	compatible = "audio-graph-card";
	dais = <&i2s2_port>;
};

i2s2: audio-controller@40003800 {
	compatible = "st,stm32h7-i2s";
	reg = <0x40003800 0x400>;
	interrupts = <36>;
	clocks = <&rcc PCLK1>, <&rcc SPI2_CK>, <&rcc PLL1_Q>, <&rcc PLL2_P>;
	clock-names = "pclk", "i2sclk",  "x8k", "x11k";
	dmas = <&dmamux2 2 39 0x400 0x1>,
           <&dmamux2 3 40 0x400 0x1>;
	dma-names = "rx", "tx";
	pinctrl-names = "default";
	pinctrl-0 = <&pinctrl_i2s2>;

	i2s2_port: port@0 {
		cpu_endpoint: endpoint {
			remote-endpoint = <&codec_endpoint>;
			format = "i2s";
		};
	};
};

audio-codec {
	codec_port: port@0 {
		codec_endpoint: endpoint {
			remote-endpoint = <&cpu_endpoint>;
		};
	};
};
```

## Documentation/devicetree/bindings/sound/st,stm32-i2s.yaml
```yaml
# SPDX-License-Identifier: (GPL-2.0-only OR BSD-2-Clause)
%YAML 1.2
---
$id: http://devicetree.org/schemas/sound/st,stm32-i2s.yaml#
$schema: http://devicetree.org/meta-schemas/core.yaml#

title: STMicroelectronics STM32 SPI/I2S Controller

maintainers:
  - Olivier Moysan <olivier.moysan@foss.st.com>

description:
  The SPI/I2S block supports I2S/PCM protocols when configured on I2S mode.
  Only some SPI instances support I2S.

properties:
  compatible:
    enum:
      - st,stm32h7-i2s
      - st,stm32mp25-i2s

  "#sound-dai-cells":
    const: 0

  reg:
    maxItems: 1

  clocks:
    items:
      - description: clock feeding the peripheral bus interface.
      - description: clock feeding the internal clock generator.
      - description: I2S parent clock for sampling rates multiple of 8kHz.
      - description: I2S parent clock for sampling rates multiple of 11.025kHz.
    minItems: 2

  clock-names:
    items:
      - const: pclk
      - const: i2sclk
      - const: x8k
      - const: x11k
    minItems: 2

  interrupts:
    maxItems: 1

  dmas:
    items:
      - description: audio capture DMA.
      - description: audio playback DMA.

  dma-names:
    items:
      - const: rx
      - const: tx

  resets:
    maxItems: 1

  "#clock-cells":
    description: Configure the I2S device as MCLK clock provider.
    const: 0

  port:
    $ref: audio-graph-port.yaml#
    unevaluatedProperties: false

  access-controllers:
    minItems: 1
    maxItems: 2

required:
  - compatible
  - "#sound-dai-cells"
  - reg
  - clocks
  - clock-names
  - interrupts
  - dmas
  - dma-names

allOf:
  - $ref: dai-common.yaml#
  - if:
      properties:
        compatible:
          contains:
            const: st,stm32h7-i2s

    then:
      properties:
        clocks:
          minItems: 4

        clock-names:
          minItems: 4

  - if:
      properties:
        compatible:
          contains:
            const: st,stm32mp25-i2s

    then:
      properties:
        clocks:
          maxItems: 2

        clock-names:
          maxItems: 2

unevaluatedProperties: false

examples:
  - |
    #include <dt-bindings/interrupt-controller/arm-gic.h>
    #include <dt-bindings/clock/stm32mp1-clks.h>
    i2s2: audio-controller@4000b000 {
        compatible = "st,stm32h7-i2s";
        #sound-dai-cells = <0>;
        reg = <0x4000b000 0x400>;
        clocks = <&rcc SPI2>, <&rcc SPI2_K>, <&rcc PLL3_Q>, <&rcc PLL3_R>;
        clock-names = "pclk", "i2sclk", "x8k", "x11k";
        interrupts = <GIC_SPI 35 IRQ_TYPE_LEVEL_HIGH>;
        dmas = <&dmamux1 39 0x400 0x01>,
               <&dmamux1 40 0x400 0x01>;
        dma-names = "rx", "tx";
        pinctrl-names = "default";
        pinctrl-0 = <&i2s2_pins_a>;

        /* assume audio-graph */
        port {
            codec_endpoint: endpoint {
                remote-endpoint = <&codec_endpoint>;
            };
        };
    };

...
```
