## Documentation/devicetree/bindings/sound/snow.txt
```
Audio Binding for Snow boards

Required properties:
- compatible : Can be one of the following,
			"google,snow-audio-max98090" or
			"google,snow-audio-max98091" or
			"google,snow-audio-max98095"
- samsung,i2s-controller (deprecated): The phandle of the Samsung I2S controller
- samsung,audio-codec (deprecated): The phandle of the audio codec

Required sub-nodes:

 - 'cpu' subnode with a 'sound-dai' property containing the phandle of the I2S
    controller
 - 'codec' subnode with a 'sound-dai' property containing list of phandles
    to the CODEC nodes, first entry must be the phandle of the MAX98090,
    MAX98091 or MAX98095 CODEC (exact device type is indicated by the compatible
    string) and the second entry must be the phandle of the HDMI IP block node

Optional:
- samsung,model: The name of the sound-card

Example:

sound {
		compatible = "google,snow-audio-max98095";

		samsung,model = "Snow-I2S-MAX98095";
		samsung,i2s-controller = <&i2s0>;
		samsung,audio-codec = <&max98095>;
};
```

## Documentation/devicetree/bindings/sound/snps,designware-i2s.yaml
```yaml
# SPDX-License-Identifier: (GPL-2.0 OR BSD-2-Clause)
%YAML 1.2
---
$id: http://devicetree.org/schemas/sound/snps,designware-i2s.yaml#
$schema: http://devicetree.org/meta-schemas/core.yaml#

title: DesignWare I2S controller

maintainers:
  - Jose Abreu <joabreu@synopsys.com>

properties:
  compatible:
    oneOf:
      - items:
          - const: canaan,k210-i2s
          - const: snps,designware-i2s
      - enum:
          - snps,designware-i2s

  reg:
    maxItems: 1

  interrupts:
    description: |
      The interrupt line number for the I2S controller. Add this
      parameter if the I2S controller that you are using does not
      support DMA.
    maxItems: 1

  clocks:
    description: Sampling rate reference clock
    maxItems: 1

  clock-names:
    const: i2sclk

  resets:
    maxItems: 1

  dmas:
    items:
      - description: TX DMA Channel
      - description: RX DMA Channel
    minItems: 1

  dma-names:
    items:
      - const: tx
      - const: rx
    minItems: 1

if:
  properties:
    compatible:
      contains:
        const: canaan,k210-i2s

then:
  properties:
    "#sound-dai-cells":
      const: 1

else:
  properties:
    "#sound-dai-cells":
      const: 0

required:
  - compatible
  - reg
  - clocks
  - clock-names

oneOf:
  - required:
      - dmas
      - dma-names
  - required:
      - interrupts

unevaluatedProperties: false

examples:
  - |
    soc_i2s: i2s@7ff90000 {
      compatible = "snps,designware-i2s";
      reg = <0x7ff90000 0x1000>;
      clocks = <&scpi_i2sclk 0>;
      clock-names = "i2sclk";
      #sound-dai-cells = <0>;
      dmas = <&dma0 5>;
      dma-names = "tx";
    };
```

## Documentation/devicetree/bindings/sound/soc-ac97link.txt
```
AC97 link bindings

These bindings can be included within any other device node.

Required properties:
 - pinctrl-names: Has to contain following states to setup the correct
   pinmuxing for the used gpios:
	"ac97-running": AC97-link is active
	"ac97-reset": AC97-link reset state
	"ac97-warm-reset": AC97-link warm reset state
 - ac97-gpios: List of gpio phandles with args in the order ac97-sync,
   ac97-sdata, ac97-reset


Example:

ssi {
	...

	pinctrl-names = "default", "ac97-running", "ac97-reset", "ac97-warm-reset";
	pinctrl-0 = <&ac97link_running>;
	pinctrl-1 = <&ac97link_running>;
	pinctrl-2 = <&ac97link_reset>;
	pinctrl-3 = <&ac97link_warm_reset>;
	ac97-gpios = <&gpio3 20 0 &gpio3 22 0 &gpio3 28 0>;

	...
};
```

## Documentation/devicetree/bindings/sound/soc/codecs/fsl-sgtl5000.txt
```
* Freescale SGTL5000 Stereo Codec

Required properties:
- compatible : "fsl,sgtl5000".

Example:

codec: sgtl5000@0a {
	compatible = "fsl,sgtl5000";
	reg = <0x0a>;
};
```

## Documentation/devicetree/bindings/sound/socionext,uniphier-aio.yaml
```yaml
# SPDX-License-Identifier: GPL-2.0-only OR BSD-2-Clause
%YAML 1.2
---
$id: http://devicetree.org/schemas/sound/socionext,uniphier-aio.yaml#
$schema: http://devicetree.org/meta-schemas/core.yaml#

title: UniPhier AIO audio system

maintainers:
  - <alsa-devel@alsa-project.org>

properties:
  compatible:
    enum:
      - socionext,uniphier-ld11-aio
      - socionext,uniphier-ld20-aio
      - socionext,uniphier-pxs2-aio

  reg:
    maxItems: 1

  interrupts:
    maxItems: 1

  clock-names:
    const: aio

  clocks:
    maxItems: 1

  reset-names:
    const: aio

  resets:
    maxItems: 1

  socionext,syscon:
    description: |
      Specifies a phandle to soc-glue, which is used for changing mode of S/PDIF
      signal pin to output from Hi-Z. This property is optional if you use I2S
      signal pins only.
    $ref: "/schemas/types.yaml#/definitions/phandle"

  "#sound-dai-cells":
    const: 1

patternProperties:
  "^port@[0-9]$":
    type: object
    properties:
      endpoint: true
    required:
      - endpoint

additionalProperties: false

required:
  - compatible
  - reg
  - interrupts
  - clock-names
  - clocks
  - reset-names
  - resets
  - "#sound-dai-cells"

examples:
  - |
    audio@56000000 {
        compatible = "socionext,uniphier-ld20-aio";
        reg = <0x56000000 0x80000>;
        interrupts = <0 144 4>;
        pinctrl-names = "default";
        pinctrl-0 = <&pinctrl_aout>;
        clock-names = "aio";
        clocks = <&sys_clk 40>;
        reset-names = "aio";
        resets = <&sys_rst 40>;
        #sound-dai-cells = <1>;
        socionext,syscon = <&soc_glue>;
    };
```

## Documentation/devicetree/bindings/sound/socionext,uniphier-evea.yaml
```yaml
# SPDX-License-Identifier: GPL-2.0-only OR BSD-2-Clause
%YAML 1.2
---
$id: http://devicetree.org/schemas/sound/socionext,uniphier-evea.yaml#
$schema: http://devicetree.org/meta-schemas/core.yaml#

title: UniPhier EVEA SoC-internal sound codec

maintainers:
  - <alsa-devel@alsa-project.org>

properties:
  compatible:
    const: socionext,uniphier-evea

  reg:
    maxItems: 1

  clock-names:
    items:
      - const: evea
      - const: exiv

  clocks:
    minItems: 2
    maxItems: 2

  reset-names:
    items:
      - const: evea
      - const: exiv
      - const: adamv

  resets:
    minItems: 3
    maxItems: 3

  "#sound-dai-cells":
    const: 1

patternProperties:
  "^port@[0-9]$":
    description: |
      Port number of DT node is specified by the following DAI channels.
        0: line1
        1: hp
        2: line2
    $ref: audio-graph-port.yaml#
    unevaluatedProperties: false

additionalProperties: false

required:
  - compatible
  - reg
  - clock-names
  - clocks
  - reset-names
  - resets
  - "#sound-dai-cells"

examples:
  - |
    codec@57900000 {
        compatible = "socionext,uniphier-evea";
        reg = <0x57900000 0x1000>;
        clock-names = "evea", "exiv";
        clocks = <&sys_clk 41>, <&sys_clk 42>;
        reset-names = "evea", "exiv", "adamv";
        resets = <&sys_rst 41>, <&sys_rst 42>, <&adamv_rst 0>;
        #sound-dai-cells = <1>;
    };
```

## Documentation/devicetree/bindings/sound/sophgo,cv1800b-codecs.yaml
```yaml
# SPDX-License-Identifier: (GPL-2.0-only OR BSD-2-Clause)
%YAML 1.2
---
$id: http://devicetree.org/schemas/sound/sophgo,cv1800b-codecs.yaml#
$schema: http://devicetree.org/meta-schemas/core.yaml#

title: Sophgo CV1800B Internal ADC/DAC Codec

maintainers:
  - Anton D. Stavinskii <stavinsky@gmail.com>

description:
  Internal ADC and DAC audio codecs integrated in the Sophgo CV1800B SoC.
  Codecs expose a single DAI and are intended to be connected
  to an I2S/TDM controller via an ASoC machine driver.

allOf:
  - $ref: dai-common.yaml#

properties:
  compatible:
    enum:
      - sophgo,cv1800b-sound-adc
      - sophgo,cv1800b-sound-dac

  reg:
    maxItems: 1

  "#sound-dai-cells":
    const: 0

required:
  - compatible
  - reg
  - "#sound-dai-cells"

unevaluatedProperties: false

examples:
  - |
    audio-codec@300a100 {
      compatible = "sophgo,cv1800b-sound-adc";
      reg = <0x0300a100 0x100>;
      #sound-dai-cells = <0>;
    };
...
```

## Documentation/devicetree/bindings/sound/sophgo,cv1800b-i2s.yaml
```yaml
# SPDX-License-Identifier: (GPL-2.0-only OR BSD-2-Clause)
%YAML 1.2
---
$id: http://devicetree.org/schemas/sound/sophgo,cv1800b-i2s.yaml#
$schema: http://devicetree.org/meta-schemas/core.yaml#

title: Sophgo CV1800B I2S/TDM controller

maintainers:
  - Anton D. Stavinskii <stavinsky@gmail.com>

description: I2S/TDM controller found in CV1800B / Sophgo SG2002/SG2000 SoCs.

allOf:
  - $ref: dai-common.yaml#

properties:
  compatible:
    const: sophgo,cv1800b-i2s

  reg:
    maxItems: 1

  "#sound-dai-cells":
    const: 0

  clocks:
    maxItems: 2

  clock-names:
    items:
      - const: i2s
      - const: mclk

  dmas:
    minItems: 1
    maxItems: 2

  dma-names:
    minItems: 1
    items:
      - enum: [rx, tx]
      - const: tx

required:
  - compatible
  - reg
  - clocks
  - clock-names
  - "#sound-dai-cells"

unevaluatedProperties: false

examples:
  - |
    #include <dt-bindings/clock/sophgo,cv1800.h>

    i2s@4110000 {
        compatible = "sophgo,cv1800b-i2s";
        reg = <0x04110000 0x10000>;
        clocks = <&clk CLK_APB_I2S1>,  <&clk CLK_SDMA_AUD1>;
        clock-names = "i2s", "mclk";
        dmas = <&dmamux 2 1>, <&dmamux 3 1>;
        dma-names = "rx", "tx";
        #sound-dai-cells = <0>;
    };
...
```

## Documentation/devicetree/bindings/sound/sound-card-common.yaml
```yaml
# SPDX-License-Identifier: (GPL-2.0-only OR BSD-2-Clause)
%YAML 1.2
---
$id: http://devicetree.org/schemas/sound/sound-card-common.yaml#
$schema: http://devicetree.org/meta-schemas/core.yaml#

title: Board Sound Card Common Properties

maintainers:
  - Mark Brown <broonie@kernel.org>

properties:
  audio-routing:
    $ref: /schemas/types.yaml#/definitions/non-unique-string-array
    description: |
      A list of the connections between audio components. Each entry is a
      pair of strings, the first being the connection's sink, the second
      being the connection's source.

  model:
    $ref: /schemas/types.yaml#/definitions/string
    description: User specified audio sound card name

required:
  - model

additionalProperties: true
```

## Documentation/devicetree/bindings/sound/sound-dai.yaml
```yaml
# SPDX-License-Identifier: GPL-2.0-only OR BSD-2-Clause
%YAML 1.2
---
$id: http://devicetree.org/schemas/sound/sound-dai.yaml#
$schema: http://devicetree.org/meta-schemas/core.yaml#

title: Digital Audio Interface consumer Device Tree Bindings

maintainers:
  - Rob Herring <robh@kernel.org>

select: true

properties:
  sound-dai:
    $ref: /schemas/types.yaml#/definitions/phandle-array
    description: A phandle plus args to digital audio interface provider(s)

additionalProperties: true
...
```

## Documentation/devicetree/bindings/sound/spacemit,k1-i2s.yaml
```yaml
# SPDX-License-Identifier: (GPL-2.0-only OR BSD-2-Clause)
%YAML 1.2
---
$id: http://devicetree.org/schemas/sound/spacemit,k1-i2s.yaml#
$schema: http://devicetree.org/meta-schemas/core.yaml#

title: K1 I2S controller

description:
  The I2S bus (Inter-IC sound bus) is a serial link for digital
  audio data transfer between devices in the system.

maintainers:
  - Troy Mitchell <troy.mitchell@linux.spacemit.com>

allOf:
  - $ref: dai-common.yaml#

properties:
  compatible:
    const: spacemit,k1-i2s

  reg:
    maxItems: 1

  clocks:
    items:
      - description: clock for I2S sysclk
      - description: clock for I2S bclk
      - description: clock for I2S bus
      - description: clock for I2S controller

  clock-names:
    items:
      - const: sysclk
      - const: bclk
      - const: bus
      - const: func

  dmas:
    minItems: 1
    maxItems: 2

  dma-names:
    minItems: 1
    items:
      - const: tx
      - const: rx

  resets:
    maxItems: 1

  port:
    $ref: audio-graph-port.yaml#
    unevaluatedProperties: false

  "#sound-dai-cells":
    const: 0

required:
  - compatible
  - reg
  - clocks
  - clock-names
  - dmas
  - dma-names
  - resets
  - "#sound-dai-cells"

unevaluatedProperties: false

examples:
  - |
    #include <dt-bindings/clock/spacemit,k1-syscon.h>
    i2s@d4026000 {
      compatible = "spacemit,k1-i2s";
      reg = <0xd4026000 0x30>;
      clocks = <&syscon_mpmu CLK_I2S_SYSCLK>,
               <&syscon_mpmu CLK_I2S_BCLK>,
               <&syscon_apbc CLK_SSPA0_BUS>,
               <&syscon_apbc CLK_SSPA0>;
      clock-names = "sysclk", "bclk", "bus", "func";
      dmas = <&pdma0 21>, <&pdma0 22>;
      dma-names = "tx", "rx";
      resets = <&syscon_apbc RESET_SSPA0>;
      #sound-dai-cells = <0>;
    };
```

## Documentation/devicetree/bindings/sound/spdif-receiver.txt
```
Device-Tree bindings for dummy spdif receiver

Required properties:
	- compatible: should be "linux,spdif-dir".

Example node:

	codec: spdif-receiver {
		compatible = "linux,spdif-dir";
	};
```

## Documentation/devicetree/bindings/sound/spdif-transmitter.txt
```
Device-Tree bindings for dummy spdif transmitter

Required properties:
	- compatible: should be "linux,spdif-dit".

Example yesde:

	codec: spdif-transmitter {
		compatible = "linux,spdif-dit";
	};
```

## Documentation/devicetree/bindings/sound/sprd,pcm-platform.yaml
```yaml
# SPDX-License-Identifier: GPL-2.0-only OR BSD-2-Clause
%YAML 1.2
---
$id: http://devicetree.org/schemas/sound/sprd,pcm-platform.yaml#
$schema: http://devicetree.org/meta-schemas/core.yaml#

title: Spreadtrum DMA platform

maintainers:
  - Orson Zhai <orsonzhai@gmail.com>
  - Baolin Wang <baolin.wang7@gmail.com>
  - Chunyan Zhang <zhang.lyra@gmail.com>

properties:
  compatible:
    const: sprd,pcm-platform

  dmas:
    maxItems: 10

  dma-names:
    items:
      - const: normal_p_l
      - const: normal_p_r
      - const: normal_c_l
      - const: normal_c_r
      - const: voice_c
      - const: fast_p
      - const: loop_c
      - const: loop_p
      - const: voip_c
      - const: voip_p

required:
  - compatible
  - dmas
  - dma-names

additionalProperties: false

examples:
  - |
    platform {
      compatible = "sprd,pcm-platform";
      dmas = <&agcp_dma 1 1>, <&agcp_dma 2 2>,
             <&agcp_dma 3 3>, <&agcp_dma 4 4>,
             <&agcp_dma 5 5>, <&agcp_dma 6 6>,
             <&agcp_dma 7 7>, <&agcp_dma 8 8>,
             <&agcp_dma 9 9>, <&agcp_dma 10 10>;
      dma-names = "normal_p_l", "normal_p_r",
                  "normal_c_l", "normal_c_r",
                  "voice_c", "fast_p",
                  "loop_c", "loop_p",
                  "voip_c", "voip_p";
    };
...
```

## Documentation/devicetree/bindings/sound/sprd,sc9860-mcdt.yaml
```yaml
# SPDX-License-Identifier: GPL-2.0-only OR BSD-2-Clause
%YAML 1.2
---
$id: http://devicetree.org/schemas/sound/sprd,sc9860-mcdt.yaml#
$schema: http://devicetree.org/meta-schemas/core.yaml#

title: Spreadtrum Multi-Channel Data Transfer controller

description:
  The Multi-channel data transfer controller is used for sound stream
  transmission between the audio subsystem and other AP/CP subsystem. It
  supports 10 DAC channels and 10 ADC channels, and each channel can be
  configured with DMA mode or interrupt mode.

maintainers:
  - Orson Zhai <orsonzhai@gmail.com>
  - Baolin Wang <baolin.wang7@gmail.com>
  - Chunyan Zhang <zhang.lyra@gmail.com>

properties:
  compatible:
    const: sprd,sc9860-mcdt

  reg:
    maxItems: 1

  interrupts:
    maxItems: 1

required:
  - compatible
  - reg
  - interrupts

additionalProperties: false

examples:
  - |
    #include <dt-bindings/interrupt-controller/arm-gic.h>
    #include <dt-bindings/interrupt-controller/irq.h>

    mcdt@41490000 {
      compatible = "sprd,sc9860-mcdt";
      reg = <0x41490000 0x170>;
      interrupts = <GIC_SPI 48 IRQ_TYPE_LEVEL_HIGH>;
    };
...
```
