## Documentation/devicetree/bindings/usb/cypress,hx3.yaml
```yaml
# SPDX-License-Identifier: GPL-2.0-only OR BSD-2-Clause
%YAML 1.2
---
$id: http://devicetree.org/schemas/usb/cypress,hx3.yaml#
$schema: http://devicetree.org/meta-schemas/core.yaml#

title: Cypress HX3 USB 3.0 hub controller family

maintainers:
  - Benjamin Bara <benjamin.bara@skidata.com>

allOf:
  - $ref: usb-device.yaml#

properties:
  compatible:
    oneOf:
      - enum:
          - usb4b4,6504
          - usb4b4,6506
      - items:
          - enum:
              - usb4b4,6500
              - usb4b4,6508
          - const: usb4b4,6504
      - items:
          - enum:
              - usb4b4,6502
              - usb4b4,6503
              - usb4b4,6507
              - usb4b4,650a
          - const: usb4b4,6506

  reg: true

  reset-gpios:
    items:
      - description: GPIO specifier for RESETN pin.

  vdd-supply:
    description:
      1V2 power supply (VDD_EFUSE, AVDD12, DVDD12).

  vdd2-supply:
    description:
      3V3 power supply (AVDD33, VDD_IO).

  peer-hub:
    $ref: /schemas/types.yaml#/definitions/phandle
    description:
      phandle to the peer hub on the controller.

required:
  - compatible
  - reg
  - peer-hub
  - vdd-supply
  - vdd2-supply

additionalProperties: false

examples:
  - |
    #include <dt-bindings/gpio/gpio.h>

    usb {
        #address-cells = <1>;
        #size-cells = <0>;

        /* 2.0 hub on port 1 */
        hub_2_0: hub@1 {
            compatible = "usb4b4,6504";
            reg = <1>;
            peer-hub = <&hub_3_0>;
            reset-gpios = <&gpio1 11 GPIO_ACTIVE_LOW>;
            vdd-supply = <&reg_1v2_usb>;
            vdd2-supply = <&reg_3v3_usb>;
        };

        /* 3.0 hub on port 2 */
        hub_3_0: hub@2 {
            compatible = "usb4b4,6506";
            reg = <2>;
            peer-hub = <&hub_2_0>;
            reset-gpios = <&gpio1 11 GPIO_ACTIVE_LOW>;
            vdd-supply = <&reg_1v2_usb>;
            vdd2-supply = <&reg_3v3_usb>;
        };
    };
```

## Documentation/devicetree/bindings/usb/da8xx-usb.txt
```
TI DA8xx MUSB
~~~~~~~~~~~~~
For DA8xx/OMAP-L1x/AM17xx/AM18xx platforms.

Required properties:
~~~~~~~~~~~~~~~~~~~~
 - compatible : Should be set to "ti,da830-musb".

 - reg: Offset and length of the USB controller register set.

 - interrupts: The USB interrupt number.

 - interrupt-names: Should be set to "mc".

 - dr_mode: The USB operation mode. Should be one of "host", "peripheral" or "otg".

 - phys: Phandle for the PHY device

 - phy-names: Should be "usb-phy"

 - dmas: specifies the dma channels

 - dma-names: specifies the names of the channels. Use "rxN" for receive
   and "txN" for transmit endpoints. N specifies the endpoint number.

Optional properties:
~~~~~~~~~~~~~~~~~~~~
 - vbus-supply: Phandle to a regulator providing the USB bus power.

DMA
~~~
- compatible: ti,da830-cppi41
- reg: offset and length of the following register spaces: CPPI DMA Controller,
  CPPI DMA Scheduler, Queue Manager
- reg-names: "controller", "scheduler", "queuemgr"
- #dma-cells: should be set to 2. The first number represents the
  channel number (0 … 3 for endpoints 1 … 4).
  The second number is 0 for RX and 1 for TX transfers.
- #dma-channels: should be set to 4 representing the 4 endpoints.

Example:
	usb_phy: usb-phy {
		compatible = "ti,da830-usb-phy";
		#phy-cells = <0>;
	};
	usb0: usb@200000 {
		compatible = "ti,da830-musb";
		reg = <0x00200000 0x1000>;
		ranges;
		#address-cells = <1>;
		#size-cells = <1>;
		interrupts = <58>;
		interrupt-names = "mc";

		dr_mode = "host";
		vbus-supply = <&usb_vbus>;
		phys = <&usb_phy 0>;
		phy-names = "usb-phy";

		dmas = <&cppi41dma 0 0 &cppi41dma 1 0
			&cppi41dma 2 0 &cppi41dma 3 0
			&cppi41dma 0 1 &cppi41dma 1 1
			&cppi41dma 2 1 &cppi41dma 3 1>;
		dma-names =
			"rx1", "rx2", "rx3", "rx4",
			"tx1", "tx2", "tx3", "tx4";


		cppi41dma: dma-controller@201000 {
			compatible = "ti,da830-cppi41";
			reg =  <0x201000 0x1000
				0x202000 0x1000
				0x204000 0x4000>;
			reg-names = "controller", "scheduler", "queuemgr";
			interrupts = <58>;
			#dma-cells = <2>;
			#dma-channels = <4>;
		};

	};
```

## Documentation/devicetree/bindings/usb/dwc2.txt
```
Platform DesignWare HS OTG USB 2.0 controller
-----------------------------------------------------

Required properties:
- compatible : One of:
  - brcm,bcm2835-usb: The DWC2 USB controller instance in the BCM2835 SoC.
  - hisilicon,hi6220-usb: The DWC2 USB controller instance in the hi6220 SoC.
  - rockchip,rk3066-usb: The DWC2 USB controller instance in the rk3066 Soc;
  - "rockchip,px30-usb", "rockchip,rk3066-usb", "snps,dwc2": for px30 Soc;
  - "rockchip,rk3188-usb", "rockchip,rk3066-usb", "snps,dwc2": for rk3188 Soc;
  - "rockchip,rk3288-usb", "rockchip,rk3066-usb", "snps,dwc2": for rk3288 Soc;
  - "lantiq,arx100-usb": The DWC2 USB controller instance in Lantiq ARX SoCs;
  - "lantiq,xrx200-usb": The DWC2 USB controller instance in Lantiq XRX SoCs;
  - "amlogic,meson8-usb": The DWC2 USB controller instance in Amlogic Meson8 SoCs;
  - "amlogic,meson8b-usb": The DWC2 USB controller instance in Amlogic Meson8b SoCs;
  - "amlogic,meson-gxbb-usb": The DWC2 USB controller instance in Amlogic S905 SoCs;
  - "amlogic,meson-g12a-usb": The DWC2 USB controller instance in Amlogic G12A SoCs;
  - "amcc,dwc-otg": The DWC2 USB controller instance in AMCC Canyonlands 460EX SoCs;
  - snps,dwc2: A generic DWC2 USB controller with default parameters.
  - "st,stm32f4x9-fsotg": The DWC2 USB FS/HS controller instance in STM32F4x9 SoCs
  configured in FS mode;
  - "st,stm32f4x9-hsotg": The DWC2 USB HS controller instance in STM32F4x9 SoCs
  configured in HS mode;
  - "st,stm32f7-hsotg": The DWC2 USB HS controller instance in STM32F7 SoCs
    configured in HS mode;
- reg : Should contain 1 register range (address and length)
- interrupts : Should contain 1 interrupt
- clocks: clock provider specifier
- clock-names: shall be "otg"
Refer to clk/clock-bindings.txt for generic clock consumer properties

Optional properties:
- phys: phy provider specifier
- phy-names: shall be "usb2-phy"
- vbus-supply: reference to the VBUS regulator. Depending on the current mode
  this is enabled (in "host" mode") or disabled (in "peripheral" mode). The
  regulator is updated if the controller is configured in "otg" mode and the
  status changes between "host" and "peripheral".
Refer to phy/phy-bindings.txt for generic phy consumer properties
- dr_mode: shall be one of "host", "peripheral" and "otg"
  Refer to usb/generic.txt
- g-rx-fifo-size: size of rx fifo size in gadget mode.
- g-np-tx-fifo-size: size of non-periodic tx fifo size in gadget mode.
- g-tx-fifo-size: size of periodic tx fifo per endpoint (except ep0) in gadget mode.
- snps,reset-phy-on-wake: If present indicates that we need to reset the PHY when
                          we detect a wakeup.  This is due to a hardware errata.

Deprecated properties:
- g-use-dma: gadget DMA mode is automatically detected

Example:

        usb@101c0000 {
                compatible = "ralink,rt3050-usb, snps,dwc2";
                reg = <0x101c0000 40000>;
                interrupts = <18>;
		clocks = <&usb_otg_ahb_clk>;
		clock-names = "otg";
		phys = <&usbphy>;
		phy-names = "usb2-phy";
        };
```

## Documentation/devicetree/bindings/usb/dwc2.yaml
```yaml
# SPDX-License-Identifier: GPL-2.0
%YAML 1.2
---
$id: http://devicetree.org/schemas/usb/dwc2.yaml#
$schema: http://devicetree.org/meta-schemas/core.yaml#

title: DesignWare HS OTG USB 2.0 controller Bindings

maintainers:
  - Rob Herring <robh@kernel.org>

allOf:
  - $ref: usb-drd.yaml#
  - $ref: usb-hcd.yaml#

properties:
  compatible:
    oneOf:
      - const: brcm,bcm2835-usb
      - const: hisilicon,hi6220-usb
      - const: ingenic,jz4775-otg
      - const: ingenic,jz4780-otg
      - const: ingenic,x1000-otg
      - const: ingenic,x1600-otg
      - const: ingenic,x1700-otg
      - const: ingenic,x1830-otg
      - const: ingenic,x2000-otg
      - items:
          - const: rockchip,rk3066-usb
          - const: snps,dwc2
      - items:
          - enum:
              - rockchip,px30-usb
              - rockchip,rk3036-usb
              - rockchip,rk3128-usb
              - rockchip,rk3188-usb
              - rockchip,rk3228-usb
              - rockchip,rk3288-usb
              - rockchip,rk3308-usb
              - rockchip,rk3328-usb
              - rockchip,rk3368-usb
              - rockchip,rv1108-usb
          - const: rockchip,rk3066-usb
          - const: snps,dwc2
      - const: lantiq,arx100-usb
      - const: lantiq,xrx200-usb
      - items:
          - enum:
              - amlogic,meson8-usb
              - amlogic,meson8b-usb
              - amlogic,meson-gxbb-usb
              - amlogic,meson-g12a-usb
              - intel,socfpga-agilex-hsotg
          - const: snps,dwc2
      - const: amcc,dwc-otg
      - const: apm,apm82181-dwc-otg
      - const: snps,dwc2
      - const: st,stm32f4x9-fsotg
      - const: st,stm32f4x9-hsotg
      - const: st,stm32f7-hsotg
      - const: st,stm32mp15-fsotg
      - items:
          - const: st,stm32mp15-hsotg
          - const: snps,dwc2
      - const: samsung,s3c6400-hsotg
      - const: intel,socfpga-agilex-hsotg

  reg:
    maxItems: 1

  interrupts:
    maxItems: 1

  clocks:
    maxItems: 1

  clock-names:
    items:
      - const: otg

  disable-over-current:
    type: boolean
    description: whether to disable detection of over-current condition.

  iommus:
    maxItems: 1

  resets:
    items:
      - description: common reset
      - description: ecc reset
    minItems: 1

  reset-names:
    items:
      - const: dwc2
      - const: dwc2-ecc
    minItems: 1

  phys:
    maxItems: 1

  phy-names:
    const: usb2-phy

  power-domains:
    maxItems: 1

  vbus-supply:
    description: reference to the VBUS regulator. Depending on the current mode
      this is enabled (in "host" mode") or disabled (in "peripheral" mode). The
      regulator is updated if the controller is configured in "otg" mode and the
      status changes between "host" and "peripheral".

  vusb_d-supply:
    description: phandle to voltage regulator of digital section,

  vusb_a-supply:
    description: phandle to voltage regulator of analog section.

  usb33d-supply:
    description: reference to the VBUS and ID sensing comparators supply, in
      order to perform OTG operation, used on STM32MP15 SoCs.

  dr_mode: true

  otg-rev: true

  hnp-disable: true

  srp-disable: true

  usb-role-switch: true

  role-switch-default-mode: true

  g-rx-fifo-size:
    $ref: /schemas/types.yaml#/definitions/uint32
    description: size of rx fifo size in gadget mode.

  g-np-tx-fifo-size:
    $ref: /schemas/types.yaml#/definitions/uint32
    description: size of non-periodic tx fifo size in gadget mode.

  g-tx-fifo-size:
    $ref: /schemas/types.yaml#/definitions/uint32-array
    description: size of periodic tx fifo per endpoint (except ep0) in gadget mode.

  snps,need-phy-for-wake:
    $ref: /schemas/types.yaml#/definitions/flag
    description: If present indicates that the phy needs to be left on for
      remote wakeup during suspend.

  snps,reset-phy-on-wake:
    $ref: /schemas/types.yaml#/definitions/flag
    description: If present indicates that we need to reset the PHY when we
      detect a wakeup. This is due to a hardware errata.

  port:
    description:
      Any connector to the data bus of this controller should be modelled
      using the OF graph bindings specified, if the "usb-role-switch"
      property is used.
    $ref: /schemas/graph.yaml#/properties/port

  tpl-support: true

dependencies:
  port: [ usb-role-switch ]
  role-switch-default-mode: [ usb-role-switch ]

required:
  - compatible
  - reg
  - interrupts
  - clocks
  - clock-names

additionalProperties: false

examples:
  - |
      usb@101c0000 {
        compatible = "rockchip,rk3066-usb", "snps,dwc2";
        reg = <0x10180000 0x40000>;
        interrupts = <18>;
        clocks = <&usb_otg_ahb_clk>;
        clock-names = "otg";
        phys = <&usbphy>;
        phy-names = "usb2-phy";
      };

...
```

## Documentation/devicetree/bindings/usb/dwc3-cavium.txt
```
Cavium SuperSpeed DWC3 USB SoC controller

Required properties:
- compatible:	Should contain "cavium,octeon-7130-usb-uctl"

Required child node:
A child node must exist to represent the core DWC3 IP block. The name of
the node is not important. The content of the node is defined in dwc3.txt.

Example device node:

		    uctl@1180069000000 {
			    compatible = "cavium,octeon-7130-usb-uctl";
			    reg = <0x00011800 0x69000000 0x00000000 0x00000100>;
			    ranges;
			    #address-cells = <0x00000002>;
			    #size-cells = <0x00000002>;
			    refclk-frequency = <0x05f5e100>;
			    refclk-type-ss = "dlmc_ref_clk0";
			    refclk-type-hs = "dlmc_ref_clk0";
			    power = <0x00000002 0x00000002 0x00000001>;
			    xhci@1690000000000 {
				    compatible = "cavium,octeon-7130-xhci", "snps,dwc3";
				    reg = <0x00016900 0x00000000 0x00000010 0x00000000>;
				    interrupt-parent = <0x00000010>;
				    interrupts = <0x00000009 0x00000004>;
			    };
		    };
```

## Documentation/devicetree/bindings/usb/dwc3-rockchip.txt
```
Rockchip SuperSpeed DWC3 USB SoC controller

Required properties:
- compatible:	should contain "rockchip,dwc3"
- clocks:		A list of phandle + clock-specifier pairs for the
				clocks listed in clock-names
- clock-names:	Should contain the following:
  "clk_usb3otg0_ref"	Controller reference clk
  "clk_usb3otg0_suspend"Controller suspend clk, can use 24 MHz or 32 KHz
  "aclk_usb3"		Master/Core clock, have to be >= 62.5 MHz for SS operation


Optional clocks:
  "aclk_usb3otg0"	Aclk for specific usb controller clock.
  "aclk_usb3_rksoc_axi_perf"  USB AXI perf clock.  Not present on all platforms.
  "aclk_usb3_noc"	USB noc clock. Not present on all platforms.
  "aclk_usb3_grf"	USB grf clock.  Not present on all platforms.

Required child node:
A child node must exist to represent the core DWC3 IP block. The name of
the node is not important. The content of the node is defined in dwc3.txt.

Phy documentation is provided in the following places:

Example device nodes:

	usbdrd3_0: usb@fe800000 {
		compatible = "rockchip,dwc3";
		clocks = <&cru SCLK_USB3OTG0_REF>, <&cru SCLK_USB3OTG0_SUSPEND>,
			 <&cru ACLK_USB3OTG0>, <&cru ACLK_USB3_RKSOC_AXI_PERF>,
			 <&cru ACLK_USB3>, <&cru ACLK_USB3_NOC>,
			 <&cru ACLK_USB3_GRF>;
		clock-names = "clk_usb3otg0_ref", "clk_usb3otg0_suspend",
			      "aclk_usb3otg0", "aclk_usb3_rksoc_axi_perf",
			      "aclk_usb3", "aclk_usb3_noc",
			      "aclk_usb3_grf";
		#address-cells = <2>;
		#size-cells = <2>;
		ranges;
		status = "disabled";
		usbdrd_dwc3_0: dwc3 {
			compatible = "snps,dwc3";
			reg = <0x0 0xfe800000 0x0 0x100000>;
			interrupts = <GIC_SPI 105 IRQ_TYPE_LEVEL_HIGH>;
			dr_mode = "otg";
			tx-fifo-resize;
			status = "disabled";
		};
	};
```
