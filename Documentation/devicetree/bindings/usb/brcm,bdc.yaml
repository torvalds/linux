## Documentation/devicetree/bindings/usb/dwc3-st.txt
```
ST DWC3 glue logic

This file documents the parameters for the dwc3-st driver.
This driver controls the glue logic used to configure the dwc3 core on
STiH407 based platforms.

Required properties:
 - compatible	: must be "st,stih407-dwc3"
 - reg		: glue logic base address and USB syscfg ctrl register offset
 - reg-names	: should be "reg-glue" and "syscfg-reg"
 - st,syscon	: should be phandle to system configuration node which
		  encompasses the glue registers
 - resets	: list of phandle and reset specifier pairs. There should be two entries, one
		  for the powerdown and softreset lines of the usb3 IP
 - reset-names	: list of reset signal names. Names should be "powerdown" and "softreset"
See: Documentation/devicetree/bindings/reset/st,sti-powerdown.txt
See: Documentation/devicetree/bindings/reset/reset.txt

 - #address-cells, #size-cells : should be '1' if the device has sub-nodes
   with 'reg' property

 - pinctl-names	: A pinctrl state named "default" must be defined
See: Documentation/devicetree/bindings/pinctrl/pinctrl-binding.txt

 - pinctrl-0	: Pin control group
See: Documentation/devicetree/bindings/pinctrl/pinctrl-binding.txt

 - ranges	: allows valid 1:1 translation between child's address space and
		  parent's address space

Sub-nodes:
The dwc3 core should be added as subnode to ST DWC3 glue as shown in the
example below. The DT binding details of dwc3 can be found in:
Documentation/devicetree/bindings/usb/dwc3.txt

NB: The dr_mode property described in [1] is NOT optional for this driver, as the default value
is "otg", which isn't supported by this SoC. Valid dr_mode values for dwc3-st are either "host"
or "device".

[1] Documentation/devicetree/bindings/usb/generic.txt

Example:

st_dwc3: dwc3@8f94000 {
	status		= "disabled";
	compatible	= "st,stih407-dwc3";
	reg		= <0x08f94000 0x1000>, <0x110 0x4>;
	reg-names	= "reg-glue", "syscfg-reg";
	st,syscfg	= <&syscfg_core>;
	resets		= <&powerdown STIH407_USB3_POWERDOWN>,
			  <&softreset STIH407_MIPHY2_SOFTRESET>;
	reset-names	= "powerdown", "softreset";
	#address-cells	= <1>;
	#size-cells	= <1>;
	pinctrl-names	= "default";
	pinctrl-0	= <&pinctrl_usb3>;
	ranges;

	dwc3: dwc3@9900000 {
		compatible	= "snps,dwc3";
		reg		= <0x09900000 0x100000>;
		interrupts	= <GIC_SPI 155 IRQ_TYPE_NONE>;
		dr_mode		= "host";
		phy-names	= "usb2-phy", "usb3-phy";
		phys		= <&usb2_picophy2>, <&phy_port2 PHY_TYPE_USB3>;
	};
};
```

## Documentation/devicetree/bindings/usb/dwc3-xilinx.txt
```
Xilinx SuperSpeed DWC3 USB SoC controller

Required properties:
- compatible:	May contain "xlnx,zynqmp-dwc3" or "xlnx,versal-dwc3"
- reg:		Base address and length of the register control block
- clocks:	A list of phandles for the clocks listed in clock-names
- clock-names:	Should contain the following:
  "bus_clk"	 Master/Core clock, have to be >= 125 MHz for SS
		 operation and >= 60MHz for HS operation

  "ref_clk"	 Clock source to core during PHY power down
- resets:	A list of phandles for resets listed in reset-names
- reset-names:
  "usb_crst"	 USB core reset
  "usb_hibrst"	 USB hibernation reset
  "usb_apbrst"	 USB APB reset

Required child node:
A child node must exist to represent the core DWC3 IP block. The name of
the node is not important. The content of the node is defined in dwc3.txt.

Optional properties for snps,dwc3:
- dma-coherent:	Enable this flag if CCI is enabled in design. Adding this
		flag configures Global SoC bus Configuration Register and
		Xilinx USB 3.0 IP - USB coherency register to enable CCI.
- interrupt-names: Should contain the following:
  "dwc_usb3"	USB gadget mode interrupts
  "otg"		USB OTG mode interrupts
  "hiber"	USB hibernation interrupts

Example device node:

		usb@0 {
			#address-cells = <0x2>;
			#size-cells = <0x1>;
			compatible = "xlnx,zynqmp-dwc3";
			reg = <0x0 0xff9d0000 0x0 0x100>;
			clock-names = "bus_clk", "ref_clk";
			clocks = <&clk125>, <&clk125>;
			resets = <&zynqmp_reset ZYNQMP_RESET_USB1_CORERESET>,
				 <&zynqmp_reset ZYNQMP_RESET_USB1_HIBERRESET>,
				 <&zynqmp_reset ZYNQMP_RESET_USB1_APB>;
			reset-names = "usb_crst", "usb_hibrst", "usb_apbrst";
			ranges;

			dwc3@fe200000 {
				compatible = "snps,dwc3";
				reg = <0x0 0xfe200000 0x40000>;
				interrupt-names = "dwc_usb3", "otg", "hiber";
				interrupts = <0 65 4>, <0 69 4>, <0 75 4>;
				phys = <&psgtr 2 PHY_TYPE_USB3 0 2>;
				phy-names = "usb3-phy";
				dr_mode = "host";
				dma-coherent;
			};
		};
```

## Documentation/devicetree/bindings/usb/dwc3-xilinx.yaml
```yaml
# SPDX-License-Identifier: (GPL-2.0 OR BSD-2-Clause)
%YAML 1.2
---
$id: http://devicetree.org/schemas/usb/dwc3-xilinx.yaml#
$schema: http://devicetree.org/meta-schemas/core.yaml#

title: Xilinx SuperSpeed DWC3 USB SoC controller

maintainers:
  - Manish Narani <manish.narani@xilinx.com>

properties:
  compatible:
    items:
      - enum:
          - xlnx,zynqmp-dwc3
          - xlnx,versal-dwc3
  reg:
    maxItems: 1

  "#address-cells":
    enum: [ 1, 2 ]

  "#size-cells":
    enum: [ 1, 2 ]

  ranges: true

  power-domains:
    description: specifies a phandle to PM domain provider node
    maxItems: 1

  clocks:
    description:
      A list of phandle and clock-specifier pairs for the clocks
      listed in clock-names.
    items:
      - description: Master/Core clock, has to be >= 125 MHz
          for SS operation and >= 60MHz for HS operation.
      - description: Clock source to core during PHY power down.

  clock-names:
    items:
      - const: bus_clk
      - const: ref_clk

  resets:
    description:
      A list of phandles for resets listed in reset-names.

    items:
      - description: USB core reset
      - description: USB hibernation reset
      - description: USB APB reset

  reset-names:
    items:
      - const: usb_crst
      - const: usb_hibrst
      - const: usb_apbrst

  phys:
    minItems: 1
    maxItems: 2

  phy-names:
    minItems: 1
    maxItems: 2
    items:
      enum:
        - usb2-phy
        - usb3-phy

  reset-gpios:
    description: GPIO used for the reset ulpi-phy
    maxItems: 1

# Required child node:

patternProperties:
  "^usb@[0-9a-f]+$":
    $ref: snps,dwc3.yaml#

required:
  - compatible
  - reg
  - "#address-cells"
  - "#size-cells"
  - ranges
  - power-domains
  - clocks
  - clock-names
  - resets
  - reset-names

additionalProperties: false

examples:
  - |
    #include <dt-bindings/dma/xlnx-zynqmp-dpdma.h>
    #include <dt-bindings/power/xlnx-zynqmp-power.h>
    #include <dt-bindings/reset/xlnx-zynqmp-resets.h>
    #include <dt-bindings/clock/xlnx-zynqmp-clk.h>
    #include <dt-bindings/reset/xlnx-zynqmp-resets.h>
    #include <dt-bindings/phy/phy.h>
    axi {
        #address-cells = <2>;
        #size-cells = <2>;

        usb@0 {
            #address-cells = <0x2>;
            #size-cells = <0x2>;
            compatible = "xlnx,zynqmp-dwc3";
            reg = <0x0 0xff9d0000 0x0 0x100>;
            clocks = <&zynqmp_clk USB0_BUS_REF>, <&zynqmp_clk USB3_DUAL_REF>;
            clock-names = "bus_clk", "ref_clk";
            power-domains = <&zynqmp_firmware PD_USB_0>;
            resets = <&zynqmp_reset ZYNQMP_RESET_USB1_CORERESET>,
                     <&zynqmp_reset ZYNQMP_RESET_USB1_HIBERRESET>,
                     <&zynqmp_reset ZYNQMP_RESET_USB1_APB>;
            reset-names = "usb_crst", "usb_hibrst", "usb_apbrst";
            phys = <&psgtr 2 PHY_TYPE_USB3 0 2>;
            phy-names = "usb3-phy";
            ranges;

            usb@fe200000 {
                compatible = "snps,dwc3";
                reg = <0x0 0xfe200000 0x0 0x40000>;
                interrupt-names = "host", "otg";
                interrupts = <0 65 4>, <0 69 4>;
                dr_mode = "host";
                dma-coherent;
            };
        };
    };
```

## Documentation/devicetree/bindings/usb/dwc3.txt
```
synopsys DWC3 CORE

DWC3- USB3 CONTROLLER. Complies to the generic USB binding properties
      as described in 'usb/generic.txt'

Required properties:
 - compatible: must be "snps,dwc3"
 - reg : Address and length of the register set for the device
 - interrupts: Interrupts used by the dwc3 controller.
 - clock-names: should contain "ref", "bus_early", "suspend"
 - clocks: list of phandle and clock specifier pairs corresponding to
           entries in the clock-names property.

Exception for clocks:
  clocks are optional if the parent node (i.e. glue-layer) is compatible to
  one of the following:
    "amlogic,meson-axg-dwc3"
    "amlogic,meson-gxl-dwc3"
    "cavium,octeon-7130-usb-uctl"
    "qcom,dwc3"
    "samsung,exynos5250-dwusb3"
    "samsung,exynos7-dwusb3"
    "sprd,sc9860-dwc3"
    "st,stih407-dwc3"
    "ti,am437x-dwc3"
    "ti,dwc3"
    "ti,keystone-dwc3"
    "rockchip,rk3399-dwc3"
    "xlnx,zynqmp-dwc3"

Optional properties:
 - usb-phy : array of phandle for the PHY device.  The first element
   in the array is expected to be a handle to the USB2/HS PHY and
   the second element is expected to be a handle to the USB3/SS PHY
 - phys: from the *Generic PHY* bindings
 - phy-names: from the *Generic PHY* bindings; supported names are "usb2-phy"
	or "usb3-phy".
 - resets: a single pair of phandle and reset specifier
 - snps,usb3_lpm_capable: determines if platform is USB3 LPM capable
 - snps,disable_scramble_quirk: true when SW should disable data scrambling.
	Only really useful for FPGA builds.
 - snps,has-lpm-erratum: true when DWC3 was configured with LPM Erratum enabled
 - snps,lpm-nyet-threshold: LPM NYET threshold
 - snps,u2exit_lfps_quirk: set if we want to enable u2exit lfps quirk
 - snps,u2ss_inp3_quirk: set if we enable P3 OK for U2/SS Inactive quirk
 - snps,req_p1p2p3_quirk: when set, the core will always request for
			P1/P2/P3 transition sequence.
 - snps,del_p1p2p3_quirk: when set core will delay P1/P2/P3 until a certain
			amount of 8B10B errors occur.
 - snps,del_phy_power_chg_quirk: when set core will delay PHY power change
			from P0 to P1/P2/P3.
 - snps,lfps_filter_quirk: when set core will filter LFPS reception.
 - snps,rx_detect_poll_quirk: when set core will disable a 400us delay to start
			Polling LFPS after RX.Detect.
 - snps,tx_de_emphasis_quirk: when set core will set Tx de-emphasis value.
 - snps,tx_de_emphasis: the value driven to the PHY is controlled by the
			LTSSM during USB3 Compliance mode.
 - snps,dis_u3_susphy_quirk: when set core will disable USB3 suspend phy.
 - snps,dis_u2_susphy_quirk: when set core will disable USB2 suspend phy.
 - snps,dis_enblslpm_quirk: when set clears the enblslpm in GUSB2PHYCFG,
			disabling the suspend signal to the PHY.
 - snps,dis_rxdet_inp3_quirk: when set core will disable receiver detection
			in PHY P3 power state.
 - snps,dis-u2-freeclk-exists-quirk: when set, clear the u2_freeclk_exists
			in GUSB2PHYCFG, specify that USB2 PHY doesn't provide
			a free-running PHY clock.
 - snps,dis-del-phy-power-chg-quirk: when set core will change PHY power
			from P0 to P1/P2/P3 without delay.
 - snps,dis-tx-ipgap-linecheck-quirk: when set, disable u2mac linestate check
			during HS transmit.
 - snps,parkmode-disable-ss-quirk: when set, all SuperSpeed bus instances in
			park mode are disabled.
 - snps,dis_metastability_quirk: when set, disable metastability workaround.
			CAUTION: use only if you are absolutely sure of it.
 - snps,is-utmi-l1-suspend: true when DWC3 asserts output signal
			utmi_l1_suspend_n, false when asserts utmi_sleep_n
 - snps,hird-threshold: HIRD threshold
 - snps,hsphy_interface: High-Speed PHY interface selection between "utmi" for
   UTMI+ and "ulpi" for ULPI when the DWC_USB3_HSPHY_INTERFACE has value 3.
 - snps,quirk-frame-length-adjustment: Value for GFLADJ_30MHZ field of GFLADJ
	register for post-silicon frame length adjustment when the
	fladj_30mhz_sdbnd signal is invalid or incorrect.
 - snps,rx-thr-num-pkt-prd: periodic ESS RX packet threshold count - host mode
			only. Set this and rx-max-burst-prd to a valid,
			non-zero value 1-16 (DWC_usb31 programming guide
			section 1.2.4) to enable periodic ESS RX threshold.
 - snps,rx-max-burst-prd: max periodic ESS RX burst size - host mode only. Set
			this and rx-thr-num-pkt-prd to a valid, non-zero value
			1-16 (DWC_usb31 programming guide section 1.2.4) to
			enable periodic ESS RX threshold.
 - snps,tx-thr-num-pkt-prd: periodic ESS TX packet threshold count - host mode
			only. Set this and tx-max-burst-prd to a valid,
			non-zero value 1-16 (DWC_usb31 programming guide
			section 1.2.3) to enable periodic ESS TX threshold.
 - snps,tx-max-burst-prd: max periodic ESS TX burst size - host mode only. Set
			this and tx-thr-num-pkt-prd to a valid, non-zero value
			1-16 (DWC_usb31 programming guide section 1.2.3) to
			enable periodic ESS TX threshold.

 - <DEPRECATED> tx-fifo-resize: determines if the FIFO *has* to be reallocated.
 - snps,incr-burst-type-adjustment: Value for INCR burst type of GSBUSCFG0
			register, undefined length INCR burst type enable and INCRx type.
			When just one value, which means INCRX burst mode enabled. When
			more than one value, which means undefined length INCR burst type
			enabled. The values can be 1, 4, 8, 16, 32, 64, 128 and 256.

 - in addition all properties from usb-xhci.txt from the current directory are
   supported as well


This is usually a subnode to DWC3 glue to which it is connected.

dwc3@4a030000 {
	compatible = "snps,dwc3";
	reg = <0x4a030000 0xcfff>;
	interrupts = <0 92 4>
	usb-phy = <&usb2_phy>, <&usb3,phy>;
	snps,incr-burst-type-adjustment = <1>, <4>, <8>, <16>;
};
```

## Documentation/devicetree/bindings/usb/ehci-mv.txt
```
* Marvell PXA/MMP EHCI controller.

Required properties:

- compatible: must be "marvell,pxau2o-ehci"
- reg: physical base addresses of the controller and length of memory mapped region
- interrupts: one EHCI controller interrupt should be described here
- clocks: phandle list of usb clocks
- clock-names: should be "USBCLK"
- phys: phandle for the PHY device
- phy-names: should be "usb"

Example:

	ehci0: usb-ehci@d4208000 {
		compatible = "marvell,pxau2o-ehci";
		reg = <0xd4208000 0x200>;
		interrupts = <44>;
		clocks = <&soc_clocks MMP2_CLK_USB>;
		clock-names = "USBCLK";
		phys = <&usb_otg_phy>;
		phy-names = "usb";
	};
```
