## Documentation/devicetree/bindings/usb/mediatek,musb.yaml
```yaml
# SPDX-License-Identifier: (GPL-2.0-only OR BSD-2-Clause)
# Copyright (c) 2020 MediaTek
%YAML 1.2
---
$id: http://devicetree.org/schemas/usb/mediatek,musb.yaml#
$schema: http://devicetree.org/meta-schemas/core.yaml#

title: MediaTek MUSB DRD/OTG Controller Device Tree Bindings

maintainers:
  - Min Guo <min.guo@mediatek.com>

properties:
  $nodename:
    pattern: '^usb@[0-9a-f]+$'

  compatible:
    items:
      - enum:
          - mediatek,mt8516-musb
          - mediatek,mt2701-musb
          - mediatek,mt7623-musb
      - const: mediatek,mtk-musb

  reg:
    maxItems: 1

  interrupts:
    maxItems: 1

  interrupt-names:
    items:
      - const: mc

  clocks:
    items:
      - description: The main/core clock
      - description: The system bus clock
      - description: The 48Mhz clock

  clock-names:
    items:
      - const: main
      - const: mcu
      - const: univpll

  phys:
    maxItems: 1

  usb-role-switch:
    $ref: /schemas/types.yaml#/definitions/flag
    description: Support role switch. See usb/generic.txt
    type: boolean

  dr_mode:
    enum:
      - host
      - otg
      - peripheral

  power-domains:
    description: A phandle to USB power domain node to control USB's MTCMOS
    maxItems: 1

  connector:
    $ref: /connector/usb-connector.yaml#
    description: Connector for dual role switch
    type: object

dependencies:
  usb-role-switch: [ 'connector' ]
  connector: [ 'usb-role-switch' ]

required:
  - compatible
  - reg
  - interrupts
  - interrupt-names
  - phys
  - clocks
  - clock-names

additionalProperties: false

examples:
  - |
    #include <dt-bindings/clock/mt2701-clk.h>
    #include <dt-bindings/gpio/gpio.h>
    #include <dt-bindings/interrupt-controller/arm-gic.h>
    #include <dt-bindings/interrupt-controller/irq.h>
    #include <dt-bindings/phy/phy.h>
    #include <dt-bindings/power/mt2701-power.h>

    usb@11200000 {
        compatible = "mediatek,mt2701-musb", "mediatek,mtk-musb";
        reg = <0x11200000 0x1000>;
        interrupts = <GIC_SPI 32 IRQ_TYPE_LEVEL_LOW>;
        interrupt-names = "mc";
        phys = <&u2port2 PHY_TYPE_USB2>;
        dr_mode = "otg";
        clocks = <&pericfg CLK_PERI_USB0>,
                 <&pericfg CLK_PERI_USB0_MCU>,
                 <&pericfg CLK_PERI_USB_SLV>;
        clock-names = "main","mcu","univpll";
        power-domains = <&scpsys MT2701_POWER_DOMAIN_IFR_MSC>;
        usb-role-switch;

        connector {
            compatible = "gpio-usb-b-connector", "usb-b-connector";
            type = "micro";
            id-gpios = <&pio 44 GPIO_ACTIVE_HIGH>;
            vbus-supply = <&usb_vbus>;
        };
    };
...
```

## Documentation/devicetree/bindings/usb/microchip,lan9691-dwc3.yaml
```yaml
# SPDX-License-Identifier: (GPL-2.0 OR BSD-2-Clause)
%YAML 1.2
---
$id: http://devicetree.org/schemas/usb/microchip,lan9691-dwc3.yaml#
$schema: http://devicetree.org/meta-schemas/core.yaml#

title: Microchip LAN969x SuperSpeed DWC3 USB SoC controller

maintainers:
  - Robert Marko <robert.marko@sartura.hr>

select:
  properties:
    compatible:
      contains:
        enum:
          - microchip,lan9691-dwc3
  required:
    - compatible

properties:
  compatible:
    items:
      - enum:
          - microchip,lan9691-dwc3
      - const: snps,dwc3

  reg:
    maxItems: 1

  interrupts:
    maxItems: 1

  clocks:
    items:
      - description: Gated USB DRD clock
      - description: Controller reference clock

  clock-names:
    items:
      - const: bus_early
      - const: ref

unevaluatedProperties: false

required:
  - compatible
  - reg
  - interrupts
  - clocks
  - clock-names

allOf:
  - $ref: snps,dwc3.yaml#

examples:
  - |
    #include <dt-bindings/interrupt-controller/arm-gic.h>

    usb@300000 {
        compatible = "microchip,lan9691-dwc3", "snps,dwc3";
        reg = <0x300000 0x80000>;
        interrupts = <GIC_SPI 80 IRQ_TYPE_LEVEL_HIGH>;
        clocks = <&clks 12>, <&clks 11>;
        clock-names = "bus_early", "ref";
    };
```

## Documentation/devicetree/bindings/usb/microchip,mpfs-musb.yaml
```yaml
# SPDX-License-Identifier: (GPL-2.0-only OR BSD-2-Clause)
%YAML 1.2
---
$id: http://devicetree.org/schemas/usb/microchip,mpfs-musb.yaml#
$schema: http://devicetree.org/meta-schemas/core.yaml#

title: Microchip MPFS USB Controller

allOf:
  - $ref: usb-drd.yaml#

maintainers:
  - Conor Dooley <conor.dooley@microchip.com>

properties:
  compatible:
    oneOf:
      - items:
          - const: microchip,pic64gx-musb
          - const: microchip,mpfs-musb
      - const: microchip,mpfs-musb

  dr_mode: true

  reg:
    maxItems: 1

  interrupts:
    minItems: 2
    maxItems: 2

  interrupt-names:
    items:
      - const: dma
      - const: mc

  clocks:
    maxItems: 1

  microchip,ext-vbus-drv:
    description:
      Some ULPI USB PHYs do not support an internal VBUS supply and driving
      the CPEN pin requires the configuration of the UPLI_USE__EXTVBUS
      bit in ULPI_BUSCONTROL.
    $ref: /schemas/types.yaml#/definitions/flag

required:
  - compatible
  - reg
  - interrupts
  - interrupt-names
  - clocks

additionalProperties: false

examples:
  - |
    #include "dt-bindings/clock/microchip,mpfs-clock.h"
    usb@20201000 {
        compatible = "microchip,mpfs-musb";
        reg = <0x20201000 0x1000>;
        clocks = <&clkcfg CLK_USB>;
        interrupt-parent = <&plic>;
        interrupts = <86>, <87>;
        interrupt-names = "dma", "mc";
        dr_mode = "host";
    };

...
```

## Documentation/devicetree/bindings/usb/microchip,usb2514.yaml
```yaml
# SPDX-License-Identifier: GPL-2.0-only OR BSD-2-Clause
%YAML 1.2
---
$id: http://devicetree.org/schemas/usb/microchip,usb2514.yaml#
$schema: http://devicetree.org/meta-schemas/core.yaml#

title: Microchip USB2514 Hub Controller

maintainers:
  - Fabio Estevam <festevam@gmail.com>

properties:
  compatible:
    oneOf:
      - enum:
          - usb424,2412
          - usb424,2417
          - usb424,2514
          - usb424,2517
      - items:
          - enum:
              - usb424,2512
              - usb424,2513
          - const: usb424,2514

  reg: true

  reset-gpios:
    description: GPIO connected to the RESET_N pin.

  vdd-supply:
    description: 3.3V power supply.

  vdda-supply:
    description: 3.3V analog power supply.

  clocks:
    description: External 24MHz clock connected to the CLKIN pin.
    maxItems: 1

required:
  - compatible
  - reg

patternProperties:
  "^.*@[0-9a-f]{1,2}$":
    description: The hard wired USB devices
    type: object
    $ref: /schemas/usb/usb-device.yaml
    additionalProperties: true

allOf:
  - $ref: usb-device.yaml#
  - if:
      not:
        properties:
          compatible:
            contains:
              const: usb424,2514
    then:
      properties:
        vdda-supply: false

unevaluatedProperties: false

examples:
  - |
    #include <dt-bindings/clock/imx6qdl-clock.h>
    #include <dt-bindings/gpio/gpio.h>

    usb {
        #address-cells = <1>;
        #size-cells = <0>;

        usb-hub@1 {
            compatible = "usb424,2514";
            reg = <1>;
            clocks = <&clks IMX6QDL_CLK_CKO>;
            reset-gpios = <&gpio7 12 GPIO_ACTIVE_LOW>;
            vdd-supply = <&reg_3v3_hub>;
            vdda-supply = <&reg_3v3a_hub>;
            #address-cells = <1>;
            #size-cells = <0>;

            ethernet@1 {
                compatible = "usbb95,772b";
                reg = <1>;
            };
        };
    };
```

## Documentation/devicetree/bindings/usb/microchip,usb5744.yaml
```yaml
# SPDX-License-Identifier: (GPL-2.0-only OR BSD-2-Clause)
%YAML 1.2
---
$id: http://devicetree.org/schemas/usb/microchip,usb5744.yaml#
$schema: http://devicetree.org/meta-schemas/core.yaml#

title: Microchip USB5744 4-port Hub Controller

description:
  Microchip's USB5744 SmartHubTM IC is a 4 port, SuperSpeed (SS)/Hi-Speed (HS),
  low power, low pin count configurable and fully compliant with the USB 3.1
  Gen 1 specification. The USB5744 also supports Full Speed (FS) and Low Speed
  (LS) USB signaling, offering complete coverage of all defined USB operating
  speeds. The new SuperSpeed hubs operate in parallel with the USB 2.0
  controller, so 5 Gbps SuperSpeed data transfers are not affected by slower
  USB 2.0 traffic.

maintainers:
  - Piyush Mehta <piyush.mehta@amd.com>
  - Michal Simek <michal.simek@amd.com>

properties:
  compatible:
    enum:
      - usb424,2744
      - usb424,5744
      - microchip,usb5744

  reg:
    maxItems: 1

  reset-gpios:
    maxItems: 1
    description:
      GPIO controlling the GRST# pin.

  vdd-supply:
    description:
      VDD power supply to the hub

  peer-hub:
    $ref: /schemas/types.yaml#/definitions/phandle
    description:
      phandle to the peer hub on the controller.

  i2c-bus:
    $ref: /schemas/types.yaml#/definitions/phandle
    description:
      phandle of an usb hub connected via i2c bus.

required:
  - compatible
  - reg

allOf:
  - if:
      properties:
        compatible:
          contains:
            const: microchip,usb5744
    then:
      properties:
        reset-gpios: false
        vdd-supply: false
        peer-hub: false
        i2c-bus: false
    else:
      $ref: /schemas/usb/usb-device.yaml
      required:
        - peer-hub

additionalProperties: false

examples:
  - |
    #include <dt-bindings/gpio/gpio.h>
    i2c: i2c {
        #address-cells = <1>;
        #size-cells = <0>;
        hub: usb-hub@2d {
            compatible = "microchip,usb5744";
            reg = <0x2d>;
        };
    };

    usb {
        #address-cells = <1>;
        #size-cells = <0>;

        /* 2.0 hub on port 1 */
        hub_2_0: hub@1 {
            compatible = "usb424,2744";
            reg = <1>;
            peer-hub = <&hub_3_0>;
            i2c-bus = <&hub>;
            reset-gpios = <&gpio 3 GPIO_ACTIVE_LOW>;
        };

        /* 3.0 hub on port 2 */
        hub_3_0: hub@2 {
            compatible = "usb424,5744";
            reg = <2>;
            peer-hub = <&hub_2_0>;
            i2c-bus = <&hub>;
            reset-gpios = <&gpio 3 GPIO_ACTIVE_LOW>;
        };
    };
```

## Documentation/devicetree/bindings/usb/msm-hsusb.txt
```
MSM SoC HSUSB controllers

EHCI

Required properties:
- compatible:	Should contain "qcom,ehci-host"
- regs:			offset and length of the register set in the memory map
- usb-phy:		phandle for the PHY device

Example EHCI controller device node:

	ehci: ehci@f9a55000 {
		compatible = "qcom,ehci-host";
		reg = <0xf9a55000 0x400>;
		usb-phy = <&usb_otg>;
	};

USB PHY with optional OTG:

Required properties:
- compatible:   Should contain:
  "qcom,usb-otg-ci" for chipsets with ChipIdea 45nm PHY
  "qcom,usb-otg-snps" for chipsets with Synopsys 28nm PHY

- regs:         Offset and length of the register set in the memory map
- interrupts:   interrupt-specifier for the OTG interrupt.

- clocks:       A list of phandle + clock-specifier pairs for the
                clocks listed in clock-names
- clock-names:  Should contain the following:
  "phy"         USB PHY reference clock
  "core"        Protocol engine clock
  "iface"       Interface bus clock
  "alt_core"    Protocol engine clock for targets with asynchronous
                reset methodology. (optional)

- vdccx-supply: phandle to the regulator for the vdd supply for
                digital circuit operation.
- v1p8-supply:  phandle to the regulator for the 1.8V supply
- v3p3-supply:  phandle to the regulator for the 3.3V supply

- resets:       A list of phandle + reset-specifier pairs for the
                resets listed in reset-names
- reset-names:  Should contain the following:
  "phy"         USB PHY controller reset
  "link"        USB LINK controller reset

- qcom,otg-control: OTG control (VBUS and ID notifications) can be one of
                1 - PHY control
                2 - PMIC control

Optional properties:
- dr_mode:      One of "host", "peripheral" or "otg". Defaults to "otg"

- switch-gpio:  A phandle + gpio-specifier pair. Some boards are using Dual
                SPDT USB Switch, witch is cotrolled by GPIO to de/multiplex
                D+/D- USB lines between connectors.

- qcom,phy-init-sequence: PHY configuration sequence values. This is related to Device
                Mode Eye Diagram test. Start address at which these values will be
                written is ULPI_EXT_VENDOR_SPECIFIC. Value of -1 is reserved as
                "do not overwrite default value at this address".
                For example: qcom,phy-init-sequence = < -1 0x63 >;
                Will update only value at address ULPI_EXT_VENDOR_SPECIFIC + 1.

- qcom,phy-num: Select number of pyco-phy to use, can be one of
                0 - PHY one, default
                1 - Second PHY
                Some platforms may have configuration to allow USB
                controller work with any of the two HSPHYs present.

- qcom,vdd-levels: This property must be a list of three integer values
                (no, min, max) where each value represents either a voltage
                in microvolts or a value corresponding to voltage corner.

- qcom,manual-pullup: If present, vbus is not routed to USB controller/phy
                and controller driver therefore enables pull-up explicitly
                before starting controller using usbcmd run/stop bit.

- extcon:       phandles to external connector devices. First phandle
                should point to external connector, which provide "USB"
                cable events, the second should point to external connector
                device, which provide "USB-HOST" cable events. If one of
                the external connector devices is not required empty <0>
                phandle should be specified.

Example HSUSB OTG controller device node:

    usb@f9a55000 {
        compatible = "qcom,usb-otg-snps";
        reg = <0xf9a55000 0x400>;
        interrupts = <0 134 0>;
        dr_mode = "peripheral";

        clocks = <&gcc GCC_XO_CLK>, <&gcc GCC_USB_HS_SYSTEM_CLK>,
                <&gcc GCC_USB_HS_AHB_CLK>;

        clock-names = "phy", "core", "iface";

        vddcx-supply = <&pm8841_s2_corner>;
        v1p8-supply = <&pm8941_l6>;
        v3p3-supply = <&pm8941_l24>;

        resets = <&gcc GCC_USB2A_PHY_BCR>, <&gcc GCC_USB_HS_BCR>;
        reset-names = "phy", "link";

        qcom,otg-control = <1>;
        qcom,phy-init-sequence = < -1 0x63 >;
        qcom,vdd-levels = <1 5 7>;
	};
```
