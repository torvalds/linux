## Documentation/devicetree/bindings/usb/octeon-usb.txt
```
OCTEON/OCTEON+ USB BLOCK

1) Main node

   Required properties:

   - compatible: must be "cavium,octeon-5750-usbn"

   - reg: specifies the physical base address of the USBN block and
     the length of the memory mapped region.

   - #address-cells: specifies the number of cells needed to encode an
     address. The value must be 2.

   - #size-cells: specifies the number of cells used to represent the size
     of an address. The value must be 2.

   - ranges: specifies the translation between child address space and parent
     address space.

   - clock-frequency: speed of the USB reference clock. Allowed values are
     12000000, 24000000 or 48000000.

   - cavium,refclk-type: type of the USB reference clock. Allowed values are
     "crystal" or "external".

   - refclk-frequency: deprecated, use "clock-frequency".

   - refclk-type: deprecated, use "cavium,refclk-type".

2) Child node

   The main node must have one child node which describes the built-in
   USB controller.

   Required properties:

   - compatible: must be "cavium,octeon-5750-usbc"

   - reg: specifies the physical base address of the USBC block and
     the length of the memory mapped region.

   - interrupts: specifies the interrupt number for the USB controller.

3) Example:

	usbn: usbn@1180068000000 {
		compatible = "cavium,octeon-5750-usbn";
		reg = <0x11800 0x68000000 0x0 0x1000>;
		ranges; /* Direct mapping */
		#address-cells = <2>;
		#size-cells = <2>;
		clock-frequency = <12000000>;
		cavium,refclk-type = "crystal";

		usbc@16f0010000000 {
			compatible = "cavium,octeon-5750-usbc";
			reg = <0x16f00 0x10000000 0x0 0x80000>;
			interrupts = <0 56>;
		};
	};
```

## Documentation/devicetree/bindings/usb/ohci-da8xx.txt
```
DA8XX USB OHCI controller

Required properties:

 - compatible: Should be "ti,da830-ohci"
 - reg:        Should contain one register range i.e. start and length
 - interrupts: Description of the interrupt line
 - phys:       Phandle for the PHY device
 - phy-names:  Should be "usb-phy"

Optional properties:
 - vbus-supply: phandle of regulator that controls vbus power / over-current

Example:

ohci: usb@0225000 {
        compatible = "ti,da830-ohci";
        reg = <0x225000 0x1000>;
        interrupts = <59>;
        phys = <&usb_phy 1>;
        phy-names = "usb-phy";
        vbus-supply = <&reg_usb_ohci>;
};
```
