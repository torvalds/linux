## Documentation/devicetree/bindings/usb/nvidia,tegra234-xusb.yaml
```yaml
# SPDX-License-Identifier: (GPL-2.0-only OR BSD-2-Clause)
%YAML 1.2
---
$id: http://devicetree.org/schemas/usb/nvidia,tegra234-xusb.yaml#
$schema: http://devicetree.org/meta-schemas/core.yaml#

title: NVIDIA Tegra234 xHCI controller

maintainers:
  - Thierry Reding <thierry.reding@gmail.com>
  - Jon Hunter <jonathanh@nvidia.com>

description: |
  The Tegra xHCI controller supports both USB2 and USB3 interfaces exposed by
  the Tegra XUSB pad controller. The xHCI controller controls up to eight
  ports; there are four USB 2.0 ports and four USB 3.2 Gen1 x1 ports.

properties:
  compatible:
    const: nvidia,tegra234-xusb

  reg:
    items:
      - description: xHCI host registers
      - description: XUSB FPCI registers
      - description: XUSB bar2 registers

  reg-names:
    items:
      - const: hcd
      - const: fpci
      - const: bar2

  interrupts:
    minItems: 2
    items:
      - description: xHCI host interrupt
      - description: mailbox interrupt
      - description: USB wake event 0
      - description: USB wake event 1
      - description: USB wake event 2
      - description: USB wake event 3
      - description: USB wake event 4
      - description: USB wake event 5
      - description: USB wake event 6
    description: |
      The first two interrupts are required for the USB host controller. The
      remaining USB wake event interrupts are optional. Each USB wake event is
      independent; it is not necessary to use all of these events on a
      platform. The USB host controller can function even if no wake-up events
      are defined. The USB wake event interrupts are handled by the Tegra PMC;
      hence, the interrupt controller for these is the PMC and the interrupt
      IDs correspond to the PMC wake event IDs. A complete list of wake event
      IDs is provided below, and this information is also present in the Tegra
      TRM document.

        PMC wake-up 76 for USB3 port 0 wakeup
        PMC wake-up 77 for USB3 port 1 wakeup
        PMC wake-up 78 for USB3 port 2 and port 3 wakeup
        PMC wake-up 79 for USB2 port 0 wakeup
        PMC wake-up 80 for USB2 port 1 wakeup
        PMC wake-up 81 for USB2 port 2 wakeup
        PMC wake-up 82 for USB2 port 3 wakeup

  clocks:
    items:
      - description: XUSB host clock
      - description: XUSB Falcon source clock
      - description: XUSB SuperSpeed clock
      - description: XUSB SuperSpeed source clock
      - description: XUSB HighSpeed clock source
      - description: XUSB FullSpeed clock source
      - description: USB PLL
      - description: reference clock
      - description: I/O PLL

  clock-names:
    items:
      - const: xusb_host
      - const: xusb_falcon_src
      - const: xusb_ss
      - const: xusb_ss_src
      - const: xusb_hs_src
      - const: xusb_fs_src
      - const: pll_u_480m
      - const: clk_m
      - const: pll_e

  interconnects:
    items:
      - description: read client
      - description: write client

  interconnect-names:
    items:
      - const: dma-mem # read
      - const: write

  iommus:
    maxItems: 1

  nvidia,xusb-padctl:
    $ref: /schemas/types.yaml#/definitions/phandle
    description: phandle to the XUSB pad controller that is used to configure
      the USB pads used by the XHCI controller

  phys:
    minItems: 1
    maxItems: 8

  phy-names:
    minItems: 1
    maxItems: 8
    items:
      enum:
        - usb2-0
        - usb2-1
        - usb2-2
        - usb2-3
        - usb3-0
        - usb3-1
        - usb3-2
        - usb3-3

  power-domains:
    items:
      - description: XUSBC power domain (for Host and USB 2.0)
      - description: XUSBA power domain (for SuperSpeed)

  power-domain-names:
    items:
      - const: xusb_host
      - const: xusb_ss

  dma-coherent: true

allOf:
  - $ref: usb-xhci.yaml

unevaluatedProperties: false

examples:
  - |
    #include <dt-bindings/clock/tegra234-clock.h>
    #include <dt-bindings/interrupt-controller/arm-gic.h>
    #include <dt-bindings/memory/tegra234-mc.h>
    #include <dt-bindings/power/tegra234-powergate.h>

    usb@3610000 {
        compatible = "nvidia,tegra234-xusb";
        reg = <0x03610000 0x40000>,
              <0x03600000 0x10000>,
              <0x03650000 0x10000>;
        reg-names = "hcd", "fpci", "bar2";

        interrupts-extended = <&gic GIC_SPI 163 IRQ_TYPE_LEVEL_HIGH>,
                              <&gic GIC_SPI 164 IRQ_TYPE_LEVEL_HIGH>,
                              <&pmc 76 IRQ_TYPE_LEVEL_HIGH>;

        clocks = <&bpmp TEGRA234_CLK_XUSB_CORE_HOST>,
                 <&bpmp TEGRA234_CLK_XUSB_FALCON>,
                 <&bpmp TEGRA234_CLK_XUSB_CORE_SS>,
                 <&bpmp TEGRA234_CLK_XUSB_SS>,
                 <&bpmp TEGRA234_CLK_CLK_M>,
                 <&bpmp TEGRA234_CLK_XUSB_FS>,
                 <&bpmp TEGRA234_CLK_UTMIP_PLL>,
                 <&bpmp TEGRA234_CLK_CLK_M>,
                 <&bpmp TEGRA234_CLK_PLLE>;
        clock-names = "xusb_host", "xusb_falcon_src",
                      "xusb_ss", "xusb_ss_src", "xusb_hs_src",
                      "xusb_fs_src", "pll_u_480m", "clk_m",
                      "pll_e";
        interconnects = <&mc TEGRA234_MEMORY_CLIENT_XUSB_HOSTR &emc>,
                        <&mc TEGRA234_MEMORY_CLIENT_XUSB_HOSTW &emc>;
        interconnect-names = "dma-mem", "write";
        iommus = <&smmu_niso1 TEGRA234_SID_XUSB_HOST>;

        power-domains = <&bpmp TEGRA234_POWER_DOMAIN_XUSBC>,
                        <&bpmp TEGRA234_POWER_DOMAIN_XUSBA>;
        power-domain-names = "xusb_host", "xusb_ss";

        nvidia,xusb-padctl = <&xusb_padctl>;

        phys = <&pad_lanes_usb2_0>;
        phy-names = "usb2-0";
    };
```

## Documentation/devicetree/bindings/usb/nxp,imx-dwc3.yaml
```yaml
# SPDX-License-Identifier: (GPL-2.0-only OR BSD-2-Clause)
# Copyright 2026 NXP
%YAML 1.2
---
$id: http://devicetree.org/schemas/usb/nxp,imx-dwc3.yaml#
$schema: http://devicetree.org/meta-schemas/core.yaml#

title: NXP i.MX Soc USB Controller

maintainers:
  - Xu Yang <xu.yang_2@nxp.com>

properties:
  compatible:
    oneOf:
      - items:
          - enum:
              - nxp,imx94-dwc3
              - nxp,imx95-dwc3
          - const: nxp,imx8mp-dwc3
      - const: nxp,imx8mp-dwc3

  reg:
    items:
      - description: DWC3 core registers
      - description: HSIO Block Control registers
      - description: Wrapper registers of dwc3 core

  reg-names:
    items:
      - const: core
      - const: blkctl
      - const: glue

  interrupts:
    items:
      - description: DWC3 controller interrupt
      - description: Wakeup interrupt from glue logic

  interrupt-names:
    items:
      - const: dwc_usb3
      - const: wakeup

  iommus:
    maxItems: 1

  clocks:
    items:
      - description: System hsio root clock
      - description: SoC Bus Clock for AHB/AXI/Native
      - description: Reference clock for generating ITP when UTMI/ULPI PHY is suspended
      - description: Suspend clock used for usb wakeup logic

  clock-names:
    items:
      - const: hsio
      - const: bus_early
      - const: ref
      - const: suspend

  fsl,permanently-attached:
    type: boolean
    description:
      Indicates if the device attached to a downstream port is
      permanently attached

  fsl,disable-port-power-control:
    type: boolean
    description:
      Indicates whether the host controller implementation includes port
      power control. Defines Bit 3 in capability register (HCCPARAMS)

  fsl,over-current-active-low:
    type: boolean
    description:
      Over current signal polarity is active low

  fsl,power-active-low:
    type: boolean
    description:
      Power pad (PWR) polarity is active low

  power-domains:
    maxItems: 1

required:
  - compatible
  - reg
  - clocks
  - clock-names
  - interrupts
  - power-domains

allOf:
  - $ref: snps,dwc3-common.yaml#

unevaluatedProperties: false

examples:
  - |
    #include <dt-bindings/interrupt-controller/arm-gic.h>

    usb@4c100000 {
      compatible = "nxp,imx94-dwc3", "nxp,imx8mp-dwc3";
      reg = <0x4c100000 0x10000>,
            <0x4c010010 0x04>,
            <0x4c1f0000 0x20>;
      reg-names = "core", "blkctl", "glue";
      clocks = <&scmi_clk 74>,    //IMX94_CLK_HSIO
               <&scmi_clk 74>,    //IMX94_CLK_HSIO
               <&scmi_clk 2>,     //IMX94_CLK_24M
               <&scmi_clk 1>;     //IMX94_CLK_32K
      clock-names = "hsio", "bus_early", "ref", "suspend";
      interrupts = <GIC_SPI 180 IRQ_TYPE_LEVEL_HIGH>,
                   <GIC_SPI 386 IRQ_TYPE_LEVEL_HIGH>;
      interrupt-names = "dwc_usb3", "wakeup";
      power-domains = <&scmi_devpd 13>;   //IMX94_PD_HSIO_TOP
      phys = <&usb3_phy>, <&usb3_phy>;
      phy-names = "usb2-phy", "usb3-phy";
      snps,gfladj-refclk-lpm-sel-quirk;
      snps,parkmode-disable-ss-quirk;
    };
```

## Documentation/devicetree/bindings/usb/nxp,isp1760.yaml
```yaml
# SPDX-License-Identifier: (GPL-2.0-only OR BSD-2-Clause)
%YAML 1.2
---
$id: http://devicetree.org/schemas/usb/nxp,isp1760.yaml#
$schema: http://devicetree.org/meta-schemas/core.yaml#

title: NXP ISP1760 family controller

maintainers:
  - Sebastian Siewior <bigeasy@linutronix.de>
  - Laurent Pinchart <laurent.pinchart@ideasonboard.com>

description: |
  NXP ISP1760 family, which includes ISP1760/1761/1763 devicetree controller
  bindings

properties:
  compatible:
    enum:
      - nxp,usb-isp1760
      - nxp,usb-isp1761
      - nxp,usb-isp1763
  reg:
    maxItems: 1

  interrupts:
    minItems: 1
    items:
      - description: Host controller interrupt
      - description: Device controller interrupt in isp1761

  interrupt-names:
    minItems: 1
    items:
      - const: host
      - const: peripheral

  bus-width:
    description:
      Number of data lines.
    enum: [8, 16, 32]
    default: 32

  dr_mode:
    enum:
      - host
      - peripheral

required:
  - compatible
  - reg
  - interrupts

additionalProperties: false

examples:
  - |
    #include <dt-bindings/interrupt-controller/arm-gic.h>
    usb@40200000 {
        compatible = "nxp,usb-isp1763";
        reg = <0x40200000 0x100000>;
        interrupts = <GIC_SPI 114 IRQ_TYPE_LEVEL_HIGH>;
        bus-width = <16>;
        dr_mode = "host";
    };

...
```

## Documentation/devicetree/bindings/usb/nxp,lpc3220-udc.yaml
```yaml
# SPDX-License-Identifier: (GPL-2.0-only OR BSD-2-Clause)
%YAML 1.2
---
$id: http://devicetree.org/schemas/usb/nxp,lpc3220-udc.yaml#
$schema: http://devicetree.org/meta-schemas/core.yaml#

title: NXP LPC32xx SoC USB Device Controller (UDC)

maintainers:
  - Frank Li <Frank.Li@nxp.com>

properties:
  compatible:
    const: nxp,lpc3220-udc

  reg:
    maxItems: 1

  interrupts:
    items:
      - description: USB Device Low Priority Interrupt
      - description: USB Device High Priority Interrupt
      - description: USB Device DMA Interrupt
      - description: External USB Transceiver Interrupt (OTG ATX)

  clocks:
    maxItems: 1

  transceiver:
    description:
      phandle of the associated ISP1301 device - this is necessary for
      the UDC controller for connecting to the USB physical layer

required:
  - compatible
  - reg
  - interrupts
  - transceiver

additionalProperties: false

examples:
  - |
    usbd@31020000 {
        compatible = "nxp,lpc3220-udc";
        reg = <0x31020000 0x300>;
        interrupt-parent = <&mic>;
        interrupts = <0x3d 0>, <0x3e 0>, <0x3c 0>, <0x3a 0>;
        transceiver = <&isp1301>;
    };
```

## Documentation/devicetree/bindings/usb/nxp,ptn36502.yaml
```yaml
# SPDX-License-Identifier: GPL-2.0-only OR BSD-2-Clause
%YAML 1.2
---
$id: http://devicetree.org/schemas/usb/nxp,ptn36502.yaml#
$schema: http://devicetree.org/meta-schemas/core.yaml#

title: NXP PTN36502 Type-C USB 3.1 Gen 1 and DisplayPort v1.2 combo redriver

maintainers:
  - Luca Weiss <luca.weiss@fairphone.com>

properties:
  compatible:
    enum:
      - nxp,ptn36502

  reg:
    maxItems: 1

  vdd18-supply:
    description: Power supply for VDD18 pin

  orientation-switch: true
  retimer-switch: true

  ports:
    $ref: /schemas/graph.yaml#/properties/ports
    properties:
      port@0:
        $ref: /schemas/graph.yaml#/properties/port
        description: Super Speed (SS) Output endpoint to the Type-C connector

      port@1:
        $ref: /schemas/graph.yaml#/properties/port
        description: Super Speed (SS) Input endpoint from the Super-Speed PHY

      port@2:
        $ref: /schemas/graph.yaml#/properties/port
        description:
          Sideband Use (SBU) AUX lines endpoint to the Type-C connector for the purpose of
          handling altmode muxing and orientation switching.

required:
  - compatible
  - reg

allOf:
  - $ref: usb-switch.yaml#

additionalProperties: false

examples:
  - |
    i2c {
        #address-cells = <1>;
        #size-cells = <0>;

        typec-mux@1a {
            compatible = "nxp,ptn36502";
            reg = <0x1a>;

            vdd18-supply = <&usb_redrive_1v8>;

            retimer-switch;
            orientation-switch;

            ports {
                #address-cells = <1>;
                #size-cells = <0>;

                port@0 {
                    reg = <0>;
                    usb_con_ss: endpoint {
                        remote-endpoint = <&typec_con_ss>;
                    };
                };
                port@1 {
                    reg = <1>;
                    phy_con_ss: endpoint {
                        remote-endpoint = <&usb_phy_ss>;
                    };
                };
                port@2 {
                    reg = <2>;
                    usb_con_sbu: endpoint {
                        remote-endpoint = <&typec_dp_aux>;
                    };
                };
            };
        };
    };
...
```

## Documentation/devicetree/bindings/usb/nxp,ptn5110.yaml
```yaml
# SPDX-License-Identifier: (GPL-2.0 OR BSD-2-Clause)
%YAML 1.2
---
$id: http://devicetree.org/schemas/usb/nxp,ptn5110.yaml#
$schema: http://devicetree.org/meta-schemas/core.yaml#

title: NXP PTN5110 Type-C Port Controller

maintainers:
  - Li Jun <jun.li@nxp.com>

properties:
  compatible:
    const: nxp,ptn5110

  reg:
    maxItems: 1

  interrupts:
    maxItems: 1

  connector:
    type: object
    $ref: /schemas/connector/usb-connector.yaml#
    unevaluatedProperties: false

required:
  - compatible
  - reg
  - interrupts
  - connector

additionalProperties: false

examples:
  - |
    #include <dt-bindings/interrupt-controller/arm-gic.h>
    #include <dt-bindings/usb/pd.h>
    i2c {
        #address-cells = <1>;
        #size-cells = <0>;

        tcpci@50 {
            compatible = "nxp,ptn5110";
            reg = <0x50>;
            interrupt-parent = <&gpio3>;
            interrupts = <3 IRQ_TYPE_LEVEL_LOW>;

            usb_con: connector {
                compatible = "usb-c-connector";
                label = "USB-C";
                data-role = "dual";
                power-role = "dual";
                try-power-role = "sink";
                source-pdos = <PDO_FIXED(5000, 2000, PDO_FIXED_USB_COMM)>;
                sink-pdos = <PDO_FIXED(5000, 2000, PDO_FIXED_USB_COMM) PDO_VAR(5000, 12000, 2000)>;
                op-sink-microwatt = <10000000>;

                ports {
                    #address-cells = <1>;
                    #size-cells = <0>;

                    port@0 {
                       reg = <0>;
                       typec1_dr_sw: endpoint {
                           remote-endpoint = <&usb1_drd_sw>;
                       };
                    };
                };
            };
        };
    };
```
