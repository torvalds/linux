## Documentation/devicetree/bindings/usb/mt8173-mtu3.txt
```
The device node for Mediatek USB3.0 DRD controller

Required properties:
 - compatible : should be "mediatek,mt8173-mtu3"
 - reg : specifies physical base address and size of the registers
 - reg-names: should be "mac" for device IP and "ippc" for IP port control
 - interrupts : interrupt used by the device IP
 - power-domains : a phandle to USB power domain node to control USB's
	mtcmos
 - vusb33-supply : regulator of USB avdd3.3v
 - clocks : a list of phandle + clock-specifier pairs, one for each
	entry in clock-names
 - clock-names : must contain "sys_ck" and "ref_ck" for clock of controller;
	"wakeup_deb_p0" and "wakeup_deb_p1" are optional, they are
	depends on "mediatek,enable-wakeup"
 - phys : a list of phandle + phy specifier pairs
 - dr_mode : should be one of "host", "peripheral" or "otg",
	refer to usb/generic.txt

Optional properties:
 - #address-cells, #size-cells : should be '2' if the device has sub-nodes
	with 'reg' property
 - ranges : allows valid 1:1 translation between child's address space and
	parent's address space
 - extcon : external connector for vbus and idpin changes detection, needed
	when supports dual-role mode.
 - vbus-supply : reference to the VBUS regulator, needed when supports
	dual-role mode.
 - pinctl-names : a pinctrl state named "default" must be defined,
	"id_float" and "id_ground" are optinal which depends on
	"mediatek,enable-manual-drd"
 - pinctrl-0 : pin control group
	See: Documentation/devicetree/bindings/pinctrl/pinctrl-bindings.txt

 - maximum-speed : valid arguments are "super-speed", "high-speed" and
	"full-speed"; refer to usb/generic.txt
 - enable-manual-drd : supports manual dual-role switch via debugfs; usually
	used when receptacle is TYPE-A and also wants to support dual-role
	mode.
 - mediatek,enable-wakeup : supports ip sleep wakeup used by host mode
 - mediatek,syscon-wakeup : phandle to syscon used to access USB wakeup
	control register, it depends on "mediatek,enable-wakeup".

Sub-nodes:
The xhci should be added as subnode to mtu3 as shown in the following example
if host mode is enabled. The DT binding details of xhci can be found in:
Documentation/devicetree/bindings/usb/mt8173-xhci.txt

Example:
ssusb: usb@11271000 {
	compatible = "mediatek,mt8173-mtu3";
	reg = <0 0x11271000 0 0x3000>,
	      <0 0x11280700 0 0x0100>;
	reg-names = "mac", "ippc";
	interrupts = <GIC_SPI 64 IRQ_TYPE_LEVEL_LOW>;
	phys = <&phy_port0 PHY_TYPE_USB3>,
	       <&phy_port1 PHY_TYPE_USB2>;
	power-domains = <&scpsys MT8173_POWER_DOMAIN_USB>;
	clocks = <&topckgen CLK_TOP_USB30_SEL>, <&clk26m>,
		 <&pericfg CLK_PERI_USB0>,
		 <&pericfg CLK_PERI_USB1>;
	clock-names = "sys_ck", "ref_ck",
		      "wakeup_deb_p0",
		      "wakeup_deb_p1";
	vusb33-supply = <&mt6397_vusb_reg>;
	vbus-supply = <&usb_p0_vbus>;
	extcon = <&extcon_usb>;
	dr_mode = "otg";
	mediatek,enable-wakeup;
	mediatek,syscon-wakeup = <&pericfg>;
	#address-cells = <2>;
	#size-cells = <2>;
	ranges;
	status = "disabled";

	usb_host: xhci@11270000 {
		compatible = "mediatek,mt8173-xhci";
		reg = <0 0x11270000 0 0x1000>;
		reg-names = "mac";
		interrupts = <GIC_SPI 115 IRQ_TYPE_LEVEL_LOW>;
		power-domains = <&scpsys MT8173_POWER_DOMAIN_USB>;
		clocks = <&topckgen CLK_TOP_USB30_SEL>, <&clk26m>;
		clock-names = "sys_ck", "ref_ck";
		vusb33-supply = <&mt6397_vusb_reg>;
		status = "disabled";
	};
};
```

## Documentation/devicetree/bindings/usb/mt8173-xhci.txt
```
MT8173 xHCI

The device node for Mediatek SOC USB3.0 host controller

Required properties:
 - compatible : should contain "mediatek,mt8173-xhci"
 - reg : specifies physical base address and size of the registers,
	the first one for MAC, the second for IPPC
 - interrupts : interrupt used by the controller
 - power-domains : a phandle to USB power domain node to control USB's
	mtcmos
 - vusb33-supply : regulator of USB avdd3.3v

 - clocks : a list of phandle + clock-specifier pairs, one for each
	entry in clock-names
 - clock-names : must contain
	"sys_ck": for clock of xHCI MAC
	"wakeup_deb_p0": for USB wakeup debounce clock of port0
	"wakeup_deb_p1": for USB wakeup debounce clock of port1

 - phys : a list of phandle + phy specifier pairs

Optional properties:
 - mediatek,wakeup-src : 1: ip sleep wakeup mode; 2: line state wakeup
	mode;
 - mediatek,syscon-wakeup : phandle to syscon used to access USB wakeup
	control register, it depends on "mediatek,wakeup-src".
 - vbus-supply : reference to the VBUS regulator;
 - usb3-lpm-capable : supports USB3.0 LPM

Example:
usb30: usb@11270000 {
	compatible = "mediatek,mt8173-xhci";
	reg = <0 0x11270000 0 0x1000>,
	      <0 0x11280700 0 0x0100>;
	interrupts = <GIC_SPI 115 IRQ_TYPE_LEVEL_LOW>;
	power-domains = <&scpsys MT8173_POWER_DOMAIN_USB>;
	clocks = <&topckgen CLK_TOP_USB30_SEL>,
		 <&pericfg CLK_PERI_USB0>,
		 <&pericfg CLK_PERI_USB1>;
	clock-names = "sys_ck",
		      "wakeup_deb_p0",
		      "wakeup_deb_p1";
	phys = <&phy_port0 PHY_TYPE_USB3>,
	       <&phy_port1 PHY_TYPE_USB2>;
	vusb33-supply = <&mt6397_vusb_reg>;
	vbus-supply = <&usb_p1_vbus>;
	usb3-lpm-capable;
	mediatek,syscon-wakeup = <&pericfg>;
	mediatek,wakeup-src = <1>;
};
```

## Documentation/devicetree/bindings/usb/mxs-phy.txt
```
* Freescale MXS USB Phy Device

Required properties:
- compatible: should contain:
	* "fsl,imx23-usbphy" for imx23 and imx28
	* "fsl,imx6q-usbphy" for imx6dq and imx6dl
	* "fsl,imx6sl-usbphy" for imx6sl
	* "fsl,vf610-usbphy" for Vybrid vf610
	* "fsl,imx6sx-usbphy" for imx6sx
	* "fsl,imx6ul-usbphy" for imx6ul
  "fsl,imx23-usbphy" is still a fallback for other strings
- reg: Should contain registers location and length
- interrupts: Should contain phy interrupt
- fsl,anatop: phandle for anatop register, it is only for imx6 SoC series

Optional properties:
- tx-d-cal: Try to adjust this value to improve signal quality, and pass
  USB Certification, the value is from 0x0 to 0xf, and the register offset
  is 0x10 (USBPHY_TX).

Example:
usbphy1: usbphy@020c9000 {
	compatible = "fsl,imx6q-usbphy", "fsl,imx23-usbphy";
	reg = <0x020c9000 0x1000>;
	interrupts = <0 44 0x04>;
	fsl,anatop = <&anatop>;
	tx-d-cal = <0x5>;
};
```

## Documentation/devicetree/bindings/usb/npcm7xx-usb.txt
```
Nuvoton NPCM7XX SoC USB controllers:
-----------------------------

EHCI:
-----

Required properties:
- compatible: should be one of
    "nuvoton,npcm750-ehci"
    "nuvoton,npcm845-ehci"
- interrupts: Should contain the EHCI interrupt
- reg:        Physical address and length of the register set for the device

Example:

	ehci1: usb@f0806000 {
		compatible = "nuvoton,npcm750-ehci";
		reg = <0xf0806000 0x1000>;
		interrupts = <0 61 4>;
	};
```

## Documentation/devicetree/bindings/usb/nvidia,tegra-xudc.yaml
```yaml
# SPDX-License-Identifier: (GPL-2.0 OR BSD-2-Clause)
%YAML 1.2
---
$id: http://devicetree.org/schemas/usb/nvidia,tegra-xudc.yaml#
$schema: http://devicetree.org/meta-schemas/core.yaml#

title: NVIDIA Tegra XUSB device mode controller (XUDC)

description:
  The Tegra XUDC controller supports both USB 2.0 HighSpeed/FullSpeed and
  USB 3.0 SuperSpeed protocols.

maintainers:
  - Nagarjuna Kristam <nkristam@nvidia.com>
  - JC Kuo <jckuo@nvidia.com>
  - Thierry Reding <treding@nvidia.com>

properties:
  compatible:
    items:
      - enum:
          - nvidia,tegra210-xudc # For Tegra210
          - nvidia,tegra186-xudc # For Tegra186
          - nvidia,tegra194-xudc # For Tegra194
          - nvidia,tegra234-xudc # For Tegra234

  reg:
    minItems: 2
    items:
      - description: XUSB device controller registers
      - description: XUSB device PCI Config registers
      - description: XUSB device registers.

  reg-names:
    minItems: 2
    items:
      - const: base
      - const: fpci
      - const: ipfs

  interrupts:
    maxItems: 1
    description: Must contain the XUSB device interrupt.

  clocks:
    minItems: 4
    items:
      - description: Clock to enable core XUSB dev clock.
      - description: Clock to enable XUSB super speed clock.
      - description: Clock to enable XUSB super speed dev clock.
      - description: Clock to enable XUSB high speed dev clock.
      - description: Clock to enable XUSB full speed dev clock.

  clock-names:
    minItems: 4
    items:
      - const: dev
      - const: ss
      - const: ss_src
      - const: fs_src
      - const: hs_src

  interconnects:
    items:
      - description: memory read client
      - description: memory write client

  interconnect-names:
    items:
      - const: dma-mem # read
      - const: write

  iommus:
    maxItems: 1

  power-domains:
    items:
      - description: XUSBB(device) power-domain
      - description: XUSBA(superspeed) power-domain

  power-domain-names:
    items:
      - const: dev
      - const: ss

  nvidia,xusb-padctl:
    $ref: /schemas/types.yaml#/definitions/phandle
    description:
      phandle to the XUSB pad controller that is used to configure the USB pads
      used by the XUDC controller.

  phys:
    minItems: 1
    maxItems: 2
    description:
      Must contain an entry for each entry in phy-names.
      See ../phy/phy-bindings.txt for details.

  phy-names:
    minItems: 1
    items:
      - const: usb2-0
      - const: usb3-0

  avddio-usb-supply:
    description: PCIe/USB3 analog logic power supply. Must supply 1.05 V.

  hvdd-usb-supply:
    description: USB controller power supply. Must supply 3.3 V.

  dma-coherent: true

required:
  - compatible
  - reg
  - reg-names
  - interrupts
  - clocks
  - clock-names
  - power-domains
  - power-domain-names
  - nvidia,xusb-padctl
  - phys
  - phy-names

allOf:
  - if:
      properties:
        compatible:
          contains:
            enum:
              - nvidia,tegra210-xudc
    then:
      properties:
        reg:
          minItems: 3
        reg-names:
          minItems: 3
        clocks:
          minItems: 5
        clock-names:
          minItems: 5
      required:
        - avddio-usb-supply
        - hvdd-usb-supply

  - if:
      properties:
        compatible:
          contains:
            enum:
              - nvidia,tegra186-xudc
              - nvidia,tegra194-xudc
              - nvidia,tegra234-xudc
    then:
      properties:
        reg:
          maxItems: 2
        reg-names:
          maxItems: 2
        clocks:
          maxItems: 4
        clock-names:
          maxItems: 4

  - if:
      properties:
        compatible:
          contains:
            enum:
              - nvidia,tegra194-xudc
              - nvidia,tegra234-xudc
    then:
      required:
        - dma-coherent

additionalProperties: false

examples:
  - |
    #include <dt-bindings/clock/tegra210-car.h>
    #include <dt-bindings/gpio/tegra-gpio.h>
    #include <dt-bindings/interrupt-controller/arm-gic.h>

    usb@700d0000 {
        compatible = "nvidia,tegra210-xudc";
        reg = <0x700d0000 0x8000>,
              <0x700d8000 0x1000>,
              <0x700d9000 0x1000>;
        reg-names = "base", "fpci", "ipfs";

        interrupts = <GIC_SPI 44 IRQ_TYPE_LEVEL_HIGH>;

        clocks = <&tegra_car TEGRA210_CLK_XUSB_DEV>,
                 <&tegra_car TEGRA210_CLK_XUSB_SS>,
                 <&tegra_car TEGRA210_CLK_XUSB_SSP_SRC>,
                 <&tegra_car TEGRA210_CLK_XUSB_FS_SRC>,
                 <&tegra_car TEGRA210_CLK_XUSB_HS_SRC>;
        clock-names = "dev", "ss", "ss_src", "fs_src", "hs_src";

        power-domains = <&pd_xusbdev>, <&pd_xusbss>;
        power-domain-names = "dev", "ss";

        nvidia,xusb-padctl = <&padctl>;

        phys = <&micro_b>;
        phy-names = "usb2-0";

        avddio-usb-supply = <&vdd_pex_1v05>;
        hvdd-usb-supply = <&vdd_3v3_sys>;
    };
```
