## Documentation/devicetree/bindings/usb/nvidia,tegra186-xusb.yaml
```yaml
# SPDX-License-Identifier: (GPL-2.0-only OR BSD-2-Clause)
%YAML 1.2
---
$id: http://devicetree.org/schemas/usb/nvidia,tegra186-xusb.yaml#
$schema: http://devicetree.org/meta-schemas/core.yaml#

title: NVIDIA Tegra186 xHCI controller

maintainers:
  - Thierry Reding <thierry.reding@gmail.com>
  - Jon Hunter <jonathanh@nvidia.com>

description: The Tegra xHCI controller supports both USB2 and USB3 interfaces
  exposed by the Tegra XUSB pad controller.

properties:
  compatible:
    const: nvidia,tegra186-xusb

  reg:
    items:
      - description: base and length of the xHCI host registers
      - description: base and length of the XUSB FPCI registers

  reg-names:
    items:
      - const: hcd
      - const: fpci

  interrupts:
    items:
      - description: xHCI host interrupt
      - description: mailbox interrupt

  clocks:
    items:
      - description: XUSB host clock
      - description: XUSB Falcon source clock
      - description: XUSB SuperSpeed clock
      - description: XUSB SuperSpeed source clock
      - description: XUSB HighSpeed clock source
      - description: XUSB FullSpeed clock source
      - description: USB PLL
      - description: reference clock
      - description: I/O PLL

  clock-names:
    items:
      - const: xusb_host
      - const: xusb_falcon_src
      - const: xusb_ss
      - const: xusb_ss_src
      - const: xusb_hs_src
      - const: xusb_fs_src
      - const: pll_u_480m
      - const: clk_m
      - const: pll_e

  interconnects:
    items:
      - description: read client
      - description: write client

  interconnect-names:
    items:
      - const: dma-mem # read
      - const: write

  iommus:
    maxItems: 1

  nvidia,xusb-padctl:
    $ref: /schemas/types.yaml#/definitions/phandle
    description: phandle to the XUSB pad controller that is used to configure
      the USB pads used by the XHCI controller

  phys:
    minItems: 1
    maxItems: 7

  phy-names:
    minItems: 1
    maxItems: 7
    items:
      enum:
        - usb2-0
        - usb2-1
        - usb2-2
        - hsic-0
        - usb3-0
        - usb3-1
        - usb3-2

  power-domains:
    items:
      - description: XUSBC power domain (for Host and USB 2.0)
      - description: XUSBA power domain (for SuperSpeed)

  power-domain-names:
    items:
      - const: xusb_host
      - const: xusb_ss

  dvddio-pex-supply:
    description: PCIe/USB3 analog logic power supply. Must supply 1.05 V.

  hvddio-pex-supply:
    description: High-voltage PCIe/USB3 power supply. Must supply 1.8 V.

  avdd-usb-supply:
    description: USB controller power supply. Must supply 3.3 V.

  avdd-pll-utmip-supply:
    description: UTMI PLL power supply. Must supply 1.8 V.

  avdd-pll-uerefe-supply:
    description: PLLE reference PLL power supply. Must supply 1.05 V.

  dvdd-usb-ss-pll-supply:
    description: PCIe/USB3 PLL power supply. Must supply 1.05 V.

  hvdd-usb-ss-pll-e-supply:
    description: High-voltage PLLE power supply. Must supply 1.8 V.

allOf:
  - $ref: usb-xhci.yaml

unevaluatedProperties: false

examples:
  - |
    #include <dt-bindings/clock/tegra186-clock.h>
    #include <dt-bindings/interrupt-controller/arm-gic.h>
    #include <dt-bindings/memory/tegra186-mc.h>
    #include <dt-bindings/power/tegra186-powergate.h>
    #include <dt-bindings/reset/tegra186-reset.h>

    usb@3530000 {
        compatible = "nvidia,tegra186-xusb";
        reg = <0x03530000 0x8000>,
              <0x03538000 0x1000>;
        reg-names = "hcd", "fpci";
        interrupts = <GIC_SPI 163 IRQ_TYPE_LEVEL_HIGH>,
                     <GIC_SPI 164 IRQ_TYPE_LEVEL_HIGH>;
        clocks = <&bpmp TEGRA186_CLK_XUSB_HOST>,
                 <&bpmp TEGRA186_CLK_XUSB_FALCON>,
                 <&bpmp TEGRA186_CLK_XUSB_SS>,
                 <&bpmp TEGRA186_CLK_XUSB_CORE_SS>,
                 <&bpmp TEGRA186_CLK_CLK_M>,
                 <&bpmp TEGRA186_CLK_XUSB_FS>,
                 <&bpmp TEGRA186_CLK_PLLU>,
                 <&bpmp TEGRA186_CLK_CLK_M>,
                 <&bpmp TEGRA186_CLK_PLLE>;
        clock-names = "xusb_host", "xusb_falcon_src", "xusb_ss",
                      "xusb_ss_src", "xusb_hs_src", "xusb_fs_src",
                      "pll_u_480m", "clk_m", "pll_e";
        power-domains = <&bpmp TEGRA186_POWER_DOMAIN_XUSBC>,
                        <&bpmp TEGRA186_POWER_DOMAIN_XUSBA>;
        power-domain-names = "xusb_host", "xusb_ss";
        interconnects = <&mc TEGRA186_MEMORY_CLIENT_XUSB_HOSTR &emc>,
                        <&mc TEGRA186_MEMORY_CLIENT_XUSB_HOSTW &emc>;
        interconnect-names = "dma-mem", "write";
        iommus = <&smmu TEGRA186_SID_XUSB_HOST>;
        nvidia,xusb-padctl = <&padctl>;

        #address-cells = <1>;
        #size-cells = <0>;

        phys = <&phy_usb2_0>, <&phy_usb2_1>, <&phy_usb3_0>;
        phy-names = "usb2-0", "usb2-1", "usb3-0";
    };
```

## Documentation/devicetree/bindings/usb/nvidia,tegra20-ehci.txt
```
Tegra SOC USB controllers

The device node for a USB controller that is part of a Tegra
SOC is as described in the document "Open Firmware Recommended
Practice : Universal Serial Bus" with the following modifications
and additions :

Required properties :
 - compatible : For Tegra20, must contain "nvidia,tegra20-ehci".
   For Tegra30, must contain "nvidia,tegra30-ehci".  Otherwise, must contain
   "nvidia,<chip>-ehci" plus at least one of the above, where <chip> is
   tegra114, tegra124, tegra132, or tegra210.
 - nvidia,phy : phandle of the PHY that the controller is connected to.
 - clocks : Must contain one entry, for the module clock.
   See ../clocks/clock-bindings.txt for details.
 - resets : Must contain an entry for each entry in reset-names.
   See ../reset/reset.txt for details.
 - reset-names : Must include the following entries:
   - usb

Optional properties:
 - nvidia,needs-double-reset : boolean is to be set for some of the Tegra20
   USB ports, which need reset twice due to hardware issues.
```

## Documentation/devicetree/bindings/usb/nvidia,tegra20-usb-phy.txt
```
Tegra SOC USB PHY

The device node for Tegra SOC USB PHY:

Required properties :
 - compatible : Should be "nvidia,tegra<chip>-usb-phy".
 - reg : Defines the following set of registers, in the order listed:
   - The PHY's own register set.
     Always present.
   - The register set of the PHY containing the UTMI pad control registers.
     Present if-and-only-if phy_type == utmi.
 - phy_type : Should be one of "utmi", "ulpi" or "hsic".
 - clocks : Defines the clocks listed in the clock-names property.
 - clock-names : The following clock names must be present:
   - reg: The clock needed to access the PHY's own registers. This is the
     associated EHCI controller's clock. Always present.
   - pll_u: PLL_U. Always present.
   - timer: The timeout clock (clk_m). Present if phy_type == utmi.
   - utmi-pads: The clock needed to access the UTMI pad control registers.
     Present if phy_type == utmi.
   - ulpi-link: The clock Tegra provides to the ULPI PHY (cdev2).
     Present if phy_type == ulpi, and ULPI link mode is in use.
 - resets : Must contain an entry for each entry in reset-names.
   See ../reset/reset.txt for details.
 - reset-names : Must include the following entries:
   - usb: The PHY's own reset signal.
   - utmi-pads: The reset of the PHY containing the chip-wide UTMI pad control
     registers. Required even if phy_type == ulpi.

Required properties for phy_type == ulpi:
  - nvidia,phy-reset-gpio : The GPIO used to reset the PHY.

Required PHY timing params for utmi phy, for all chips:
  - nvidia,hssync-start-delay : Number of 480 Mhz clock cycles to wait before
    start of sync launches RxActive
  - nvidia,elastic-limit : Variable FIFO Depth of elastic input store
  - nvidia,idle-wait-delay : Number of 480 Mhz clock cycles of idle to wait
    before declare IDLE.
  - nvidia,term-range-adj : Range adjusment on terminations
  - Either one of the following for HS driver output control:
    - nvidia,xcvr-setup : integer, uses the provided value.
    - nvidia,xcvr-setup-use-fuses : boolean, indicates that the value is read
      from the on-chip fuses
    If both are provided, nvidia,xcvr-setup-use-fuses takes precedence.
  - nvidia,xcvr-lsfslew : LS falling slew rate control.
  - nvidia,xcvr-lsrslew :  LS rising slew rate control.

Required PHY timing params for utmi phy, only on Tegra30 and above:
  - nvidia,xcvr-hsslew : HS slew rate control.
  - nvidia,hssquelch-level : HS squelch detector level.
  - nvidia,hsdiscon-level : HS disconnect detector level.

Optional properties:
  - nvidia,has-legacy-mode : boolean indicates whether this controller can
    operate in legacy mode (as APX 2500 / 2600). In legacy mode some
    registers are accessed through the APB_MISC base address instead of
    the USB controller.
  - nvidia,is-wired : boolean. Indicates whether we can do certain kind of power
    optimizations for the devices that are always connected. e.g. modem.
  - dr_mode : dual role mode. Indicates the working mode for the PHY. Can be
    "host", "peripheral", or "otg". Defaults to "host" if not defined.
      host means this is a host controller
      peripheral means it is device controller
      otg means it can operate as either ("on the go")
  - nvidia,has-utmi-pad-registers : boolean indicates whether this controller
    contains the UTMI pad control registers common to all USB controllers.

VBUS control (required for dr_mode == otg, optional for dr_mode == host):
  - vbus-supply: regulator for VBUS
```

## Documentation/devicetree/bindings/usb/nvidia,tegra210-xusb.yaml
```yaml
# SPDX-License-Identifier: (GPL-2.0-only OR BSD-2-Clause)
%YAML 1.2
---
$id: http://devicetree.org/schemas/usb/nvidia,tegra210-xusb.yaml#
$schema: http://devicetree.org/meta-schemas/core.yaml#

title: NVIDIA Tegra210 xHCI controller

maintainers:
  - Thierry Reding <thierry.reding@gmail.com>
  - Jon Hunter <jonathanh@nvidia.com>

description: The Tegra xHCI controller supports both USB2 and USB3 interfaces
  exposed by the Tegra XUSB pad controller.

properties:
  compatible:
    const: nvidia,tegra210-xusb

  reg:
    items:
      - description: base and length of the xHCI host registers
      - description: base and length of the XUSB FPCI registers
      - description: base and length of the XUSB IPFS registers

  reg-names:
    items:
      - const: hcd
      - const: fpci
      - const: ipfs

  interrupts:
    items:
      - description: xHCI host interrupt
      - description: mailbox interrupt

  clocks:
    items:
      - description: XUSB host clock
      - description: XUSB host source clock
      - description: XUSB Falcon source clock
      - description: XUSB SuperSpeed clock
      - description: XUSB SuperSpeed clock divider
      - description: XUSB SuperSpeed source clock
      - description: XUSB HighSpeed clock source
      - description: XUSB FullSpeed clock source
      - description: USB PLL
      - description: reference clock
      - description: I/O PLL

  clock-names:
    items:
      - const: xusb_host
      - const: xusb_host_src
      - const: xusb_falcon_src
      - const: xusb_ss
      - const: xusb_ss_div2
      - const: xusb_ss_src
      - const: xusb_hs_src
      - const: xusb_fs_src
      - const: pll_u_480m
      - const: clk_m
      - const: pll_e

  resets:
    items:
      - description: reset for the XUSB host controller
      - description: reset for the SuperSpeed logic
      - description: shared reset for xusb_{ss,hs,fs,falcon,host}_src.

  reset-names:
    items:
      - const: xusb_host
      - const: xusb_ss
      - const: xusb_src

  nvidia,xusb-padctl:
    $ref: /schemas/types.yaml#/definitions/phandle
    description: phandle to the XUSB pad controller that is used to configure
      the USB pads used by the XHCI controller

  phys:
    minItems: 1
    maxItems: 9

  phy-names:
    minItems: 1
    maxItems: 9
    items:
      enum:
        - usb2-0
        - usb2-1
        - usb2-2
        - usb2-3
        - hsic-0
        - usb3-0
        - usb3-1
        - usb3-2
        - usb3-3

  power-domains:
    items:
      - description: XUSBC power domain (for Host and USB 2.0)
      - description: XUSBA power domain (for SuperSpeed)

  power-domain-names:
    items:
      - const: xusb_host
      - const: xusb_ss

  dvddio-pex-supply:
    description: PCIe/USB3 analog logic power supply. Must supply 1.05 V.

  hvddio-pex-supply:
    description: High-voltage PCIe/USB3 power supply. Must supply 1.8 V.

  avdd-usb-supply:
    description: USB controller power supply. Must supply 3.3 V.

  avdd-pll-utmip-supply:
    description: UTMI PLL power supply. Must supply 1.8 V.

  avdd-pll-uerefe-supply:
    description: PLLE reference PLL power supply. Must supply 1.05 V.

  dvdd-usb-ss-pll-supply:
    description: PCIe/USB3 PLL power supply. Must supply 1.05 V.

  hvdd-usb-ss-pll-e-supply:
    description: High-voltage PLLE power supply. Must supply 1.8 V.

allOf:
  - $ref: usb-xhci.yaml

unevaluatedProperties: false

examples:
  - |
    #include <dt-bindings/clock/tegra210-car.h>
    #include <dt-bindings/interrupt-controller/arm-gic.h>

    usb@70090000 {
        compatible = "nvidia,tegra210-xusb";
        reg = <0x70090000 0x8000>,
              <0x70098000 0x1000>,
              <0x70099000 0x1000>;
        reg-names = "hcd", "fpci", "ipfs";

        interrupts = <GIC_SPI 39 IRQ_TYPE_LEVEL_HIGH>,
                     <GIC_SPI 40 IRQ_TYPE_LEVEL_HIGH>;

        clocks = <&tegra_car TEGRA210_CLK_XUSB_HOST>,
                 <&tegra_car TEGRA210_CLK_XUSB_HOST_SRC>,
                 <&tegra_car TEGRA210_CLK_XUSB_FALCON_SRC>,
                 <&tegra_car TEGRA210_CLK_XUSB_SS>,
                 <&tegra_car TEGRA210_CLK_XUSB_SS_DIV2>,
                 <&tegra_car TEGRA210_CLK_XUSB_SS_SRC>,
                 <&tegra_car TEGRA210_CLK_XUSB_HS_SRC>,
                 <&tegra_car TEGRA210_CLK_XUSB_FS_SRC>,
                 <&tegra_car TEGRA210_CLK_PLL_U_480M>,
                 <&tegra_car TEGRA210_CLK_CLK_M>,
                 <&tegra_car TEGRA210_CLK_PLL_E>;
        clock-names = "xusb_host", "xusb_host_src",
                      "xusb_falcon_src", "xusb_ss",
                      "xusb_ss_div2", "xusb_ss_src",
                      "xusb_hs_src", "xusb_fs_src",
                      "pll_u_480m", "clk_m", "pll_e";
        resets = <&tegra_car 89>, <&tegra_car 156>,
                 <&tegra_car 143>;
        reset-names = "xusb_host", "xusb_ss", "xusb_src";
        power-domains = <&pd_xusbhost>, <&pd_xusbss>;
        power-domain-names = "xusb_host", "xusb_ss";

        nvidia,xusb-padctl = <&padctl>;

        phys = <&phy_usb2_0>, <&phy_usb2_1>, <&phy_usb2_2>, <&phy_usb2_3>,
               <&phy_pcie_6>, <&phy_pcie_5>;
        phy-names = "usb2-0", "usb2-1", "usb2-2", "usb2-3", "usb3-0",
                    "usb3-1";
        dvddio-pex-supply = <&vdd_pex_1v05>;
        hvddio-pex-supply = <&vdd_1v8>;
        avdd-usb-supply = <&vdd_3v3_sys>;
        avdd-pll-utmip-supply = <&vdd_1v8>;
        avdd-pll-uerefe-supply = <&vdd_pex_1v05>;
        dvdd-usb-ss-pll-supply = <&vdd_pex_1v05>;
        hvdd-usb-ss-pll-e-supply = <&vdd_1v8>;

        #address-cells = <1>;
        #size-cells = <0>;

        ethernet@1 {
                compatible = "usb955,9ff";
                reg = <1>;
        };
    };
```
