## Documentation/devicetree/bindings/usb/fcs,fsa4480.yaml
```yaml
# SPDX-License-Identifier: GPL-2.0-only OR BSD-2-Clause
%YAML 1.2
---
$id: http://devicetree.org/schemas/usb/fcs,fsa4480.yaml#
$schema: http://devicetree.org/meta-schemas/core.yaml#

title: ON Semiconductor Analog Audio Switch

maintainers:
  - Bjorn Andersson <bjorn.andersson@linaro.org>

properties:
  compatible:
    oneOf:
      - const: fcs,fsa4480
      - items:
          - enum:
              - ocs,ocp96011
          - const: fcs,fsa4480

  reg:
    maxItems: 1

  interrupts:
    maxItems: 1

  vcc-supply:
    description: power supply (2.7V-5.5V)

  mode-switch: true
  orientation-switch: true

  port:
    $ref: /schemas/graph.yaml#/$defs/port-base
    description:
      A port node to link the FSA4480 to a TypeC controller for the purpose of
      handling altmode muxing and orientation switching.
    unevaluatedProperties: false

    properties:
      endpoint:
        $ref: /schemas/graph.yaml#/$defs/endpoint-base
        unevaluatedProperties: false

        properties:
          data-lanes:
            $ref: /schemas/types.yaml#/definitions/uint32-array
            description:
              Specifies how the AUX+/- lines are connected to SBU1/2.
            oneOf:
              - items:
                  - const: 0
                  - const: 1
                description: |
                  Default AUX/SBU layout (FSA4480)
                  - AUX+ connected to SBU2
                  - AUX- connected to SBU1
                  Default AUX/SBU layout (OCP96011)
                  - AUX+ connected to SBU1
                  - AUX- connected to SBU2
              - items:
                  - const: 1
                  - const: 0
                description: |
                  Swapped AUX/SBU layout (FSA4480)
                  - AUX+ connected to SBU1
                  - AUX- connected to SBU2
                  Swapped AUX/SBU layout (OCP96011)
                  - AUX+ connected to SBU2
                  - AUX- connected to SBU1

required:
  - compatible
  - reg
  - port

allOf:
  - $ref: usb-switch.yaml#
  - $ref: usb-switch-ports.yaml#

additionalProperties: false

examples:
  - |
    #include <dt-bindings/interrupt-controller/irq.h>
    i2c13 {
        #address-cells = <1>;
        #size-cells = <0>;

        typec-mux@42 {
            compatible = "fcs,fsa4480";
            reg = <0x42>;

            interrupts-extended = <&tlmm 2 IRQ_TYPE_LEVEL_LOW>;

            vcc-supply = <&vreg_bob>;

            mode-switch;
            orientation-switch;

            port {
                fsa4480_ept: endpoint {
                    remote-endpoint = <&typec_controller>;
                };
            };
        };
    };
...
```

## Documentation/devicetree/bindings/usb/fcs,fusb302.txt
```
Fairchild FUSB302 Type-C Port controllers

Required properties :
- compatible             : "fcs,fusb302"
- reg                    : I2C slave address
- interrupts             : Interrupt specifier

Required sub-node:
- connector : The "usb-c-connector" attached to the FUSB302 IC. The bindings
  of the connector node are specified in:

	Documentation/devicetree/bindings/connector/usb-connector.txt


Example:

fusb302: typec-portc@54 {
	compatible = "fcs,fusb302";
	reg = <0x54>;
	interrupt-parent = <&nmi_intc>;
	interrupts = <0 IRQ_TYPE_LEVEL_LOW>;

	usb_con: connector {
		compatible = "usb-c-connector";
		label = "USB-C";
		power-role = "dual";
		try-power-role = "sink";
		source-pdos = <PDO_FIXED(5000, 3000, PDO_FIXED_USB_COMM)>;
		sink-pdos = <PDO_FIXED(5000, 3000, PDO_FIXED_USB_COMM)
			     PDO_VAR(3000, 12000, 3000)
			     PDO_PPS_APDO(3000, 11000, 3000)>;
		op-sink-microwatt = <10000000>;
	};
};
```

## Documentation/devicetree/bindings/usb/fcs,fusb302.yaml
```yaml
# SPDX-License-Identifier: GPL-2.0
%YAML 1.2
---
$id: http://devicetree.org/schemas/usb/fcs,fusb302.yaml#
$schema: http://devicetree.org/meta-schemas/core.yaml#

title: Fairchild FUSB302 Type-C Port controller

maintainers:
  - Rob Herring <robh@kernel.org>

properties:
  compatible:
    const: fcs,fusb302

  reg:
    maxItems: 1

  interrupts:
    maxItems: 1

  vbus-supply:
    description: VBUS power supply

  connector:
    type: object
    $ref: /schemas/connector/usb-connector.yaml#
    unevaluatedProperties: false

required:
  - compatible
  - reg
  - interrupts
  - vbus-supply
  - connector

additionalProperties: false

examples:
  - |
    #include <dt-bindings/interrupt-controller/irq.h>
    #include <dt-bindings/usb/pd.h>

    i2c {
      #address-cells = <1>;
      #size-cells = <0>;

      typec-portc@54 {
        compatible = "fcs,fusb302";
        reg = <0x54>;
        interrupt-parent = <&nmi_intc>;
        interrupts = <0 IRQ_TYPE_LEVEL_LOW>;
        vbus-supply = <&vbus_typec>;

        connector {
          compatible = "usb-c-connector";
          label = "USB-C";
          power-role = "dual";
          try-power-role = "sink";
          source-pdos = <PDO_FIXED(5000, 3000, PDO_FIXED_USB_COMM)>;
          sink-pdos = <PDO_FIXED(5000, 3000, PDO_FIXED_USB_COMM)
                       PDO_VAR(3000, 12000, 3000)
                       PDO_PPS_APDO(3000, 11000, 3000)>;
          op-sink-microwatt = <10000000>;
        };
      };
    };
```

## Documentation/devicetree/bindings/usb/fsl,imx8mp-dwc3.yaml
```yaml
# SPDX-License-Identifier: (GPL-2.0-only OR BSD-2-Clause)
# Copyright (c) 2020 NXP
%YAML 1.2
---
$id: http://devicetree.org/schemas/usb/fsl,imx8mp-dwc3.yaml#
$schema: http://devicetree.org/meta-schemas/core.yaml#

title: NXP iMX8MP Soc USB Controller

maintainers:
  - Li Jun <jun.li@nxp.com>

properties:
  compatible:
    const: fsl,imx8mp-dwc3

  reg:
    items:
      - description: Address and length of the register set for HSIO Block Control
      - description: Address and length of the register set for the wrapper of dwc3 core on the SOC.

  "#address-cells":
    enum: [ 1, 2 ]

  "#size-cells":
    enum: [ 1, 2 ]

  dma-ranges:
    description:
      See section 2.3.9 of the DeviceTree Specification.

  ranges: true

  interrupts:
    maxItems: 1
    description: The interrupt that is asserted when a wakeup event is
      received.

  clocks:
    description:
      A list of phandle and clock-specifier pairs for the clocks
      listed in clock-names.
    items:
      - description: system hsio root clock.
      - description: suspend clock, used for usb wakeup logic.

  clock-names:
    items:
      - const: hsio
      - const: suspend

  fsl,permanently-attached:
    type: boolean
    description:
      Indicates if the device attached to a downstream port is
      permanently attached.

  fsl,disable-port-power-control:
    type: boolean
    description:
      Indicates whether the host controller implementation includes port
      power control. Defines Bit 3 in capability register (HCCPARAMS).

  fsl,over-current-active-low:
    type: boolean
    description:
      Over current signal polarity is active low.

  fsl,power-active-low:
    type: boolean
    description:
      Power pad (PWR) polarity is active low.

  power-domains:
    maxItems: 1

# Required child node:

patternProperties:
  "^usb@[0-9a-f]+$":
    $ref: snps,dwc3.yaml#

required:
  - compatible
  - reg
  - "#address-cells"
  - "#size-cells"
  - dma-ranges
  - ranges
  - clocks
  - clock-names
  - interrupts
  - power-domains

additionalProperties: false

examples:
  - |
    #include <dt-bindings/clock/imx8mp-clock.h>
    #include <dt-bindings/power/imx8mp-power.h>
    #include <dt-bindings/interrupt-controller/arm-gic.h>
    usb3_0: usb@32f10100 {
      compatible = "fsl,imx8mp-dwc3";
      reg = <0x32f10100 0x8>,
            <0x381f0000 0x20>;
      clocks = <&clk IMX8MP_CLK_HSIO_ROOT>,
               <&clk IMX8MP_CLK_USB_ROOT>;
      clock-names = "hsio", "suspend";
      interrupts = <GIC_SPI 148 IRQ_TYPE_LEVEL_HIGH>;
      power-domains = <&hsio_blk_ctrl IMX8MP_HSIOBLK_PD_USB>;
      #address-cells = <1>;
      #size-cells = <1>;
      dma-ranges = <0x40000000 0x40000000 0xc0000000>;
      ranges;

      usb@38100000 {
        compatible = "snps,dwc3";
        reg = <0x38100000 0x10000>;
        clocks = <&clk IMX8MP_CLK_HSIO_AXI>,
                 <&clk IMX8MP_CLK_USB_CORE_REF>,
                 <&clk IMX8MP_CLK_USB_ROOT>;
        clock-names = "bus_early", "ref", "suspend";
        assigned-clocks = <&clk IMX8MP_CLK_HSIO_AXI>;
        assigned-clock-parents = <&clk IMX8MP_SYS_PLL2_500M>;
        assigned-clock-rates = <500000000>;
        interrupts = <GIC_SPI 40 IRQ_TYPE_LEVEL_HIGH>;
        phys = <&usb3_phy0>, <&usb3_phy0>;
        phy-names = "usb2-phy", "usb3-phy";
        snps,dis-u2-freeclk-exists-quirk;
      };
    };
```

## Documentation/devicetree/bindings/usb/fsl,imx8mq-dwc3.yaml
```yaml
# SPDX-License-Identifier: (GPL-2.0-only OR BSD-2-Clause)
%YAML 1.2
---
$id: http://devicetree.org/schemas/usb/fsl,imx8mq-dwc3.yaml#
$schema: http://devicetree.org/meta-schemas/core.yaml#

title: NXP iMX8MQ Soc USB Controller

maintainers:
  - Li Jun <jun.li@nxp.com>
  - Peng Fan <peng.fan@nxp.com>

select:
  properties:
    compatible:
      contains:
        enum:
          - fsl,imx8mq-dwc3
  required:
    - compatible

properties:
  compatible:
    items:
      - const: fsl,imx8mq-dwc3
      - const: snps,dwc3

allOf:
  - $ref: snps,dwc3.yaml#

unevaluatedProperties: false

examples:
  - |
    #include <dt-bindings/clock/imx8mq-clock.h>
    #include <dt-bindings/interrupt-controller/arm-gic.h>

    usb_dwc3_1: usb@38200000 {
        compatible = "fsl,imx8mq-dwc3", "snps,dwc3";
        reg = <0x38200000 0x10000>;
        clocks = <&clk IMX8MQ_CLK_USB2_CTRL_ROOT>,
                 <&clk IMX8MQ_CLK_USB_CORE_REF>,
                 <&clk IMX8MQ_CLK_32K>;
        clock-names = "bus_early", "ref", "suspend";
        interrupts = <GIC_SPI 41 IRQ_TYPE_LEVEL_HIGH>;
        phys = <&usb3_phy1>, <&usb3_phy1>;
        phy-names = "usb2-phy", "usb3-phy";
    };
```

## Documentation/devicetree/bindings/usb/fsl,imx8qm-cdns3.yaml
```yaml
# SPDX-License-Identifier: (GPL-2.0-only OR BSD-2-Clause)
# Copyright (c) 2020 NXP
%YAML 1.2
---
$id: http://devicetree.org/schemas/usb/fsl,imx8qm-cdns3.yaml#
$schema: http://devicetree.org/meta-schemas/core.yaml#

title: NXP iMX8QM Soc USB Controller

maintainers:
  - Frank Li <Frank.Li@nxp.com>

properties:
  compatible:
    const: fsl,imx8qm-usb3

  reg:
    items:
      - description: Register set for iMX USB3 Platform Control

  "#address-cells":
    enum: [ 1, 2 ]

  "#size-cells":
    enum: [ 1, 2 ]

  ranges: true

  clocks:
    items:
      - description: Standby clock. Used during ultra low power states.
      - description: USB bus clock for usb3 controller.
      - description: AXI clock for AXI interface.
      - description: ipg clock for register access.
      - description: Core clock for usb3 controller.

  clock-names:
    items:
      - const: lpm
      - const: bus
      - const: aclk
      - const: ipg
      - const: core

  power-domains:
    maxItems: 1

# Required child node:

patternProperties:
  "^usb@[0-9a-f]+$":
    $ref: cdns,usb3.yaml#

required:
  - compatible
  - reg
  - "#address-cells"
  - "#size-cells"
  - ranges
  - clocks
  - clock-names
  - power-domains

additionalProperties: false

examples:
  - |
    #include <dt-bindings/clock/imx8-lpcg.h>
    #include <dt-bindings/firmware/imx/rsrc.h>
    #include <dt-bindings/interrupt-controller/arm-gic.h>

    usb@5b110000 {
      compatible = "fsl,imx8qm-usb3";
      reg = <0x5b110000 0x10000>;
      ranges;
      clocks = <&usb3_lpcg IMX_LPCG_CLK_1>,
               <&usb3_lpcg IMX_LPCG_CLK_0>,
               <&usb3_lpcg IMX_LPCG_CLK_7>,
               <&usb3_lpcg IMX_LPCG_CLK_4>,
               <&usb3_lpcg IMX_LPCG_CLK_5>;
      clock-names = "lpm", "bus", "aclk", "ipg", "core";
      assigned-clocks = <&clk IMX_SC_R_USB_2 IMX_SC_PM_CLK_MST_BUS>;
      assigned-clock-rates = <250000000>;
      power-domains = <&pd IMX_SC_R_USB_2>;
      #address-cells = <1>;
      #size-cells = <1>;

      usb@5b120000 {
        compatible = "cdns,usb3";
        reg = <0x5b120000 0x10000>,   /* memory area for OTG/DRD registers */
              <0x5b130000 0x10000>,   /* memory area for HOST registers */
              <0x5b140000 0x10000>;   /* memory area for DEVICE registers */
        reg-names = "otg", "xhci", "dev";
        interrupt-parent = <&gic>;
        interrupts = <GIC_SPI 271 IRQ_TYPE_LEVEL_HIGH>,
                     <GIC_SPI 271 IRQ_TYPE_LEVEL_HIGH>,
                     <GIC_SPI 271 IRQ_TYPE_LEVEL_HIGH>,
                     <GIC_SPI 271 IRQ_TYPE_LEVEL_HIGH>;
        interrupt-names = "host", "peripheral", "otg", "wakeup";
        phys = <&usb3_phy>;
        phy-names = "cdns3,usb3-phy";
      };
    };
```

## Documentation/devicetree/bindings/usb/fsl,ls1028a.yaml
```yaml
# SPDX-License-Identifier: (GPL-2.0 OR BSD-2-Clause)
%YAML 1.2
---
$id: http://devicetree.org/schemas/usb/fsl,ls1028a.yaml#
$schema: http://devicetree.org/meta-schemas/core.yaml#

title: Freescale layerscape SuperSpeed DWC3 USB SoC controller

maintainers:
  - Frank Li <Frank.Li@nxp.com>

properties:
  compatible:
    oneOf:
      - items:
          - enum:
              - fsl,ls1012a-dwc3
              - fsl,ls1043a-dwc3
              - fsl,ls1046a-dwc3
              - fsl,ls1088a-dwc3
              - fsl,ls208xa-dwc3
              - fsl,lx2160a-dwc3
          - const: fsl,ls1028a-dwc3
      - const: fsl,ls1028a-dwc3

  reg:
    maxItems: 1

  interrupts:
    maxItems: 1

  iommus:
    maxItems: 1

  dma-coherent: true

unevaluatedProperties: false

required:
  - compatible
  - reg
  - interrupts

allOf:
  - $ref: snps,dwc3-common.yaml#

examples:
  - |
    #include <dt-bindings/interrupt-controller/arm-gic.h>

    usb@fe800000 {
        compatible = "fsl,ls1028a-dwc3";
        reg = <0xfe800000 0x100000>;
        interrupts = <GIC_SPI 105 IRQ_TYPE_LEVEL_HIGH>;
    };
```
