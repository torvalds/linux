## Documentation/devicetree/bindings/usb/generic-ohci.yaml
```yaml
# SPDX-License-Identifier: GPL-2.0
%YAML 1.2
---
$id: http://devicetree.org/schemas/usb/generic-ohci.yaml#
$schema: http://devicetree.org/meta-schemas/core.yaml#

title: USB OHCI Controller

maintainers:
  - Greg Kroah-Hartman <gregkh@linuxfoundation.org>

properties:
  compatible:
    oneOf:
      - items:
          - enum:
              - allwinner,sun4i-a10-ohci
              - allwinner,sun50i-a100-ohci
              - allwinner,sun50i-a64-ohci
              - allwinner,sun50i-h6-ohci
              - allwinner,sun50i-h616-ohci
              - allwinner,sun5i-a13-ohci
              - allwinner,sun6i-a31-ohci
              - allwinner,sun7i-a20-ohci
              - allwinner,sun8i-a23-ohci
              - allwinner,sun8i-a83t-ohci
              - allwinner,sun8i-h3-ohci
              - allwinner,sun8i-r40-ohci
              - allwinner,sun8i-v3s-ohci
              - allwinner,sun9i-a80-ohci
              - allwinner,sun20i-d1-ohci
              - brcm,bcm3384-ohci
              - brcm,bcm63268-ohci
              - brcm,bcm6328-ohci
              - brcm,bcm6358-ohci
              - brcm,bcm6362-ohci
              - brcm,bcm6368-ohci
              - brcm,bcm7125-ohci
              - brcm,bcm7346-ohci
              - brcm,bcm7358-ohci
              - brcm,bcm7360-ohci
              - brcm,bcm7362-ohci
              - brcm,bcm7420-ohci
              - brcm,bcm7425-ohci
              - brcm,bcm7435-ohci
              - hpe,gxp-ohci
              - ibm,476gtr-ohci
              - ingenic,jz4740-ohci
              - rockchip,rk3588-ohci
              - snps,hsdk-v1.0-ohci
          - const: generic-ohci
      - enum:
          - generic-ohci
          - ti,ohci-omap3
      - items:
          - enum:
              - cavium,octeon-6335-ohci
              - nintendo,hollywood-usb-ohci
              - nxp,ohci-nxp
              - st,spear600-ohci
          - const: usb-ohci

  reg:
    maxItems: 1

  interrupts:
    maxItems: 1

  resets:
    minItems: 1
    maxItems: 2

  clocks:
    minItems: 1
    maxItems: 4
    description: |
      In case the Renesas R-Car Gen3 SoCs:
        - if a host only channel: first clock should be host.
        - if a USB DRD channel: first clock should be host and second
          one should be peripheral

  power-domains:
    maxItems: 1

  big-endian:
    $ref: /schemas/types.yaml#/definitions/flag
    description:
      Set this flag for HCDs with big endian descriptors and big
      endian registers.

  big-endian-desc:
    $ref: /schemas/types.yaml#/definitions/flag
    description:
      Set this flag for HCDs with big endian descriptors.

  big-endian-regs:
    $ref: /schemas/types.yaml#/definitions/flag
    description:
      Set this flag for HCDs with big endian registers.

  remote-wakeup-connected:
    $ref: /schemas/types.yaml#/definitions/flag
    description:
      Remote wakeup is wired on the platform.

  no-big-frame-no:
    $ref: /schemas/types.yaml#/definitions/flag
    description:
      Set if frame_no lives in bits [15:0] of HCCA

  num-ports:
    $ref: /schemas/types.yaml#/definitions/uint32
    description:
      Overrides the detected port count

  phys:
    minItems: 1
    maxItems: 3

  phy-names:
    const: usb

  iommus:
    maxItems: 1

  dr_mode:
    enum:
      - host
      - otg

  transceiver:
    $ref: /schemas/types.yaml#/definitions/phandle
    description:
      The associated ISP1301 device. Necessary for the UDC controller for
      connecting to the USB physical layer.

required:
  - compatible
  - reg
  - interrupts

allOf:
  - $ref: usb-hcd.yaml
  - if:
      not:
        properties:
          compatible:
            contains:
              const: nxp,ohci-nxp
    then:
      properties:
        transceiver: false
  - if:
      properties:
        compatible:
          contains:
            const: rockchip,rk3588-ohci
    then:
      properties:
        clocks:
          minItems: 4
    else:
      properties:
        clocks:
          minItems: 1
          maxItems: 3

unevaluatedProperties: false

examples:
  - |
      ohci0: usb@1c14400 {
          compatible = "allwinner,sun4i-a10-ohci", "generic-ohci";
          reg = <0x01c14400 0x100>;
          interrupts = <64>;
          clocks = <&usb_clk 6>, <&ahb_gates 2>;
          phys = <&usbphy 1>;
          phy-names = "usb";
      };

...
```

## Documentation/devicetree/bindings/usb/generic-xhci.yaml
```yaml
# SPDX-License-Identifier: GPL-2.0
%YAML 1.2
---
$id: http://devicetree.org/schemas/usb/generic-xhci.yaml#
$schema: http://devicetree.org/meta-schemas/core.yaml#

title: USB xHCI Controller

maintainers:
  - Mathias Nyman <mathias.nyman@intel.com>

allOf:
  - $ref: usb-xhci.yaml#

properties:
  compatible:
    oneOf:
      - description: Generic xHCI device
        const: generic-xhci
      - description: Armada 37xx/375/38x/8k SoCs
        items:
          - enum:
              - marvell,armada3700-xhci
              - marvell,armada-375-xhci
              - marvell,armada-380-xhci
              - marvell,armada-8k-xhci
          - const: generic-xhci
      - description: Broadcom STB SoCs with xHCI
        enum:
          - brcm,xhci-brcm-v2
          - brcm,bcm7445-xhci
      - description: Generic xHCI device
        const: xhci-platform
        deprecated: true

  reg:
    maxItems: 1

  interrupts:
    maxItems: 1

  clocks:
    minItems: 1
    maxItems: 2

  clock-names:
    minItems: 1
    items:
      - const: core
      - const: reg

unevaluatedProperties: false

required:
  - compatible
  - reg
  - interrupts

examples:
  - |
    usb@f0931000 {
      compatible = "generic-xhci";
      reg = <0xf0931000 0x8c8>;
      interrupts = <0x0 0x4e 0x0>;
    };
```

## Documentation/devicetree/bindings/usb/generic.txt
```
Generic USB Properties

Optional properties:
 - maximum-speed: tells USB controllers we want to work up to a certain
			speed. Valid arguments are "super-speed", "high-speed",
			"full-speed" and "low-speed". In case this isn't passed
			via DT, USB controllers should default to their maximum
			HW capability.
 - dr_mode: tells Dual-Role USB controllers that we want to work on a
			particular mode. Valid arguments are "host",
			"peripheral" and "otg". In case this attribute isn't
			passed via DT, USB DRD controllers should default to
			OTG.
 - phy_type: tells USB controllers that we want to configure the core to support
			a UTMI+ PHY with an 8- or 16-bit interface if UTMI+ is
			selected. Valid arguments are "utmi" and "utmi_wide".
			In case this isn't passed via DT, USB controllers should
			default to HW capability.
 - otg-rev: tells usb driver the release number of the OTG and EH supplement
			with which the device and its descriptors are compliant,
			in binary-coded decimal (i.e. 2.0 is 0200H). This
			property is used if any real OTG features(HNP/SRP/ADP)
			is enabled, if ADP is required, otg-rev should be
			0x0200 or above.
 - companion: phandle of a companion
 - hnp-disable: tells OTG controllers we want to disable OTG HNP, normally HNP
			is the basic function of real OTG except you want it
			to be a srp-capable only B device.
 - srp-disable: tells OTG controllers we want to disable OTG SRP, SRP is
			optional for OTG device.
 - adp-disable: tells OTG controllers we want to disable OTG ADP, ADP is
			optional for OTG device.
 - usb-role-switch: boolean, indicates that the device is capable of assigning
			the USB data role (USB host or USB device) for a given
			USB connector, such as Type-C, Type-B(micro).
			see connector/usb-connector.txt.

This is an attribute to a USB controller such as:

dwc3@4a030000 {
	compatible = "synopsys,dwc3";
	reg = <0x4a030000 0xcfff>;
	interrupts = <0 92 4>
	usb-phy = <&usb2_phy>, <&usb3,phy>;
	maximum-speed = "super-speed";
	dr_mode = "otg";
	phy_type = "utmi_wide";
	otg-rev = <0x0200>;
	adp-disable;
};
```

## Documentation/devicetree/bindings/usb/genesys,gl850g.yaml
```yaml
# SPDX-License-Identifier: GPL-2.0-only OR BSD-2-Clause
%YAML 1.2
---
$id: http://devicetree.org/schemas/usb/genesys,gl850g.yaml#
$schema: http://devicetree.org/meta-schemas/core.yaml#

title: Genesys Logic USB hub controller

maintainers:
  - Icenowy Zheng <uwu@icenowy.me>

properties:
  compatible:
    enum:
      - usb5e3,608
      - usb5e3,610
      - usb5e3,620
      - usb5e3,626

  reg: true

  reset-gpios:
    description: GPIO controlling the RESET# pin.

  vdd-supply:
    description:
      The regulator that provides 3.3V or 5.0V core power to the hub.

  peer-hub:
    $ref: /schemas/types.yaml#/definitions/phandle
    description:
      For onboard hub controllers that support USB 3.x and USB 2.0 hubs
      with shared resets and power supplies, this property is used to identify
      the hubs with which these are shared.

required:
  - compatible
  - reg

allOf:
  - $ref: usb-device.yaml#
  - if:
      properties:
        compatible:
          contains:
            enum:
              - usb5e3,608
    then:
      properties:
        peer-hub: false
        vdd-supply: false

  - if:
      properties:
        compatible:
          contains:
            enum:
              - usb5e3,610
              - usb5e3,620
    then:
      properties:
        peer-hub: true
        vdd-supply: true

patternProperties:
  "^.*@[0-9a-f]{1,2}$":
    description: The hard wired USB devices
    type: object
    $ref: /schemas/usb/usb-device.yaml
    additionalProperties: true

unevaluatedProperties: false

examples:
  - |
    #include <dt-bindings/gpio/gpio.h>
    usb {
        dr_mode = "host";
        #address-cells = <1>;
        #size-cells = <0>;

        hub: hub@1 {
            compatible = "usb5e3,608";
            reg = <1>;
            reset-gpios = <&pio 7 2 GPIO_ACTIVE_LOW>;
        };
    };

  - |
    #include <dt-bindings/gpio/gpio.h>
    usb {
        dr_mode = "host";
        #address-cells = <1>;
        #size-cells = <0>;

        /* 2.0 hub on port 1 */
        hub_2_0: hub@1 {
            compatible = "usb5e3,610";
            reg = <1>;
            peer-hub = <&hub_3_0>;
            reset-gpios = <&gpio 20 GPIO_ACTIVE_LOW>;
            vdd-supply = <&vcc_5v>;
        };

        /* 3.1 hub on port 4 */
        hub_3_0: hub@2 {
            compatible = "usb5e3,620";
            reg = <2>;
            peer-hub = <&hub_2_0>;
            reset-gpios = <&gpio 20 GPIO_ACTIVE_LOW>;
            vdd-supply = <&vcc_5v>;
        };
    };
```

## Documentation/devicetree/bindings/usb/google,lga-dwc3.yaml
```yaml
# SPDX-License-Identifier: (GPL-2.0 OR BSD-2-Clause)
# Copyright (c) 2025, Google LLC
%YAML 1.2
---
$id: http://devicetree.org/schemas/usb/google,lga-dwc3.yaml#
$schema: http://devicetree.org/meta-schemas/core.yaml#

title: Google Tensor Series G5 (Laguna) DWC3 USB SoC Controller

maintainers:
  - Roy Luo <royluo@google.com>

description:
  Describes the DWC3 USB controller block implemented on Google Tensor SoCs,
  starting with the G5 generation (laguna). Based on Synopsys DWC3 IP, the
  controller features Dual-Role Device single port with hibernation add-on.

properties:
  compatible:
    const: google,lga-dwc3

  reg:
    items:
      - description: Core DWC3 IP registers.

  interrupts:
    items:
      - description: Core DWC3 interrupt.
      - description: High speed power management event for remote wakeup.
      - description: Super speed power management event for remote wakeup.

  interrupt-names:
    items:
      - const: core
      - const: hs_pme
      - const: ss_pme

  clocks:
    items:
      - description: Non-sticky module clock.
      - description: Sticky module clock.

  clock-names:
    items:
      - const: non_sticky
      - const: sticky

  resets:
    items:
      - description: Non-sticky module reset.
      - description: Sticky module reset.
      - description: DRD bus reset.
      - description: Top-level reset.

  reset-names:
    items:
      - const: non_sticky
      - const: sticky
      - const: drd_bus
      - const: top

  power-domains:
    items:
      - description: Power switchable domain, the child of top domain.
          Turning it on puts the controller into full power state,
          turning it off puts the controller into power gated state.
      - description: Top domain, the parent of power switchable domain.
          Turning it on puts the controller into power gated state,
          turning it off completely shuts off the controller.

  power-domain-names:
    items:
      - const: psw
      - const: top

  iommus:
    maxItems: 1

  google,usb-cfg-csr:
    description:
      A phandle to a syscon node used to access the USB configuration
      registers. These registers are the top-level wrapper of the USB
      subsystem and provide control and status for the integrated USB
      controller and USB PHY.
    $ref: /schemas/types.yaml#/definitions/phandle-array
    items:
      - items:
          - description: phandle to the syscon node.
          - description: USB host controller configuration register offset.
          - description: USB custom interrrupts control register offset.

required:
  - compatible
  - reg
  - interrupts
  - interrupt-names
  - clocks
  - clock-names
  - resets
  - reset-names
  - power-domains
  - power-domain-names
  - google,usb-cfg-csr

allOf:
  - $ref: snps,dwc3-common.yaml#

unevaluatedProperties: false

examples:
  - |
    #include <dt-bindings/interrupt-controller/arm-gic.h>
    #include <dt-bindings/interrupt-controller/irq.h>
    soc {
        #address-cells = <2>;
        #size-cells = <2>;

        usb@c400000 {
            compatible = "google,lga-dwc3";
            reg = <0 0x0c400000  0 0xd060>;
            interrupts = <GIC_SPI 580 IRQ_TYPE_LEVEL_HIGH 0>,
                         <GIC_SPI 597 IRQ_TYPE_LEVEL_HIGH 0>,
                         <GIC_SPI 598 IRQ_TYPE_LEVEL_HIGH 0>;
            interrupt-names = "core", "hs_pme", "ss_pme";
            clocks = <&hsion_usbc_non_sticky_clk>,  <&hsion_usbc_sticky_clk>;
            clock-names = "non_sticky", "sticky";
            resets = <&hsion_resets_usbc_non_sticky>, <&hsion_resets_usbc_sticky>,
                     <&hsion_resets_usb_drd_bus>, <&hsion_resets_usb_top>;
            reset-names = "non_sticky", "sticky", "drd_bus", "top";
            power-domains = <&hsio_n_usb_psw>, <&hsio_n_usb>;
            power-domain-names = "psw", "top";
            phys = <&usb_phy 0>;
            phy-names = "usb2-phy";
            snps,quirk-frame-length-adjustment = <0x20>;
            snps,gfladj-refclk-lpm-sel-quirk;
            snps,incr-burst-type-adjustment = <4>;
            google,usb-cfg-csr = <&usb_cfg_csr 0x0 0x20>;
        };
    };
...
```
