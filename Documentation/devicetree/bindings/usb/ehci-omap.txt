## Documentation/devicetree/bindings/usb/fsl,usb2.yaml
```yaml
# SPDX-License-Identifier: (GPL-2.0-only OR BSD-2-Clause)
%YAML 1.2
---
$id: http://devicetree.org/schemas/usb/fsl,usb2.yaml#
$schema: http://devicetree.org/meta-schemas/core.yaml#

title: Freescale SOC USB controllers

maintainers:
  - Frank Li <Frank.Li@nxp.com>

description: |
  The device node for a USB controller that is part of a Freescale
  SOC is as described in the document "Open Firmware Recommended
  Practice: Universal Serial Bus" with the following modifications
  and additions.

properties:
  compatible:
    oneOf:
      - enum:
          - fsl-usb2-mph
          - fsl-usb2-dr
      - items:
          - enum:
              - fsl-usb2-dr-v2.2
              - fsl-usb2-dr-v2.5
          - const: fsl-usb2-dr

  reg:
    maxItems: 1

  interrupts:
    maxItems: 1

  phy_type:
    $ref: /schemas/types.yaml#/definitions/string
    enum: [ulpi, serial, utmi, utmi_wide]

  port0:
    $ref: /schemas/types.yaml#/definitions/flag
    description:
      Indicates port0 is connected for fsl-usb2-mph compatible controllers.

  port1:
    $ref: /schemas/types.yaml#/definitions/flag
    description:
      Indicates port1 is connected for "fsl-usb2-mph" compatible controllers.

  fsl,invert-drvvbus:
    $ref: /schemas/types.yaml#/definitions/flag
    description:
      for MPC5121 USB0 only. Indicates the
      port power polarity of internal PHY signal DRVVBUS is inverted.

  fsl,invert-pwr-fault:
    $ref: /schemas/types.yaml#/definitions/flag
    description:
      for MPC5121 USB0 only. Indicates
      the PWR_FAULT signal polarity is inverted.

required:
  - compatible
  - reg
  - interrupts
  - phy_type

allOf:
  - $ref: usb-drd.yaml#

unevaluatedProperties: false

examples:
  - |
    #include <dt-bindings/interrupt-controller/irq.h>

    usb@22000 {
        compatible = "fsl-usb2-mph";
        reg = <22000 1000>;
        interrupts = <27 IRQ_TYPE_EDGE_RISING>;
        phy_type = "ulpi";
        port0;
        port1;
    };

  - |
    #include <dt-bindings/interrupt-controller/irq.h>

    usb@23000 {
        compatible = "fsl-usb2-dr";
        reg = <23000 1000>;
        interrupts = <26 IRQ_TYPE_EDGE_RISING>;
        dr_mode = "otg";
        phy_type = "ulpi";
    };
```

## Documentation/devicetree/bindings/usb/fsl,usbmisc.yaml
```yaml
# SPDX-License-Identifier: (GPL-2.0-only OR BSD-2-Clause)
%YAML 1.2
---
$id: http://devicetree.org/schemas/usb/fsl,usbmisc.yaml#
$schema: http://devicetree.org/meta-schemas/core.yaml#

title: Freescale i.MX wrapper module for Chipidea USB2 controller

maintainers:
  - Xu Yang <xu.yang_2@nxp.com>
  - Peng Fan <peng.fan@nxp.com>

properties:
  compatible:
    oneOf:
      - enum:
          - fsl,imx25-usbmisc
          - fsl,imx27-usbmisc
          - fsl,imx35-usbmisc
          - fsl,imx51-usbmisc
          - fsl,imx53-usbmisc
          - fsl,imx6q-usbmisc
          - fsl,vf610-usbmisc
          - nxp,s32g2-usbmisc
          - nxp,s32g3-usbmisc
      - items:
          - enum:
              - fsl,imx6ul-usbmisc
              - fsl,imx6sl-usbmisc
              - fsl,imx6sx-usbmisc
              - fsl,imx7d-usbmisc
          - const: fsl,imx6q-usbmisc
      - items:
          - enum:
              - fsl,imx7ulp-usbmisc
              - fsl,imx8mm-usbmisc
              - fsl,imx8mn-usbmisc
              - fsl,imx8ulp-usbmisc
              - fsl,imx95-usbmisc
          - const: fsl,imx7d-usbmisc
          - const: fsl,imx6q-usbmisc
      - items:
          - const: fsl,imx6sll-usbmisc
          - const: fsl,imx6ul-usbmisc
          - const: fsl,imx6q-usbmisc

  clocks:
    maxItems: 1

  reg:
    minItems: 1
    items:
      - description: Base and length of the Wrapper module register
      - description: Base and length of the HSIO Block Control register

  '#index-cells':
    const: 1
    description: Cells used to describe usb controller index.
    deprecated: true

required:
  - compatible
  - reg

allOf:
  # imx95 soc needs use HSIO Block Control
  - if:
      properties:
        compatible:
          contains:
            enum:
              - fsl,imx95-usbmisc
    then:
      properties:
        reg:
          minItems: 2
    else:
      properties:
        reg:
          maxItems: 1

additionalProperties: false

examples:
  - |
    usbmisc@2184800 {
        compatible = "fsl,imx6q-usbmisc";
        reg = <0x02184800 0x200>;
        #index-cells = <1>;
    };

...
```

## Documentation/devicetree/bindings/usb/fsl-usb.txt
```
Freescale SOC USB controllers

The device node for a USB controller that is part of a Freescale
SOC is as described in the document "Open Firmware Recommended
Practice : Universal Serial Bus" with the following modifications
and additions :

Required properties :
 - compatible : Should be "fsl-usb2-mph" for multi port host USB
   controllers, or "fsl-usb2-dr" for dual role USB controllers
   or "fsl,mpc5121-usb2-dr" for dual role USB controllers of MPC5121.
   Wherever applicable, the IP version of the USB controller should
   also be mentioned (for eg. fsl-usb2-dr-v2.2 for bsc9132).
 - phy_type : For multi port host USB controllers, should be one of
   "ulpi", or "serial". For dual role USB controllers, should be
   one of "ulpi", "utmi", "utmi_wide", or "serial".
 - reg : Offset and length of the register set for the device
 - port0 : boolean; if defined, indicates port0 is connected for
   fsl-usb2-mph compatible controllers.  Either this property or
   "port1" (or both) must be defined for "fsl-usb2-mph" compatible
   controllers.
 - port1 : boolean; if defined, indicates port1 is connected for
   fsl-usb2-mph compatible controllers.  Either this property or
   "port0" (or both) must be defined for "fsl-usb2-mph" compatible
   controllers.
 - dr_mode : indicates the working mode for "fsl-usb2-dr" compatible
   controllers.  Can be "host", "peripheral", or "otg".  Default to
   "host" if not defined for backward compatibility.

Recommended properties :
 - interrupts : <a b> where a is the interrupt number and b is a
   field that represents an encoding of the sense and level
   information for the interrupt.  This should be encoded based on
   the information in section 2) depending on the type of interrupt
   controller you have.
 - interrupt-parent : the phandle for the interrupt controller that
   services interrupts for this device.

Optional properties :
 - fsl,invert-drvvbus : boolean; for MPC5121 USB0 only. Indicates the
   port power polarity of internal PHY signal DRVVBUS is inverted.
 - fsl,invert-pwr-fault : boolean; for MPC5121 USB0 only. Indicates
   the PWR_FAULT signal polarity is inverted.

Example multi port host USB controller device node :
	usb@22000 {
		compatible = "fsl-usb2-mph";
		reg = <22000 1000>;
		#address-cells = <1>;
		#size-cells = <0>;
		interrupt-parent = <700>;
		interrupts = <27 1>;
		phy_type = "ulpi";
		port0;
		port1;
	};

Example dual role USB controller device node :
	usb@23000 {
		compatible = "fsl-usb2-dr";
		reg = <23000 1000>;
		#address-cells = <1>;
		#size-cells = <0>;
		interrupt-parent = <700>;
		interrupts = <26 1>;
		dr_mode = "otg";
		phy = "ulpi";
	};

Example dual role USB controller device node for MPC5121ADS:

	usb@4000 {
		compatible = "fsl,mpc5121-usb2-dr";
		reg = <0x4000 0x1000>;
		#address-cells = <1>;
		#size-cells = <0>;
		interrupt-parent = < &ipic >;
		interrupts = <44 0x8>;
		dr_mode = "otg";
		phy_type = "utmi_wide";
		fsl,invert-drvvbus;
		fsl,invert-pwr-fault;
	};
```

## Documentation/devicetree/bindings/usb/generic-ehci.yaml
```yaml
# SPDX-License-Identifier: GPL-2.0
%YAML 1.2
---
$id: http://devicetree.org/schemas/usb/generic-ehci.yaml#
$schema: http://devicetree.org/meta-schemas/core.yaml#

title: USB EHCI Controller

maintainers:
  - Greg Kroah-Hartman <gregkh@linuxfoundation.org>

allOf:
  - $ref: usb-hcd.yaml
  - if:
      properties:
        compatible:
          not:
            contains:
              const: ibm,usb-ehci-440epx
    then:
      properties:
        reg:
          maxItems: 1

properties:
  compatible:
    oneOf:
      - items:
          - enum:
              - allwinner,sun4i-a10-ehci
              - allwinner,sun50i-a100-ehci
              - allwinner,sun50i-a64-ehci
              - allwinner,sun50i-h6-ehci
              - allwinner,sun50i-h616-ehci
              - allwinner,sun5i-a13-ehci
              - allwinner,sun6i-a31-ehci
              - allwinner,sun7i-a20-ehci
              - allwinner,sun8i-a23-ehci
              - allwinner,sun8i-a83t-ehci
              - allwinner,sun8i-h3-ehci
              - allwinner,sun8i-r40-ehci
              - allwinner,sun8i-v3s-ehci
              - allwinner,sun9i-a80-ehci
              - allwinner,sun20i-d1-ehci
              - aspeed,ast2400-ehci
              - aspeed,ast2500-ehci
              - aspeed,ast2600-ehci
              - brcm,bcm3384-ehci
              - brcm,bcm63268-ehci
              - brcm,bcm6328-ehci
              - brcm,bcm6358-ehci
              - brcm,bcm6362-ehci
              - brcm,bcm6368-ehci
              - brcm,bcm7125-ehci
              - brcm,bcm7346-ehci
              - brcm,bcm7358-ehci
              - brcm,bcm7360-ehci
              - brcm,bcm7362-ehci
              - brcm,bcm7420-ehci
              - brcm,bcm7425-ehci
              - brcm,bcm7435-ehci
              - hpe,gxp-ehci
              - ibm,476gtr-ehci
              - nxp,lpc1850-ehci
              - qca,ar7100-ehci
              - rockchip,rk3588-ehci
              - snps,hsdk-v1.0-ehci
              - socionext,uniphier-ehci
          - const: generic-ehci
      - items:
          - enum:
              - atmel,at91sam9g45-ehci
              - cavium,octeon-6335-ehci
              - ibm,usb-ehci-440epx
              - ibm,usb-ehci-460ex
              - nintendo,hollywood-usb-ehci
              - st,spear600-ehci
          - const: usb-ehci
      - enum:
          - generic-ehci
          - marvell,ac5-ehci
          - marvell,armada-3700-ehci
          - marvell,orion-ehci
          - nuvoton,npcm750-ehci
          - nuvoton,npcm845-ehci
          - ti,ehci-omap
          - usb-ehci

  reg:
    minItems: 1
    maxItems: 2

  interrupts:
    maxItems: 1

  resets:
    minItems: 1
    maxItems: 4

  clocks:
    minItems: 1
    maxItems: 4
    description: |
      In case the Renesas R-Car Gen3 SoCs:
        - if a host only channel: first clock should be host.
        - if a USB DRD channel: first clock should be host and second
          one should be peripheral

  power-domains:
    maxItems: 1

  big-endian:
    $ref: /schemas/types.yaml#/definitions/flag
    description:
      Set this flag for HCDs with big endian descriptors and big
      endian registers.

  big-endian-desc:
    $ref: /schemas/types.yaml#/definitions/flag
    description:
      Set this flag for HCDs with big endian descriptors.

  big-endian-regs:
    $ref: /schemas/types.yaml#/definitions/flag
    description:
      Set this flag for HCDs with big endian registers.

  has-transaction-translator:
    $ref: /schemas/types.yaml#/definitions/flag
    description:
      Set this flag if EHCI has a Transaction Translator built into
      the root hub.

  needs-reset-on-resume:
    $ref: /schemas/types.yaml#/definitions/flag
    description:
      Set this flag to force EHCI reset after resume.

  spurious-oc:
    $ref: /schemas/types.yaml#/definitions/flag
    description:
      Set this flag to indicate that the hardware sometimes turns on
      the OC bit when an over-current isn't actually present.

  phys:
    minItems: 1
    maxItems: 3

  phy-names:
    const: usb

  iommus:
    maxItems: 1

  dr_mode:
    enum:
      - host
      - otg

required:
  - compatible
  - reg
  - interrupts

unevaluatedProperties: false

examples:
  - |
    usb@e0000300 {
        compatible = "ibm,usb-ehci-440epx", "usb-ehci";
        interrupt-parent = <&UIC0>;
        interrupts = <0x1a 4>;
        reg = <0xe0000300 90>, <0xe0000390 70>;
        big-endian;
    };

  - |
    ehci0: usb@1c14000 {
        compatible = "allwinner,sun4i-a10-ehci", "generic-ehci";
        reg = <0x01c14000 0x100>;
        interrupts = <39>;
        clocks = <&ahb_gates 1>;
        phys = <&usbphy 1>;
        phy-names = "usb";
    };

...
```
