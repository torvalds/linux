## Documentation/devicetree/bindings/usb/ehci-omap.txt
```
OMAP HS USB EHCI controller

This device is usually the child of the omap-usb-host
Documentation/devicetree/bindings/mfd/omap-usb-host.txt

Required properties:

- compatible: should be "ti,ehci-omap"
- reg: should contain one register range i.e. start and length
- interrupts: description of the interrupt line

Optional properties:

- phys: list of phandles to PHY nodes.
  This property is required if at least one of the ports are in
  PHY mode i.e. OMAP_EHCI_PORT_MODE_PHY

To specify the port mode, see
Documentation/devicetree/bindings/mfd/omap-usb-host.txt

Example for OMAP4:

usbhsehci: ehci@4a064c00 {
	compatible = "ti,ehci-omap";
	reg = <0x4a064c00 0x400>;
	interrupts = <0 77 0x4>;
};

&usbhsehci {
	phys = <&hsusb1_phy 0 &hsusb3_phy>;
};
```

## Documentation/devicetree/bindings/usb/ehci-orion.txt
```
* EHCI controller, Orion Marvell variants

Required properties:
- compatible: must be one of the following
	"marvell,orion-ehci"
	"marvell,armada-3700-ehci"
- reg: physical base address of the controller and length of memory mapped
  region.
- interrupts: The EHCI interrupt

Optional properties:
- clocks: reference to the clock
- phys: reference to the USB PHY
- phy-names: name of the USB PHY, should be "usb"

Example:

	ehci@50000 {
		compatible = "marvell,orion-ehci";
		reg = <0x50000 0x1000>;
		interrupts = <19>;
	};
```

## Documentation/devicetree/bindings/usb/ehci-st.txt
```
ST USB EHCI controller

Required properties:
 - compatible		: must be "st,st-ehci-300x"
 - reg			: physical base addresses of the controller and length of memory mapped
			  region
 - interrupts		: one EHCI interrupt should be described here
 - pinctrl-names	: a pinctrl state named "default" must be defined
 - pinctrl-0		: phandle referencing pin configuration of the USB controller
See: Documentation/devicetree/bindings/pinctrl/pinctrl-bindings.txt
 - clocks		: phandle list of usb clocks
 - clock-names		: should be "ic" for interconnect clock and "clk48"
See: Documentation/devicetree/bindings/clock/clock-bindings.txt

 - phys			: phandle for the PHY device
 - phy-names		: should be "usb"
 - resets		: phandle + reset specifier pairs to the powerdown and softreset lines
			  of the USB IP
 - reset-names		: should be "power" and "softreset"
See: Documentation/devicetree/bindings/reset/st,sti-powerdown.txt
See: Documentation/devicetree/bindings/reset/reset.txt

Example:

	ehci1: usb@0xfe203e00 {
		compatible = "st,st-ehci-300x";
		reg = <0xfe203e00 0x100>;
		interrupts = <GIC_SPI 148 IRQ_TYPE_NONE>;
		pinctrl-names = "default";
		pinctrl-0 = <&pinctrl_usb1>;
		clocks = <&clk_s_a1_ls 0>;
		phys = <&usb2_phy>;
		phy-names = "usb";

		resets = <&powerdown STIH416_USB1_POWERDOWN>,
			 <&softreset STIH416_USB1_SOFTRESET>;
		reset-names = "power", "softreset";
	};
```

## Documentation/devicetree/bindings/usb/eswin,eic7700-usb.yaml
```yaml
# SPDX-License-Identifier: (GPL-2.0-only OR BSD-2-Clause)
%YAML 1.2
---
$id: http://devicetree.org/schemas/usb/eswin,eic7700-usb.yaml#
$schema: http://devicetree.org/meta-schemas/core.yaml#

title: ESWIN EIC7700 SoC Usb Controller

maintainers:
  - Wei Yang <yangwei1@eswincomputing.com>
  - Senchuan Zhang <zhangsenchuan@eswincomputing.com>
  - Hang Cao <caohang@eswincomputing.com>

description:
  The Usb controller on EIC7700 SoC.

allOf:
  - $ref: snps,dwc3-common.yaml#

properties:
  compatible:
    const: eswin,eic7700-dwc3

  reg:
    maxItems: 1

  interrupts:
    maxItems: 1

  interrupt-names:
    items:
      - const: peripheral

  clocks:
    maxItems: 3

  clock-names:
    items:
      - const: aclk
      - const: cfg
      - const: usb_en

  resets:
    maxItems: 2

  reset-names:
    items:
      - const: vaux
      - const: usb_rst

  eswin,hsp-sp-csr:
    description:
      HSP CSR is to control and get status of different high-speed peripherals
      (such as Ethernet, USB, SATA, etc.) via register, which can tune
      board-level's parameters of PHY, etc.
    $ref: /schemas/types.yaml#/definitions/phandle-array
    items:
      - items:
          - description: phandle to HSP Register Controller hsp_sp_csr node.
          - description: USB bus register offset.
          - description: AXI low power register offset.

required:
  - compatible
  - reg
  - clocks
  - clock-names
  - interrupts
  - interrupt-names
  - resets
  - reset-names
  - eswin,hsp-sp-csr

unevaluatedProperties: false

examples:
  - |
    usb@50480000 {
        compatible = "eswin,eic7700-dwc3";
        reg = <0x50480000 0x10000>;
        clocks = <&clock 135>,
                 <&clock 136>,
                 <&hspcrg 18>;
        clock-names = "aclk", "cfg", "usb_en";
        interrupt-parent = <&plic>;
        interrupts = <85>;
        interrupt-names = "peripheral";
        resets = <&reset 84>, <&hspcrg 2>;
        reset-names = "vaux", "usb_rst";
        dr_mode = "peripheral";
        maximum-speed = "high-speed";
        phy_type = "utmi";
        eswin,hsp-sp-csr = <&hsp_sp_csr 0x800 0x818>;
    };
```

## Documentation/devicetree/bindings/usb/etek,et7303.yaml
```yaml
# SPDX-License-Identifier: (GPL-2.0-only OR BSD-2-Clause)
%YAML 1.2
---
$id: "http://devicetree.org/schemas/usb/etek,et7303.yaml#"
$schema: "http://devicetree.org/meta-schemas/core.yaml#"

title: Etek ET7303 Type-C Port controller DT bindings

maintainers:
  - Wang Jie <dave.wang@rock-chips.com>

properties:
  compatible:
    const: etek,et7303

  reg:
    maxItems: 1

  interrupts:
    maxItems: 1

  ports:
    type: object
    properties:
      port@0:
        type: object
        description: TCPC connected to USB controller to support dual-role switch.

    required:
      - port@0

  connector:
    type: object
    $ref: ../connector/usb-connector.yaml#
    description:
      Properties for usb c connector that attached to the tcpci chip.

required:
  - compatible
  - reg
  - interrupts
  - connector

additionalProperties: false

examples:
  - |
    #include "dt-bindings/usb/pd.h"
    i2c0 {
      usbc0: et7303@4e {
        compatible = "etek,et7303";
        reg = <0x4e>;
        interrupt-parent = <&gpio1>;
        interrupts = <RK_PA2 IRQ_TYPE_LEVEL_LOW>;
        pinctrl-names = "default";
        pinctrl-0 = <&et7303_int>;
        vbus-supply = <&vcc5v0_typec>;
        status = "okay";

        ports {
          #address-cells = <1>;
          #size-cells = <0>;

          port@0 {
            reg = <0>;
            usbc0_role_sw: endpoint@0 {
              remote-endpoint = <&dwc3_0_role_switch>;
            };
          };
        };

        usb_con: connector {
          compatible = "usb-c-connector";
          label = "USB-C";
          data-role = "dual";
          power-role = "dual";
          try-power-role = "sink";
          op-sink-microwatt = <1000000>;
          sink-pdos = <PDO_FIXED(5000, 2000, PDO_FIXED_USB_COMM)>;
          source-pdos = <PDO_FIXED(5000, 3000, PDO_FIXED_USB_COMM)>;

          ports {
            #address-cells = <1>;
            #size-cells = <0>;

            port@0 {
              reg = <0>;
              usbc0_orien_sw: endpoint {
                remote-endpoint = <&usbdp_phy0_orientation_switch>;
              };
            };
          };
        };
      };
    };
...
```

## Documentation/devicetree/bindings/usb/exynos-usb.txt
```
Samsung Exynos SoC USB controller

The USB devices interface with USB controllers on Exynos SOCs.
The device node has following properties.

EHCI
Required properties:
 - compatible: should be "samsung,exynos4210-ehci" for USB 2.0
   EHCI controller in host mode.
 - reg: physical base address of the controller and length of memory mapped
   region.
 - interrupts: interrupt number to the cpu.
 - clocks: from common clock binding: handle to usb clock.
 - clock-names: from common clock binding: Shall be "usbhost".
 - phys: from the *Generic PHY* bindings; array specifying phy(s) used
   by the root port.
 - phy-names: from the *Generic PHY* bindings; array of the names for
   each phy for the root ports, must be a subset of the following:
   "host", "hsic0", "hsic1".

Optional properties:
 - samsung,vbus-gpio:  if present, specifies the GPIO that
   needs to be pulled up for the bus to be powered.

Example:

	usb@12110000 {
		compatible = "samsung,exynos4210-ehci";
		reg = <0x12110000 0x100>;
		interrupts = <0 71 0>;
		samsung,vbus-gpio = <&gpx2 6 1 3 3>;

		clocks = <&clock 285>;
		clock-names = "usbhost";

		phys = <&usb2phy 1>;
		phy-names = "host";
	};

OHCI
Required properties:
 - compatible: should be "samsung,exynos4210-ohci" for USB 2.0
   OHCI companion controller in host mode.
 - reg: physical base address of the controller and length of memory mapped
   region.
 - interrupts: interrupt number to the cpu.
 - clocks: from common clock binding: handle to usb clock.
 - clock-names: from common clock binding: Shall be "usbhost".
 - phys: from the *Generic PHY* bindings; array specifying phy(s) used
   by the root port.
 - phy-names: from the *Generic PHY* bindings; array of the names for
   each phy for the root ports, must be a subset of the following:
   "host", "hsic0", "hsic1".

Example:
	usb@12120000 {
		compatible = "samsung,exynos4210-ohci";
		reg = <0x12120000 0x100>;
		interrupts = <0 71 0>;

		clocks = <&clock 285>;
		clock-names = "usbhost";

		phys = <&usb2phy 1>;
		phy-names = "host";
	};

DWC3
Required properties:
 - compatible: should be one of the following -
	       "samsung,exynos5250-dwusb3": for USB 3.0 DWC3 controller on
					    Exynos5250/5420.
	       "samsung,exynos5433-dwusb3": for USB 3.0 DWC3 controller on
					    Exynos5433.
	       "samsung,exynos7-dwusb3": for USB 3.0 DWC3 controller on Exynos7.
 - #address-cells, #size-cells : should be '1' if the device has sub-nodes
				 with 'reg' property.
 - ranges: allows valid 1:1 translation between child's address space and
	   parent's address space
 - clocks: Clock IDs array as required by the controller.
 - clock-names: names of clocks correseponding to IDs in the clock property
 - vdd10-supply: 1.0V powr supply
 - vdd33-supply: 3.0V/3.3V power supply

Sub-nodes:
The dwc3 core should be added as subnode to Exynos dwc3 glue.
- dwc3 :
   The binding details of dwc3 can be found in:
   Documentation/devicetree/bindings/usb/dwc3.txt

Example:
	usb@12000000 {
		compatible = "samsung,exynos5250-dwusb3";
		clocks = <&clock 286>;
		clock-names = "usbdrd30";
		#address-cells = <1>;
		#size-cells = <1>;
		ranges;
		vdd10-supply = <&ldo11_reg>;
		vdd33-supply = <&ldo9_reg>;

		dwc3 {
			compatible = "synopsys,dwc3";
			reg = <0x12000000 0x10000>;
			interrupts = <0 72 0>;
			usb-phy = <&usb2_phy &usb3_phy>;
		};
	};
```

## Documentation/devicetree/bindings/usb/faraday,fotg210.txt
```
Faraday FOTG Host controller

This OTG-capable USB host controller is found in Cortina Systems
Gemini and other SoC products.

Required properties:
- compatible: should be one of:
  "faraday,fotg210"
  "cortina,gemini-usb", "faraday,fotg210"
- reg: should contain one register range i.e. start and length
- interrupts: description of the interrupt line

Optional properties:
- clocks: should contain the IP block clock
- clock-names: should be "PCLK" for the IP block clock

Required properties for "cortina,gemini-usb" compatible:
- syscon: a phandle to the system controller to access PHY registers

Optional properties for "cortina,gemini-usb" compatible:
- cortina,gemini-mini-b: boolean property that indicates that a Mini-B
  OTG connector is in use
- wakeup-source: see power/wakeup-source.txt

Example for Gemini:

usb@68000000 {
	compatible = "cortina,gemini-usb", "faraday,fotg210";
	reg = <0x68000000 0x1000>;
	interrupts = <10 IRQ_TYPE_LEVEL_HIGH>;
	clocks = <&cc 12>;
	clock-names = "PCLK";
	syscon = <&syscon>;
	wakeup-source;
};
```

## Documentation/devicetree/bindings/usb/faraday,fotg210.yaml
```yaml
# SPDX-License-Identifier: (GPL-2.0 OR BSD-2-Clause)
# Copyright 2022 Linaro Ltd.
%YAML 1.2
---
$id: http://devicetree.org/schemas/usb/faraday,fotg210.yaml#
$schema: http://devicetree.org/meta-schemas/core.yaml#

title: Faraday Technology FOTG200 series HS OTG USB 2.0 controller

maintainers:
  - Linus Walleij <linus.walleij@linaro.org>

allOf:
  - $ref: usb-drd.yaml#
  - $ref: usb-hcd.yaml#

properties:
  compatible:
    oneOf:
      - const: faraday,fotg200
      - const: faraday,fotg210
      - items:
          - const: cortina,gemini-usb
          - const: faraday,fotg200

  reg:
    maxItems: 1

  interrupts:
    maxItems: 1

  clocks:
    maxItems: 1

  clock-names:
    items:
      - const: PCLK

  resets:
    maxItems: 1

  syscon:
    $ref: /schemas/types.yaml#/definitions/phandle
    description: a phandle to the global Gemini system controller on
      Gemini systems

  dr_mode: true

  phys:
    maxItems: 1

  phy-names:
    const: usb2-phy

required:
  - compatible
  - reg
  - interrupts
  - clocks
  - clock-names

additionalProperties: false

examples:
  - |
    #include <dt-bindings/interrupt-controller/irq.h>
    #include <dt-bindings/clock/cortina,gemini-clock.h>
    #include <dt-bindings/reset/cortina,gemini-reset.h>
    usb0: usb@68000000 {
        compatible = "cortina,gemini-usb", "faraday,fotg200";
        reg = <0x68000000 0x1000>;
        interrupts = <10 IRQ_TYPE_LEVEL_HIGH>;
        resets = <&syscon GEMINI_RESET_USB0>;
        clocks = <&syscon GEMINI_CLK_GATE_USB0>;
        clock-names = "PCLK";
        syscon = <&syscon>;
        dr_mode = "host";
    };
```
