## Documentation/devicetree/bindings/usb/renesas_usbhs.txt
```
Renesas Electronics USBHS driver

Required properties:
  - compatible: Must contain one or more of the following:

	- "renesas,usbhs-r8a7743" for r8a7743 (RZ/G1M) compatible device
	- "renesas,usbhs-r8a7745" for r8a7745 (RZ/G1E) compatible device
	- "renesas,usbhs-r8a7790" for r8a7790 (R-Car H2) compatible device
	- "renesas,usbhs-r8a7791" for r8a7791 (R-Car M2-W) compatible device
	- "renesas,usbhs-r8a7792" for r8a7792 (R-Car V2H) compatible device
	- "renesas,usbhs-r8a7793" for r8a7793 (R-Car M2-N) compatible device
	- "renesas,usbhs-r8a7794" for r8a7794 (R-Car E2) compatible device
	- "renesas,usbhs-r8a7795" for r8a7795 (R-Car H3) compatible device
	- "renesas,usbhs-r8a7796" for r8a7796 (R-Car M3-W) compatible device
	- "renesas,usbhs-r8a77995" for r8a77995 (R-Car D3) compatible device
	- "renesas,usbhs-r7s72100" for r7s72100 (RZ/A1) compatible device
	- "renesas,rcar-gen2-usbhs" for R-Car Gen2 or RZ/G1 compatible devices
	- "renesas,rcar-gen3-usbhs" for R-Car Gen3 compatible device
	- "renesas,rza1-usbhs" for RZ/A1 compatible device

	When compatible with the generic version, nodes must list the
	SoC-specific version corresponding to the platform first followed
	by the generic version.

  - reg: Base address and length of the register for the USBHS
  - interrupts: Interrupt specifier for the USBHS
  - clocks: A list of phandle + clock specifier pairs

Optional properties:
  - renesas,buswait: Integer to use BUSWAIT register
  - renesas,enable-gpio: A gpio specifier to check GPIO determining if USB
			 function should be enabled
  - phys: phandle + phy specifier pair
  - phy-names: must be "usb"
  - dmas: Must contain a list of references to DMA specifiers.
  - dma-names : named "ch%d", where %d is the channel number ranging from zero
                to the number of channels (DnFIFOs) minus one.

Example:
	usbhs: usb@e6590000 {
		compatible = "renesas,usbhs-r8a7790", "renesas,rcar-gen2-usbhs";
		reg = <0 0xe6590000 0 0x100>;
		interrupts = <0 107 IRQ_TYPE_LEVEL_HIGH>;
		clocks = <&mstp7_clks R8A7790_CLK_HSUSB>;
	};
```

## Documentation/devicetree/bindings/usb/richtek,rt1711h.txt
```
Richtek RT1711H TypeC PD Controller.

Required properties:
 - compatible : Must be "richtek,rt1711h".
 - reg : Must be 0x4e, it's slave address of RT1711H.
 - interrupts : <a b> where a is the interrupt number and b represents an
   encoding of the sense and level information for the interrupt.

Required sub-node:
- connector: The "usb-c-connector" attached to the tcpci chip, the bindings
  of connector node are specified in
  Documentation/devicetree/bindings/connector/usb-connector.txt

Example :
rt1711h@4e {
	compatible = "richtek,rt1711h";
	reg = <0x4e>;
	interrupt-parent = <&gpio26>;
	interrupts = <0 IRQ_TYPE_LEVEL_LOW>;

	usb_con: connector {
		compatible = "usb-c-connector";
		label = "USB-C";
		data-role = "dual";
		power-role = "dual";
		try-power-role = "sink";
		source-pdos = <PDO_FIXED(5000, 2000, PDO_FIXED_USB_COMM)>;
		sink-pdos = <PDO_FIXED(5000, 2000, PDO_FIXED_USB_COMM)
			     PDO_VAR(5000, 12000, 2000)>;
		op-sink-microwatt = <10000000>;

		ports {
			#address-cells = <1>;
			#size-cells = <0>;

			port@1 {
				reg = <1>;
				usb_con_ss: endpoint {
					remote-endpoint = <&usb3_data_ss>;
				};
			};
		};
	};
};
```

## Documentation/devicetree/bindings/usb/richtek,rt1711h.yaml
```yaml
# SPDX-License-Identifier: (GPL-2.0-only OR BSD-2-Clause)
%YAML 1.2
---
$id: "http://devicetree.org/schemas/usb/richtek,rt1711h.yaml#"
$schema: "http://devicetree.org/meta-schemas/core.yaml#"

title: Richtek RT1711H Type-C Port Switch and Power Delivery controller

maintainers:
  - Gene Chen <gene_chen@richtek.com>

description: |
  The RT1711H is a USB Type-C controller that complies with the latest
  USB Type-C and PD standards. It does the USB Type-C detection including attach
  and orientation. It integrates the physical layer of the USB BMC power
  delivery protocol to allow up to 100W of power. The BMC PD block enables full
  support for alternative interfaces of the Type-C specification.

properties:
  compatible:
    enum:
      - richtek,rt1711h
      - richtek,rt1715
    description:
      RT1711H support PD20, RT1715 support PD30 except Fast Role Swap.

  reg:
    maxItems: 1

  interrupts:
    maxItems: 1

  wakeup-source:
    type: boolean

  connector:
    type: object
    $ref: /schemas/connector/usb-connector.yaml#
    description:
      Properties for usb c connector.

additionalProperties: false

required:
  - compatible
  - reg
  - connector
  - interrupts

examples:
  - |
    #include <dt-bindings/interrupt-controller/irq.h>
    #include <dt-bindings/usb/pd.h>
    i2c0 {
      #address-cells = <1>;
      #size-cells = <0>;

      rt1711h@4e {
        compatible = "richtek,rt1711h";
        reg = <0x4e>;
        interrupts-extended = <&gpio26 3 IRQ_TYPE_LEVEL_LOW>;
        wakeup-source;

        connector {
          compatible = "usb-c-connector";
          label = "USB-C";
          data-role = "dual";
          power-role = "dual";
          try-power-role = "sink";
          source-pdos = <PDO_FIXED(5000, 2000, PDO_FIXED_DUAL_ROLE | PDO_FIXED_DATA_SWAP)>;
          sink-pdos = <PDO_FIXED(5000, 2000, PDO_FIXED_DUAL_ROLE | PDO_FIXED_DATA_SWAP)>;
          op-sink-microwatt = <10000000>;

          ports {
            #address-cells = <1>;
            #size-cells = <0>;

            port@0 {
              reg = <0>;
              endpoint {
                remote-endpoint = <&usb_hs>;
              };
            };
            port@1 {
              reg = <1>;
              endpoint {
                remote-endpoint = <&usb_ss>;
              };
            };
            port@2 {
              reg = <2>;
              endpoint {
                remote-endpoint = <&dp_aux>;
              };
            };
          };
        };
      };
    };
...
```

## Documentation/devicetree/bindings/usb/richtek,rt1719.yaml
```yaml
# SPDX-License-Identifier: GPL-2.0-only OR BSD-2-Clause
%YAML 1.2
---
$id: http://devicetree.org/schemas/usb/richtek,rt1719.yaml#
$schema: http://devicetree.org/meta-schemas/core.yaml#

title: Richtek RT1719 sink-only Type-C PD controller

maintainers:
  - ChiYuan Huang <cy_huang@richtek.com>

description: |
  The RT1719 is a sink-only USB Type-C contoller that complies with the latest
  USB Type-C and PD standards. It does the USB Type-C detection including attach
  and orientation. It integrates the physical layer of the USB BMC power
  delivery protocol to allow up to 100W of power. The BMC PD block enables full
  support for alternative interfaces of the Type-C specification.

properties:
  compatible:
    enum:
      - richtek,rt1719

  reg:
    maxItems: 1

  interrupts:
    maxItems: 1

  wakeup-source:
    description: enable IRQ remote wakeup, see power/wakeup-source.txt
    type: boolean

  connector:
    type: object
    $ref: ../connector/usb-connector.yaml#
    description:
      Properties for usb c connector.

additionalProperties: false

required:
  - compatible
  - reg
  - connector
  - interrupts

examples:
  - |
    #include <dt-bindings/interrupt-controller/irq.h>
    i2c {
      #address-cells = <1>;
      #size-cells = <0>;

      rt1719@43 {
        compatible = "richtek,rt1719";
        reg = <0x43>;
        interrupts-extended = <&gpio26 2 IRQ_TYPE_LEVEL_LOW>;
        wakeup-source;

        connector {
          compatible = "usb-c-connector";
          label = "USB-C";

          ports {
            #address-cells = <1>;
            #size-cells = <0>;

            port@0 {
              reg = <0>;
              endpoint {
                remote-endpoint = <&usb_hs>;
              };
            };
            port@1 {
              reg = <1>;
              endpoint {
                remote-endpoint = <&usb_ss>;
              };
            };
          };
        };
      };
    };
...
```

## Documentation/devicetree/bindings/usb/rockchip,dwc3.txt
```
Rockchip SuperSpeed DWC3 USB SoC controller

Required properties:
- compatible:	should contain "rockchip,rk3399-dwc3" for rk3399 SoC
- clocks:	A list of phandle + clock-specifier pairs for the
		clocks listed in clock-names
- clock-names:	Should contain the following:
  "ref_clk"	Controller reference clk, have to be 24 MHz
  "suspend_clk"	Controller suspend clk, have to be 24 MHz or 32 KHz
  "bus_clk"	Master/Core clock, have to be >= 62.5 MHz for SS
		operation and >= 30MHz for HS operation
  "grf_clk"	Controller grf clk

Required child node:
A child node must exist to represent the core DWC3 IP block. The name of
the node is not important. The content of the node is defined in dwc3.txt.

Phy documentation is provided in the following places:
Documentation/devicetree/bindings/phy/qcom-dwc3-usb-phy.txt

Example device nodes:

	usbdrd3_0: usb@fe800000 {
		compatible = "rockchip,rk3399-dwc3";
		clocks = <&cru SCLK_USB3OTG0_REF>, <&cru SCLK_USB3OTG0_SUSPEND>,
			 <&cru ACLK_USB3OTG0>, <&cru ACLK_USB3_GRF>;
		clock-names = "ref_clk", "suspend_clk",
			      "bus_clk", "grf_clk";
		#address-cells = <2>;
		#size-cells = <2>;
		ranges;
		usbdrd_dwc3_0: dwc3@fe800000 {
			compatible = "snps,dwc3";
			reg = <0x0 0xfe800000 0x0 0x100000>;
			interrupts = <GIC_SPI 105 IRQ_TYPE_LEVEL_HIGH>;
			dr_mode = "otg";
		};
	};

	usbdrd3_1: usb@fe900000 {
		compatible = "rockchip,rk3399-dwc3";
		clocks = <&cru SCLK_USB3OTG1_REF>, <&cru SCLK_USB3OTG1_SUSPEND>,
			 <&cru ACLK_USB3OTG1>, <&cru ACLK_USB3_GRF>;
		clock-names = "ref_clk", "suspend_clk",
			      "bus_clk", "grf_clk";
		#address-cells = <2>;
		#size-cells = <2>;
		ranges;
		usbdrd_dwc3_1: dwc3@fe900000 {
			compatible = "snps,dwc3";
			reg = <0x0 0xfe900000 0x0 0x100000>;
			interrupts = <GIC_SPI 110 IRQ_TYPE_LEVEL_HIGH>;
			dr_mode = "otg";
		};
	};
```

## Documentation/devicetree/bindings/usb/rockchip,dwc3.yaml
```yaml
# SPDX-License-Identifier: GPL-2.0
%YAML 1.2
---
$id: http://devicetree.org/schemas/usb/rockchip,dwc3.yaml#
$schema: http://devicetree.org/meta-schemas/core.yaml#

title: Rockchip SuperSpeed DWC3 USB SoC controller

maintainers:
  - Heiko Stuebner <heiko@sntech.de>

description:
  The common content of the node is defined in snps,dwc3.yaml.

  Phy documentation is provided in the following places.

  USB2.0 PHY
  Documentation/devicetree/bindings/phy/rockchip,inno-usb2phy.yaml

  Type-C PHY
  Documentation/devicetree/bindings/phy/rockchip,rk3399-typec-phy.yaml

select:
  properties:
    compatible:
      contains:
        enum:
          - rockchip,rk3328-dwc3
          - rockchip,rk3562-dwc3
          - rockchip,rk3568-dwc3
          - rockchip,rk3576-dwc3
          - rockchip,rk3588-dwc3
  required:
    - compatible

properties:
  compatible:
    items:
      - enum:
          - rockchip,rk3328-dwc3
          - rockchip,rk3562-dwc3
          - rockchip,rk3568-dwc3
          - rockchip,rk3576-dwc3
          - rockchip,rk3588-dwc3
      - const: snps,dwc3

  reg:
    maxItems: 1

  interrupts:
    maxItems: 1

  clocks:
    minItems: 3
    items:
      - description:
          Controller reference clock, must to be 24 MHz
      - description:
          Controller suspend clock, must to be 24 MHz or 32 KHz
      - description:
          Master/Core clock, must to be >= 62.5 MHz for SS
          operation and >= 30MHz for HS operation
      - description:
          Controller grf clock OR UTMI clock
      - description:
          PIPE clock

  clock-names:
    minItems: 3
    items:
      - const: ref_clk
      - const: suspend_clk
      - const: bus_clk
      - enum:
          - grf_clk
          - utmi
          - pipe
      - const: pipe

  power-domains:
    maxItems: 1

  resets:
    maxItems: 1

  reset-names:
    const: usb3-otg

unevaluatedProperties: false

required:
  - compatible
  - reg
  - interrupts
  - clocks
  - clock-names

allOf:
  - $ref: snps,dwc3.yaml#
  - if:
      properties:
        compatible:
          contains:
            const: rockchip,rk3328-dwc3
    then:
      properties:
        clocks:
          minItems: 3
          maxItems: 4
        clock-names:
          minItems: 3
          items:
            - const: ref_clk
            - const: suspend_clk
            - const: bus_clk
            - const: grf_clk
  - if:
      properties:
        compatible:
          contains:
            const: rockchip,rk3562-dwc3
    then:
      properties:
        clocks:
          minItems: 4
          maxItems: 4
        clock-names:
          items:
            - const: ref_clk
            - const: suspend_clk
            - const: bus_clk
            - const: pipe
  - if:
      properties:
        compatible:
          contains:
            enum:
              - rockchip,rk3568-dwc3
              - rockchip,rk3576-dwc3
    then:
      properties:
        clocks:
          maxItems: 3
        clock-names:
          maxItems: 3
  - if:
      properties:
        compatible:
          contains:
            const: rockchip,rk3588-dwc3
    then:
      properties:
        clock-names:
          minItems: 3
          items:
            - const: ref_clk
            - const: suspend_clk
            - const: bus_clk
            - const: utmi
            - const: pipe

examples:
  - |
    #include <dt-bindings/clock/rk3328-cru.h>
    #include <dt-bindings/interrupt-controller/arm-gic.h>

    bus {
      #address-cells = <2>;
      #size-cells = <2>;

      usbdrd3_0: usb@fe800000 {
        compatible = "rockchip,rk3328-dwc3", "snps,dwc3";
        reg = <0x0 0xfe800000 0x0 0x100000>;
        interrupts = <GIC_SPI 105 IRQ_TYPE_LEVEL_HIGH>;
        clocks = <&cru SCLK_USB3OTG_REF>, <&cru SCLK_USB3OTG_SUSPEND>,
                 <&cru ACLK_USB3OTG>;
        clock-names = "ref_clk", "suspend_clk",
                      "bus_clk", "grf_clk";
        dr_mode = "otg";
      };
    };
```
