## Documentation/devicetree/bindings/usb/socionext,uniphier-dwc3.yaml
```yaml
# SPDX-License-Identifier: (GPL-2.0-only OR BSD-2-Clause)
%YAML 1.2
---
$id: http://devicetree.org/schemas/usb/socionext,uniphier-dwc3.yaml#
$schema: http://devicetree.org/meta-schemas/core.yaml#

title: Socionext Uniphier SuperSpeed DWC3 USB SoC controller

maintainers:
  - Kunihiko Hayashi <hayashi.kunihiko@socionext.com>
  - Masami Hiramatsu <mhiramat@kernel.org>

select:
  properties:
    compatible:
      contains:
        const: socionext,uniphier-dwc3
  required:
    - compatible

properties:
  compatible:
    items:
      - const: socionext,uniphier-dwc3
      - const: snps,dwc3

  reg:
    maxItems: 1

  interrupts:
    minItems: 1
    items:
      - description: Host or single combined interrupt
      - description: Peripheral interrupt

  interrupt-names:
    minItems: 1
    items:
      - enum:
          - dwc_usb3
          - host
      - const: peripheral

  clocks:
    maxItems: 3

  clock-names:
    items:
      - const: ref
      - const: bus_early
      - const: suspend

  phys:
    description: 1 to 4 HighSpeed PHYs followed by 1 or 2 SuperSpeed PHYs
    minItems: 1
    maxItems: 6

  resets:
    maxItems: 1

required:
  - compatible
  - reg
  - interrupts
  - clocks
  - clock-names
  - phys

unevaluatedProperties: false

allOf:
  - $ref: snps,dwc3.yaml#

examples:
  - |
    #include <dt-bindings/interrupt-controller/arm-gic.h>

    usb@65a00000 {
        compatible = "socionext,uniphier-dwc3", "snps,dwc3";
        reg = <0x65a00000 0xcd00>;
        interrupt-names = "dwc_usb3";
        interrupts = <GIC_SPI 134 IRQ_TYPE_LEVEL_HIGH>;
        clock-names = "ref", "bus_early", "suspend";
        clocks = <&sys_clk 12>, <&sys_clk 12>, <&sys_clk 12>;
        resets = <&usb0_rst 15>;
        phys = <&usb0_hsphy0>, <&usb0_hsphy1>,
               <&usb0_ssphy0>, <&usb0_ssphy1>;
        dr_mode = "host";
    };
```

## Documentation/devicetree/bindings/usb/spacemit,k1-dwc3.yaml
```yaml
# SPDX-License-Identifier: (GPL-2.0 OR BSD-2-Clause)
%YAML 1.2
---
$id: http://devicetree.org/schemas/usb/spacemit,k1-dwc3.yaml#
$schema: http://devicetree.org/meta-schemas/core.yaml#

title: SpacemiT K1 SuperSpeed DWC3 USB SoC Controller

maintainers:
  - Ze Huang <huang.ze@linux.dev>

description: |
  The SpacemiT K1 embeds a DWC3 USB IP Core which supports Host functions
  for USB 3.0 and DRD for USB 2.0.

  Key features:
  - USB3.0 SuperSpeed and USB2.0 High/Full/Low-Speed support
  - Supports low-power modes (USB2.0 suspend, USB3.0 U1/U2/U3)
  - Internal DMA controller and flexible endpoint FIFO sizing

  Communication Interface:
  - Use of PIPE3 (125MHz) interface for USB3.0 PHY
  - Use of UTMI+ (30/60MHz) interface for USB2.0 PHY

allOf:
  - $ref: snps,dwc3-common.yaml#

properties:
  compatible:
    const: spacemit,k1-dwc3

  reg:
    maxItems: 1

  clocks:
    maxItems: 1

  clock-names:
    const: usbdrd30

  interrupts:
    maxItems: 1

  phys:
    items:
      - description: phandle to USB2/HS PHY
      - description: phandle to USB3/SS PHY

  phy-names:
    items:
      - const: usb2-phy
      - const: usb3-phy

  resets:
    items:
      - description: USB3.0 AHB reset
      - description: USB3.0 VCC reset
      - description: USB3.0 PHY reset

  reset-names:
    items:
      - const: ahb
      - const: vcc
      - const: phy

  reset-delay:
    $ref: /schemas/types.yaml#/definitions/uint32
    default: 2
    description: delay after reset sequence [us]

  vbus-supply:
    description: A phandle to the regulator supplying the VBUS voltage.

required:
  - compatible
  - reg
  - clocks
  - clock-names
  - interrupts
  - phys
  - phy-names
  - resets
  - reset-names

unevaluatedProperties: false

examples:
  - |
    usb@c0a00000 {
        compatible = "spacemit,k1-dwc3";
        reg = <0xc0a00000 0x10000>;
        clocks = <&syscon_apmu 16>;
        clock-names = "usbdrd30";
        interrupts = <125>;
        phys = <&usb2phy>, <&usb3phy>;
        phy-names = "usb2-phy", "usb3-phy";
        resets = <&syscon_apmu 8>,
                 <&syscon_apmu 9>,
                 <&syscon_apmu 10>;
        reset-names = "ahb", "vcc", "phy";
        reset-delay = <2>;
        vbus-supply = <&usb3_vbus>;
        #address-cells = <1>;
        #size-cells = <0>;

        hub_2_0: hub@1 {
            compatible = "usb2109,2817";
            reg = <1>;
            vdd-supply = <&usb3_vhub>;
            peer-hub = <&hub_3_0>;
            reset-gpios = <&gpio 3 28 1>;
        };

        hub_3_0: hub@2 {
            compatible = "usb2109,817";
            reg = <2>;
            vdd-supply = <&usb3_vhub>;
            peer-hub = <&hub_2_0>;
            reset-gpios = <&gpio 3 28 1>;
        };
    };
```

## Documentation/devicetree/bindings/usb/spear-usb.txt
```
ST SPEAr SoC USB controllers:
-----------------------------

EHCI:
-----

Required properties:
- compatible: "st,spear600-ehci"
- interrupts: Should contain the EHCI interrupt

Example:

	ehci@e1800000 {
		compatible = "st,spear600-ehci", "usb-ehci";
		reg = <0xe1800000 0x1000>;
		interrupt-parent = <&vic1>;
		interrupts = <27>;
	};


OHCI:
-----

Required properties:
- compatible: "st,spear600-ohci"
- interrupts: Should contain the OHCI interrupt

Example:

	ohci@e1900000 {
		compatible = "st,spear600-ohci", "usb-ohci";
		reg = <0xe1800000 0x1000>;
		interrupt-parent = <&vic1>;
		interrupts = <26>;
	};
```

## Documentation/devicetree/bindings/usb/st,st-ohci-300x.yaml
```yaml
# SPDX-License-Identifier: (GPL-2.0-only OR BSD-2-Clause)
%YAML 1.2
---
$id: http://devicetree.org/schemas/usb/st,st-ohci-300x.yaml#
$schema: http://devicetree.org/meta-schemas/core.yaml#

title: STMicroelectronics USB OHCI Controller

maintainers:
  - Peter Griffin <peter.griffin@linaro.org>

description:
  The STMicroelectronics USB Open Host Controller Interface (OHCI)
  compliant USB host controller found in ST platforms. The controller
  provides full- and low-speed USB host functionality and interfaces
  with an external USB PHY. It requires dedicated clock, reset, and
  interrupt resources for proper operation.

allOf:
  - $ref: /schemas/usb/usb-hcd.yaml#

properties:
  compatible:
    const: st,st-ohci-300x

  reg:
    maxItems: 1

  interrupts:
    maxItems: 1

  clocks:
    maxItems: 2

  clock-names:
    items:
      - const: ic
      - const: clk48

  phys:
    maxItems: 1

  phy-names:
    items:
      - const: usb

  resets:
    maxItems: 2

  reset-names:
    items:
      - const: power
      - const: softreset

required:
  - compatible
  - reg
  - interrupts
  - clocks
  - clock-names
  - phys
  - phy-names
  - resets
  - reset-names

unevaluatedProperties: false

examples:
  - |
    #include <dt-bindings/interrupt-controller/arm-gic.h>
    #include <dt-bindings/reset/stih407-resets.h>
    usb@fe1ffc00 {
        compatible = "st,st-ohci-300x";
        reg = <0xfe1ffc00 0x100>;
        interrupts = <GIC_SPI 149 IRQ_TYPE_NONE>;
        clocks = <&clk_s_a1_ls 0>,
                 <&clockgen_b0 0>;
        clock-names = "ic", "clk48";
        phys = <&usb2_phy>;
        phy-names = "usb";
        resets = <&powerdown STIH407_USB2_PORT0_POWERDOWN>,
                 <&softreset STIH407_USB2_PORT0_SOFTRESET>;
        reset-names = "power", "softreset";
    };
...
```

## Documentation/devicetree/bindings/usb/st,stusb160x.yaml
```yaml
# SPDX-License-Identifier: GPL-2.0-only OR BSD-2-Clause
%YAML 1.2
---
$id: "http://devicetree.org/schemas/usb/st,stusb160x.yaml#"
$schema: "http://devicetree.org/meta-schemas/core.yaml#"

title: STMicroelectronics STUSB160x Type-C controller bindings

maintainers:
  - Amelie Delaunay <amelie.delaunay@foss.st.com>

properties:
  compatible:
    enum:
      - st,stusb1600

  reg:
    maxItems: 1

  interrupts:
    maxItems: 1

  vdd-supply:
    description: main power supply (4.1V-22V)

  vsys-supply:
    description: low power supply (3.0V-5.5V)

  vconn-supply:
    description: power supply (2.7V-5.5V) used to supply VConn on CC pin in
      source or dual power role

  connector:
    type: object
    $ref: /schemas/connector/usb-connector.yaml#
    unevaluatedProperties: false

    properties:
      compatible:
        const: usb-c-connector

      power-role: true

      typec-power-opmode: true

    required:
      - compatible

required:
  - compatible
  - reg
  - connector

additionalProperties: false

examples:
  - |
    #include <dt-bindings/interrupt-controller/irq.h>
    i2c4 {
        #address-cells = <1>;
        #size-cells = <0>;

        typec: stusb1600@28 {
            compatible = "st,stusb1600";
            reg = <0x28>;
            vdd-supply = <&vbus_drd>;
            vsys-supply = <&vdd_usb>;
            interrupts = <11 IRQ_TYPE_EDGE_FALLING>;
            interrupt-parent = <&gpioi>;

            typec_con: connector {
                compatible = "usb-c-connector";
                label = "USB-C";
                power-role = "dual";
                data-role = "dual";
                typec-power-opmode = "default";

                ports {
                    #address-cells = <1>;
                    #size-cells = <0>;
                    port@0 {
                        reg = <0>;
                        typec_con_ep: endpoint {
                            remote-endpoint = <&usbotg_hs_ep>;
                        };
                    };
                };
            };
        };
    };
...
```

## Documentation/devicetree/bindings/usb/st,typec-stm32g0.yaml
```yaml
# SPDX-License-Identifier: (GPL-2.0 OR BSD-2-Clause)
%YAML 1.2
---
$id: http://devicetree.org/schemas/usb/st,typec-stm32g0.yaml#
$schema: http://devicetree.org/meta-schemas/core.yaml#

title: STMicroelectronics STM32G0 USB Type-C PD controller

description: |
  The STM32G0 MCU can be programmed to control Type-C connector(s) through I2C
  typically using the UCSI protocol over I2C, with a dedicated alert
  (interrupt) pin.

maintainers:
  - Fabrice Gasnier <fabrice.gasnier@foss.st.com>

properties:
  compatible:
    const: st,stm32g0-typec

  reg:
    maxItems: 1

  interrupts:
    maxItems: 1

  connector:
    type: object
    $ref: /schemas/connector/usb-connector.yaml#
    unevaluatedProperties: false

  firmware-name:
    description: |
      Should contain the name of the default firmware image
      file located on the firmware search path

  wakeup-source: true

  power-domains:
    maxItems: 1

required:
  - compatible
  - reg
  - interrupts
  - connector

additionalProperties: false

examples:
  - |
    #include <dt-bindings/interrupt-controller/irq.h>
    i2c {
      #address-cells = <1>;
      #size-cells = <0>;

      typec@53 {
        compatible = "st,stm32g0-typec";
        reg = <0x53>;
        /* Alert pin on GPIO PE12 */
        interrupts = <12 IRQ_TYPE_EDGE_FALLING>;
        interrupt-parent = <&gpioe>;

        /* Example with one type-C connector */
        connector {
          compatible = "usb-c-connector";
          label = "USB-C";

          ports {
            #address-cells = <1>;
            #size-cells = <0>;
            port@0 {
              reg = <0>;
              con_usb_c_ep: endpoint {
                remote-endpoint = <&usb_ep>;
              };
            };
          };
        };
      };
    };

    usb {
      usb-role-switch;
      port {
        usb_ep: endpoint {
          remote-endpoint = <&con_usb_c_ep>;
        };
      };
    };
...
```

## Documentation/devicetree/bindings/usb/starfive,jh7110-usb.yaml
```yaml
# SPDX-License-Identifier: (GPL-2.0-only OR BSD-2-Clause)
%YAML 1.2
---
$id: http://devicetree.org/schemas/usb/starfive,jh7110-usb.yaml#
$schema: http://devicetree.org/meta-schemas/core.yaml#

title: StarFive JH7110 wrapper module for the Cadence USBSS-DRD controller

maintainers:
  - Minda Chen <minda.chen@starfivetech.com>

properties:
  compatible:
    const: starfive,jh7110-usb

  ranges: true

  starfive,stg-syscon:
    $ref: /schemas/types.yaml#/definitions/phandle-array
    items:
      - items:
          - description: phandle to System Register Controller stg_syscon node.
          - description: dr mode register offset of STG_SYSCONSAIF__SYSCFG register for USB.
    description:
      The phandle to System Register Controller syscon node and the offset
      of STG_SYSCONSAIF__SYSCFG register for USB.

  dr_mode:
    enum: [host, otg, peripheral]

  "#address-cells":
    enum: [1, 2]

  "#size-cells":
    enum: [1, 2]

  clocks:
    items:
      - description: link power management clock
      - description: standby clock
      - description: APB clock
      - description: AXI clock
      - description: UTMI APB clock

  clock-names:
    items:
      - const: lpm
      - const: stb
      - const: apb
      - const: axi
      - const: utmi_apb

  resets:
    items:
      - description: Power up reset
      - description: APB clock reset
      - description: AXI clock reset
      - description: UTMI APB clock reset

  reset-names:
    items:
      - const: pwrup
      - const: apb
      - const: axi
      - const: utmi_apb

patternProperties:
  "^usb@[0-9a-f]+$":
    $ref: cdns,usb3.yaml#
    description: Required child node

required:
  - compatible
  - ranges
  - starfive,stg-syscon
  - '#address-cells'
  - '#size-cells'
  - dr_mode
  - clocks
  - resets

additionalProperties: false

examples:
  - |
    usb@10100000 {
        compatible = "starfive,jh7110-usb";
        ranges = <0x0 0x10100000 0x100000>;
        #address-cells = <1>;
        #size-cells = <1>;
        starfive,stg-syscon = <&stg_syscon 0x4>;
        clocks = <&syscrg 4>,
                 <&stgcrg 5>,
                 <&stgcrg 1>,
                 <&stgcrg 3>,
                 <&stgcrg 2>;
        clock-names = "lpm", "stb", "apb", "axi", "utmi_apb";
        resets = <&stgcrg 10>,
                 <&stgcrg 8>,
                 <&stgcrg 7>,
                 <&stgcrg 9>;
        reset-names = "pwrup", "apb", "axi", "utmi_apb";
        dr_mode = "host";

        usb@0 {
            compatible = "cdns,usb3";
            reg = <0x0 0x10000>,
                  <0x10000 0x10000>,
                  <0x20000 0x10000>;
            reg-names = "otg", "xhci", "dev";
            interrupts = <100>, <108>, <110>;
            interrupt-names = "host", "peripheral", "otg";
            maximum-speed = "super-speed";
        };
    };
```

## Documentation/devicetree/bindings/usb/starfive,jhb100-dwc3.yaml
```yaml
# SPDX-License-Identifier: (GPL-2.0-only OR BSD-2-Clause)
%YAML 1.2
---
$id: http://devicetree.org/schemas/usb/starfive,jhb100-dwc3.yaml#
$schema: http://devicetree.org/meta-schemas/core.yaml#

title: StarFive JHB100 DWC3 USB SoC Controller

maintainers:
  - Minda Chen <minda.chen@starfivetech.com>

description:
  The USB DRD controller on JHB100 BMC SoC.

allOf:
  - $ref: snps,dwc3-common.yaml#

properties:
  compatible:
    const: starfive,jhb100-dwc3

  reg:
    maxItems: 1

  interrupts:
    maxItems: 1

  clocks:
    items:
      - description: USB main enable clk
      - description: DWC3 bus early clock
      - description: DWC3 ref clock

  clock-names:
    items:
      - const: main
      - const: bus_early
      - const: ref

  resets:
    maxItems: 1

required:
  - compatible
  - reg
  - clocks
  - clock-names
  - interrupts

unevaluatedProperties: false

examples:
  - |
    usb@11800000 {
        compatible = "starfive,jhb100-dwc3";
        reg = <0x11800000 0x10000>;
        clocks = <&usbcrg 9>,
                 <&usbcrg 5>,
                 <&usbcrg 6>;
        clock-names = "main", "bus_early", "ref";
        resets = <&usbcrg 4>;
        interrupts = <105>;
        dr_mode = "host";
    };
```
