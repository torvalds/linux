## Documentation/devicetree/bindings/usb/gr-udc.txt
```
USB Peripheral Controller driver for Aeroflex Gaisler GRUSBDC.

The GRUSBDC USB Device Controller core is available in the GRLIB VHDL
IP core library.

Note: In the ordinary environment for the core, a Leon SPARC system,
these properties are built from information in the AMBA plug&play.

Required properties:

- name : Should be "GAISLER_USBDC" or "01_021"

- reg : Address and length of the register set for the device

- interrupts : Interrupt numbers for this device. Either one interrupt number
	for all interrupts, or one for status related interrupts, one for IN
	endpoint related interrupts and one for OUT endpoint related interrupts.

Optional properties:

- epobufsizes : Array of buffer sizes for OUT endpoints when they differ
	from the default size of 1024. The array is indexed by the OUT endpoint
	number. If the property is present it typically contains one entry for
	each OUT endpoint of the core. Fewer entries overrides the default sizes
	only for as many endpoints as the array contains.

- epibufsizes : Array of buffer sizes for IN endpoints when they differ
	from the default size of 1024. The array is indexed by the IN endpoint
	number. If the property is present it typically contains one entry for
	each IN endpoint of the core. Fewer entries overrides the default sizes
	only for as many endpoints as the array contains.

For further information look in the documentation for the GLIB IP core library:
http://www.gaisler.com/products/grlib/grip.pdf
```

## Documentation/devicetree/bindings/usb/hisilicon,hi3798mv200-dwc3.yaml
```yaml
# SPDX-License-Identifier: (GPL-2.0 OR BSD-2-Clause)
%YAML 1.2
---
$id: http://devicetree.org/schemas/usb/hisilicon,hi3798mv200-dwc3.yaml#
$schema: http://devicetree.org/meta-schemas/core.yaml#

title: HiSilicon Hi3798MV200 DWC3 USB SoC controller

maintainers:
  - Yang Xiwen <forbidden405@foxmail.com>

properties:
  compatible:
    const: hisilicon,hi3798mv200-dwc3

  '#address-cells':
    const: 1

  '#size-cells':
    const: 1

  ranges: true

  clocks:
    items:
      - description: Controller bus clock
      - description: Controller suspend clock
      - description: Controller reference clock
      - description: Controller gm clock
      - description: Controller gs clock
      - description: Controller utmi clock
      - description: Controller pipe clock

  clock-names:
    items:
      - const: bus
      - const: suspend
      - const: ref
      - const: gm
      - const: gs
      - const: utmi
      - const: pipe

  resets:
    maxItems: 1

  reset-names:
    const: soft

patternProperties:
  '^usb@[0-9a-f]+$':
    $ref: snps,dwc3.yaml#

required:
  - compatible
  - ranges
  - '#address-cells'
  - '#size-cells'
  - clocks
  - clock-names
  - resets
  - reset-names

additionalProperties: false

examples:
  - |
    #include <dt-bindings/interrupt-controller/arm-gic.h>

    usb {
        compatible = "hisilicon,hi3798mv200-dwc3";
        ranges;
        #address-cells = <1>;
        #size-cells = <1>;
        clocks = <&clk_bus>,
                 <&clk_suspend>,
                 <&clk_ref>,
                 <&clk_gm>,
                 <&clk_gs>,
                 <&clk_utmi>,
                 <&clk_pipe>;
        clock-names = "bus", "suspend", "ref", "gm", "gs", "utmi", "pipe";
        resets = <&crg 0xb0 12>;
        reset-names = "soft";

        usb@98a0000 {
            compatible = "snps,dwc3";
            reg = <0x98a0000 0x10000>;
            interrupts = <GIC_SPI 69 IRQ_TYPE_LEVEL_HIGH>;
            clocks = <&clk_bus>,
                     <&clk_suspend>,
                     <&clk_ref>;
            clock-names = "bus_early", "suspend", "ref";
            phys = <&usb2_phy1_port2>, <&combphy0 0>;
            phy-names = "usb2-phy", "usb3-phy";
            maximum-speed = "super-speed";
            dr_mode = "host";
        };
    };
```

## Documentation/devicetree/bindings/usb/hisilicon,histb-xhci.txt
```
HiSilicon STB xHCI

The device node for HiSilicon STB xHCI host controller

Required properties:
 - compatible: should be "hisilicon,hi3798cv200-xhci"
 - reg: specifies physical base address and size of the registers
 - interrupts : interrupt used by the controller
 - clocks: a list of phandle + clock-specifier pairs, one for each
	entry in clock-names
 - clock-names: must contain
	"bus": for bus clock
	"utmi": for utmi clock
	"pipe": for pipe clock
	"suspend": for suspend clock
 - resets: a list of phandle and reset specifier pairs as listed in
	reset-names property.
 - reset-names: must contain
	"soft": for soft reset
 - phys: a list of phandle + phy specifier pairs
 - phy-names: must contain at least one of following:
	"inno": for inno phy
	"combo": for combo phy

Optional properties:
  - usb2-lpm-disable: indicate if we don't want to enable USB2 HW LPM
  - usb3-lpm-capable: determines if platform is USB3 LPM capable
  - imod-interval-ns: default interrupt moderation interval is 40000ns

Example:

xhci0: xchi@f98a0000 {
	compatible = "hisilicon,hi3798cv200-xhci";
	reg = <0xf98a0000 0x10000>;
	interrupts = <GIC_SPI 69 IRQ_TYPE_LEVEL_HIGH>;
	clocks = <&crg HISTB_USB3_BUS_CLK>,
		 <&crg HISTB_USB3_UTMI_CLK>,
		 <&crg HISTB_USB3_PIPE_CLK>,
		 <&crg HISTB_USB3_SUSPEND_CLK>;
	clock-names = "bus", "utmi", "pipe", "suspend";
	resets = <&crg 0xb0 12>;
	reset-names = "soft";
	phys = <&usb2_phy1_port1 0>, <&combphy0 PHY_TYPE_USB3>;
	phy-names = "inno", "combo";
};
```

## Documentation/devicetree/bindings/usb/hynetek,husb311.yaml
```yaml
# SPDX-License-Identifier: (GPL-2.0-only OR BSD-2-Clause)
%YAML 1.2
---
$id: "http://devicetree.org/schemas/usb/hynetek,husb311.yaml#"
$schema: "http://devicetree.org/meta-schemas/core.yaml#"

title: Hynetek HUSB311 Type-C Port controller DT bindings

maintainers:
  - Guenter Roeck <linux@roeck-us.net>
  - Heikki Krogerus <heikki.krogerus@linux.intel.com>

properties:
  compatible:
    const: hynetek,husb311

  reg:
    maxItems: 1

  interrupts:
    maxItems: 1

  ports:
    type: object
    properties:
      port@0:
        type: object
        description: TCPC connected to USB controller to support dual-role switch.

    required:
      - port@0

  connector:
    type: object
    $ref: ../connector/usb-connector.yaml#
    description:
      Properties for usb c connector that attached to the tcpci chip.

required:
  - compatible
  - reg
  - interrupts
  - connector

additionalProperties: true

examples:
  - |
    #include "dt-bindings/usb/pd.h"

    usbc0: husb311@4e {
        compatible = "hynetek,husb311";
        reg = <0x4e>;
        interrupt-parent = <&gpio1>;
        interrupts = <RK_PA2 IRQ_TYPE_LEVEL_LOW>;
        vbus-supply = <&vcc5v0_typec>;
        status = "okay";

        ports {
            #address-cells = <1>;
            #size-cells = <0>;

            port@0 {
                reg = <0>;
                usbc0_role_sw: endpoint@0 {
                    remote-endpoint = <&dwc3_0_role_switch>;
                };
            };
        };

        usb_con: connector {
            compatible = "usb-c-connector";
            label = "USB-C";
            data-role = "dual";
            power-role = "dual";
            try-power-role = "sink";
            op-sink-microwatt = <1000000>;
            sink-pdos =
                <PDO_FIXED(5000, 1000, PDO_FIXED_USB_COMM)>;
            source-pdos =
                <PDO_FIXED(5000, 3000, PDO_FIXED_USB_COMM)>;

            ports {
                #address-cells = <1>;
                #size-cells = <0>;

                port@0 {
                    reg = <0>;
                    usbc0_orien_sw: endpoint {
                        remote-endpoint = <&usbdp_phy0_orientation_switch>;
                    };
                };
            };
        };
    };
...
```

## Documentation/devicetree/bindings/usb/ingenic,jz4740-musb.txt
```
Ingenic JZ4740 MUSB driver

Required properties:

- compatible: Must be "ingenic,jz4740-musb"
- reg: Address range of the UDC register set
- interrupts: IRQ number related to the UDC hardware
- interrupt-names: must be "mc"
- clocks: phandle to the "udc" clock
- clock-names: must be "udc"

Example:

udc: usb@13040000 {
	compatible = "ingenic,jz4740-musb";
	reg = <0x13040000 0x10000>;

	interrupt-parent = <&intc>;
	interrupts = <24>;
	interrupt-names = "mc";

	clocks = <&cgu JZ4740_CLK_UDC>;
	clock-names = "udc";
};
```

## Documentation/devicetree/bindings/usb/ingenic,musb.yaml
```yaml
# SPDX-License-Identifier: (GPL-2.0-only OR BSD-2-Clause)
%YAML 1.2
---
$id: http://devicetree.org/schemas/usb/ingenic,musb.yaml#
$schema: http://devicetree.org/meta-schemas/core.yaml#

title: Ingenic JZ47xx USB IP DT bindings

maintainers:
  - Paul Cercueil <paul@crapouillou.net>

properties:
  $nodename:
    pattern: '^usb@.*'

  compatible:
    oneOf:
      - enum:
          - ingenic,jz4770-musb
          - ingenic,jz4740-musb
      - items:
          - const: ingenic,jz4725b-musb
          - const: ingenic,jz4740-musb

  reg:
    maxItems: 1

  clocks:
    maxItems: 1

  clock-names:
    items:
      - const: udc

  interrupts:
    maxItems: 1

  interrupt-names:
    items:
      - const: mc

  phys:
    description: PHY specifier for the USB PHY

  usb-role-switch:
    type: boolean

required:
  - compatible
  - reg
  - clocks
  - clock-names
  - interrupts
  - interrupt-names
  - phys

additionalProperties: false

examples:
  - |
    #include <dt-bindings/clock/jz4740-cgu.h>
    usb_phy: usb-phy {
      compatible = "usb-nop-xceiv";
      #phy-cells = <0>;
    };

    udc: usb@13040000 {
      compatible = "ingenic,jz4740-musb";
      reg = <0x13040000 0x10000>;

      interrupt-parent = <&intc>;
      interrupts = <24>;
      interrupt-names = "mc";

      clocks = <&cgu JZ4740_CLK_UDC>;
      clock-names = "udc";

      phys = <&usb_phy>;
    };
```

## Documentation/devicetree/bindings/usb/intel,ixp4xx-udc.yaml
```yaml
# SPDX-License-Identifier: (GPL-2.0-only OR BSD-2-Clause)
%YAML 1.2
---
$id: http://devicetree.org/schemas/usb/intel,ixp4xx-udc.yaml#
$schema: http://devicetree.org/meta-schemas/core.yaml#

title: Intel IXP4xx SoC USB Device Controller (UDC)

description: The IXP4xx SoCs has a full-speed USB Device
  Controller with 16 endpoints and a built-in transceiver.

maintainers:
  - Linus Walleij <linus.walleij@linaro.org>

properties:
  compatible:
    const: intel,ixp4xx-udc

  reg:
    maxItems: 1

  interrupts:
    maxItems: 1

required:
  - compatible
  - reg
  - interrupts

additionalProperties: false

examples:
  - |
    #include <dt-bindings/interrupt-controller/irq.h>
    usb@c800b000 {
        compatible = "intel,ixp4xx-udc";
        reg = <0xc800b000 0x1000>;
        interrupts = <12 IRQ_TYPE_LEVEL_HIGH>;
    };
```

## Documentation/devicetree/bindings/usb/intel,keembay-dwc3.yaml
```yaml
# SPDX-License-Identifier: (GPL-2.0-only OR BSD-2-Clause)
%YAML 1.2
---
$id: http://devicetree.org/schemas/usb/intel,keembay-dwc3.yaml#
$schema: http://devicetree.org/meta-schemas/core.yaml#

title: Intel Keem Bay DWC3 USB controller

maintainers:
  - Wan Ahmad Zainie <wan.ahmad.zainie.wan.mohamad@intel.com>

properties:
  compatible:
    const: intel,keembay-dwc3

  reg:
    maxItems: 1

  clocks:
    maxItems: 4

  clock-names:
    items:
      - const: async_master
      - const: ref
      - const: alt_ref
      - const: suspend

  ranges: true

  '#address-cells':
    enum: [ 1, 2 ]

  '#size-cells':
    enum: [ 1, 2 ]

# Required child node:

patternProperties:
  "^usb@[0-9a-f]+$":
    $ref: snps,dwc3.yaml#

required:
  - compatible
  - clocks
  - clock-names
  - ranges

additionalProperties: false

examples:
  - |
    #include <dt-bindings/interrupt-controller/arm-gic.h>
    #include <dt-bindings/interrupt-controller/irq.h>
    #define KEEM_BAY_A53_AUX_USB
    #define KEEM_BAY_A53_AUX_USB_REF
    #define KEEM_BAY_A53_AUX_USB_ALT_REF
    #define KEEM_BAY_A53_AUX_USB_SUSPEND

    usb {
        compatible = "intel,keembay-dwc3";
        clocks = <&scmi_clk KEEM_BAY_A53_AUX_USB>,
                 <&scmi_clk KEEM_BAY_A53_AUX_USB_REF>,
                 <&scmi_clk KEEM_BAY_A53_AUX_USB_ALT_REF>,
                 <&scmi_clk KEEM_BAY_A53_AUX_USB_SUSPEND>;
        clock-names = "async_master", "ref", "alt_ref", "suspend";
        ranges;
        #address-cells = <1>;
        #size-cells = <1>;

        usb@34000000 {
            compatible = "snps,dwc3";
            reg = <0x34000000 0x10000>;
            interrupts = <GIC_SPI 91 IRQ_TYPE_LEVEL_HIGH>;
            dr_mode = "peripheral";
        };
    };
```

## Documentation/devicetree/bindings/usb/iproc-udc.txt
```
Broadcom IPROC USB Device controller.

The device node is used for UDCs integrated into Broadcom's
iProc family (Northstar2, Cygnus) of SoCs'. The UDC is based
on Synopsys Designware Cores AHB Subsystem Device Controller
IP.

Required properties:
 - compatible: Add the compatibility strings for supported platforms.
   For Broadcom NS2 platform, add "brcm,ns2-udc","brcm,iproc-udc".
   For Broadcom Cygnus platform, add "brcm,cygnus-udc", "brcm,iproc-udc".
 - reg: Offset and length of UDC register set
 - interrupts: description of interrupt line
 - phys: phandle to phy node.

Example:
	udc_dwc: usb@664e0000 {
		compatible = "brcm,ns2-udc", "brcm,iproc-udc";
		reg = <0x664e0000 0x2000>;
		interrupts = <GIC_SPI 424 IRQ_TYPE_LEVEL_HIGH>;
		phys = <&usbdrd_phy>;
```

## Documentation/devicetree/bindings/usb/isp1301.txt
```
* NXP ISP1301 USB transceiver

Required properties:
- compatible: must be "nxp,isp1301"
- reg: I2C address of the ISP1301 device

Optional properties of devices using ISP1301:
- transceiver: phandle of isp1301 - this helps the ISP1301 driver to find the
               ISP1301 instance associated with the respective USB driver

Example:

	isp1301: usb-transceiver@2c {
		compatible = "nxp,isp1301";
		reg = <0x2c>;
	};

	usbd@31020000 {
		compatible = "nxp,lpc3220-udc";
		reg = <0x31020000 0x300>;
		interrupt-parent = <&mic>;
		interrupts = <0x3d 0>, <0x3e 0>, <0x3c 0>, <0x3a 0>;
		transceiver = <&isp1301>;
	};
```

## Documentation/devicetree/bindings/usb/ite,it5205.yaml
```yaml
# SPDX-License-Identifier: GPL-2.0-only OR BSD-2-Clause
%YAML 1.2
---
$id: http://devicetree.org/schemas/usb/ite,it5205.yaml#
$schema: http://devicetree.org/meta-schemas/core.yaml#

title: ITE IT5202 Type-C USB Alternate Mode Passive MUX

maintainers:
  - AngeloGioacchino Del Regno <angelogioacchino.delregno@collabora.com>
  - Tianping Fang <tianping.fang@mediatek.com>

properties:
  compatible:
    const: ite,it5205

  reg:
    maxItems: 1

  vcc-supply:
    description: Power supply for VCC pin (3.3V)

  mode-switch:
    description: Flag the port as possible handle of altmode switching
    type: boolean

  orientation-switch:
    description: Flag the port as possible handler of orientation switching
    type: boolean

  ite,ovp-enable:
    description: Enable Over Voltage Protection functionality
    type: boolean

  port:
    $ref: /schemas/graph.yaml#/properties/port
    description:
      A port node to link the IT5205 to a TypeC controller for the purpose of
      handling altmode muxing and orientation switching.

required:
  - compatible
  - reg
  - orientation-switch
  - port

additionalProperties: false

examples:
  - |
    #include <dt-bindings/interrupt-controller/irq.h>
    i2c2 {
        #address-cells = <1>;
        #size-cells = <0>;

        typec-mux@48 {
            compatible = "ite,it5205";
            reg = <0x48>;

            mode-switch;
            orientation-switch;

            vcc-supply = <&mt6359_vibr_ldo_reg>;

            port {
                it5205_usbss_sbu: endpoint {
                    remote-endpoint = <&typec_controller>;
                };
            };
        };
    };
...
```
