## Documentation/devicetree/bindings/usb/keystone-usb.txt
```
TI Keystone Soc USB Controller

DWC3 GLUE

Required properties:
 - compatible: should be "ti,keystone-dwc3".
 - #address-cells, #size-cells : should be '1' if the device has sub-nodes
   with 'reg' property.
 - reg : Address and length of the register set for the USB subsystem on
   the SOC.
 - interrupts : The irq number of this device that is used to interrupt the
   MPU.
 - ranges: allows valid 1:1 translation between child's address space and
   parent's address space.

SoC-specific Required Properties:
The following are mandatory properties for Keystone 2 66AK2HK, 66AK2L and 66AK2E
SoCs only:

- clocks:		Clock ID for USB functional clock.
- clock-names:		Must be "usb".


The following are mandatory properties for Keystone 2 66AK2G SoCs only:

- power-domains:	Should contain a phandle to a PM domain provider node
			and an args specifier containing the USB device id
			value. This property is as per the binding,
			Documentation/devicetree/bindings/soc/ti/sci-pm-domain.txt

Sub-nodes:
The dwc3 core should be added as subnode to Keystone DWC3 glue.
- dwc3 :
   The binding details of dwc3 can be found in:
   Documentation/devicetree/bindings/usb/dwc3.txt

Example:
	usb: usb@2680000 {
		compatible = "ti,keystone-dwc3";
		#address-cells = <1>;
		#size-cells = <1>;
		reg = <0x2680000 0x10000>;
		clocks = <&clkusb>;
		clock-names = "usb";
		interrupts = <GIC_SPI 393 IRQ_TYPE_EDGE_RISING>;
		ranges;

		dwc3@2690000 {
			compatible = "synopsys,dwc3";
			reg = <0x2690000 0x70000>;
			interrupts = <GIC_SPI 393 IRQ_TYPE_EDGE_RISING>;
			usb-phy = <&usb_phy>, <&usb_phy>;
		};
	};
```

## Documentation/devicetree/bindings/usb/lpc32xx-udc.txt
```
* NXP LPC32xx SoC USB Device Controller (UDC)

Required properties:
- compatible: Must be "nxp,lpc3220-udc"
- reg: Physical base address of the controller and length of memory mapped
  region.
- interrupts: The USB interrupts:
              * USB Device Low Priority Interrupt
              * USB Device High Priority Interrupt
              * USB Device DMA Interrupt
              * External USB Transceiver Interrupt (OTG ATX)
- transceiver: phandle of the associated ISP1301 device - this is necessary for
               the UDC controller for connecting to the USB physical layer

Example:

	isp1301: usb-transceiver@2c {
		compatible = "nxp,isp1301";
		reg = <0x2c>;
	};

	usbd@31020000 {
		compatible = "nxp,lpc3220-udc";
		reg = <0x31020000 0x300>;
		interrupt-parent = <&mic>;
		interrupts = <0x3d 0>, <0x3e 0>, <0x3c 0>, <0x3a 0>;
		transceiver = <&isp1301>;
	};
```

## Documentation/devicetree/bindings/usb/marvell,pxau2o-ehci.yaml
```yaml
# SPDX-License-Identifier: (GPL-2.0-only OR BSD-2-Clause)
# Copyright 2019,2020 Lubomir Rintel <lkundrak@v3.sk>
%YAML 1.2
---
$id: http://devicetree.org/schemas/usb/marvell,pxau2o-ehci.yaml#
$schema: http://devicetree.org/meta-schemas/core.yaml#

title: Marvell PXA/MMP EHCI bindings

maintainers:
  - Lubomir Rintel <lkundrak@v3.sk>

allOf:
  - $ref: usb-hcd.yaml#

properties:
  compatible:
    const: marvell,pxau2o-ehci

  reg:
    maxItems: 1

  interrupts:
    maxItems: 1

  clocks:
    maxItems: 1

  clock-names:
    const: USBCLK

  phys:
    maxItems: 1

  phy-names:
    const: usb

required:
  - compatible
  - reg
  - interrupts
  - clocks
  - clock-names
  - phys
  - phy-names

unevaluatedProperties: false

examples:
  - |
    #include <dt-bindings/clock/marvell,mmp2.h>
    usb@d4208000 {
        compatible = "marvell,pxau2o-ehci";
        reg = <0xd4208000 0x200>;
        interrupts = <44>;
        clocks = <&soc_clocks MMP2_CLK_USB>;
        clock-names = "USBCLK";
        phys = <&usb_otg_phy>;
        phy-names = "usb";
    };

...
```

## Documentation/devicetree/bindings/usb/maxim,max33359.yaml
```yaml
# SPDX-License-Identifier: (GPL-2.0-only OR BSD-2-Clause)
%YAML 1.2
---
$id: "http://devicetree.org/schemas/usb/maxim,max33359.yaml#"
$schema: "http://devicetree.org/meta-schemas/core.yaml#"

title: Maxim TCPCI Type-C PD controller

maintainers:
  - Badhri Jagan Sridharan <badhri@google.com>

description: Maxim TCPCI Type-C PD controller

properties:
  compatible:
    enum:
      - maxim,max33359

  reg:
    maxItems: 1

  interrupts:
    maxItems: 1

  connector:
    type: object
    $ref: ../connector/usb-connector.yaml#
    description:
      Properties for usb c connector.

required:
  - compatible
  - reg
  - interrupts
  - connector

additionalProperties: false

examples:
  - |
    #include <dt-bindings/interrupt-controller/irq.h>
    #include <dt-bindings/usb/pd.h>
    i2c0 {
        #address-cells = <1>;
        #size-cells = <0>;

        maxtcpc@25 {
            compatible = "maxim,max33359";
            reg = <0x25>;
            interrupt-parent = <&gpa8>;
            interrupts = <2 IRQ_TYPE_LEVEL_LOW>;

            connector {
                compatible = "usb-c-connector";
                label = "USB-C";
                data-role = "dual";
                power-role = "dual";
                try-power-role = "sink";
                self-powered;
                op-sink-microwatt = <2600000>;
                new-source-frs-typec-current = <FRS_5V_1P5A>;
                source-pdos = <PDO_FIXED(5000, 900,
                                         PDO_FIXED_SUSPEND |
                                         PDO_FIXED_USB_COMM |
                                         PDO_FIXED_DATA_SWAP |
                                         PDO_FIXED_DUAL_ROLE)>;
                sink-pdos = <PDO_FIXED(5000, 3000,
                                       PDO_FIXED_USB_COMM |
                                       PDO_FIXED_DATA_SWAP |
                                       PDO_FIXED_DUAL_ROLE)
                                       PDO_FIXED(9000, 2000, 0)>;
            };
        };
    };
...
```

## Documentation/devicetree/bindings/usb/maxim,max3420-udc.yaml
```yaml
# SPDX-License-Identifier: (GPL-2.0 OR BSD-2-Clause)
%YAML 1.2
---
$id: http://devicetree.org/schemas/usb/maxim,max3420-udc.yaml#
$schema: http://devicetree.org/meta-schemas/core.yaml#

title: MAXIM MAX3420/1 USB Peripheral Controller

maintainers:
  - Jassi Brar <jaswinder.singh@linaro.org>

description: |
  The controller provices USB2.0 compliant FullSpeed peripheral
  implementation over the SPI interface.

  Specifications about the part can be found at:
    http://datasheets.maximintegrated.com/en/ds/MAX3420E.pdf

properties:
  compatible:
    enum:
      - maxim,max3420-udc
      - maxim,max3421-udc

  reg:
    maxItems: 1

  interrupts:
    items:
      - description: usb irq from max3420
      - description: vbus detection irq
    minItems: 1

  interrupt-names:
    items:
      - const: udc
      - const: vbus
    minItems: 1

  spi-max-frequency:
    maximum: 26000000

required:
  - compatible
  - reg
  - interrupts
  - interrupt-names

additionalProperties: false

examples:
  - |
      #include <dt-bindings/gpio/gpio.h>
      #include <dt-bindings/interrupt-controller/irq.h>
      spi0 {
            #address-cells = <1>;
            #size-cells = <0>;

            udc@0 {
                  compatible = "maxim,max3420-udc";
                  reg = <0>;
                  interrupt-parent = <&gpio>;
                  interrupts = <0 IRQ_TYPE_EDGE_FALLING>, <10 IRQ_TYPE_EDGE_BOTH>;
                  interrupt-names = "udc", "vbus";
                  spi-max-frequency = <12500000>;
            };
      };
```

## Documentation/devicetree/bindings/usb/maxim,max3421.txt
```
Maxim Integrated SPI-based USB 2.0 host controller MAX3421E

Required properties:
 - compatible: Should be "maxim,max3421"
 - spi-max-frequency: maximum frequency for this device must not exceed 26 MHz.
 - reg: chip select number to which this device is connected.
 - maxim,vbus-en-pin: <GPOUTx ACTIVE_LEVEL>
   GPOUTx is the number (1-8) of the GPOUT pin of MAX3421E to drive Vbus.
   ACTIVE_LEVEL is 0 or 1.
 - interrupts: the interrupt line description for the interrupt controller.
   The driver configures MAX3421E for active low level triggered interrupts,
   configure your interrupt line accordingly.

Example:

	usb@0 {
		compatible = "maxim,max3421";
		reg = <0>;
		maxim,vbus-en-pin = <3 1>;
		spi-max-frequency = <26000000>;
		interrupt-parent = <&PIC>;
		interrupts = <42>;
	};
```

## Documentation/devicetree/bindings/usb/maxim,max3421.yaml
```yaml
# SPDX-License-Identifier: (GPL-2.0 OR BSD-2-Clause)
%YAML 1.2
---
$id: http://devicetree.org/schemas/usb/maxim,max3421.yaml#
$schema: http://devicetree.org/meta-schemas/core.yaml#

title: MAXIM MAX3421e USB Peripheral/Host Controller

maintainers:
  - David Mosberger <davidm@egauge.net>

description: |
  The controller provides USB2.0 compliant with Full Speed or Low Speed when in
  the host mode. At peripheral, it operates at Full Speed. At both cases, it
  uses a SPI interface.
  Datasheet at:
    https://www.analog.com/media/en/technical-documentation/data-sheets/max3421e.pdf

properties:
  compatible:
    const: maxim,max3421

  reg:
    maxItems: 1

  interrupts:
    maxItems: 1

  spi-max-frequency:
    maximum: 26000000

  maxim,vbus-en-pin:
    $ref: /schemas/types.yaml#/definitions/uint32-array
    description:
      One of eight GPOUT pins to control external VBUS power and the polarity
      of the active level. It's an array of GPIO number and the active level of it.
    minItems: 2
    maxItems: 2

required:
  - compatible
  - reg
  - interrupts
  - maxim,vbus-en-pin

allOf:
  - $ref: /schemas/spi/spi-peripheral-props.yaml#

unevaluatedProperties: false

examples:
  - |
    #include <dt-bindings/gpio/gpio.h>
    #include <dt-bindings/interrupt-controller/irq.h>
    spi {
        #address-cells = <1>;
        #size-cells = <0>;

        usb@0 {
          compatible = "maxim,max3421";
          reg = <0>;
          maxim,vbus-en-pin = <3 1>;
          spi-max-frequency = <26000000>;
          interrupt-parent = <&gpio>;
          interrupts = <42>;
        };
    };
```

## Documentation/devicetree/bindings/usb/mediatek,mt6360-tcpc.yaml
```yaml
# SPDX-License-Identifier: (GPL-2.0-only OR BSD-2-Clause)
%YAML 1.2
---
$id: "http://devicetree.org/schemas/usb/mediatek,mt6360-tcpc.yaml#"
$schema: "http://devicetree.org/meta-schemas/core.yaml#"

title: Mediatek MT6360 Type-C Port Switch and Power Delivery controller DT bindings

maintainers:
  - ChiYuan Huang <cy_huang@richtek.com>

description: |
  Mediatek MT6360 is a multi-functional device. It integrates charger, ADC, flash, RGB indicators,
  regulators (BUCKs/LDOs), and TypeC Port Switch with Power Delivery controller.
  This document only describes MT6360 Type-C Port Switch and Power Delivery controller.

properties:
  compatible:
    enum:
      - mediatek,mt6360-tcpc

  interrupts:
    maxItems: 1

  interrupt-names:
    items:
      - const: PD_IRQB

  connector:
    type: object
    $ref: ../connector/usb-connector.yaml#
    description:
      Properties for usb c connector.

additionalProperties: false

required:
  - compatible
  - interrupts
  - interrupt-names

examples:
  - |
    #include <dt-bindings/interrupt-controller/irq.h>
    #include <dt-bindings/usb/pd.h>
    i2c0 {
      #address-cells = <1>;
      #size-cells = <0>;

      mt6360@34 {
        compatible = "mediatek,mt6360";
        reg = <0x34>;
        tcpc {
          compatible = "mediatek,mt6360-tcpc";
          interrupts-extended = <&gpio26 3 IRQ_TYPE_LEVEL_LOW>;
          interrupt-names = "PD_IRQB";

          connector {
            compatible = "usb-c-connector";
            label = "USB-C";
            data-role = "dual";
            power-role = "dual";
            try-power-role = "sink";
            source-pdos = <PDO_FIXED(5000, 1000, PDO_FIXED_DUAL_ROLE | PDO_FIXED_DATA_SWAP)>;
            sink-pdos = <PDO_FIXED(5000, 2000, PDO_FIXED_DUAL_ROLE | PDO_FIXED_DATA_SWAP)>;
            op-sink-microwatt = <10000000>;

            ports {
              #address-cells = <1>;
              #size-cells = <0>;

              port@0 {
                reg = <0>;
                endpoint {
                  remote-endpoint = <&usb_hs>;
                };
              };
              port@1 {
                reg = <1>;
                endpoint {
                  remote-endpoint = <&usb_ss>;
                };
              };
              port@2 {
                reg = <2>;
                endpoint {
                  remote-endpoint = <&dp_aux>;
                };
              };
            };
          };
        };
      };
    };
...
```

## Documentation/devicetree/bindings/usb/mediatek,mt6370-tcpc.yaml
```yaml
# SPDX-License-Identifier: (GPL-2.0-only OR BSD-2-Clause)
%YAML 1.2
---
$id: "http://devicetree.org/schemas/usb/mediatek,mt6370-tcpc.yaml#"
$schema: "http://devicetree.org/meta-schemas/core.yaml#"

title: MediatTek MT6370 Type-C Port Switch and Power Delivery controller

maintainers:
  - ChiYuan Huang <cy_huang@richtek.com>

description: |
  MediaTek MT6370 is a multi-functional device.
  It integrates charger, ADC, flash, RGB indicators,
  regulators (DSV/VIBLDO), and TypeC Port Switch with Power Delivery controller.
  This document only describes MT6370 Type-C Port Switch and
  Power Delivery controller.

properties:
  compatible:
    enum:
      - mediatek,mt6370-tcpc

  interrupts:
    maxItems: 1

  connector:
    type: object
    $ref: /schemas/connector/usb-connector.yaml#
    unevaluatedProperties: false

additionalProperties: false

required:
  - compatible
  - interrupts
```
