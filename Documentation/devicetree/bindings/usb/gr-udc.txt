## Documentation/devicetree/bindings/usb/mediatek,mtk-xhci.txt
```
MT8173 xHCI

The device node for Mediatek SOC USB3.0 host controller

There are two scenarios: the first one only supports xHCI driver;
the second one supports dual-role mode, and the host is based on xHCI
driver. Take account of backward compatibility, we divide bindings
into two parts.

1st: only supports xHCI driver
------------------------------------------------------------------------

Required properties:
 - compatible : should be "mediatek,<soc-model>-xhci", "mediatek,mtk-xhci",
	soc-model is the name of SoC, such as mt8173, mt2712 etc, when using
	"mediatek,mtk-xhci" compatible string, you need SoC specific ones in
	addition, one of:
	- "mediatek,mt8173-xhci"
 - reg : specifies physical base address and size of the registers
 - reg-names: should be "mac" for xHCI MAC and "ippc" for IP port control
 - interrupts : interrupt used by the controller
 - power-domains : a phandle to USB power domain node to control USB's
	mtcmos
 - vusb33-supply : regulator of USB avdd3.3v

 - clocks : a list of phandle + clock-specifier pairs, one for each
	entry in clock-names
 - clock-names : must contain
	"sys_ck": controller clock used by normal mode,
	the following ones are optional:
	"ref_ck": reference clock used by low power mode etc,
	"mcu_ck": mcu_bus clock for register access,
	"dma_ck": dma_bus clock for data transfer by DMA

 - phys : a list of phandle + phy specifier pairs

Optional properties:
 - wakeup-source : enable USB remote wakeup;
 - mediatek,syscon-wakeup : phandle to syscon used to access the register
	of the USB wakeup glue layer between xHCI and SPM; it depends on
	"wakeup-source", and has two arguments:
	- the first one : register base address of the glue layer in syscon;
	- the second one : hardware version of the glue layer
		- 1 : used by mt8173 etc
		- 2 : used by mt2712 etc
 - mediatek,u3p-dis-msk : mask to disable u3ports, bit0 for u3port0,
	bit1 for u3port1, ... etc;
 - vbus-supply : reference to the VBUS regulator;
 - usb3-lpm-capable : supports USB3.0 LPM
 - pinctrl-names : a pinctrl state named "default" must be defined
 - pinctrl-0 : pin control group
	See: Documentation/devicetree/bindings/pinctrl/pinctrl-bindings.txt
 - imod-interval-ns: default interrupt moderation interval is 5000ns

Example:
usb30: usb@11270000 {
	compatible = "mediatek,mt8173-xhci";
	reg = <0 0x11270000 0 0x1000>,
	      <0 0x11280700 0 0x0100>;
	reg-names = "mac", "ippc";
	interrupts = <GIC_SPI 115 IRQ_TYPE_LEVEL_LOW>;
	power-domains = <&scpsys MT8173_POWER_DOMAIN_USB>;
	clocks = <&topckgen CLK_TOP_USB30_SEL>, <&clk26m>,
		 <&pericfg CLK_PERI_USB0>,
		 <&pericfg CLK_PERI_USB1>;
	clock-names = "sys_ck", "ref_ck";
	phys = <&phy_port0 PHY_TYPE_USB3>,
	       <&phy_port1 PHY_TYPE_USB2>;
	vusb33-supply = <&mt6397_vusb_reg>;
	vbus-supply = <&usb_p1_vbus>;
	usb3-lpm-capable;
	mediatek,syscon-wakeup = <&pericfg 0x400 1>;
	wakeup-source;
	imod-interval-ns = <10000>;
};

2nd: dual-role mode with xHCI driver
------------------------------------------------------------------------

In the case, xhci is added as subnode to mtu3. An example and the DT binding
details of mtu3 can be found in:
Documentation/devicetree/bindings/usb/mediatek,mtu3.txt

Required properties:
 - compatible : should be "mediatek,<soc-model>-xhci", "mediatek,mtk-xhci",
	soc-model is the name of SoC, such as mt8173, mt2712 etc, when using
	"mediatek,mtk-xhci" compatible string, you need SoC specific ones in
	addition, one of:
	- "mediatek,mt8173-xhci"
 - reg : specifies physical base address and size of the registers
 - reg-names: should be "mac" for xHCI MAC
 - interrupts : interrupt used by the host controller
 - power-domains : a phandle to USB power domain node to control USB's
	mtcmos
 - vusb33-supply : regulator of USB avdd3.3v

 - clocks : a list of phandle + clock-specifier pairs, one for each
	entry in clock-names
 - clock-names : must contain "sys_ck", and the following ones are optional:
	"ref_ck", "mcu_ck" and "dma_ck"

Optional properties:
 - vbus-supply : reference to the VBUS regulator;
 - usb3-lpm-capable : supports USB3.0 LPM

Example:
usb30: usb@11270000 {
	compatible = "mediatek,mt8173-xhci";
	reg = <0 0x11270000 0 0x1000>;
	reg-names = "mac";
	interrupts = <GIC_SPI 115 IRQ_TYPE_LEVEL_LOW>;
	power-domains = <&scpsys MT8173_POWER_DOMAIN_USB>;
	clocks = <&topckgen CLK_TOP_USB30_SEL>, <&clk26m>;
	clock-names = "sys_ck", "ref_ck";
	vusb33-supply = <&mt6397_vusb_reg>;
	usb3-lpm-capable;
};
```

## Documentation/devicetree/bindings/usb/mediatek,mtk-xhci.yaml
```yaml
# SPDX-License-Identifier: (GPL-2.0-only OR BSD-2-Clause)
# Copyright (c) 2020 MediaTek
%YAML 1.2
---
$id: http://devicetree.org/schemas/usb/mediatek,mtk-xhci.yaml#
$schema: http://devicetree.org/meta-schemas/core.yaml#

title: MediaTek USB3 xHCI

maintainers:
  - Chunfeng Yun <chunfeng.yun@mediatek.com>

allOf:
  - $ref: "usb-xhci.yaml"

description: |
  There are two scenarios:
  case 1: only supports xHCI driver;
  case 2: supports dual-role mode, and the host is based on xHCI driver.

properties:
  # common properties for both case 1 and case 2
  compatible:
    items:
      - enum:
          - mediatek,mt2701-xhci
          - mediatek,mt2712-xhci
          - mediatek,mt7622-xhci
          - mediatek,mt7623-xhci
          - mediatek,mt7629-xhci
          - mediatek,mt8173-xhci
          - mediatek,mt8183-xhci
          - mediatek,mt8186-xhci
          - mediatek,mt8188-xhci
          - mediatek,mt8192-xhci
          - mediatek,mt8195-xhci
      - const: mediatek,mtk-xhci

  reg:
    minItems: 1
    items:
      - description: the registers of xHCI MAC
      - description: the registers of IP Port Control

  reg-names:
    minItems: 1
    items:
      - const: mac
      - const: ippc  # optional, only needed for case 1.

  interrupts:
    description:
      use "interrupts-extended" when the interrupts are connected to the
      separate interrupt controllers
    minItems: 1
    items:
      - description: xHCI host controller interrupt
      - description: optional, wakeup interrupt used to support runtime PM

  interrupt-names:
    minItems: 1
    items:
      - const: host
      - const: wakeup

  power-domains:
    description: A phandle to USB power domain node to control USB's MTCMOS
    maxItems: 1

  clocks:
    minItems: 1
    items:
      - description: Controller clock used by normal mode
      - description: Reference clock used by low power mode etc
      - description: Mcu bus clock for register access
      - description: DMA bus clock for data transfer
      - description: controller clock

  clock-names:
    minItems: 1
    items:
      - const: sys_ck  # required, the following ones are optional
      - const: ref_ck
      - const: mcu_ck
      - const: dma_ck
      - const: xhci_ck

  assigned-clocks:
    minItems: 1
    maxItems: 5

  assigned-clock-parents:
    minItems: 1
    maxItems: 5

  phys:
    description:
      List of all PHYs used on this HCD, it's better to keep PHYs in order
      as the hardware layout
    minItems: 1
    items:
      - description: USB2/HS PHY    # required, others are optional
      - description: USB3/SS(P) PHY
      - description: USB2/HS PHY
      - description: USB3/SS(P) PHY
      - description: USB2/HS PHY
      - description: USB3/SS(P) PHY
      - description: USB2/HS PHY
      - description: USB3/SS(P) PHY
      - description: USB2/HS PHY

  vusb33-supply:
    description: Regulator of USB AVDD3.3v

  vbus-supply:
    description: Regulator of USB VBUS5v

  resets:
    maxItems: 1

  usb3-lpm-capable: true

  usb2-lpm-disable: true

  imod-interval-ns:
    description:
      Interrupt moderation interval value, it is 8 times as much as that
      defined in the xHCI spec on MTK's controller.
    default: 5000

  # the following properties are only used for case 1
  wakeup-source:
    description: enable USB remote wakeup, see power/wakeup-source.txt
    type: boolean

  mediatek,syscon-wakeup:
    $ref: /schemas/types.yaml#/definitions/phandle-array
    maxItems: 1
    description:
      A phandle to syscon used to access the register of the USB wakeup glue
      layer between xHCI and SPM, the field should always be 3 cells long.
    items:
      items:
        - description:
            The first cell represents a phandle to syscon
        - description:
            The second cell represents the register base address of the glue
            layer in syscon
        - description: |
            The third cell represents the hardware version of the glue layer,
            1 - used by mt8173 etc, revision 1 without following IPM rule;
            2 - used by mt2712 etc, revision 2 following IPM rule;
            101 - used by mt8183, specific 1.01;
            102 - used by mt8192, specific 1.02;
            103 - used by mt8195, IP0, specific 1.03;
            104 - used by mt8195, IP1, specific 1.04;
            105 - used by mt8195, IP2, specific 1.05;
            106 - used by mt8195, IP3, specific 1.06;
          enum: [1, 2, 101, 102, 103, 104, 105, 106]

  mediatek,u3p-dis-msk:
    $ref: /schemas/types.yaml#/definitions/uint32
    description: The mask to disable u3ports, bit0 for u3port0,
      bit1 for u3port1, ... etc

  mediatek,u2p-dis-msk:
    $ref: /schemas/types.yaml#/definitions/uint32
    description: The mask to disable u2ports, bit0 for u2port0,
      bit1 for u2port1, ... etc

  "#address-cells":
    const: 1

  "#size-cells":
    const: 0

patternProperties:
  "@[0-9a-f]{1}$":
    type: object
    description: The hard wired USB devices.

dependencies:
  wakeup-source: [ 'mediatek,syscon-wakeup' ]

required:
  - compatible
  - reg
  - reg-names
  - interrupts
  - clocks
  - clock-names

additionalProperties: false

examples:
  - |
    #include <dt-bindings/clock/mt8173-clk.h>
    #include <dt-bindings/interrupt-controller/arm-gic.h>
    #include <dt-bindings/interrupt-controller/irq.h>
    #include <dt-bindings/phy/phy.h>
    #include <dt-bindings/power/mt8173-power.h>

    usb@11270000 {
        compatible = "mediatek,mt8173-xhci", "mediatek,mtk-xhci";
        reg = <0x11270000 0x1000>, <0x11280700 0x0100>;
        reg-names = "mac", "ippc";
        interrupts = <GIC_SPI 115 IRQ_TYPE_LEVEL_LOW>;
        power-domains = <&scpsys MT8173_POWER_DOMAIN_USB>;
        clocks = <&topckgen CLK_TOP_USB30_SEL>, <&clk26m>;
        clock-names = "sys_ck", "ref_ck";
        phys = <&u3port0 PHY_TYPE_USB3>, <&u2port1 PHY_TYPE_USB2>;
        vusb33-supply = <&mt6397_vusb_reg>;
        vbus-supply = <&usb_p1_vbus>;
        imod-interval-ns = <10000>;
        mediatek,syscon-wakeup = <&pericfg 0x400 1>;
        wakeup-source;
        usb3-lpm-capable;
    };
...
```

## Documentation/devicetree/bindings/usb/mediatek,mtu3.txt
```
The device node for Mediatek USB3.0 DRD controller

Required properties:
 - compatible : should be "mediatek,<soc-model>-mtu3", "mediatek,mtu3",
	soc-model is the name of SoC, such as mt8173, mt2712 etc,
	when using "mediatek,mtu3" compatible string, you need SoC specific
	ones in addition, one of:
	- "mediatek,mt8173-mtu3"
 - reg : specifies physical base address and size of the registers
 - reg-names: should be "mac" for device IP and "ippc" for IP port control
 - interrupts : interrupt used by the device IP
 - power-domains : a phandle to USB power domain node to control USB's
	mtcmos
 - vusb33-supply : regulator of USB avdd3.3v
 - clocks : a list of phandle + clock-specifier pairs, one for each
	entry in clock-names
 - clock-names : must contain "sys_ck" for clock of controller,
	the following clocks are optional:
	"ref_ck", "mcu_ck" and "dam_ck";
 - phys : see usb-hcd.txt in the current directory
 - dr_mode : should be one of "host", "peripheral" or "otg",
	refer to usb/generic.txt

Optional properties:
 - #address-cells, #size-cells : should be '2' if the device has sub-nodes
	with 'reg' property
 - ranges : allows valid 1:1 translation between child's address space and
	parent's address space
 - extcon : external connector for vbus and idpin changes detection, needed
	when supports dual-role mode.
 - vbus-supply : reference to the VBUS regulator, needed when supports
	dual-role mode.
 - pinctrl-names : a pinctrl state named "default" is optional, and need be
	defined if auto drd switch is enabled, that means the property dr_mode
	is set as "otg", and meanwhile the property "mediatek,enable-manual-drd"
	is not set.
 - pinctrl-0 : pin control group
	See: Documentation/devicetree/bindings/pinctrl/pinctrl-bindings.txt

 - maximum-speed : valid arguments are "super-speed", "high-speed" and
	"full-speed"; refer to usb/generic.txt
 - enable-manual-drd : supports manual dual-role switch via debugfs; usually
	used when receptacle is TYPE-A and also wants to support dual-role
	mode.
 - wakeup-source: enable USB remote wakeup of host mode.
 - mediatek,syscon-wakeup : phandle to syscon used to access the register
	of the USB wakeup glue layer between SSUSB and SPM; it depends on
	"wakeup-source", and has two arguments:
	- the first one : register base address of the glue layer in syscon;
	- the second one : hardware version of the glue layer
		- 1 : used by mt8173 etc
		- 2 : used by mt2712 etc
 - mediatek,u3p-dis-msk : mask to disable u3ports, bit0 for u3port0,
	bit1 for u3port1, ... etc;

additionally the properties from usb-hcd.txt (in the current directory) are
supported.

Sub-nodes:
The xhci should be added as subnode to mtu3 as shown in the following example
if host mode is enabled. The DT binding details of xhci can be found in:
Documentation/devicetree/bindings/usb/mediatek,mtk-xhci.txt

Example:
ssusb: usb@11271000 {
	compatible = "mediatek,mt8173-mtu3";
	reg = <0 0x11271000 0 0x3000>,
	      <0 0x11280700 0 0x0100>;
	reg-names = "mac", "ippc";
	interrupts = <GIC_SPI 64 IRQ_TYPE_LEVEL_LOW>;
	phys = <&phy_port0 PHY_TYPE_USB3>,
	       <&phy_port1 PHY_TYPE_USB2>;
	power-domains = <&scpsys MT8173_POWER_DOMAIN_USB>;
	clocks = <&topckgen CLK_TOP_USB30_SEL>, <&clk26m>,
		 <&pericfg CLK_PERI_USB0>,
		 <&pericfg CLK_PERI_USB1>;
	clock-names = "sys_ck", "ref_ck";
	vusb33-supply = <&mt6397_vusb_reg>;
	vbus-supply = <&usb_p0_vbus>;
	extcon = <&extcon_usb>;
	dr_mode = "otg";
	wakeup-source;
	mediatek,syscon-wakeup = <&pericfg 0x400 1>;
	#address-cells = <2>;
	#size-cells = <2>;
	ranges;

	usb_host: xhci@11270000 {
		compatible = "mediatek,mt8173-xhci";
		reg = <0 0x11270000 0 0x1000>;
		reg-names = "mac";
		interrupts = <GIC_SPI 115 IRQ_TYPE_LEVEL_LOW>;
		power-domains = <&scpsys MT8173_POWER_DOMAIN_USB>;
		clocks = <&topckgen CLK_TOP_USB30_SEL>, <&clk26m>;
		clock-names = "sys_ck", "ref_ck";
		vusb33-supply = <&mt6397_vusb_reg>;
	};
};
```
