## Documentation/devicetree/bindings/usb/qcom,pmic-typec.yaml
```yaml
# SPDX-License-Identifier: (GPL-2.0-only OR BSD-2-Clause)
%YAML 1.2
---
$id: http://devicetree.org/schemas/usb/qcom,pmic-typec.yaml#
$schema: http://devicetree.org/meta-schemas/core.yaml#

title: Qualcomm PMIC based USB Type-C block

maintainers:
  - Bryan O'Donoghue <bryan.odonoghue@linaro.org>

description:
  Qualcomm PMIC Type-C block

properties:
  compatible:
    oneOf:
      - enum:
          - qcom,pmi632-typec
          - qcom,pm8150b-typec
      - items:
          - enum:
              - qcom,pm6150-typec
          - const: qcom,pm8150b-typec
      - items:
          - enum:
              - qcom,pm4125-typec
          - const: qcom,pmi632-typec


  connector:
    type: object
    $ref: /schemas/connector/usb-connector.yaml#
    unevaluatedProperties: false

  reg:
    description: Type-C port and pdphy SPMI register base offsets
    minItems: 1
    maxItems: 2

  interrupts:
    minItems: 8
    items:
      - description: Type-C CC attach notification, VBUS error, tCCDebounce done
      - description: Type-C VCONN powered
      - description: Type-C CC state change
      - description: Type-C VCONN over-current
      - description: Type-C VBUS state change
      - description: Type-C Attach/detach notification
      - description: Type-C Legacy cable detect
      - description: Type-C Try.Src Try.Snk state change
      - description: Power Domain Signal TX - HardReset or CableReset signal TX
      - description: Power Domain Signal RX - HardReset or CableReset signal RX
      - description: Power Domain TX complete
      - description: Power Domain RX complete
      - description: Power Domain TX fail
      - description: Power Domain TX message discard
      - description: Power Domain RX message discard
      - description: Power Domain Fast Role Swap event

  interrupt-names:
    minItems: 8
    items:
      - const: or-rid-detect-change
      - const: vpd-detect
      - const: cc-state-change
      - const: vconn-oc
      - const: vbus-change
      - const: attach-detach
      - const: legacy-cable-detect
      - const: try-snk-src-detect
      - const: sig-tx
      - const: sig-rx
      - const: msg-tx
      - const: msg-rx
      - const: msg-tx-failed
      - const: msg-tx-discarded
      - const: msg-rx-discarded
      - const: fr-swap

  vdd-vbus-supply:
    description: VBUS power supply.

  vdd-pdphy-supply:
    description: VDD regulator supply to the PDPHY.

  port:
    $ref: /schemas/graph.yaml#/properties/port
    description:
      Contains a port which produces data-role switching messages.

required:
  - compatible
  - reg
  - interrupts
  - interrupt-names
  - vdd-vbus-supply

allOf:
  - if:
      properties:
        compatible:
          contains:
            enum:
              - qcom,pmi632-typec
    then:
      properties:
        reg:
          maxItems: 1
        interrupts:
          maxItems: 8
        interrupt-names:
          maxItems: 8
        vdd-pdphy-supply: false
    else:
      properties:
        reg:
          maxItems: 2
        interrupts:
          minItems: 16
        interrupt-names:
          maxItems: 16
      required:
        - vdd-pdphy-supply

additionalProperties: false

examples:
  - |
    #include <dt-bindings/interrupt-controller/arm-gic.h>
    #include <dt-bindings/usb/pd.h>

    pmic {
        #address-cells = <1>;
        #size-cells = <0>;

        pm8150b_typec: typec@1500 {
            compatible = "qcom,pm8150b-typec";
            reg = <0x1500>,
                  <0x1700>;

            interrupts = <0x2 0x15 0x00 IRQ_TYPE_EDGE_RISING>,
                         <0x2 0x15 0x01 IRQ_TYPE_EDGE_BOTH>,
                         <0x2 0x15 0x02 IRQ_TYPE_EDGE_RISING>,
                         <0x2 0x15 0x03 IRQ_TYPE_EDGE_BOTH>,
                         <0x2 0x15 0x04 IRQ_TYPE_EDGE_RISING>,
                         <0x2 0x15 0x05 IRQ_TYPE_EDGE_RISING>,
                         <0x2 0x15 0x06 IRQ_TYPE_EDGE_BOTH>,
                         <0x2 0x15 0x07 IRQ_TYPE_EDGE_RISING>,
                         <0x2 0x17 0x00 IRQ_TYPE_EDGE_RISING>,
                         <0x2 0x17 0x01 IRQ_TYPE_EDGE_RISING>,
                         <0x2 0x17 0x02 IRQ_TYPE_EDGE_RISING>,
                         <0x2 0x17 0x03 IRQ_TYPE_EDGE_RISING>,
                         <0x2 0x17 0x04 IRQ_TYPE_EDGE_RISING>,
                         <0x2 0x17 0x05 IRQ_TYPE_EDGE_RISING>,
                         <0x2 0x17 0x06 IRQ_TYPE_EDGE_RISING>,
                         <0x2 0x17 0x07 IRQ_TYPE_EDGE_RISING>;

            interrupt-names = "or-rid-detect-change",
                              "vpd-detect",
                              "cc-state-change",
                              "vconn-oc",
                              "vbus-change",
                              "attach-detach",
                              "legacy-cable-detect",
                              "try-snk-src-detect",
                              "sig-tx",
                              "sig-rx",
                              "msg-tx",
                              "msg-rx",
                              "msg-tx-failed",
                              "msg-tx-discarded",
                              "msg-rx-discarded",
                              "fr-swap";

            vdd-vbus-supply = <&pm8150b_vbus>;
            vdd-pdphy-supply = <&vreg_l2a_3p1>;

            connector {
                compatible = "usb-c-connector";

                power-role = "source";
                data-role = "dual";
                self-powered;

                source-pdos = <PDO_FIXED(5000, 3000, PDO_FIXED_DUAL_ROLE |
                               PDO_FIXED_USB_COMM | PDO_FIXED_DATA_SWAP)>;

                ports {
                    #address-cells = <1>;
                    #size-cells = <0>;

                    port@0 {
                        reg = <0>;
                        pmic_typec_mux_out: endpoint {
                            remote-endpoint = <&usb_phy_typec_mux_in>;
                        };
                    };

                    port@1 {
                        reg = <1>;
                        pmic_typec_role_switch_out: endpoint {
                            remote-endpoint = <&usb_role_switch_in>;
                        };
                    };
                };
            };
        };
    };

    usb {
        dr_mode = "otg";
        usb-role-switch;
        port {
            usb_role_switch_in: endpoint {
                remote-endpoint = <&pmic_typec_role_switch_out>;
            };
        };
    };

    usb-phy {
        orientation-switch;
        port {
            usb_phy_typec_mux_in: endpoint {
                remote-endpoint = <&pmic_typec_mux_out>;
            };
        };
    };

...
```

## Documentation/devicetree/bindings/usb/qcom,wcd939x-usbss.yaml
```yaml
# SPDX-License-Identifier: GPL-2.0-only OR BSD-2-Clause
%YAML 1.2
---
$id: http://devicetree.org/schemas/usb/qcom,wcd939x-usbss.yaml#
$schema: http://devicetree.org/meta-schemas/core.yaml#

title: Qualcomm WCD9380/WCD9385 USB SubSystem Altmode/Analog Audio Switch

maintainers:
  - Neil Armstrong <neil.armstrong@linaro.org>

description:
  Qualcomm WCD9390/WCD9395 is a standalone Hi-Fi audio codec IC with a
  functionally separate USB SubSystem for Altmode/Analog Audio Switch
  accessible over an I2C interface.
  The Audio Headphone and Microphone data path between the Codec and the
  USB-C Mux subsystems are external to the IC, thus requiring DT port-endpoint
  graph description to handle USB-C altmode & orientation switching for Audio
  Accessory Mode.

properties:
  compatible:
    oneOf:
      - const: qcom,wcd9390-usbss
      - items:
          - const: qcom,wcd9395-usbss
          - const: qcom,wcd9390-usbss

  reg:
    maxItems: 1

  reset-gpios:
    maxItems: 1

  vdd-supply:
    description: USBSS VDD power supply

  mode-switch: true
  orientation-switch: true

  ports:
    $ref: /schemas/graph.yaml#/properties/ports
    properties:
      port@0:
        $ref: /schemas/graph.yaml#/properties/port
        description:
          A port node to link the WCD939x USB SubSystem to a TypeC controller for the
          purpose of handling altmode muxing and orientation switching.

      port@1:
        $ref: /schemas/graph.yaml#/properties/port
        description:
          A port node to link the WCD939x USB SubSystem to the Codec SubSystem for the
          purpose of handling USB-C Audio Accessory Mode muxing and orientation switching.

required:
  - compatible
  - reg
  - ports

allOf:
  - $ref: usb-switch.yaml#
  - $ref: usb-switch-ports.yaml#

additionalProperties: false

examples:
  - |
    i2c {
        #address-cells = <1>;
        #size-cells = <0>;

        typec-mux@42 {
            compatible = "qcom,wcd9390-usbss";
            reg = <0x42>;

            vdd-supply = <&vreg_bob>;

            mode-switch;
            orientation-switch;

            ports {
                #address-cells = <1>;
                #size-cells = <0>;

                port@0 {
                    reg = <0>;
                    wcd9390_usbss_sbu: endpoint {
                        remote-endpoint = <&typec_sbu>;
                    };
                };
                port@1 {
                    reg = <1>;
                    wcd9390_usbss_codec: endpoint {
                        remote-endpoint = <&wcd9390_codec_usbss>;
                    };
                };
            };
        };
    };
...
```

## Documentation/devicetree/bindings/usb/realtek,rtd-dwc3.yaml
```yaml
# SPDX-License-Identifier: (GPL-2.0 OR BSD-2-Clause)
# Copyright 2023 Realtek Semiconductor Corporation
%YAML 1.2
---
$id: http://devicetree.org/schemas/usb/realtek,rtd-dwc3.yaml#
$schema: http://devicetree.org/meta-schemas/core.yaml#

title: Realtek DWC3 USB SoC Controller Glue

maintainers:
  - Stanley Chang <stanley_chang@realtek.com>

description:
  The Realtek DHC SoC embeds a DWC3 USB IP Core configured for USB 2.0
  and USB 3.0 in host or dual-role mode.

properties:
  compatible:
    items:
      - enum:
          - realtek,rtd1295-dwc3
          - realtek,rtd1315e-dwc3
          - realtek,rtd1319-dwc3
          - realtek,rtd1319d-dwc3
          - realtek,rtd1395-dwc3
          - realtek,rtd1619-dwc3
          - realtek,rtd1619b-dwc3
      - const: realtek,rtd-dwc3

  reg:
    items:
      - description: Address and length of register set for wrapper of dwc3 core.
      - description: Address and length of register set for pm control.

  '#address-cells':
    const: 1

  '#size-cells':
    const: 1

  ranges: true

patternProperties:
  "^usb@[0-9a-f]+$":
    $ref: snps,dwc3.yaml#
    description: Required child node

required:
  - compatible
  - reg
  - "#address-cells"
  - "#size-cells"
  - ranges

additionalProperties: false

examples:
  - |
    usb@98013e00 {
        compatible = "realtek,rtd1319d-dwc3", "realtek,rtd-dwc3";
        reg = <0x98013e00 0x140>, <0x98013f60 0x4>;
        #address-cells = <1>;
        #size-cells = <1>;
        ranges;

        usb@98050000 {
            compatible = "snps,dwc3";
            reg = <0x98050000 0x9000>;
            interrupts = <0 94 4>;
            phys = <&usb2phy &usb3phy>;
            phy-names = "usb2-phy", "usb3-phy";
            dr_mode = "otg";
            usb-role-switch;
            role-switch-default-mode = "host";
            snps,dis_u2_susphy_quirk;
            snps,parkmode-disable-ss-quirk;
            snps,parkmode-disable-hs-quirk;
            maximum-speed = "high-speed";
        };
    };
```

## Documentation/devicetree/bindings/usb/realtek,rtd-type-c.yaml
```yaml
# SPDX-License-Identifier: (GPL-2.0-only OR BSD-2-Clause)
# Copyright 2023 Realtek Semiconductor Corporation
%YAML 1.2
---
$id: http://devicetree.org/schemas/usb/realtek,rtd-type-c.yaml#
$schema: http://devicetree.org/meta-schemas/core.yaml#

title: Realtek DHC RTD SoCs USB Type-C Connector detection

maintainers:
  - Stanley Chang <stanley_chang@realtek.com>

description:
  Realtek digital home center (DHC) RTD series SoCs include a type c module.
  This module is able to detect the state of type c connector.

properties:
  compatible:
    enum:
      - realtek,rtd1295-type-c
      - realtek,rtd1312c-type-c
      - realtek,rtd1315e-type-c
      - realtek,rtd1319-type-c
      - realtek,rtd1319d-type-c
      - realtek,rtd1395-type-c
      - realtek,rtd1619-type-c
      - realtek,rtd1619b-type-c

  reg:
    maxItems: 1

  interrupts:
    maxItems: 1

  nvmem-cell-names:
    items:
      - const: usb-cal

  nvmem-cells:
    maxItems: 1
    description:
      The phandle to nvmem cell that contains the trimming data.
      The type c parameter trimming data specified via efuse.
      If unspecified, default value is used.

  realtek,rd-ctrl-gpios:
    description: The gpio node to control external Rd on board.
    maxItems: 1

  connector:
    $ref: /schemas/connector/usb-connector.yaml#
    description: Properties for usb c connector.
    type: object

required:
  - compatible
  - reg
  - interrupts

additionalProperties: false

examples:
  - |
    #include <dt-bindings/interrupt-controller/irq.h>

    type-c@7220 {
        compatible = "realtek,rtd1619b-type-c";
        reg = <0x7220 0x20>;
        interrupts = <0 60 IRQ_TYPE_LEVEL_HIGH>;

        pinctrl-names = "default";
        pinctrl-0 = <&usb_cc1_pins>, <&usb_cc2_pins>;
        nvmem-cells = <&otp_usb_cal>;
        nvmem-cell-names = "usb-cal";

        connector {
            compatible = "usb-c-connector";
            label = "USB-C";
            data-role = "dual";
            power-role = "dual";
        };
    };
```

## Documentation/devicetree/bindings/usb/realtek,rts5411.yaml
```yaml
# SPDX-License-Identifier: GPL-2.0-only OR BSD-2-Clause
%YAML 1.2
---
$id: http://devicetree.org/schemas/usb/realtek,rts5411.yaml#
$schema: http://devicetree.org/meta-schemas/core.yaml#

title: Realtek RTS5411 USB 3.0 hub controller

maintainers:
  - Matthias Kaehlcke <mka@chromium.org>

allOf:
  - $ref: usb-hub.yaml#

properties:
  compatible:
    items:
      - enum:
          - usbbda,5411
          - usbbda,411

  vdd-supply:
    description:
      phandle to the regulator that provides power to the hub.

  peer-hub: true

  ports:
    $ref: /schemas/graph.yaml#/properties/ports

    patternProperties:
      '^port@':
        $ref: /schemas/graph.yaml#/properties/port

        properties:
          reg:
            minimum: 1
            maximum: 4

additionalProperties:
  properties:
    reg:
      minimum: 1
      maximum: 4

required:
  - peer-hub
  - compatible
  - reg

examples:
  - |
    usb {
        dr_mode = "host";
        #address-cells = <1>;
        #size-cells = <0>;

        /* 2.0 hub on port 1 */
        hub_2_0: hub@1 {
            compatible = "usbbda,5411";
            reg = <1>;
            vdd-supply = <&pp3300_hub>;
            peer-hub = <&hub_3_0>;
            #address-cells = <1>;
            #size-cells = <0>;
            /* USB 2.0 device on port 2 */
            device@2 {
                compatible = "usb123,4567";
                reg = <2>;
            };
        };

        /* 3.0 hub on port 2 */
        hub_3_0: hub@2 {
            compatible = "usbbda,411";
            reg = <2>;
            vdd-supply = <&pp3300_hub>;
            peer-hub = <&hub_2_0>;

            ports {
                #address-cells = <1>;
                #size-cells = <0>;
                /* Type-A connector on port 4 */
                port@4 {
                    reg = <4>;
                    endpoint {
                      remote-endpoint = <&usb_a0_ss>;
                    };
                };
            };
        };
    };
```
