## Documentation/devicetree/bindings/usb/renesas,rzg3e-xhci.yaml
```yaml
# SPDX-License-Identifier: (GPL-2.0-only OR BSD-2-Clause)
%YAML 1.2
---
$id: http://devicetree.org/schemas/usb/renesas,rzg3e-xhci.yaml#
$schema: http://devicetree.org/meta-schemas/core.yaml#

title: Renesas RZ/G3E USB 3.2 Gen2 Host controller

maintainers:
  - Biju Das <biju.das.jz@bp.renesas.com>

properties:
  compatible:
    const: renesas,r9a09g047-xhci

  reg:
    maxItems: 1

  interrupts:
    items:
      - description: Logical OR of all interrupt signals.
      - description: System management interrupt
      - description: Host system error interrupt
      - description: Power management event interrupt
      - description: xHC interrupt

  interrupt-names:
    items:
      - const: all
      - const: smi
      - const: hse
      - const: pme
      - const: xhc

  clocks:
    maxItems: 1

  phys:
    maxItems: 2

  phy-names:
    items:
      - const: usb2-phy
      - const: usb3-phy

  power-domains:
    maxItems: 1

  resets:
    maxItems: 1

required:
  - compatible
  - reg
  - interrupts
  - interrupt-names
  - clocks
  - power-domains
  - resets
  - phys
  - phy-names

allOf:
  - $ref: usb-xhci.yaml

additionalProperties: false

examples:
  - |
    #include <dt-bindings/clock/renesas,r9a09g047-cpg.h>
    #include <dt-bindings/interrupt-controller/arm-gic.h>

    usb@15850000 {
      compatible = "renesas,r9a09g047-xhci";
      reg = <0x15850000 0x10000>;
      interrupts = <GIC_SPI 759 IRQ_TYPE_LEVEL_HIGH>,
                   <GIC_SPI 758 IRQ_TYPE_LEVEL_HIGH>,
                   <GIC_SPI 757 IRQ_TYPE_LEVEL_HIGH>,
                   <GIC_SPI 756 IRQ_TYPE_LEVEL_HIGH>,
                   <GIC_SPI 755 IRQ_TYPE_LEVEL_HIGH>;
      interrupt-names = "all", "smi", "hse", "pme", "xhc";
      clocks = <&cpg CPG_MOD 0xaf>;
      power-domains = <&cpg>;
      resets = <&cpg 0xaa>;
      phys = <&usb3_phy>, <&usb3_phy>;
      phy-names = "usb2-phy", "usb3-phy";
    };
```

## Documentation/devicetree/bindings/usb/renesas,rzn1-usbf.yaml
```yaml
# SPDX-License-Identifier: (GPL-2.0-only OR BSD-2-Clause)
%YAML 1.2
---
$id: http://devicetree.org/schemas/usb/renesas,rzn1-usbf.yaml#
$schema: http://devicetree.org/meta-schemas/core.yaml#

title: Renesas RZ/N1 SoCs USBF (USB Function) controller

description: |
   The Renesas USBF controller is an USB2.0 device
   controller (UDC).

maintainers:
  - Herve Codina <herve.codina@bootlin.com>

properties:
  compatible:
    items:
      - enum:
          - renesas,r9a06g032-usbf
      - const: renesas,rzn1-usbf

  reg:
    maxItems: 1

  clocks:
    items:
      - description: Internal bus clock (AHB) for Function
      - description: Internal bus clock (AHB) for Power Management

  clock-names:
    items:
      - const: hclkf
      - const: hclkpm

  power-domains:
    maxItems: 1

  interrupts:
    items:
      - description: The USBF EPC interrupt
      - description: The USBF AHB-EPC interrupt

required:
  - compatible
  - reg
  - clocks
  - clock-names
  - power-domains
  - interrupts

additionalProperties: false

examples:
  - |
    #include <dt-bindings/interrupt-controller/arm-gic.h>
    #include <dt-bindings/clock/r9a06g032-sysctrl.h>

    usb@4001e000 {
        compatible = "renesas,r9a06g032-usbf", "renesas,rzn1-usbf";
        reg = <0x4001e000 0x2000>;
        interrupts = <GIC_SPI 77 IRQ_TYPE_LEVEL_HIGH>,
                     <GIC_SPI 78 IRQ_TYPE_LEVEL_HIGH>;
        clocks = <&sysctrl R9A06G032_HCLK_USBF>,
                 <&sysctrl R9A06G032_HCLK_USBPM>;
        clock-names = "hclkf", "hclkpm";
        power-domains = <&sysctrl>;
    };
```

## Documentation/devicetree/bindings/usb/renesas,rzv2m-usb3drd.yaml
```yaml
# SPDX-License-Identifier: (GPL-2.0-only OR BSD-2-Clause)
%YAML 1.2
---
$id: http://devicetree.org/schemas/usb/renesas,rzv2m-usb3drd.yaml#
$schema: http://devicetree.org/meta-schemas/core.yaml#

title: Renesas RZ/V2M USB 3.1 DRD controller

maintainers:
  - Biju Das <biju.das.jz@bp.renesas.com>

description: |
  The RZ/V2{M, MA} USB3.1 DRD module supports the following functions
  * Role swapping function by the ID pin of the Micro-AB receptacle
  * Battery Charging Specification Revision 1.2

properties:
  compatible:
    items:
      - enum:
          - renesas,r9a09g011-usb3drd  # RZ/V2M
          - renesas,r9a09g055-usb3drd  # RZ/V2MA
      - const: renesas,rzv2m-usb3drd

  reg:
    maxItems: 1

  interrupts:
    items:
      - description: Dual Role Device (DRD)
      - description: Battery Charging
      - description: Global Purpose Input

  interrupt-names:
    items:
      - const: drd
      - const: bc
      - const: gpi

  clocks:
    items:
      - description: Peripheral AXI clock
      - description: APB clock

  clock-names:
    items:
      - const: axi
      - const: reg

  power-domains:
    maxItems: 1

  resets:
    maxItems: 1

  ranges: true

  '#address-cells':
    enum: [ 1, 2 ]

  '#size-cells':
    enum: [ 1, 2 ]

patternProperties:
  "^usb3peri@[0-9a-f]+$":
    type: object
    $ref: /schemas/usb/renesas,usb3-peri.yaml

  "^usb@[0-9a-f]+$":
    type: object
    $ref: renesas,usb-xhci.yaml#

required:
  - compatible
  - reg
  - interrupts
  - interrupt-names
  - clocks
  - clock-names
  - power-domains
  - resets

additionalProperties: false

examples:
  - |
    #include <dt-bindings/clock/r9a09g011-cpg.h>
    #include <dt-bindings/interrupt-controller/arm-gic.h>

    usb3drd: usb@85070400 {
        compatible = "renesas,r9a09g011-usb3drd", "renesas,rzv2m-usb3drd";
        reg = <0x85070400 0x100>;
        interrupts = <GIC_SPI 242 IRQ_TYPE_LEVEL_HIGH>,
                     <GIC_SPI 243 IRQ_TYPE_LEVEL_HIGH>,
                     <GIC_SPI 244 IRQ_TYPE_LEVEL_HIGH>;
        interrupt-names = "drd", "bc", "gpi";
        clocks = <&cpg CPG_MOD R9A09G011_USB_ACLK_P>,
                 <&cpg CPG_MOD R9A09G011_USB_PCLK>;
        clock-names = "axi", "reg";
        power-domains = <&cpg>;
        resets = <&cpg R9A09G011_USB_DRD_RESET>;
        ranges;
        #address-cells = <1>;
        #size-cells = <1>;

        usb3host: usb@85060000 {
            compatible = "renesas,r9a09g011-xhci",
                         "renesas,rzv2m-xhci";
            reg = <0x85060000 0x2000>;
            interrupts = <GIC_SPI 245 IRQ_TYPE_LEVEL_HIGH>;
            clocks = <&cpg CPG_MOD R9A09G011_USB_ACLK_H>,
                     <&cpg CPG_MOD R9A09G011_USB_PCLK>;
            clock-names = "axi", "reg";
            power-domains = <&cpg>;
            resets = <&cpg R9A09G011_USB_ARESETN_H>;
        };

        usb3peri: usb3peri@85070000 {
            compatible = "renesas,r9a09g011-usb3-peri",
                         "renesas,rzv2m-usb3-peri";
            reg = <0x85070000 0x400>;
            interrupts = <GIC_SPI 246 IRQ_TYPE_LEVEL_HIGH>;
            clocks = <&cpg CPG_MOD R9A09G011_USB_ACLK_P>,
                     <&cpg CPG_MOD R9A09G011_USB_PCLK>;
            clock-names = "axi", "reg";
            power-domains = <&cpg>;
            resets = <&cpg R9A09G011_USB_ARESETN_P>;
        };
    };
```

## Documentation/devicetree/bindings/usb/renesas,upd720201-pci.yaml
```yaml
# SPDX-License-Identifier: (GPL-2.0-only OR BSD-2-Clause)
%YAML 1.2
---
$id: http://devicetree.org/schemas/usb/renesas,upd720201-pci.yaml#
$schema: http://devicetree.org/meta-schemas/core.yaml#

title: UPD720201/UPD720202 USB 3.0 xHCI Host Controller (PCIe)

maintainers:
  - Neil Armstrong <neil.armstrong@linaro.org>

description:
  UPD720201 USB 3.0 xHCI Host Controller via PCIe x1 Gen2 interface.
  The UPD720202 supports up to two downstream ports, while UPD720201
  supports up to four downstream USB 3.0 rev1.0 ports.

properties:
  compatible:
    enum:
      - pci1912,0014 # UPD720201
      - pci1912,0015 # UPD720202

  reg:
    maxItems: 1

  avdd33-supply:
    description: +3.3 V power supply for analog circuit

  vdd10-supply:
    description: +1.05 V power supply

  vdd33-supply:
    description: +3.3 V power supply

required:
  - compatible
  - reg
  - avdd33-supply
  - vdd10-supply
  - vdd33-supply

allOf:
  - $ref: usb-xhci.yaml

additionalProperties: true

examples:
  - |
    pcie@0 {
        reg = <0x0 0x1000>;
        ranges = <0x02000000 0x0 0x100000 0x10000000 0x0 0x0>;
        #address-cells = <3>;
        #size-cells = <2>;
        device_type = "pci";

        usb-controller@0 {
            compatible = "pci1912,0014";
            reg = <0x0 0x0 0x0 0x0 0x0>;
            avdd33-supply = <&avdd33_reg>;
            vdd10-supply = <&vdd10_reg>;
            vdd33-supply = <&vdd33_reg>;
        };
    };
```

## Documentation/devicetree/bindings/usb/renesas,usb-xhci.yaml
```yaml
# SPDX-License-Identifier: (GPL-2.0-only OR BSD-2-Clause)
%YAML 1.2
---
$id: http://devicetree.org/schemas/usb/renesas,usb-xhci.yaml#
$schema: http://devicetree.org/meta-schemas/core.yaml#

title: Renesas USB xHCI controllers

maintainers:
  - Lad Prabhakar <prabhakar.mahadev-lad.rj@bp.renesas.com>
  - Yoshihiro Shimoda <yoshihiro.shimoda.uh@renesas.com>

properties:
  compatible:
    oneOf:
      - items:
          - enum:
              - renesas,xhci-r8a7742 # RZ/G1H
              - renesas,xhci-r8a7743 # RZ/G1M
              - renesas,xhci-r8a7744 # RZ/G1N
              - renesas,xhci-r8a7790 # R-Car H2
              - renesas,xhci-r8a7791 # R-Car M2-W
              - renesas,xhci-r8a7793 # R-Car M2-N
          - const: renesas,rcar-gen2-xhci # R-Car Gen2 and RZ/G1
      - items:
          - enum:
              - renesas,xhci-r8a774a1 # RZ/G2M
              - renesas,xhci-r8a774b1 # RZ/G2N
              - renesas,xhci-r8a774c0 # RZ/G2E
              - renesas,xhci-r8a774e1 # RZ/G2H
              - renesas,xhci-r8a7795  # R-Car H3
              - renesas,xhci-r8a7796  # R-Car M3-W
              - renesas,xhci-r8a77961 # R-Car M3-W+
              - renesas,xhci-r8a77965 # R-Car M3-N
              - renesas,xhci-r8a77990 # R-Car E3
          - const: renesas,rcar-gen3-xhci # R-Car Gen3 and RZ/G2
      - items:
          - enum:
              - renesas,r9a09g011-xhci # RZ/V2M
              - renesas,r9a09g055-xhci # RZ/V2MA
          - const: renesas,rzv2m-xhci  # RZ/{V2M, V2MA}

  reg:
    maxItems: 1

  interrupts:
    maxItems: 1

  clocks:
    minItems: 1
    items:
      - description: Main clock for host
      - description: Register access clock

  clock-names:
    minItems: 1
    items:
      - const: axi
      - const: reg

  phys:
    maxItems: 1

  phy-names:
    items:
      - const: usb

  power-domains:
    maxItems: 1

  resets:
    maxItems: 1

required:
  - compatible
  - reg
  - interrupts
  - clocks
  - power-domains
  - resets

allOf:
  - $ref: usb-xhci.yaml

  - if:
      properties:
        compatible:
          contains:
            enum:
              - renesas,rzv2m-xhci
    then:
      properties:
        clocks:
          minItems: 2
        clock-names:
          minItems: 2
      required:
        - clock-names
    else:
      properties:
        clocks:
          maxItems: 1

unevaluatedProperties: false

examples:
  - |
    #include <dt-bindings/clock/r8a7795-cpg-mssr.h>
    #include <dt-bindings/interrupt-controller/arm-gic.h>
    #include <dt-bindings/power/r8a7795-sysc.h>

    xhci0: usb@ee000000 {
        compatible = "renesas,xhci-r8a7795", "renesas,rcar-gen3-xhci";
        reg = <0xee000000 0xc00>;
        interrupts = <GIC_SPI 102 IRQ_TYPE_LEVEL_HIGH>;
        clocks = <&cpg CPG_MOD 328>;
        power-domains = <&sysc R8A7795_PD_ALWAYS_ON>;
        resets = <&cpg 328>;
    };
```

## Documentation/devicetree/bindings/usb/renesas,usb3-peri.yaml
```yaml
# SPDX-License-Identifier: GPL-2.0-only
%YAML 1.2
---
$id: http://devicetree.org/schemas/usb/renesas,usb3-peri.yaml#
$schema: http://devicetree.org/meta-schemas/core.yaml#

title: Renesas USB 3.0 Peripheral controller

maintainers:
  - Yoshihiro Shimoda <yoshihiro.shimoda.uh@renesas.com>

properties:
  compatible:
    oneOf:
      - items:
          - enum:
              - renesas,r8a774a1-usb3-peri # RZ/G2M
              - renesas,r8a774b1-usb3-peri # RZ/G2N
              - renesas,r8a774c0-usb3-peri # RZ/G2E
              - renesas,r8a774e1-usb3-peri # RZ/G2H
              - renesas,r8a7795-usb3-peri  # R-Car H3
              - renesas,r8a7796-usb3-peri  # R-Car M3-W
              - renesas,r8a77961-usb3-peri # R-Car M3-W+
              - renesas,r8a77965-usb3-peri # R-Car M3-N
              - renesas,r8a77990-usb3-peri # R-Car E3
          - const: renesas,rcar-gen3-usb3-peri

      - items:
          - enum:
              - renesas,r9a09g011-usb3-peri # RZ/V2M
              - renesas,r9a09g055-usb3-peri # RZ/V2MA
          - const: renesas,rzv2m-usb3-peri

  reg:
    maxItems: 1

  interrupts:
    maxItems: 1

  clocks:
    minItems: 1
    items:
      - description: Main clock
      - description: Register access clock

  clock-names:
    minItems: 1
    items:
      - const: axi
      - const: reg

  phys:
    maxItems: 1

  phy-names:
    const: usb

  power-domains:
    maxItems: 1

  resets:
    maxItems: 1

  usb-role-switch:
    $ref: /schemas/types.yaml#/definitions/flag
    description: Support role switch.

  companion:
    $ref: /schemas/types.yaml#/definitions/phandle
    description: phandle of a companion.

  ports:
    $ref: /schemas/graph.yaml#/properties/ports
    description: |
      any connector to the data bus of this controller should be modelled
      using the OF graph bindings specified, if the "usb-role-switch"
      property is used.

    properties:
      port@0:
        $ref: /schemas/graph.yaml#/properties/port
        description: High Speed (HS) data bus.

      port@1:
        $ref: /schemas/graph.yaml#/properties/port
        description: Super Speed (SS) data bus.

    required:
      - port@0
      - port@1

required:
  - compatible
  - interrupts
  - clocks

allOf:
  - if:
      properties:
        compatible:
          contains:
            enum:
              - renesas,rzv2m-usb3-peri
    then:
      properties:
        clocks:
          minItems: 2
        clock-names:
          minItems: 2
      required:
        - clock-names
        - resets
    else:
      properties:
        clocks:
          maxItems: 1

additionalProperties: false

examples:
  - |
    #include <dt-bindings/clock/r8a774c0-cpg-mssr.h>
    #include <dt-bindings/interrupt-controller/arm-gic.h>
    #include <dt-bindings/power/r8a774c0-sysc.h>

    usb3_peri0: usb@ee020000 {
        compatible = "renesas,r8a774c0-usb3-peri", "renesas,rcar-gen3-usb3-peri";
        reg = <0xee020000 0x400>;
        interrupts = <GIC_SPI 104 IRQ_TYPE_LEVEL_HIGH>;
        clocks = <&cpg CPG_MOD 328>;
        companion = <&xhci0>;
        usb-role-switch;

        ports {
            #address-cells = <1>;
            #size-cells = <0>;
            port@0 {
                reg = <0>;
                usb3_hs_ep: endpoint {
                    remote-endpoint = <&hs_ep>;
                };
            };
            port@1 {
                reg = <1>;
                usb3_role_switch: endpoint {
                    remote-endpoint = <&hd3ss3220_out_ep>;
                };
            };
        };
    };
```
