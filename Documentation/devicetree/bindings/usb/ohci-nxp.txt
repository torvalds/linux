## Documentation/devicetree/bindings/usb/ohci-nxp.txt
```
* OHCI controller, NXP ohci-nxp variant

Required properties:
- compatible: must be "nxp,ohci-nxp"
- reg: physical base address of the controller and length of memory mapped
  region.
- interrupts: The OHCI interrupt
- transceiver: phandle of the associated ISP1301 device - this is necessary for
               the UDC controller for connecting to the USB physical layer

Example (LPC32xx):

	isp1301: usb-transceiver@2c {
		compatible = "nxp,isp1301";
		reg = <0x2c>;
	};

	ohci@31020000 {
		compatible = "nxp,ohci-nxp";
		reg = <0x31020000 0x300>;
		interrupt-parent = <&mic>;
		interrupts = <0x3b 0>;
		transceiver = <&isp1301>;
	};
```

## Documentation/devicetree/bindings/usb/ohci-omap3.txt
```
OMAP HS USB OHCI controller (OMAP3 and later)

Required properties:

- compatible: should be "ti,ohci-omap3"
- reg: should contain one register range i.e. start and length
- interrupts: description of the interrupt line

Example for OMAP4:

usbhsohci: ohci@4a064800 {
	compatible = "ti,ohci-omap3";
	reg = <0x4a064800 0x400>;
	interrupts = <0 76 0x4>;
};
```

## Documentation/devicetree/bindings/usb/ohci-st.txt
```
ST USB OHCI controller

Required properties:

 - compatible		: must be "st,st-ohci-300x"
 - reg			: physical base addresses of the controller and length of memory mapped
			  region
 - interrupts		: one OHCI controller interrupt should be described here
 - clocks		: phandle list of usb clocks
 - clock-names		: should be "ic" for interconnect clock and "clk48"
See: Documentation/devicetree/bindings/clock/clock-bindings.txt

 - phys			: phandle for the PHY device
 - phy-names		: should be "usb"

 - resets		: phandle to the powerdown and reset controller for the USB IP
 - reset-names		: should be "power" and "softreset".
See: Documentation/devicetree/bindings/reset/st,stih407-powerdown.yaml
See: Documentation/devicetree/bindings/reset/reset.txt

Example:

	ohci0: usb@fe1ffc00 {
		compatible = "st,st-ohci-300x";
		reg = <0xfe1ffc00 0x100>;
		interrupts = <GIC_SPI 149 IRQ_TYPE_NONE>;
		clocks = <&clk_s_a1_ls 0>,
			 <&clockgen_b0 0>;
		clock-names = "ic", "clk48";
		phys = <&usb2_phy>;
		phy-names = "usb";

		resets = <&powerdown STIH416_USB0_POWERDOWN>,
			 <&softreset STIH416_USB0_SOFTRESET>;
		reset-names = "power", "softreset";
	};
```

## Documentation/devicetree/bindings/usb/omap-usb.txt
```
OMAP GLUE AND OTHER OMAP SPECIFIC COMPONENTS

OMAP MUSB GLUE
 - compatible : Should be "ti,omap4-musb" or "ti,omap3-musb"
 - ti,hwmods : must be "usb_otg_hs"
 - multipoint : Should be "1" indicating the musb controller supports
   multipoint. This is a MUSB configuration-specific setting.
 - num-eps : Specifies the number of endpoints. This is also a
   MUSB configuration-specific setting. Should be set to "16"
 - ram-bits : Specifies the ram address size. Should be set to "12"
 - interface-type : This is a board specific setting to describe the type of
   interface between the controller and the phy. It should be "0" or "1"
   specifying ULPI and UTMI respectively.
 - mode : Should be "3" to represent OTG. "1" signifies HOST and "2"
   represents PERIPHERAL.
 - power : Should be "50". This signifies the controller can supply up to
   100mA when operating in host mode.
 - usb-phy : the phandle for the PHY device
 - phys : the phandle for the PHY device (used by generic PHY framework)
 - phy-names : the names of the PHY corresponding to the PHYs present in the
   *phy* phandle.

Optional properties:
 - ctrl-module : phandle of the control module this glue uses to write to
   mailbox

SOC specific device node entry
usb_otg_hs: usb_otg_hs@4a0ab000 {
	compatible = "ti,omap4-musb";
	ti,hwmods = "usb_otg_hs";
	multipoint = <1>;
	num-eps = <16>;
	ram-bits = <12>;
	ctrl-module = <&omap_control_usb>;
	phys = <&usb2_phy>;
	phy-names = "usb2-phy";
};

Board specific device node entry
&usb_otg_hs {
	interface-type = <1>;
	mode = <3>;
	power = <50>;
};

OMAP DWC3 GLUE
 - compatible : Should be "ti,dwc3"
 - ti,hwmods : Should be "usb_otg_ss"
 - reg : Address and length of the register set for the device.
 - interrupts : The irq number of this device that is used to interrupt the
   MPU
 - #address-cells, #size-cells : Must be present if the device has sub-nodes
 - utmi-mode : controls the source of UTMI/PIPE status for VBUS and OTG ID.
   It should be set to "1" for HW mode and "2" for SW mode.
 - ranges: the child address space are mapped 1:1 onto the parent address space

Optional Properties:
 - extcon : phandle for the extcon device omap dwc3 uses to detect
   connect/disconnect events.
 - vbus-supply : phandle to the regulator device tree node if needed.

Sub-nodes:
The dwc3 core should be added as subnode to omap dwc3 glue.
- dwc3 :
   The binding details of dwc3 can be found in:
   Documentation/devicetree/bindings/usb/dwc3.txt

omap_dwc3 {
	compatible = "ti,dwc3";
	ti,hwmods = "usb_otg_ss";
	reg = <0x4a020000 0x1ff>;
	interrupts = <0 93 4>;
	#address-cells = <1>;
	#size-cells = <1>;
	utmi-mode = <2>;
	ranges;
};
```

## Documentation/devicetree/bindings/usb/onnn,nb7vpq904m.yaml
```yaml
# SPDX-License-Identifier: GPL-2.0-only OR BSD-2-Clause
%YAML 1.2
---
$id: http://devicetree.org/schemas/usb/onnn,nb7vpq904m.yaml#
$schema: http://devicetree.org/meta-schemas/core.yaml#

title: ON Semiconductor Type-C DisplayPort ALT Mode Linear Redriver

maintainers:
  - Neil Armstrong <neil.armstrong@linaro.org>

properties:
  compatible:
    enum:
      - onnn,nb7vpq904m

  reg:
    maxItems: 1

  vcc-supply:
    description: power supply (1.8V)

  enable-gpios: true
  orientation-switch: true
  retimer-switch: true

  ports:
    $ref: /schemas/graph.yaml#/properties/ports
    properties:
      port@0:
        $ref: /schemas/graph.yaml#/properties/port
        description: Super Speed (SS) Output endpoint to the Type-C connector

      port@1:
        $ref: /schemas/graph.yaml#/$defs/port-base
        description: Super Speed (SS) Input endpoint from the Super-Speed PHY
        unevaluatedProperties: false

        properties:
          endpoint:
            $ref: /schemas/graph.yaml#/$defs/endpoint-base
            unevaluatedProperties: false

            properties:
              data-lanes:
                $ref: /schemas/types.yaml#/definitions/uint32-array
                description: |
                  An array of physical data lane indexes. Position determines how
                  lanes are connected to the redriver, It is assumed the same order
                  is kept on the other side of the redriver.
                  Lane number represents the following
                  - 0 is RX2 lane
                  - 1 is TX2 lane
                  - 2 is TX1 lane
                  - 3 is RX1 lane
                  The position determines the physical port of the redriver, in the
                  order A, B, C & D.
                oneOf:
                  - items:
                      - const: 0
                      - const: 1
                      - const: 2
                      - const: 3
                    description: |
                      This is the lanes default layout
                      - Port A to RX2 lane
                      - Port B to TX2 lane
                      - Port C to TX1 lane
                      - Port D to RX1 lane
                  - items:
                      - const: 3
                      - const: 2
                      - const: 1
                      - const: 0
                    description: |
                      This is the USBRX2/USBTX2 and USBRX1/USBTX1 swapped lanes layout
                      - Port A to RX1 lane
                      - Port B to TX1 lane
                      - Port C to TX2 lane
                      - Port D to RX2 lane

      port@2:
        $ref: /schemas/graph.yaml#/properties/port
        description:
          Sideband Use (SBU) AUX lines endpoint to the Type-C connector for the purpose of
          handling altmode muxing and orientation switching.

required:
  - compatible
  - reg

allOf:
  - $ref: usb-switch.yaml#

additionalProperties: false

examples:
  - |
    i2c {
        #address-cells = <1>;
        #size-cells = <0>;

        typec-mux@32 {
            compatible = "onnn,nb7vpq904m";
            reg = <0x32>;

            vcc-supply = <&vreg_l15b_1p8>;

            retimer-switch;
            orientation-switch;

            ports {
                #address-cells = <1>;
                #size-cells = <0>;

                port@0 {
                    reg = <0>;
                    usb_con_ss: endpoint {
                        remote-endpoint = <&typec_con_ss>;
                    };
                };
                port@1 {
                    reg = <1>;
                    phy_con_ss: endpoint {
                        remote-endpoint = <&usb_phy_ss>;
                        data-lanes = <3 2 1 0>;
                    };
                };
                port@2 {
                    reg = <2>;
                    usb_con_sbu: endpoint {
                        remote-endpoint = <&typec_dp_aux>;
                    };
                };
            };
        };
    };
...
```

## Documentation/devicetree/bindings/usb/parade,ps5511.yaml
```yaml
# SPDX-License-Identifier: GPL-2.0-only OR BSD-2-Clause
%YAML 1.2
---
$id: http://devicetree.org/schemas/usb/parade,ps5511.yaml#
$schema: http://devicetree.org/meta-schemas/core.yaml#

title: Parade PS5511 4+1 Port USB 3.2 Gen 1 Hub Controller

maintainers:
  - Pin-yen Lin <treapking@chromium.org>

properties:
  compatible:
    enum:
      - usb1da0,5511
      - usb1da0,55a1

  reset-gpios:
    items:
      - description: GPIO specifier for RESETB pin.

  vddd11-supply:
    description:
      1V1 power supply to the hub

  vdd33-supply:
    description:
      3V3 power supply to the hub

  peer-hub: true

  ports:
    $ref: /schemas/graph.yaml#/properties/ports

    patternProperties:
      '^port@':
        $ref: /schemas/graph.yaml#/properties/port

        properties:
          reg:
            minimum: 1
            maximum: 5

additionalProperties:
  properties:
    reg:
      minimum: 1
      maximum: 5

required:
  - peer-hub

allOf:
  - $ref: usb-hub.yaml#
  - if:
      not:
        properties:
          compatible:
            enum:
              - usb1da0,55a1
    then:
      properties:
        ports:
          properties:
            port@5: false

      patternProperties:
        '^.*@5$': false

examples:
  - |
    usb {
        #address-cells = <1>;
        #size-cells = <0>;

        /* 2.0 hub on port 1 */
        hub_2_0: hub@1 {
            compatible = "usb1da0,55a1";
            reg = <1>;
            peer-hub = <&hub_3_0>;
            #address-cells = <1>;
            #size-cells = <0>;
            /* USB 2.0 device on port 5 */
            device@5 {
                reg = <5>;
                compatible = "usb123,4567";
            };
        };

        /* 3.0 hub on port 2 */
        hub_3_0: hub@2 {
            compatible = "usb1da0,5511";
            reg = <2>;
            peer-hub = <&hub_2_0>;

            ports {
                #address-cells = <1>;
                #size-cells = <0>;
                /* Type-A connector on port 3 */
                port@3 {
                    reg = <3>;
                    endpoint {
                        remote-endpoint = <&usb_a0_ss>;
                    };
                };
            };
        };
    };
```

## Documentation/devicetree/bindings/usb/parade,ps8830.yaml
```yaml
# SPDX-License-Identifier: GPL-2.0-only OR BSD-2-Clause
%YAML 1.2
---
$id: http://devicetree.org/schemas/usb/parade,ps8830.yaml#
$schema: http://devicetree.org/meta-schemas/core.yaml#

title: Parade PS883x USB and DisplayPort Retimer

maintainers:
  - Abel Vesa <abel.vesa@linaro.org>

properties:
  compatible:
    enum:
      - parade,ps8830

  reg:
    maxItems: 1

  clocks:
    items:
      - description: XO Clock

  reset-gpios:
    maxItems: 1

  vdd-supply:
    description: power supply (1.07V)

  vdd33-supply:
    description: power supply (3.3V)

  vdd33-cap-supply:
    description: power supply (3.3V)

  vddar-supply:
    description: power supply (1.07V)

  vddat-supply:
    description: power supply (1.07V)

  vddio-supply:
    description: power supply (1.2V or 1.8V)

  orientation-switch: true
  retimer-switch: true

  ports:
    $ref: /schemas/graph.yaml#/properties/ports
    properties:
      port@0:
        $ref: /schemas/graph.yaml#/properties/port
        description: Super Speed (SS) Output endpoint to the Type-C connector

      port@1:
        $ref: /schemas/graph.yaml#/$defs/port-base
        description: Super Speed (SS) Input endpoint from the Super-Speed PHY
        unevaluatedProperties: false

      port@2:
        $ref: /schemas/graph.yaml#/properties/port
        description:
          Sideband Use (SBU) AUX lines endpoint to the Type-C connector for the purpose of
          handling altmode muxing and orientation switching.

required:
  - compatible
  - reg
  - clocks
  - reset-gpios
  - vdd-supply
  - vdd33-supply
  - vdd33-cap-supply
  - vddat-supply
  - vddio-supply
  - orientation-switch
  - retimer-switch

allOf:
  - $ref: usb-switch.yaml#

additionalProperties: false

examples:
  - |
    #include <dt-bindings/gpio/gpio.h>

    i2c {
        #address-cells = <1>;
        #size-cells = <0>;

        typec-mux@8 {
            compatible = "parade,ps8830";
            reg = <0x8>;

            clocks = <&clk_rtmr_xo>;

            vdd-supply = <&vreg_rtmr_1p15>;
            vdd33-supply = <&vreg_rtmr_3p3>;
            vdd33-cap-supply = <&vreg_rtmr_3p3>;
            vddar-supply = <&vreg_rtmr_1p15>;
            vddat-supply = <&vreg_rtmr_1p15>;
            vddio-supply = <&vreg_rtmr_1p8>;

            reset-gpios = <&tlmm 10 GPIO_ACTIVE_LOW>;

            retimer-switch;
            orientation-switch;

            ports {
                #address-cells = <1>;
                #size-cells = <0>;

                port@0 {
                    reg = <0>;

                    endpoint {
                        remote-endpoint = <&typec_con_ss>;
                    };
                };

                port@1 {
                    reg = <1>;

                    endpoint {
                        remote-endpoint = <&usb_phy_ss>;
                    };
                };

                port@2 {
                    reg = <2>;

                    endpoint {
                        remote-endpoint = <&typec_dp_aux>;
                    };
                };
            };
        };
    };
...
```

## Documentation/devicetree/bindings/usb/platform-uhci.txt
```
Generic Platform UHCI Controller
-----------------------------------------------------

Required properties:
- compatible : "platform-uhci"
- reg : Should contain 1 register ranges(address and length)
- interrupts : UHCI controller interrupt

Example:

	uhci@d8007b00 {
		compatible = "platform-uhci";
		reg = <0xd8007b00 0x200>;
		interrupts = <43>;
	};
```
