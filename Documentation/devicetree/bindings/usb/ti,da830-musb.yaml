## drivers/clk/zte/Kconfig
```kconfig
# SPDX-License-Identifier: GPL-2.0-only
#
# ZTE Clock Drivers
#

config COMMON_CLK_ZTE
	tristate "Clock driver for ZTE SoCs"
	depends on HAS_IOMEM
	depends on ARCH_ZTE || COMPILE_TEST
	default ARCH_ZTE
	select MFD_SYSCON
	help
	  This option selects common clock infrastructure for ZTE based SoCs.
	  You will need to enable one or more SoC specific drivers to make use
	  of this.

	  Enable this if you are building a kernel for a ZTE designed board.

config CLK_ZTE_ZX297520V3
	tristate "Clock driver for ZTE zx297520v3 based SoCs"
	depends on COMMON_CLK_ZTE && (MFD_ZTE_ZX297520V3_CRM || COMPILE_TEST)
	default SOC_ZX297520V3
	help
	  This driver supports ZTE zx297520v3 basic clocks.

	  Enable this if you want to build a kernel that is able to run on
	  boards based on this SoC. You can safely enable multiple clock
	  drivers. The one(s) matching the device tree will be used.
```

## drivers/firmware/arm_rmm/Kconfig
```kconfig
# SPDX-License-Identifier: GPL-2.0-only
config ARCH_SUPPORTS_RMM
	bool

config ARM_RMM_RMI
	bool "Realm Management Interface (RMI) Support"
	depends on ARCH_SUPPORTS_RMM
	help
	  Support the Realm Management Monitor (RMM) on Arm systems that
	  implement the Realm Management Extension (RME), as defined by the
	  Arm Confidential Compute Architecture.

	  The RMM runs at EL2 in the Realm world and provides the Realm
	  Management Interface (RMI) used by a Normal World host to create,
	  manage and run protected virtual machines called Realms. The RMM can
	  also act as a TSM, as defined by the PCIe TDISP and can manage the
	  PCI IDE setup for securing the PCIe links.

	  This option builds the host-side RMI support used by KVM to detect a
	  compatible RMM, configure it, manage delegated memory and enable
	  Realm guests.

	  Selecting this option does not by itself make Realm guests available:
	  the system must also provide RME-capable hardware and firmware with a
	  compatible RMM implementation.

config ARM_RMM_RSI
	bool "Realm Service Interface (RSI) Support"
	depends on ARCH_SUPPORTS_RMM
	default y
	help
	  Enable support for running Linux as a Realm guest under a Realm
	  Management Monitor (RMM), as defined by the Arm Confidential
	  Compute Architecture.

	  The RMM exposes the Realm Service Interface (RSI) to Realm guests.
	  Linux uses RSI to negotiate the interface version, obtain the Realm
	  configuration, and manage the protected or shared state of guest
	  memory.
```

## drivers/firmware/coreboot/Kconfig
```kconfig
# SPDX-License-Identifier: GPL-2.0-only
menuconfig COREBOOT_FIRMWARE
	bool "coreboot firmware drivers"
	default GOOGLE_FIRMWARE
	default n
	help
	  These firmware drivers are used by devices running coreboot
	  firmware, including Chromebooks and some Google servers.
	  They include shared support for coreboot table entries and
	  drivers for CBMEM, framebuffer, firmware console and VPD records.
	  If in doubt, say "N".

if COREBOOT_FIRMWARE

config GOOGLE_SMI
	tristate "SMI interface for Google platforms"
	depends on X86 && ACPI && DMI
	help
	  Say Y here if you want to enable SMI callbacks for Google
	  platforms.  This provides an interface for writing to and
	  clearing the event log.  If CONFIG_EFI is also enabled this
	  driver provides an interface for reading and writing NVRAM
	  variables.

config COREBOOT_CBMEM
	tristate "CBMEM entries in sysfs"
	depends on COREBOOT_TABLE
	default GOOGLE_CBMEM
	help
	  CBMEM is a downwards-growing memory region created by the
	  Coreboot BIOS containing tagged data structures from the
	  BIOS.  These data structures expose things like the verified
	  boot firmware variables, flash layout, firmware event log,
	  and more.

	  This option enables the cbmem module, which causes the
	  kernel to search for Coreboot CBMEM entries, and expose the
	  memory for each entry in sysfs under
	  /sys/bus/coreboot/devices/cbmem-<id>.

config COREBOOT_TABLE
	tristate "Coreboot Table Access"
	depends on HAS_IOMEM && (ACPI || OF)
	default GOOGLE_COREBOOT_TABLE
	help
	  This option enables the coreboot_table module, which provides other
	  firmware modules access to the coreboot table. The coreboot table
	  pointer is accessed through the ACPI "GOOGCB00" object or the
	  device tree node /firmware/coreboot.
	  If unsure say N.

config COREBOOT_CFR
	tristate "coreboot CFR firmware attributes"
	depends on EFI
	depends on COREBOOT_TABLE
	depends on HAS_IOPORT
	select CRC32
	select FW_ATTR_CLASS
	help
	  This driver parses the coreboot CFR table and exposes runtime EFI
	  variable-backed options through the firmware-attributes sysfs
	  interface.

	  If you have a system running coreboot with CFR runtime
	  configuration support, say Y or M here.

config COREBOOT_MEMCONSOLE_COMMON
	tristate
	depends on GOOGLE_MEMCONSOLE_X86_LEGACY || COREBOOT_MEMCONSOLE
	default GOOGLE_MEMCONSOLE

config GOOGLE_MEMCONSOLE_X86_LEGACY
	tristate "Firmware Memory Console - X86 Legacy support"
	depends on X86 && ACPI && DMI
	select COREBOOT_MEMCONSOLE_COMMON
	help
	  This option enables the kernel to search for a firmware log in
	  the EBDA on Google servers.  If found, this log is exported to
	  userland in the file /sys/firmware/log.
	  This driver is limited to x86 systems that expose the legacy
	  Google EBDA console format.

config COREBOOT_FRAMEBUFFER
	tristate "Coreboot Framebuffer"
	depends on COREBOOT_TABLE
	default GOOGLE_FRAMEBUFFER_COREBOOT
	help
	  This option enables the kernel to search for a framebuffer in
	  the coreboot table.  If found, it is registered with a platform
	  device of type coreboot-framebuffer. Using the old device of
	  type simple-framebuffer is deprecated.

config COREBOOT_MEMCONSOLE
	tristate "Firmware Memory Console"
	depends on COREBOOT_TABLE
	select COREBOOT_MEMCONSOLE_COMMON
	default GOOGLE_MEMCONSOLE_COREBOOT
	help
	  This option enables the kernel to search for a firmware log in
	  the coreboot table.  If found, this log is exported to userland
	  in the file /sys/firmware/log.
	  This is the coreboot-table backed variant of the firmware memory
	  console driver.

config GOOGLE_VPD
	tristate "Vital Product Data"
	depends on COREBOOT_TABLE
	help
	  This option enables the kernel to expose the content of Google VPD
	  under /sys/firmware/vpd.
	  VPD records carry firmware-provided key/value data used by
	  Google devices.

endif # COREBOOT_FIRMWARE

config GOOGLE_FIRMWARE
	bool
	transitional

config GOOGLE_CBMEM
	tristate
	transitional

config GOOGLE_COREBOOT_TABLE
	tristate
	transitional

config GOOGLE_MEMCONSOLE
	tristate
	transitional

config GOOGLE_FRAMEBUFFER_COREBOOT
	tristate
	transitional

config GOOGLE_MEMCONSOLE_COREBOOT
	tristate
	transitional
```

## drivers/gpu/Kconfig
```kconfig
# SPDX-License-Identifier: GPL-2.0

config GPU_BUDDY
       bool
       help
         A page based buddy allocator for GPU memory.

config GPU_BUDDY_KUNIT_TEST
       tristate "KUnit tests for GPU buddy allocator" if !KUNIT_ALL_TESTS
       depends on KUNIT
       select GPU_BUDDY
       default KUNIT_ALL_TESTS
       help
         KUnit tests for the GPU buddy allocator.
```

## drivers/gpu/nova-core/Kconfig
```kconfig
config NOVA_CORE
	tristate "Nova Core GPU driver"
	depends on 64BIT
	depends on PCI
	depends on RUST
	depends on !CPU_BIG_ENDIAN
	select AUXILIARY_BUS
	select GPU_BUDDY
	select RUST_FW_LOADER_ABSTRACTIONS
	default n
	help
	  Choose this if you want to build the Nova Core driver for Nvidia
	  GPUs based on the GPU System Processor (GSP). This is true for Turing
	  and later GPUs.

	  This driver is work in progress and may not be functional.

	  If M is selected, the module will be called nova-core.

config NOVA_CORE_SELFTESTS
	bool "Nova Core driver self-tests"
	depends on NOVA_CORE
	default n
	help
	  Build the driver self-tests and run them when the GPU is probed.

	  If the interrupt delivery test fails, the probe fails and the driver
	  does not bind to the GPU. A broken interrupt path would otherwise
	  show up later as a hang, far from its cause. Every other self-test
	  logs its failure and lets the probe continue.

	  If unsure, say N.
```

## drivers/i3c/Kconfig
```kconfig
# SPDX-License-Identifier: GPL-2.0

menuconfig I3C
	tristate "I3C support"
	select I2C
	help
	  I3C is a serial protocol standardized by the MIPI alliance.

	  It's supposed to be backward compatible with I2C while providing
	  support for high speed transfers and native interrupt support
	  without the need for extra pins.

	  The I3C protocol also standardizes the slave device types and is
	  mainly designed to communicate with sensors.

	  If you want I3C support, you should say Y here and also to the
	  specific driver for your bus adapter(s) below.

	  This I3C support can also be built as a module.  If so, the module
	  will be called i3c.

if I3C
source "drivers/i3c/master/Kconfig"

config I3C_HUB
	tristate "I3C Hub Support"
	help
	  Enable support for the I3C interface in hub devices.

	  This option adds virtual I3C bus support for hubs by creating
	  virtual master controllers for downstream ports and forwarding
	  bus operations through the hub device. It also provides an
	  interface used by hub drivers to enable or disable downstream
	  ports during bus transactions.

	  Say Y here if your platform includes an I3C hub device

endif # I3C

config I3C_OR_I2C
	tristate
	default m if I3C=m
	default I2C
	help
	  Device drivers using module_i3c_i2c_driver() can use either
	  i2c or i3c hosts, but cannot be built-in for the kernel when
	  CONFIG_I3C=m.

	  Add 'depends on I2C_OR_I3C' in Kconfig for those drivers to
	  get the correct dependencies.
```
