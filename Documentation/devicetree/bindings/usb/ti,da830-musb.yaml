## arch/mips/configs/econet_en751221_defconfig
```kconfig
# CONFIG_LOCALVERSION_AUTO is not set
CONFIG_KERNEL_XZ=y
CONFIG_SYSVIPC=y
CONFIG_POSIX_MQUEUE=y
# CONFIG_CROSS_MEMORY_ATTACH is not set
CONFIG_HIGH_RES_TIMERS=y
CONFIG_BPF_SYSCALL=y
CONFIG_BPF_JIT=y
CONFIG_PREEMPT=y
CONFIG_CGROUPS=y
CONFIG_MEMCG=y
CONFIG_BLK_CGROUP=y
CONFIG_CGROUP_SCHED=y
CONFIG_CFS_BANDWIDTH=y
CONFIG_RT_GROUP_SCHED=y
CONFIG_CGROUP_PIDS=y
CONFIG_CGROUP_RDMA=y
CONFIG_CPUSETS=y
CONFIG_CGROUP_CPUACCT=y
CONFIG_CGROUP_BPF=y
CONFIG_NAMESPACES=y
# CONFIG_TIME_NS is not set
CONFIG_USER_NS=y
CONFIG_BLK_DEV_INITRD=y
# CONFIG_RD_GZIP is not set
# CONFIG_RD_BZIP2 is not set
# CONFIG_RD_LZMA is not set
# CONFIG_RD_XZ is not set
# CONFIG_RD_LZO is not set
# CONFIG_RD_LZ4 is not set
# CONFIG_RD_ZSTD is not set
# CONFIG_INITRAMFS_PRESERVE_MTIME is not set
CONFIG_LD_DEAD_CODE_DATA_ELIMINATION=y
CONFIG_EXPERT=y
# CONFIG_SGETMASK_SYSCALL is not set
# CONFIG_IO_URING is not set
# CONFIG_RSEQ is not set
# CONFIG_CACHESTAT_SYSCALL is not set
CONFIG_ECONET=y
CONFIG_CPU_MIPS32_R2=y
CONFIG_ZBOOT_LOAD_ADDRESS=0x80020000
CONFIG_ARCH_FORCE_MAX_ORDER=11
# CONFIG_MIPS_FP_SUPPORT is not set
CONFIG_NR_CPUS=2
CONFIG_HZ_100=y
CONFIG_MIPS_RAW_APPENDED_DTB=y
# CONFIG_SCHED_SMT is not set
CONFIG_JUMP_LABEL=y
# CONFIG_STACKPROTECTOR_STRONG is not set
# CONFIG_GCC_PLUGINS is not set
CONFIG_MODULES=y
CONFIG_MODULE_UNLOAD=y
# CONFIG_BLOCK_LEGACY_AUTOLOAD is not set
CONFIG_BLK_DEV_THROTTLING=y
# CONFIG_BLK_DEBUG_FS is not set
CONFIG_PARTITION_ADVANCED=y
CONFIG_OF_PARTITION=y
# CONFIG_MQ_IOSCHED_DEADLINE is not set
# CONFIG_MQ_IOSCHED_KYBER is not set
# CONFIG_CORE_DUMP_DEFAULT_ELF_HEADERS is not set
CONFIG_SLAB_FREELIST_RANDOM=y
CONFIG_SLAB_FREELIST_HARDENED=y
# CONFIG_COMPAT_BRK is not set
CONFIG_LRU_GEN=y
CONFIG_LRU_GEN_ENABLED=y
CONFIG_NET=y
CONFIG_PACKET=y
CONFIG_UNIX=y
CONFIG_INET=y
CONFIG_IP_MULTICAST=y
CONFIG_IP_ADVANCED_ROUTER=y
CONFIG_IP_MULTIPLE_TABLES=y
CONFIG_IP_ROUTE_MULTIPATH=y
CONFIG_IP_ROUTE_VERBOSE=y
CONFIG_IP_MROUTE=y
CONFIG_IP_MROUTE_MULTIPLE_TABLES=y
CONFIG_IP_PIMSM_V1=y
CONFIG_IP_PIMSM_V2=y
CONFIG_SYN_COOKIES=y
# CONFIG_INET_DIAG is not set
CONFIG_TCP_CONG_ADVANCED=y
# CONFIG_TCP_CONG_BIC is not set
# CONFIG_TCP_CONG_WESTWOOD is not set
# CONFIG_TCP_CONG_HTCP is not set
# CONFIG_IPV6_SIT is not set
CONFIG_IPV6_SUBTREES=y
CONFIG_IPV6_MROUTE=y
CONFIG_IPV6_MROUTE_MULTIPLE_TABLES=y
CONFIG_IPV6_PIMSM_V2=y
CONFIG_IPV6_SEG6_LWTUNNEL=y
CONFIG_MPTCP=y
CONFIG_NETFILTER=y
# CONFIG_NETFILTER_EGRESS is not set
CONFIG_NF_CONNTRACK=m
CONFIG_NF_CONNTRACK_MARK=y
CONFIG_NF_CONNTRACK_ZONES=y
CONFIG_NF_CONNTRACK_PROCFS=y
CONFIG_NF_CONNTRACK_TIMEOUT=y
# CONFIG_NF_CT_PROTO_SCTP is not set
CONFIG_NF_TABLES=m
CONFIG_NF_TABLES_INET=y
CONFIG_NF_TABLES_NETDEV=y
CONFIG_NFT_NUMGEN=m
CONFIG_NFT_CT=m
CONFIG_NFT_FLOW_OFFLOAD=m
CONFIG_NFT_LOG=m
CONFIG_NFT_LIMIT=m
CONFIG_NFT_MASQ=m
CONFIG_NFT_REDIR=m
CONFIG_NFT_NAT=m
CONFIG_NFT_QUOTA=m
CONFIG_NFT_REJECT=m
CONFIG_NFT_HASH=m
CONFIG_NFT_FIB_INET=m
CONFIG_NF_FLOW_TABLE_INET=m
CONFIG_NF_FLOW_TABLE=m
CONFIG_NFT_FIB_IPV4=m
CONFIG_NF_TABLES_ARP=y
CONFIG_NF_LOG_IPV4=m
CONFIG_NFT_FIB_IPV6=m
CONFIG_NF_LOG_IPV6=m
CONFIG_NF_TABLES_BRIDGE=m
CONFIG_BRIDGE=y
CONFIG_BRIDGE_VLAN_FILTERING=y
CONFIG_VLAN_8021Q=y
CONFIG_NET_SCHED=y
CONFIG_NET_SCH_FQ_CODEL=y
CONFIG_NET_SCH_DEFAULT=y
CONFIG_DEFAULT_FQ_CODEL=y
CONFIG_NET_SWITCHDEV=y
CONFIG_NET_L3_MASTER_DEV=y
CONFIG_RFKILL=y
# CONFIG_LWTUNNEL_BPF is not set
CONFIG_PCI=y
CONFIG_PCIEPORTBUS=y
CONFIG_PCIEAER=y
# CONFIG_PCIEASPM is not set
CONFIG_PCI_MSI=y
# CONFIG_VGA_ARB is not set
CONFIG_PCIE_MEDIATEK=y
CONFIG_MTD=y
CONFIG_MTD_BLOCK=y
CONFIG_MTD_CFI=y
CONFIG_MTD_CFI_INTELEXT=y
CONFIG_MTD_CFI_AMDSTD=y
CONFIG_MTD_COMPLEX_MAPPINGS=y
CONFIG_MTD_SPI_NAND=y
CONFIG_MTD_UBI=y
CONFIG_MTD_UBI_BEB_LIMIT=13
CONFIG_MTD_UBI_BLOCK=y
CONFIG_NETDEVICES=y
# CONFIG_NET_VENDOR_ASIX is not set
# CONFIG_NET_VENDOR_ENGLEDER is not set
# CONFIG_NET_VENDOR_FUNGIBLE is not set
# CONFIG_NET_VENDOR_LITEX is not set
# CONFIG_NET_VENDOR_MICROSOFT is not set
# CONFIG_NET_VENDOR_VERTEXCOM is not set
# CONFIG_NET_VENDOR_WANGXUN is not set
CONFIG_PPP=m
CONFIG_PPP_FILTER=y
CONFIG_PPP_MULTILINK=y
CONFIG_PPPOE=m
CONFIG_PPP_ASYNC=m
# CONFIG_WLAN_VENDOR_ADMTEK is not set
# CONFIG_WLAN_VENDOR_ATH is not set
# CONFIG_WLAN_VENDOR_ATMEL is not set
# CONFIG_WLAN_VENDOR_BROADCOM is not set
# CONFIG_WLAN_VENDOR_INTEL is not set
# CONFIG_WLAN_VENDOR_INTERSIL is not set
# CONFIG_WLAN_VENDOR_MARVELL is not set
# CONFIG_WLAN_VENDOR_MEDIATEK is not set
# CONFIG_WLAN_VENDOR_MICROCHIP is not set
# CONFIG_WLAN_VENDOR_PURELIFI is not set
# CONFIG_WLAN_VENDOR_RALINK is not set
# CONFIG_WLAN_VENDOR_REALTEK is not set
# CONFIG_WLAN_VENDOR_RSI is not set
# CONFIG_WLAN_VENDOR_SILABS is not set
# CONFIG_WLAN_VENDOR_ST is not set
# CONFIG_WLAN_VENDOR_TI is not set
# CONFIG_WLAN_VENDOR_ZYDAS is not set
# CONFIG_WLAN_VENDOR_QUANTENNA is not set
# CONFIG_INPUT is not set
# CONFIG_SERIO is not set
# CONFIG_VT is not set
# CONFIG_LEGACY_PTYS is not set
# CONFIG_LEGACY_TIOCSTI is not set
CONFIG_SERIAL_8250=y
CONFIG_SERIAL_8250_CONSOLE=y
CONFIG_SERIAL_OF_PLATFORM=y
# CONFIG_HW_RANDOM is not set
# CONFIG_DEVMEM is not set
CONFIG_SPI=y
# CONFIG_PTP_1588_CLOCK is not set
CONFIG_GPIOLIB=y
# CONFIG_HWMON is not set
CONFIG_WATCHDOG=y
CONFIG_MFD_SYSCON=y
# CONFIG_USB_PCI is not set
CONFIG_NEW_LEDS=y
CONFIG_LEDS_CLASS=y
CONFIG_LEDS_CLASS_MULTICOLOR=y
CONFIG_LEDS_GPIO=m
CONFIG_LEDS_TRIGGERS=y
CONFIG_LEDS_TRIGGER_TIMER=y
CONFIG_LEDS_TRIGGER_HEARTBEAT=y
CONFIG_LEDS_TRIGGER_DEFAULT_ON=y
CONFIG_LEDS_TRIGGER_NETDEV=y
CONFIG_STAGING=y
# CONFIG_MIPS_PLATFORM_DEVICES is not set
CONFIG_COMMON_CLK_EN7523=y
# CONFIG_IOMMU_SUPPORT is not set
CONFIG_RESET_CONTROLLER=y
CONFIG_PHY_ECONET_PCIE=y
# CONFIG_DNOTIFY is not set
CONFIG_FANOTIFY=y
CONFIG_OVERLAY_FS=y
# CONFIG_OVERLAY_FS_REDIRECT_ALWAYS_FOLLOW is not set
# CONFIG_PROC_PAGE_MONITOR is not set
CONFIG_TMPFS=y
CONFIG_TMPFS_POSIX_ACL=y
CONFIG_JFFS2_FS=y
CONFIG_JFFS2_SUMMARY=y
CONFIG_JFFS2_FS_XATTR=y
CONFIG_JFFS2_COMPRESSION_OPTIONS=y
CONFIG_UBIFS_FS=y
CONFIG_SQUASHFS=y
CONFIG_SQUASHFS_FILE_DIRECT=y
CONFIG_SQUASHFS_COMPILE_DECOMP_MULTI_PERCPU=y
# CONFIG_SQUASHFS_ZLIB is not set
CONFIG_SQUASHFS_XZ=y
CONFIG_SQUASHFS_EMBEDDED=y
CONFIG_KEYS=y
CONFIG_INIT_STACK_NONE=y
CONFIG_FORTIFY_SOURCE=y
CONFIG_HARDENED_USERCOPY=y
CONFIG_LIST_HARDENED=y
CONFIG_CRYPTO_NULL=y
CONFIG_CRYPTO_AES=y
CONFIG_CRYPTO_CCM=y
CONFIG_CRYPTO_GCM=y
# CONFIG_CRYPTO_HW is not set
# CONFIG_XZ_DEC_X86 is not set
# CONFIG_XZ_DEC_POWERPC is not set
# CONFIG_XZ_DEC_ARM is not set
# CONFIG_XZ_DEC_ARMTHUMB is not set
# CONFIG_XZ_DEC_ARM64 is not set
# CONFIG_XZ_DEC_SPARC is not set
# CONFIG_XZ_DEC_RISCV is not set
CONFIG_PRINTK_TIME=y
# CONFIG_DEBUG_MISC is not set
CONFIG_DEBUG_INFO_DWARF_TOOLCHAIN_DEFAULT=y
CONFIG_DEBUG_INFO_REDUCED=y
CONFIG_FRAME_WARN=1024
CONFIG_STRIP_ASM_SYMS=y
CONFIG_MAGIC_SYSRQ=y
# CONFIG_MAGIC_SYSRQ_SERIAL is not set
CONFIG_DEBUG_FS=y
# CONFIG_SLUB_DEBUG is not set
CONFIG_SCHED_STACK_END_CHECK=y
CONFIG_PANIC_ON_OOPS=y
CONFIG_PANIC_TIMEOUT=1
CONFIG_RCU_CPU_STALL_TIMEOUT=60
# CONFIG_RCU_TRACE is not set
# CONFIG_FTRACE is not set
```

## arch/riscv/crypto/Kconfig
```kconfig
# SPDX-License-Identifier: GPL-2.0

menu "Accelerated Cryptographic Algorithms for CPU (riscv)"

config CRYPTO_SM4_RISCV64
	tristate "Ciphers: SM4 (ShangMi 4)"
	depends on 64BIT && TOOLCHAIN_HAS_VECTOR_CRYPTO && \
		   RISCV_EFFICIENT_VECTOR_UNALIGNED_ACCESS
	select CRYPTO_ALGAPI
	select CRYPTO_SM4
	help
	  SM4 block cipher algorithm (OSCCA GB/T 32907-2016,
	  ISO/IEC 18033-3:2010/Amd 1:2021)

	  SM4 (GBT.32907-2016) is a cryptographic standard issued by the
	  Organization of State Commercial Administration of China (OSCCA)
	  as an authorized cryptographic algorithm for use within China.

	  Architecture: riscv64 using:
	  - Zvksed vector crypto extension
	  - Zvkb vector crypto extension

endmenu
```

## arch/s390/kvm/Kconfig
```kconfig
# SPDX-License-Identifier: GPL-2.0
#
# KVM configuration
#
source "virt/kvm/Kconfig"

menuconfig VIRTUALIZATION
	def_bool y
	prompt "KVM"
	help
	  Say Y here to get to see options for using your Linux host to run other
	  operating systems inside virtual machines (guests).
	  This option alone does not add any kernel code.

	  If you say N, all options in this submenu will be skipped and disabled.

if VIRTUALIZATION

config KVM
	def_tristate y
	prompt "Kernel-based Virtual Machine (KVM) support"
	select HAVE_KVM_CPU_RELAX_INTERCEPT
	select KVM_ASYNC_PF
	select KVM_ASYNC_PF_SYNC
	select KVM_COMMON
	select HAVE_KVM_IRQCHIP
	select HAVE_KVM_IRQ_ROUTING
	select KVM_VFIO
	select VIRT_XFER_TO_GUEST_WORK
	select KVM_MMU_LOCKLESS_AGING
	select KVM_GENERIC_PRE_FAULT_MEMORY
	help
	  Enable support for hosting virtualized, hardware-accelerated
	  virtual machines via two modules: kvm and kvm_arm64.

	  The kvm module provides access to host hardware-accelerated s390
	  guests using the Start Interpretive Execution (SIE) instruction via a
	  character device node named /dev/kvm. This requires a 64-bit machine
	  (hardware model).

	  The kvm_arm64 module provides access to host hardware-accelerated
	  arm64 guests using the Start ARM Execution (SAE) instruction via a
	  character device node named /dev/kvm_arm64. This requires hardware
	  models that support the Arm execution facility (AEF).

	  To compile this driver as a module, choose M here. The module will be
	  called kvm for the SIE acceleration and kvm_arm64 for the SAE
	  acceleration.

	  If unsure, say N.

config KVM_S390_UCONTROL
	bool "Userspace controlled virtual machines"
	depends on KVM
	help
	  Allow CAP_SYS_ADMIN users to create KVM virtual machines that are
	  controlled by userspace.

	  If unsure, say N.

endif # VIRTUALIZATION
```

## drivers/acpi/loongarch/Kconfig
```kconfig
# SPDX-License-Identifier: GPL-2.0-only
#
# ACPI Configuration for LOONGARCH
#

config ACPI_IOVT
	bool
```

## drivers/android/Kconfig
```kconfig
# SPDX-License-Identifier: GPL-2.0
menu "Android"

config ANDROID_BINDER_IPC_RUST
	bool "Android Binder IPC Driver"
	depends on MMU
	depends on NET
	depends on RUST
	default n
	help
	  Binder is used in Android for both communication between processes,
	  and remote method invocation.

	  This means one Android process can call a method/routine in another
	  Android process, using Binder to identify, invoke and pass arguments
	  between said processes.

config ANDROID_BINDER_DEVICES
	string "Android Binder devices"
	depends on ANDROID_BINDER_IPC_RUST
	default "binder,hwbinder,vndbinder"
	help
	  Default value for the binder.devices parameter.

	  The binder.devices parameter is a comma-separated list of strings
	  that specifies the names of the binder device nodes that will be
	  created. Each binder device has its own context manager, and is
	  therefore logically separated from the other devices.

endmenu
```

## drivers/bus/mhi/ep/clients/Kconfig
```kconfig
# SPDX-License-Identifier: GPL-2.0

config MHI_BUS_EP_LOOPBACK
	tristate "MHI Endpoint LOOPBACK client driver"
	depends on MHI_BUS_EP
	help
	  MHI Endpoint LOOPBACK client driver that binds to the MHI LOOPBACK
	  channel as defined in the MHI specification. The LOOPBACK channel is
	  implemented by MHI-based endpoint devices (modems, WLAN) in the field,
	  where the endpoint firmware echoes back whatever the host sends.

	  This driver receives data on the uplink channel and echoes it back on
	  the downlink channel for testing the MHI endpoint data path.

	  To compile this driver as a module, choose M here. The module
	  will be called mhi_ep_loopback.
```

## drivers/bus/mhi/host/clients/Kconfig
```kconfig
# SPDX-License-Identifier: GPL-2.0

config MHI_BUS_LOOPBACK
	tristate "MHI LOOPBACK client driver"
	depends on MHI_BUS
	help
	  MHI LOOPBACK client driver that binds to the MHI LOOPBACK channel
	  as defined in the MHI specification. The LOOPBACK channel is
	  implemented by MHI-based devices (e.g. modems, WLAN) in the field,
	  where the endpoint firmware echoes back whatever the host sends.

	  This driver exposes a sysfs interface for testing MHI data path
	  integrity between host and endpoint. Users can configure the TRE
	  size and count, and trigger a loopback test.

	  To compile this driver as a module, choose M here. The module
	  will be called mhi_loopback.
```

## drivers/clk/anlogic/Kconfig
```kconfig
# SPDX-License-Identifier: GPL-2.0-only

config ANLOGIC_DR1_CRU
	tristate "Clock support for Anlogic DR1 series SoCs"
	depends on ARCH_ANLOGIC || COMPILE_TEST
	select AUXILIARY_BUS
	default ARCH_ANLOGIC
	help
	  Say Y to enable clock controller unit support for Anlogic DR1 series
	  SoCs.

if ANLOGIC_DR1_CRU

config ANLOGIC_DR1V90_CRU
	tristate "Anlogic DR1V90 clock support"
	depends on ARCH_ANLOGIC || COMPILE_TEST
	default ARCH_ANLOGIC
	help
	  Support for the Clock and Reset Unit in Anlogic DR1V90 SoCs.

endif
```

## drivers/clk/cix/Kconfig
```kconfig
# SPDX-License-Identifier: GPL-2.0
# Audio subsystem clock support for Cixtech SoC family
menu "Cixtech Audio Subsystem Clock Driver"

config CLK_SKY1_AUDSS
	tristate "Cixtech Sky1 Audio Subsystem Clock Driver"
	depends on ARCH_CIX || COMPILE_TEST
	select AUXILIARY_BUS
	select REGMAP_MMIO
	select RESET_CONTROLLER
	help
	  Support for the Audio Subsystem clock controller present on
	  Cixtech Sky1 SoC. This driver provides mux, divider and gate
	  clocks for DSP, I2S, HDA and related blocks in the audio
	  subsystem. Say M or Y here if you want to build this driver.
endmenu
```

## drivers/clk/davinci/Kconfig
```kconfig
# SPDX-License-Identifier: GPL-2.0-only
config COMMON_CLK_DAVINCI
	bool "Clock drivers for TI DaVinci SoCs"
	depends on ARCH_DAVINCI || COMPILE_TEST
	depends on HAS_IOMEM
	select REGMAP_MMIO
	select RESET_CONTROLLER
	default ARCH_DAVINCI
	help
	  Support for the clock controllers found on TI DaVinci SoCs.
```

## drivers/clk/eswin/Kconfig
```kconfig
# SPDX-License-Identifier: GPL-2.0

config COMMON_CLK_ESWIN
	bool

config COMMON_CLK_EIC7700
	tristate "EIC7700 Clock Driver"
	depends on ARCH_ESWIN || COMPILE_TEST
	select COMMON_CLK_ESWIN
	default ARCH_ESWIN
	help
	  This driver provides support for clock controller on ESWIN EIC7700
	  SoC. The clock controller generates and supplies clocks to various
	  peripherals within the SoC.
	  Say yes here to support the clock controller on the EIC7700 SoC.

config COMMON_CLK_EIC7700_HSP
	tristate "EIC7700 HSP Clock Driver"
	depends on ARCH_ESWIN || COMPILE_TEST
	select AUXILIARY_BUS
	select COMMON_CLK_EIC7700
	select RESET_EIC7700_HSP if RESET_CONTROLLER
	select REGMAP_MMIO
	help
	  This driver provides support for clock controller on ESWIN EIC7700
	  HSP. The clock controller generates and supplies clocks to high
	  speed peripherals within the SoC.
	  Say yes here to support the clock controller on the EIC7700 HSP.
```

## drivers/clk/mmp/Kconfig
```kconfig
# SPDX-License-Identifier: GPL-2.0-only

config COMMON_CLK_MMP
	bool
	default ARCH_MMP

config COMMON_CLK_PXA1908
	bool "Clock driver for Marvell PXA1908"
	depends on ARCH_MMP || COMPILE_TEST
	depends on OF
	default y if ARCH_MMP && ARM64
	select COMMON_CLK_MMP
	select AUXILIARY_BUS
	help
	  This driver supports the Marvell PXA1908 SoC clocks.
```

## drivers/clk/ultrarisc/Kconfig
```kconfig
# SPDX-License-Identifier: GPL-2.0-only

config CLK_ULTRARISC
	tristate
	depends on OF
	depends on ARCH_ULTRARISC || COMPILE_TEST

config CLK_ULTRARISC_DP1000
	tristate "UltraRISC DP1000 clock controller"
	select CLK_ULTRARISC
	depends on OF && HAS_IOMEM
	depends on ARCH_ULTRARISC || COMPILE_TEST
	default ARCH_ULTRARISC
	help
	  This driver provides the clock controller for the UltraRISC
	  DP1000 SoC. It exposes the PLL output, derived fixed-factor
	  clocks, programmable divider clocks, and peripheral gate
	  clocks to Linux consumers.
```
