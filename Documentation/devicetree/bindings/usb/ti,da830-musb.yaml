## Documentation/devicetree/bindings/usb/ti,da830-musb.yaml
```yaml
# SPDX-License-Identifier: (GPL-2.0-only OR BSD-2-Clause)
%YAML 1.2
---
$id: http://devicetree.org/schemas/usb/ti,da830-musb.yaml#
$schema: http://devicetree.org/meta-schemas/core.yaml#

title: TI DA8xx MUSB

maintainers:
  - Bin Liu <b-liu@ti.com>

allOf:
  - $ref: /schemas/usb/usb-drd.yaml#

properties:
  compatible:
    const: ti,da830-musb

  reg:
    maxItems: 1

  interrupts:
    maxItems: 1

  interrupt-names:
    const: mc

  phys:
    maxItems: 1

  phy-names:
    const: usb-phy

  dmas:
    minItems: 1
    maxItems: 8

  dma-names:
    minItems: 1
    maxItems: 8
    items:
      pattern: "^(rx|tx)[1-4]$"

  vbus-supply:
    description: Phandle to a regulator providing the USB bus power.

  clocks:
    maxItems: 1

  clock-ranges: true

  ranges: true

  "#address-cells":
    const: 1

  "#size-cells":
    const: 1

patternProperties:
  "^dma-controller@[0-9a-f]+$":
    $ref: /schemas/dma/ti/ti,cppi41.yaml#

required:
  - compatible
  - reg
  - interrupts
  - interrupt-names
  - phys
  - phy-names
  - ranges
  - "#address-cells"
  - "#size-cells"

unevaluatedProperties: false

examples:
  - |
    usb@200000 {
        compatible = "ti,da830-musb";
        reg = <0x00200000 0x1000>;
        ranges;
        #address-cells = <1>;
        #size-cells = <1>;
        interrupts = <58>;
        interrupt-names = "mc";

        dr_mode = "host";
        vbus-supply = <&usb_vbus>;
        phys = <&usb_phy 0>;
        phy-names = "usb-phy";

        clocks = <&psc1 1>;
        clock-ranges;

        dmas = <&cppi41dma 0 0>, <&cppi41dma 1 0>,
               <&cppi41dma 2 0>, <&cppi41dma 3 0>,
               <&cppi41dma 0 1>, <&cppi41dma 1 1>,
               <&cppi41dma 2 1>, <&cppi41dma 3 1>;
        dma-names = "rx1", "rx2", "rx3", "rx4",
                    "tx1", "tx2", "tx3", "tx4";

        dma-controller@201000 {
            compatible = "ti,da830-cppi41";
            reg = <0x201000 0x1000>,
                  <0x202000 0x1000>,
                  <0x204000 0x4000>;
            reg-names = "controller", "scheduler", "queuemgr";
            interrupts = <58>;
            #dma-cells = <2>;
            dma-channels = <4>;
        };
    };
```

## Documentation/devicetree/bindings/usb/ti,da830-ohci.yaml
```yaml
# SPDX-License-Identifier: (GPL-2.0-only OR BSD-2-Clause)
%YAML 1.2
---
$id: http://devicetree.org/schemas/usb/ti,da830-ohci.yaml#
$schema: http://devicetree.org/meta-schemas/core.yaml#

title: DA8XX USB OHCI controller

maintainers:
  - Axel Haslam <ahaslam@baylibre.com>

allOf:
  - $ref: usb-hcd.yaml#

properties:
  compatible:
    const: ti,da830-ohci

  reg:
    maxItems: 1

  interrupts:
    maxItems: 1

  phys:
    maxItems: 1

  clocks:
    maxItems: 1

  phy-names:
    const: usb-phy

  vbus-supply:
    description:
      phandle of regulator that controls vbus power / over-current

  oc-gpios:
    maxItems: 1

required:
  - compatible
  - reg
  - interrupts
  - phys
  - phy-names
  - clocks

unevaluatedProperties: false

examples:
  - |
    usb@225000 {
        compatible = "ti,da830-ohci";
        reg = <0x225000 0x1000>;
        interrupts = <59>;
        phys = <&usb_phy 1>;
        phy-names = "usb-phy";
        clocks = <&psc1 2>;
        vbus-supply = <&reg_usb_ohci>;
    };
```

## Documentation/devicetree/bindings/usb/ti,hd3ss3220.yaml
```yaml
# SPDX-License-Identifier: (GPL-2.0 OR BSD-2-Clause)
%YAML 1.2
---
$id: http://devicetree.org/schemas/usb/ti,hd3ss3220.yaml#
$schema: http://devicetree.org/meta-schemas/core.yaml#

title: TI HD3SS3220 TypeC DRP Port Controller

maintainers:
  - Biju Das <biju.das.jz@bp.renesas.com>

description: |-
  HD3SS3220 is a USB SuperSpeed (SS) 2:1 mux with DRP port controller. The device provides Channel
  Configuration (CC) logic and 5V VCONN sourcing for ecosystems implementing USB Type-C. The
  HD3SS3220 can be configured as a Downstream Facing Port (DFP), Upstream Facing Port (UFP) or a
  Dual Role Port (DRP) making it ideal for any application.

properties:
  compatible:
    const: ti,hd3ss3220

  reg:
    maxItems: 1

  interrupts:
    maxItems: 1

  vcc33-supply:
    description: 3.3V supply (VCC33 pin), powering the SuperSpeed 2:1 MUX.

  vdd5-supply:
    description:
      5V supply (VDD5 pin), powering the CC controller and sourcing VCONN.
      VDD5 has to be stable for at least tVDD5V_PG (2ms) before VCC33 starts
      ramping up, unless ENn_CC is held high while both rails ramp up.

  id-gpios:
    description:
      An input gpio for USB ID pin. Upon detecting a UFP device, HD3SS3220
      will keep ID pin high if VBUS is not at VSafe0V. Once VBUS is at VSafe0V,
      the HD3SS3220 will assert ID pin low. This is done to enforce Type-C
      requirement that VBUS must be at VSafe0V before re-enabling VBUS.
    maxItems: 1

  ports:
    $ref: /schemas/graph.yaml#/properties/ports
    description: OF graph bindings (specified in bindings/graph.txt) that model
      SS data bus to the SS capable connector.

    properties:
      port@0:
        $ref: /schemas/graph.yaml#/properties/port
        description: Super Speed (SS) MUX inputs connected to SS capable connector.

      port@1:
        $ref: /schemas/graph.yaml#/properties/port
        description: Output of 2:1 MUX connected to Super Speed (SS) data bus.

    required:
      - port@0
      - port@1

required:
  - compatible
  - reg

additionalProperties: false

examples:
  - |
    i2c {
        #address-cells = <1>;
        #size-cells = <0>;

        hd3ss3220@47 {
            compatible = "ti,hd3ss3220";
            reg = <0x47>;
            interrupt-parent = <&gpio6>;
            interrupts = <3>;
            vcc33-supply = <&vcc3v3_control>;
            vdd5-supply = <&vcc5v0_device_s0>;

            ports {
                #address-cells = <1>;
                #size-cells = <0>;
                port@0 {
                    reg = <0>;
                    hd3ss3220_in_ep: endpoint {
                        remote-endpoint = <&ss_ep>;
                    };
                };
                port@1 {
                    reg = <1>;
                    hd3ss3220_out_ep: endpoint {
                        remote-endpoint = <&usb3_role_switch>;
                    };
                };
            };
        };
    };
```

## Documentation/devicetree/bindings/usb/ti,musb-am33xx.yaml
```yaml
# SPDX-License-Identifier: (GPL-2.0-only OR BSD-2-Clause)
%YAML 1.2
---
$id: http://devicetree.org/schemas/usb/ti,musb-am33xx.yaml#
$schema: http://devicetree.org/meta-schemas/core.yaml#

title: TI AM33xx/DM816 MUSB

maintainers:
  - Ravi B <ravibabu@ti.com>
  - Ajay Kumar Gupta <ajay.gupta@ti.com>

allOf:
  - $ref: /schemas/usb/usb-drd.yaml#

properties:
  compatible:
    enum:
      - ti,musb-am33xx
      - ti,musb-dm816

  reg:
    maxItems: 2

  reg-names:
    items:
      - const: mc
      - const: control

  interrupts:
    minItems: 1
    maxItems: 2

  interrupt-names:
    minItems: 1
    items:
      - const: mc
      - const: vbus

  mentor,multipoint:
    $ref: /schemas/types.yaml#/definitions/uint32
    description: Indicates the musb controller supports multipoint.
    enum: [0, 1]

  mentor,num-eps:
    $ref: /schemas/types.yaml#/definitions/uint32
    description: Specifies the number of endpoints.
    const: 16

  mentor,ram-bits:
    description: Specifies the ram address size.
    const: 12

  mentor,power:
    $ref: /schemas/types.yaml#/definitions/uint32
    description: Controller supply capacity (in mA) when operating in host mode.
    const: 500

  phys:
    maxItems: 1

  dmas:
    minItems: 1
    maxItems: 30

  dma-names:
    minItems: 1
    maxItems: 30
    items:
      pattern: "^(rx|tx)([1-9]|1[0-5])$"

  phy-names:
    const: usb2-phy

  interface-type:
    $ref: /schemas/types.yaml#/definitions/uint32
    description: Describes the type of interface between the controller and the PHY.
    enum: [ 0, 1 ]

required:
  - compatible
  - reg
  - reg-names
  - interrupts
  - interrupt-names
  - dr_mode
  - mentor,multipoint
  - mentor,num-eps
  - mentor,ram-bits
  - mentor,power
  - phys

unevaluatedProperties: false

examples:
  - |
    usb@47401000 {
        compatible = "ti,musb-am33xx";
        reg = <0x47401400 0x400>,
              <0x47401000 0x200>;
        reg-names = "mc", "control";
        interrupts = <18>;
        interrupt-names = "mc";
        dr_mode = "otg";
        mentor,multipoint = <1>;
        mentor,num-eps = <16>;
        mentor,ram-bits = <12>;
        mentor,power = <500>;
        phys = <&usb0_phy>;
        dmas = <&cppi41dma 0 0 &cppi41dma 1 0>;
        dma-names = "rx1", "tx1";
    };
```

## Documentation/devicetree/bindings/watchdog/nuvoton,ma35d1-wdt.yaml
```yaml
# SPDX-License-Identifier: (GPL-2.0-only OR BSD-2-Clause)
%YAML 1.2
---
$id: http://devicetree.org/schemas/watchdog/nuvoton,ma35d1-wdt.yaml#
$schema: http://devicetree.org/meta-schemas/core.yaml#

title: Nuvoton MA35D1 Watchdog Timer

maintainers:
  - Zi-Yu Chen <zychennvt@gmail.com>

allOf:
  - $ref: watchdog.yaml#

properties:
  compatible:
    enum:
      - nuvoton,ma35d1-wdt

  reg:
    maxItems: 1

  interrupts:
    maxItems: 1

  clocks:
    maxItems: 1

  wakeup-source: true

required:
  - compatible
  - reg
  - interrupts
  - clocks

unevaluatedProperties: false

examples:
  - |
    #include <dt-bindings/interrupt-controller/arm-gic.h>
    #include <dt-bindings/interrupt-controller/irq.h>
    #include <dt-bindings/clock/nuvoton,ma35d1-clk.h>

    soc {
        #address-cells = <2>;
        #size-cells = <2>;
        wdt1: watchdog@40440000 {
          compatible = "nuvoton,ma35d1-wdt";
          reg = <0x0 0x40440000 0x0 0x100>;
          interrupts = <GIC_SPI 43 IRQ_TYPE_LEVEL_HIGH>;
          clocks = <&clk WDT1_GATE>;
        };
    };
...
```
