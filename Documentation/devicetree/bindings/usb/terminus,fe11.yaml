## Documentation/devicetree/bindings/usb/terminus,fe11.yaml
```yaml
# SPDX-License-Identifier: GPL-2.0-only OR BSD-2-Clause
%YAML 1.2
---
$id: http://devicetree.org/schemas/usb/terminus,fe11.yaml#
$schema: http://devicetree.org/meta-schemas/core.yaml#

title: Terminus FE1.1/1.1S USB 2.0 Hub Controller

maintainers:
  - Yixun Lan <dlan@kernel.org>

allOf:
  - $ref: usb-hub.yaml#

properties:
  compatible:
    enum:
      - usb1a40,0101

  reg: true

  reset-gpios:
    description:
      GPIO controlling the RESET#.

  vdd-supply:
    description:
      Regulator supply to the hub, one of 3.3V or 5V can be chosen.

  ports:
    $ref: /schemas/graph.yaml#/properties/ports

    patternProperties:
      '^port@':
        $ref: /schemas/graph.yaml#/properties/port

        properties:
          reg:
            minimum: 1
            maximum: 4

required:
  - compatible
  - reg
  - vdd-supply

unevaluatedProperties: false

examples:
  - |
    #include <dt-bindings/gpio/gpio.h>
    usb {
        #address-cells = <1>;
        #size-cells = <0>;

        hub@1 {
            compatible = "usb1a40,0101";
            reg = <1>;
            reset-gpios = <&gpio0 1 GPIO_ACTIVE_LOW>;
            vdd-supply = <&vcc_5v>;
        };
    };
```

## Documentation/devicetree/bindings/usb/ti,am62-usb.yaml
```yaml
# SPDX-License-Identifier: GPL-2.0-only OR BSD-2-Clause
%YAML 1.2
---
$id: http://devicetree.org/schemas/usb/ti,am62-usb.yaml#
$schema: http://devicetree.org/meta-schemas/core.yaml#

title: TI's AM62 wrapper module for the Synopsys USBSS-DRD controller

maintainers:
  - Aswath Govindraju <a-govindraju@ti.com>

properties:
  compatible:
    const: ti,am62-usb

  reg:
    minItems: 1
    items:
      - description: USB CFG register space
      - description: USB PHY2 register space

  ranges: true

  power-domains:
    description:
      PM domain provider node and an args specifier containing
      the USB ISO device id value. See,
      Documentation/devicetree/bindings/soc/ti/sci-pm-domain.yaml
    maxItems: 1

  clocks:
    description: Clock phandle to usb2_refclk
    maxItems: 1

  clock-names:
    items:
      - const: ref

  ti,vbus-divider:
    description:
      Should be present if USB VBUS line is connected to the
      VBUS pin of the SoC via a 1/3 voltage divider.
    type: boolean

  ti,syscon-phy-pll-refclk:
    $ref: /schemas/types.yaml#/definitions/phandle-array
    items:
      - items:
          - description: Phandle to the SYSCON entry
          - description: USB phy control register offset within SYSCON
    description:
      Specifier for conveying frequency of ref clock input, for the
      operation of USB2PHY.

  '#address-cells':
    const: 2

  '#size-cells':
    const: 2

patternProperties:
  "^usb@[0-9a-f]+$":
    $ref: snps,dwc3.yaml#
    description: Required child node

required:
  - compatible
  - reg
  - power-domains
  - clocks
  - clock-names
  - ti,syscon-phy-pll-refclk

additionalProperties: false

examples:
  - |
    #include <dt-bindings/soc/ti,sci_pm_domain.h>
    #include <dt-bindings/interrupt-controller/arm-gic.h>
    #include <dt-bindings/gpio/gpio.h>

    bus {
      #address-cells = <2>;
      #size-cells = <2>;

      usbss1: usb@f910000 {
        compatible = "ti,am62-usb";
        reg = <0x00 0x0f910000 0x00 0x800>,
              <0x00 0x0f918000 0x00 0x400>;
        clocks = <&k3_clks 162 3>;
        clock-names = "ref";
        ti,syscon-phy-pll-refclk = <&wkup_conf 0x4018>;
        power-domains = <&k3_pds 179 TI_SCI_PD_EXCLUSIVE>;
        #address-cells = <2>;
        #size-cells = <2>;

        usb@31100000 {
          compatible = "snps,dwc3";
          reg = <0x00 0x31100000 0x00 0x50000>;
          interrupts = <GIC_SPI 226 IRQ_TYPE_LEVEL_HIGH>, /* irq.0 */
                       <GIC_SPI 226 IRQ_TYPE_LEVEL_HIGH>; /* irq.0 */
          interrupt-names = "host", "peripheral";
          maximum-speed = "high-speed";
          dr_mode = "otg";
        };
      };
    };
```

## Documentation/devicetree/bindings/usb/ti,dwc3.yaml
```yaml
# SPDX-License-Identifier: (GPL-2.0-only OR BSD-2-Clause)
%YAML 1.2
---
$id: http://devicetree.org/schemas/usb/ti,dwc3.yaml#
$schema: http://devicetree.org/meta-schemas/core.yaml#

title: Texas Instruments OMAP DWC3 USB Glue Layer

maintainers:
  - Felipe Balbi <balbi@ti.com>

description:
  Texas Instruments glue layer for Synopsys DesignWare USB3 (DWC3)
  controller on OMAP and AM43xx SoCs. Manages SoC-specific integration
  including register mapping, interrupt routing, UTMI/PIPE interface mode
  selection (HW/SW), and child DWC3 core instantiation via address space
  translation. Supports both legacy single-instance and multi-instance
  (numbered) configurations.

properties:
  compatible:
    enum:
      - ti,dwc3
      - ti,am437x-dwc3

  reg:
    maxItems: 1

  interrupts:
    maxItems: 1

  utmi-mode:
    $ref: /schemas/types.yaml#/definitions/uint32
    description:
      Controls the source of UTMI/PIPE status for VBUS and OTG ID.
      1 for HW mode, 2 for SW mode.
    enum: [1, 2]

  "#address-cells":
    const: 1

  "#size-cells":
    const: 1

  ranges: true

  extcon:
    $ref: /schemas/types.yaml#/definitions/phandle
    description:
      Phandle for the extcon device used to detect connect/
      disconnect events.

  vbus-supply:
    description: Phandle to the regulator device tree node if needed.

patternProperties:
  "^usb@[0-9a-f]+$":
    type: object
    $ref: snps,dwc3.yaml#
    unevaluatedProperties: false

required:
  - reg
  - compatible
  - interrupts
  - "#address-cells"
  - "#size-cells"
  - utmi-mode
  - ranges

unevaluatedProperties: false

examples:
  - |
    #include <dt-bindings/interrupt-controller/arm-gic.h>
    omap_dwc3_1@0 {
        compatible = "ti,dwc3";
        reg = <0x0 0x10000>;
        interrupts = <GIC_SPI 72 IRQ_TYPE_LEVEL_HIGH>;
        #address-cells = <1>;
        #size-cells = <1>;
        utmi-mode = <2>;
        ranges = <0 0 0x20000>;

        usb@10000 {
            compatible = "snps,dwc3";
            reg = <0x10000 0x17000>;
            interrupts = <GIC_SPI 71 IRQ_TYPE_LEVEL_HIGH>,
                         <GIC_SPI 71 IRQ_TYPE_LEVEL_HIGH>,
                         <GIC_SPI 72 IRQ_TYPE_LEVEL_HIGH>;
            interrupt-names = "peripheral", "host", "otg";
            phys = <&usb2_phy1>, <&usb3_phy1>;
            phy-names = "usb2-phy", "usb3-phy";
            maximum-speed = "super-speed";
            dr_mode = "otg";
            snps,dis_u3_susphy_quirk;
            snps,dis_u2_susphy_quirk;
        };
    };
...
```

## Documentation/devicetree/bindings/usb/ti,hd3ss3220.txt
```
TI HD3SS3220 TypeC DRP Port Controller.

Required properties:
 - compatible: Must be "ti,hd3ss3220".
 - reg: I2C slave address, must be 0x47 or 0x67 based on ADDR pin.
 - interrupts: An interrupt specifier.

Required sub-node:
 - connector: The "usb-c-connector" attached to the hd3ss3220 chip. The
   bindings of the connector node are specified in:

	Documentation/devicetree/bindings/connector/usb-connector.yaml

Example:
hd3ss3220@47 {
	compatible = "ti,hd3ss3220";
	reg = <0x47>;
	interrupt-parent = <&gpio6>;
	interrupts = <3 IRQ_TYPE_LEVEL_LOW>;

	connector {
		compatible = "usb-c-connector";
		label = "USB-C";
		data-role = "dual";

		ports {
			#address-cells = <1>;
			#size-cells = <0>;

			port@1 {
				reg = <1>;
				hd3ss3220_ep: endpoint {
					remote-endpoint = <&usb3_role_switch>;
				};
			};
		};
	};
};
```

## Documentation/devicetree/bindings/usb/ti,j721e-usb.yaml
```yaml
# SPDX-License-Identifier: GPL-2.0
%YAML 1.2
---
$id: "http://devicetree.org/schemas/usb/ti,j721e-usb.yaml#"
$schema: "http://devicetree.org/meta-schemas/core.yaml#"

title: Bindings for the TI wrapper module for the Cadence USBSS-DRD controller

maintainers:
  - Roger Quadros <rogerq@ti.com>

properties:
  compatible:
    oneOf:
      - const: ti,j721e-usb
      - const: ti,am64-usb
      - items:
          - const: ti,j721e-usb
          - const: ti,am64-usb

  reg:
    maxItems: 1

  ranges: true

  power-domains:
    description:
      PM domain provider node and an args specifier containing
      the USB device id value. See,
      Documentation/devicetree/bindings/soc/ti/sci-pm-domain.txt
    maxItems: 1

  clocks:
    description: Clock phandles to usb2_refclk and lpm_clk
    minItems: 2
    maxItems: 2

  clock-names:
    items:
      - const: ref
      - const: lpm

  ti,usb2-only:
    description:
      If present, it restricts the controller to USB2.0 mode of
      operation. Must be present if USB3 PHY is not available
      for USB.
    type: boolean

  ti,vbus-divider:
    description:
      Should be present if USB VBUS line is connected to the
      VBUS pin of the SoC via a 1/3 voltage divider.
    type: boolean

  assigned-clocks:
    maxItems: 1

  assigned-clock-parents:
    maxItems: 1

  '#address-cells':
    const: 2

  '#size-cells':
    const: 2

  dma-coherent: true

patternProperties:
  "^usb@":
    type: object

required:
  - compatible
  - reg
  - power-domains
  - clocks
  - clock-names

additionalProperties: false

examples:
  - |
    #include <dt-bindings/soc/ti,sci_pm_domain.h>
    #include <dt-bindings/interrupt-controller/arm-gic.h>

    bus {
        #address-cells = <2>;
        #size-cells = <2>;

        cdns_usb@4104000 {
            compatible = "ti,j721e-usb";
            reg = <0x00 0x4104000 0x00 0x100>;
            power-domains = <&k3_pds 288 TI_SCI_PD_EXCLUSIVE>;
            clocks = <&k3_clks 288 15>, <&k3_clks 288 3>;
            clock-names = "ref", "lpm";
            assigned-clocks = <&k3_clks 288 15>;	/* USB2_REFCLK */
            assigned-clock-parents = <&k3_clks 288 16>; /* HFOSC0 */
            #address-cells = <2>;
            #size-cells = <2>;

            usb@6000000 {
                  compatible = "cdns,usb3";
                  reg = <0x00 0x6000000 0x00 0x10000>,
                        <0x00 0x6010000 0x00 0x10000>,
                        <0x00 0x6020000 0x00 0x10000>;
                  reg-names = "otg", "xhci", "dev";
                  interrupts = <GIC_SPI 96 IRQ_TYPE_LEVEL_HIGH>,	/* irq.0 */
                               <GIC_SPI 102 IRQ_TYPE_LEVEL_HIGH>,	/* irq.6 */
                               <GIC_SPI 120 IRQ_TYPE_LEVEL_HIGH>;	/* otgirq.0 */
                  interrupt-names = "host",
                                    "peripheral",
                                    "otg";
                  maximum-speed = "super-speed";
                  dr_mode = "otg";
            };
        };
    };
```

## Documentation/devicetree/bindings/usb/ti,keystone-dwc3.yaml
```yaml
# SPDX-License-Identifier: (GPL-2.0-only OR BSD-2-Clause)
%YAML 1.2
---
$id: http://devicetree.org/schemas/usb/ti,keystone-dwc3.yaml#
$schema: http://devicetree.org/meta-schemas/core.yaml#

title: TI Keystone Soc USB Controller

maintainers:
  - Roger Quadros <rogerq@ti.com>

properties:
  compatible:
    items:
      - enum:
          - ti,keystone-dwc3
          - ti,am654-dwc3

  reg:
    maxItems: 1

  '#address-cells':
    const: 1

  '#size-cells':
    const: 1

  ranges: true

  interrupts:
    maxItems: 1

  clocks:
    minItems: 1
    maxItems: 2

  assigned-clocks:
    minItems: 1
    maxItems: 2

  assigned-clock-parents:
    minItems: 1
    maxItems: 2

  power-domains:
    maxItems: 1
    description: Should contain a phandle to a PM domain provider node
      and an args specifier containing the USB device id
      value. This property is as per the binding,
      Documentation/devicetree/bindings/soc/ti/sci-pm-domain.txt

  phys:
    maxItems: 1
    description:
      PHY specifier for the USB3.0 PHY. Some SoCs need the USB3.0 PHY
      to be turned on before the controller.
      Documentation/devicetree/bindings/phy/phy-bindings.txt

  phy-names:
    items:
      - const: usb3-phy

  dma-coherent: true

  dma-ranges: true

patternProperties:
  "usb@[a-f0-9]+$":
    $ref: snps,dwc3.yaml#

required:
  - compatible
  - reg
  - "#address-cells"
  - "#size-cells"
  - ranges
  - interrupts

additionalProperties: false

examples:
  - |
    #include <dt-bindings/interrupt-controller/arm-gic.h>

    dwc3@2680000 {
      compatible = "ti,keystone-dwc3";
      #address-cells = <1>;
      #size-cells = <1>;
      reg = <0x2680000 0x10000>;
      clocks = <&clkusb>;
      interrupts = <GIC_SPI 393 IRQ_TYPE_EDGE_RISING>;
      ranges;

      usb@2690000 {
        compatible = "synopsys,dwc3";
        reg = <0x2690000 0x70000>;
        interrupts = <GIC_SPI 393 IRQ_TYPE_EDGE_RISING>;
        usb-phy = <&usb_phy>, <&usb_phy>;
      };
    };
```

## Documentation/devicetree/bindings/usb/ti,omap4-musb.yaml
```yaml
# SPDX-License-Identifier: (GPL-2.0-only OR BSD-2-Clause)
%YAML 1.2
---
$id: http://devicetree.org/schemas/usb/ti,omap4-musb.yaml#
$schema: http://devicetree.org/meta-schemas/core.yaml#

title: Texas Instruments OMAP MUSB USB OTG Controller

maintainers:
  - Felipe Balbi <balbi@ti.com>

description:
  Texas Instruments glue layer for the Mentor Graphics MUSB OTG controller.
  Handles SoC-specific integration including PHY interface bridging(ULPI/
  UTMI), interrupt aggregation, DMA engine coordination (internal/
  external), VBUS/session control via control module mailbox, and
  clock/reset management. Provides fixed hardware configuration parameters
  to the generic MUSB core driver.

properties:
  compatible:
    enum:
      - ti,omap3-musb
      - ti,omap4-musb

  reg:
    maxItems: 1

  interrupts:
    minItems: 1
    maxItems: 2

  interrupt-names:
    minItems: 1
    items:
      - const: mc
      - const: dma

  multipoint:
    $ref: /schemas/types.yaml#/definitions/uint32
    description:
      Indicates the MUSB controller supports multipoint. This is a MUSB
      configuration-specific setting.
    const: 1

  num-eps:
    $ref: /schemas/types.yaml#/definitions/uint32
    description:
      Specifies the number of endpoints. This is a MUSB configuration
      specific setting.
    const: 16

  ram-bits:
    description: Specifies the RAM address size.
    const: 12

  interface-type:
    $ref: /schemas/types.yaml#/definitions/uint32
    description:
      Describes the type of interface between the controller and the PHY.
      0 for ULPI, 1 for UTMI.
    enum: [0, 1]

  mode:
    $ref: /schemas/types.yaml#/definitions/uint32
    description: 1 for HOST, 2 for PERIPHERAL, 3 for OTG.
    enum: [1, 2, 3]

  power:
    $ref: /schemas/types.yaml#/definitions/uint32
    description:
      Indicates the maximum current the controller can supply when
      operating in host mode. A value of 50 corresponds to 100 mA, and a
      value of 150 corresponds to 300 mA.
    enum: [50, 150]

  phys:
    maxItems: 1

  phy-names:
    const: usb2-phy

  usb-phy:
    $ref: /schemas/types.yaml#/definitions/phandle-array
    description: Phandle for the PHY device.
    deprecated: true

  ctrl-module:
    $ref: /schemas/types.yaml#/definitions/phandle
    description:
      Phandle of the control module this glue uses to write to mailbox.

required:
  - reg
  - compatible
  - interrupts
  - interrupt-names

unevaluatedProperties: false

examples:
  - |
    #include <dt-bindings/interrupt-controller/arm-gic.h>
    usb@4a0ab000 {
        compatible = "ti,omap4-musb";
        reg = <0x4a0ab000 0x1000>;
        interrupts = <GIC_SPI 92 IRQ_TYPE_LEVEL_HIGH>,
                     <GIC_SPI 93 IRQ_TYPE_LEVEL_HIGH>;
        interrupt-names = "mc", "dma";
        multipoint = <1>;
        num-eps = <16>;
        ram-bits = <12>;
        ctrl-module = <&omap_control_usb>;
        phys = <&usb2_phy>;
        phy-names = "usb2-phy";
        interface-type = <1>;
        mode = <3>;
        power = <50>;
    };
...
```
