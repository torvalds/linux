## Documentation/devicetree/bindings/usb/usb-device.txt
```
Generic USB Device Properties

Usually, we only use device tree for hard wired USB device.
The reference binding doc is from:
http://www.devicetree.org/open-firmware/bindings/usb/usb-1_0.ps

Four types of device-tree yesdes are defined: "host-controller yesdes"
representing USB host controllers, "device yesdes" representing USB devices,
"interface yesdes" representing USB interfaces and "combined yesdes"
representing simple USB devices.

A combined yesde shall be used instead of a device yesde and an interface yesde
for devices of class 0 or 9 (hub) with a single configuration and a single
interface.

A "hub yesde" is a combined yesde or an interface yesde that represents a USB
hub.


Required properties for device yesdes:
- compatible: "usbVID,PID", where VID is the vendor id and PID the product id.
  The textual representation of VID and PID shall be in lower case hexadecimal
  with leading zeroes suppressed. The other compatible strings from the above
  standard binding could also be used, but a device adhering to this binding
  may leave out all except for "usbVID,PID".
- reg: the number of the USB hub port or the USB host-controller port to which
  this device is attached. The range is 1-255.


Required properties for device yesdes with interface yesdes:
- #address-cells: shall be 2
- #size-cells: shall be 0


Required properties for interface yesdes:
- compatible: "usbifVID,PID.configCN.IN", where VID is the vendor id, PID is
  the product id, CN is the configuration value and IN is the interface
  number. The textual representation of VID, PID, CN and IN shall be in lower
  case hexadecimal with leading zeroes suppressed. The other compatible
  strings from the above standard binding could also be used, but a device
  adhering to this binding may leave out all except for
  "usbifVID,PID.configCN.IN".
- reg: the interface number and configuration value

The configuration component is yest included in the textual representation of
an interface-yesde unit address for configuration 1.


Required properties for combined yesdes:
- compatible: "usbVID,PID", where VID is the vendor id and PID the product id.
  The textual representation of VID and PID shall be in lower case hexadecimal
  with leading zeroes suppressed. The other compatible strings from the above
  standard binding could also be used, but a device adhering to this binding
  may leave out all except for "usbVID,PID".
- reg: the number of the USB hub port or the USB host-controller port to which
  this device is attached. The range is 1-255.


Required properties for hub yesdes with device yesdes:
- #address-cells: shall be 1
- #size-cells: shall be 0


Required properties for host-controller yesdes with device yesdes:
- #address-cells: shall be 1
- #size-cells: shall be 0


Example:

&usb1 {	/* host controller */
	#address-cells = <1>;
	#size-cells = <0>;

	hub@1 {		/* hub connected to port 1 */
		compatible = "usb5e3,608";
		reg = <1>;
	};

	device@2 {	/* device connected to port 2 */
		compatible = "usb123,4567";
		reg = <2>;
	};

	device@3 { 	/* device connected to port 3 */
		compatible = "usb123,abcd";
		reg = <3>;

		#address-cells = <2>;
		#size-cells = <0>;

		interface@0 {	/* interface 0 of configuration 1 */
			compatible = "usbif123,abcd.config1.0";
			reg = <0 1>;
		};

		interface@0,2 {	/* interface 0 of configuration 2 */
			compatible = "usbif123,abcd.config2.0";
			reg = <0 2>;
		};
	};
};
```

## Documentation/devicetree/bindings/usb/usb-device.yaml
```yaml
# SPDX-License-Identifier: (GPL-2.0-only OR BSD-2-Clause)
%YAML 1.2
---
$id: http://devicetree.org/schemas/usb/usb-device.yaml#
$schema: http://devicetree.org/meta-schemas/core.yaml#

title: Generic USB Device

maintainers:
  - Greg Kroah-Hartman <gregkh@linuxfoundation.org>

description: |
  Usually, we only use device tree for hard wired USB device.
  The reference binding doc is from:
  http://www.devicetree.org/open-firmware/bindings/usb/usb-1_0.ps

  Four types of device-tree analdes are defined: "host-controller analdes"
  representing USB host controllers, "device analdes" representing USB devices,
  "interface analdes" representing USB interfaces and "combined analdes"
  representing simple USB devices.

  A combined analde shall be used instead of a device analde and an interface analde
  for devices of class 0 or 9 (hub) with a single configuration and a single
  interface.

  A "hub analde" is a combined analde or an interface analde that represents a USB
  hub.

properties:
  compatible:
    pattern: "^usb[0-9a-f]{1,4},[0-9a-f]{1,4}$"
    description: Device analdes or combined analdes.
      "usbVID,PID", where VID is the vendor id and PID the product id.
      The textual representation of VID and PID shall be in lower case
      hexadecimal with leading zeroes suppressed. The other compatible
      strings from the above standard binding could also be used,
      but a device adhering to this binding may leave out all except
      for "usbVID,PID".

  reg:
    description: the number of the USB hub port or the USB host-controller
      port to which this device is attached. The range is 1-255.
    maxItems: 1

  "#address-cells":
    description: should be 1 for hub analdes with device analdes,
      should be 2 for device analdes with interface analdes.
    enum: [1, 2]

  "#size-cells":
    const: 0

patternProperties:
  "^interface@[0-9a-f]{1,2}(,[0-9a-f]{1,2})$":
    type: object
    description: USB interface analdes.
      The configuration component is analt included in the textual
      representation of an interface-analde unit address for configuration 1.

    properties:
      compatible:
        pattern: "^usbif[0-9a-f]{1,4},[0-9a-f]{1,4}.config[0-9a-f]{1,2}.[0-9a-f]{1,2}$"
        description: Interface analdes.
          "usbifVID,PID.configCN.IN", where VID is the vendor id, PID is
          the product id, CN is the configuration value and IN is the interface
          number. The textual representation of VID, PID, CN and IN shall be
          in lower case hexadecimal with leading zeroes suppressed.
          The other compatible strings from the above standard binding could
          also be used, but a device adhering to this binding may leave out
          all except for "usbifVID,PID.configCN.IN".

      reg:
        description: should be 2 cells long, the first cell represents
          the interface number and the second cell represents the
          configuration value.
        maxItems: 1

required:
  - reg

additionalProperties: true

examples:
  # hub connected to port 1
  # device connected to port 2
  # device connected to port 3
  #    interface 0 of configuration 1
  #    interface 0 of configuration 2
  - |
    usb@11270000 {
        reg = <0x11270000 0x1000>;
        interrupts = <0x0 0x4e 0x0>;
        #address-cells = <1>;
        #size-cells = <0>;

        hub@1 {
            compatible = "usb5e3,608";
            reg = <1>;
        };

        device@2 {
            compatible = "usb123,4567";
            reg = <2>;
        };

        device@3 {
            compatible = "usb123,abcd";
            reg = <3>;

            #address-cells = <2>;
            #size-cells = <0>;

            interface@0 {
                compatible = "usbif123,abcd.config1.0";
                reg = <0 1>;
            };

            interface@0,2 {
                compatible = "usbif123,abcd.config2.0";
                reg = <0 2>;
            };
        };
    };
```

## Documentation/devicetree/bindings/usb/usb-drd.yaml
```yaml
# SPDX-License-Identifier: GPL-2.0
%YAML 1.2
---
$id: http://devicetree.org/schemas/usb/usb-drd.yaml#
$schema: http://devicetree.org/meta-schemas/core.yaml#

title: Generic USB OTG Controller Device Tree Bindings

maintainers:
  - Greg Kroah-Hartman <gregkh@linuxfoundation.org>

properties:
  otg-rev:
    description:
      Tells usb driver the release number of the OTG and EH supplement with
      which the device and its descriptors are compliant, in binary-coded
      decimal (i.e. 2.0 is 0200H). This property is used if any real OTG
      features (HNP/SRP/ADP) is enabled. If ADP is required, otg-rev should be
      0x0200 or above.
    $ref: /schemas/types.yaml#/definitions/uint32
    enum: [0x0100, 0x0120, 0x0130, 0x0200]

  dr_mode:
    description:
      Tells Dual-Role USB controllers that we want to work on a particular
      mode. In case this attribute isn't passed via DT, USB DRD controllers
      should default to OTG.
    $ref: /schemas/types.yaml#/definitions/string
    enum: [host, peripheral, otg]

  hnp-disable:
    description:
      Tells OTG controllers we want to disable OTG HNP. Normally HNP is the
      basic function of real OTG except you want it to be a srp-capable only B
      device.
    type: boolean

  srp-disable:
    description:
      Tells OTG controllers we want to disable OTG SRP. SRP is optional for OTG
      device.
    type: boolean

  adp-disable:
    description:
      Tells OTG controllers we want to disable OTG ADP. ADP is optional for OTG
      device.
    type: boolean

  usb-role-switch:
    description:
      Indicates that the device is capable of assigning the USB data role
      (USB host or USB device) for a given USB connector, such as Type-C,
      Type-B(micro). See connector/usb-connector.yaml.

  role-switch-default-mode:
    description:
      Indicates if usb-role-switch is enabled, the device default operation
      mode of controller while usb role is USB_ROLE_NONE.
    $ref: /schemas/types.yaml#/definitions/string
    enum: [host, peripheral]
    default: peripheral

additionalProperties: true

examples:
  - |
    usb@4a030000 {
        compatible = "snps,dwc3";
        reg = <0x4a030000 0xcfff>;
        interrupts = <0 92 4>;
        usb-phy = <&usb2_phy>, <&usb3_phy>;
        maximum-speed = "super-speed";
        dr_mode = "otg";
        phy_type = "utmi_wide";
        otg-rev = <0x0200>;
        adp-disable;
    };
```

## Documentation/devicetree/bindings/usb/usb-ehci.txt
```
USB EHCI controllers

Required properties:
  - compatible : should be "generic-ehci".
  - reg : should contain at least address and length of the standard EHCI
    register set for the device. Optional platform-dependent registers
    (debug-port or other) can be also specified here, but only after
    definition of standard EHCI registers.
  - interrupts : one EHCI interrupt should be described here.

Optional properties:
 - big-endian-regs : boolean, set this for hcds with big-endian registers
 - big-endian-desc : boolean, set this for hcds with big-endian descriptors
 - big-endian : boolean, for hcds with big-endian-regs + big-endian-desc
 - needs-reset-on-resume : boolean, set this to force EHCI reset after resume
 - has-transaction-translator : boolean, set this if EHCI have a Transaction
				Translator built into the root hub.
 - clocks : a list of phandle + clock specifier pairs
 - phys : phandle + phy specifier pair
 - phy-names : "usb"
 - resets : phandle + reset specifier pair

Example (Sequoia 440EPx):
    ehci@e0000300 {
	   compatible = "ibm,usb-ehci-440epx", "usb-ehci";
	   interrupt-parent = <&UIC0>;
	   interrupts = <1a 4>;
	   reg = <0 e0000300 90 0 e0000390 70>;
	   big-endian;
   };

Example (Allwinner sun4i A10 SoC):
   ehci0: usb@01c14000 {
	   compatible = "allwinner,sun4i-a10-ehci", "generic-ehci";
	   reg = <0x01c14000 0x100>;
	   interrupts = <39>;
	   clocks = <&ahb_gates 1>;
	   phys = <&usbphy 1>;
	   phy-names = "usb";
   };
```

## Documentation/devicetree/bindings/usb/usb-hcd.txt
```
Generic USB HCD (Host Controller Device) Properties

Optional properties:
- phys: a list of all USB PHYs on this HCD

Example:
	&usb1 {
		phys = <&usb2_phy1>, <&usb3_phy1>;
	};
```

## Documentation/devicetree/bindings/usb/usb-hcd.yaml
```yaml
# SPDX-License-Identifier: GPL-2.0
%YAML 1.2
---
$id: http://devicetree.org/schemas/usb/usb-hcd.yaml#
$schema: http://devicetree.org/meta-schemas/core.yaml#

title: Generic USB Host Controller

maintainers:
  - Greg Kroah-Hartman <gregkh@linuxfoundation.org>

allOf:
  - $ref: usb.yaml#

properties:
  companion:
    description: Phandle of a companion device
    $ref: /schemas/types.yaml#/definitions/phandle

  tpl-support:
    description:
      Indicates if the Targeted Peripheral List is supported for given
      targeted hosts (non-PC hosts).
    type: boolean

  "#address-cells":
    const: 1

  "#size-cells":
    const: 0

patternProperties:
  "^.*@[0-9a-f]{1,2}$":
    description: The hard wired USB devices
    type: object
    $ref: /schemas/usb/usb-device.yaml

additionalProperties: true

examples:
  - |
    usb {
        phys = <&usb2_phy1>, <&usb3_phy1>;
        phy-names = "usb2", "usb3";
        #address-cells = <1>;
        #size-cells = <0>;

        hub@1 {
            compatible = "usb5e3,610";
            reg = <1>;
        };
    };
```

## Documentation/devicetree/bindings/usb/usb-hub.yaml
```yaml
# SPDX-License-Identifier: GPL-2.0-only OR BSD-2-Clause
%YAML 1.2
---
$id: http://devicetree.org/schemas/usb/usb-hub.yaml#
$schema: http://devicetree.org/meta-schemas/core.yaml#

title: Generic USB Hub

maintainers:
  - Pin-yen Lin <treapking@chromium.org>

allOf:
  - $ref: usb-device.yaml#

properties:
  '#address-cells':
    const: 1

  peer-hub:
    $ref: /schemas/types.yaml#/definitions/phandle
    description:
      phandle to the peer hub on the controller.

  ports:
    $ref: /schemas/graph.yaml#/properties/ports
    description:
      The downstream facing USB ports

    patternProperties:
      "^port@[1-9a-f][0-9a-f]*$":
        $ref: /schemas/graph.yaml#/properties/port

patternProperties:
  '^.*@[1-9a-f][0-9a-f]*$':
    description: The hard wired USB devices
    type: object
    $ref: /schemas/usb/usb-device.yaml
    additionalProperties: true

required:
  - compatible
  - reg

additionalProperties: true

examples:
  - |
    usb {
        #address-cells = <1>;
        #size-cells = <0>;

        /* 2.0 hub on port 1 */
        hub_2_0: hub@1 {
            compatible = "usb123,4567";
            reg = <1>;
            peer-hub = <&hub_3_0>;
            #address-cells = <1>;
            #size-cells = <0>;
            /* USB 2.0 device on port 5 */
            device@5 {
                reg = <5>;
                compatible = "usb765,4321";
            };
        };

        /* 3.0 hub on port 2 */
        hub_3_0: hub@2 {
            compatible = "usb123,abcd";
            reg = <2>;
            peer-hub = <&hub_2_0>;

            ports {
                #address-cells = <1>;
                #size-cells = <0>;
                /* Type-A connector on port 3 */
                port@3 {
                    reg = <3>;
                    endpoint {
                        remote-endpoint = <&usb_a0_ss>;
                    };
                };
            };
        };
    };
```
