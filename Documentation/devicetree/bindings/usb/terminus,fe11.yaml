## Documentation/devicetree/bindings/usb/ti,tps6598x.yaml
```yaml
# SPDX-License-Identifier: (GPL-2.0-only OR BSD-2-Clause)
%YAML 1.2
---
$id: http://devicetree.org/schemas/usb/ti,tps6598x.yaml#
$schema: http://devicetree.org/meta-schemas/core.yaml#

title: Texas Instruments 6598x Type-C Port Switch and Power Delivery controller

maintainers:
  - Bryan O'Donoghue <bryan.odonoghue@linaro.org>

description: |
  Texas Instruments 6598x Type-C Port Switch and Power Delivery controller

  A variant of this controller known as Apple CD321x or Apple ACE is also
  present on hardware with Apple SoCs such as the M1.

properties:
  compatible:
    enum:
      - ti,tps6598x
      - apple,cd321x
      - ti,tps25750

  reg:
    minItems: 1
    items:
      - description: main PD controller address
      - description: |
          I2C slave address field in PBMs input data
          which is used as the device address when writing the
          patch for TPS25750.
          The patch address can be any value except 0x00, 0x20,
          0x21, 0x22, and 0x23

  reg-names:
    items:
      - const: main
      - const: patch-address

  reset-gpios:
    description: GPIO used for the HRESET pin.
    maxItems: 1

  wakeup-source: true

  interrupts:
    maxItems: 1

  interrupt-names:
    items:
      - const: irq

  connector:
    $ref: /schemas/connector/usb-connector.yaml#

  firmware-name:
    description: |
      Should contain the name of the default patch binary
      file located on the firmware search path which is
      used to switch the controller into APP mode.
      This is used when tps25750 doesn't have an EEPROM
      connected to it.
    maxItems: 1

required:
  - compatible
  - reg

allOf:
  - if:
      properties:
        compatible:
          contains:
            const: ti,tps25750
    then:
      properties:
        reg:
          maxItems: 2

        connector:
          required:
            - data-role

      required:
        - connector
        - reg-names
    else:
      properties:
        reg:
          maxItems: 1

additionalProperties: false

examples:
  - |
    #include <dt-bindings/gpio/gpio.h>
    #include <dt-bindings/interrupt-controller/irq.h>
    i2c {
        #address-cells = <1>;
        #size-cells = <0>;

        tps6598x: tps6598x@38 {
            compatible = "ti,tps6598x";
            reg = <0x38>;
            wakeup-source;

            interrupt-parent = <&msmgpio>;
            interrupts = <107 IRQ_TYPE_LEVEL_LOW>;
            interrupt-names = "irq";

            pinctrl-names = "default";
            pinctrl-0 = <&typec_pins>;
            reset-gpios = <&gpio1 6 GPIO_ACTIVE_HIGH>;

            typec_con: connector {
                compatible = "usb-c-connector";
                label = "USB-C";
                port {
                    typec_ep: endpoint {
                        remote-endpoint = <&otg_ep>;
                    };
                };
            };
        };
    };

  - |
    #include <dt-bindings/interrupt-controller/irq.h>
    i2c {
        #address-cells = <1>;
        #size-cells = <0>;

        typec@21 {
            compatible = "ti,tps25750";
            reg = <0x21>, <0x0f>;
            reg-names = "main", "patch-address";

            interrupt-parent = <&msmgpio>;
            interrupts = <100 IRQ_TYPE_LEVEL_LOW>;
            interrupt-names = "irq";
            firmware-name = "tps25750.bin";

            pinctrl-names = "default";
            pinctrl-0 = <&typec_pins>;

            typec_con0: connector {
                compatible = "usb-c-connector";
                label = "USB-C";
                data-role = "dual";
                port {
                    typec_ep0: endpoint {
                        remote-endpoint = <&otg_ep>;
                    };
                };
            };
        };
    };
...
```

## Documentation/devicetree/bindings/usb/ti,tusb1046.yaml
```yaml
# SPDX-License-Identifier: (GPL-2.0-only OR BSD-2-Clause)
%YAML 1.2
---
$id: http://devicetree.org/schemas/usb/ti,tusb1046.yaml#
$schema: http://devicetree.org/meta-schemas/core.yaml#

title: Texas Instruments TUSB1046-DCI Type-C crosspoint switch

maintainers:
  - Romain Gantois <romain.gantois@bootlin.com>

allOf:
  - $ref: usb-switch.yaml#
  - $ref: usb-switch-ports.yaml#

properties:
  compatible:
    const: ti,tusb1046

  reg:
    maxItems: 1

required:
  - compatible
  - reg
  - port

unevaluatedProperties: false

examples:
  - |
    i2c {
        #address-cells = <1>;
        #size-cells = <0>;

        typec-mux@44 {
            compatible = "ti,tusb1046";
            reg = <0x44>;

            mode-switch;
            orientation-switch;

            port {
                endpoint {
                    remote-endpoint = <&typec_controller>;
                };
            };
        };
    };
...
```

## Documentation/devicetree/bindings/usb/ti,tusb73x0-pci.yaml
```yaml
# SPDX-License-Identifier: (GPL-2.0-only OR BSD-2-Clause)
%YAML 1.2
---
$id: http://devicetree.org/schemas/usb/ti,tusb73x0-pci.yaml#
$schema: http://devicetree.org/meta-schemas/core.yaml#

title: TUSB73x0 USB 3.0 xHCI Host Controller (PCIe)

maintainers:
  - Francesco Dolcini <francesco.dolcini@toradex.com>

description:
  TUSB73x0 USB 3.0 xHCI Host Controller via PCIe x1 Gen2 interface.
  The TUSB7320 supports up to two downstream ports, the TUSB7340 supports up
  to four downstream ports, both variants share the same PCI device ID.

properties:
  compatible:
    const: pci104c,8241

  reg:
    maxItems: 1

  ti,pwron-active-high:
    $ref: /schemas/types.yaml#/definitions/flag
    description:
      Configure the polarity of the PWRONx# signals. When this is present, the
      PWRONx# pins are active high and their internal pull-down resistors are
      disabled. When this is absent, the PWRONx# pins are active low (default)
      and their internal pull-down resistors are enabled.

required:
  - compatible
  - reg

allOf:
  - $ref: usb-xhci.yaml

additionalProperties: false

examples:
  - |
    pcie@0 {
        reg = <0x0 0x1000>;
        ranges = <0x02000000 0x0 0x100000 0x10000000 0x0 0x0>;
        #address-cells = <3>;
        #size-cells = <2>;
        device_type = "pci";

        usb@0 {
            compatible = "pci104c,8241";
            reg = <0x0 0x0 0x0 0x0 0x0>;
            ti,pwron-active-high;
        };
    };
```

## Documentation/devicetree/bindings/usb/ti,twl4030-usb.yaml
```yaml
# SPDX-License-Identifier: (GPL-2.0-only OR BSD-2-Clause)
%YAML 1.2
---
$id: http://devicetree.org/schemas/usb/ti,twl4030-usb.yaml#
$schema: http://devicetree.org/meta-schemas/core.yaml#

title: Texas Instruments TWL4030 USB PHY and Comparator

maintainers:
  - Peter Ujfalusi <peter.ujfalusi@gmail.com>

description:
  Bindings for the USB PHY and comparator module found within the
  TWL4030 family of companion chips. If a sibling node is compatible with
  "ti,twl4030-bci", the driver for that node will query this device for
  USB power status.

properties:
  compatible:
    const: ti,twl4030-usb

  interrupts:
    minItems: 1
    items:
      - description: OTG interrupt number for ID events.
      - description: USB interrupt number for VBUS events.

  usb1v5-supply:
    description: Phandle to the vusb1v5 regulator.

  usb1v8-supply:
    description: Phandle to the vusb1v8 regulator.

  usb3v1-supply:
    description: Phandle to the vusb3v1 regulator.

  usb_mode:
    description: |
      The mode used by the PHY to connect to the controller:
        1: ULPI mode
        2: CEA2011_3PIN mode
    $ref: /schemas/types.yaml#/definitions/uint32
    enum: [1, 2]

  '#phy-cells':
    const: 0

required:
  - compatible
  - interrupts
  - usb1v5-supply
  - usb1v8-supply
  - usb3v1-supply
  - usb_mode

additionalProperties: false

examples:
  - |
    #include <dt-bindings/interrupt-controller/irq.h>

    usb-phy {
        compatible = "ti,twl4030-usb";

        interrupts = <10 IRQ_TYPE_LEVEL_HIGH>;
        interrupt-parent = <&gic>;

        usb1v5-supply = <&reg_vusb1v5>;
        usb1v8-supply = <&reg_vusb1v8>;
        usb3v1-supply  = <&reg_vusb3v1>;
        usb_mode = <1>;

        #phy-cells = <0>;
    };
```

## Documentation/devicetree/bindings/usb/ti,twl6030-usb.yaml
```yaml
# SPDX-License-Identifier: (GPL-2.0-only OR BSD-2-Clause)
%YAML 1.2
---
$id: http://devicetree.org/schemas/usb/ti,twl6030-usb.yaml#
$schema: http://devicetree.org/meta-schemas/core.yaml#

title: Texas Instruments TWL6030 USB Comparator

maintainers:
  - Peter Ujfalusi <peter.ujfalusi@gmail.com>

description:
  Bindings for the USB comparator module found within the TWL6030
  family of companion chips.

properties:
  compatible:
    const: ti,twl6030-usb

  interrupts:
    items:
      - description: OTG for ID events in host mode
      - description: USB device mode for VBUS events

  usb-supply:
    description:
      Phandle to the VUSB regulator. For TWL6030, this should be the 'vusb'
      regulator. For TWL6032 subclass, it should be the 'ldousb' regulator.

required:
  - compatible
  - interrupts
  - usb-supply

additionalProperties: false

examples:
  - |
    #include <dt-bindings/interrupt-controller/irq.h>

    usb {
        compatible = "ti,twl6030-usb";

        interrupts = <4 IRQ_TYPE_LEVEL_HIGH>, <10 IRQ_TYPE_LEVEL_HIGH>;
        interrupt-parent = <&gic>;

        usb-supply = <&reg_vusb>;
    };
```

## Documentation/devicetree/bindings/usb/ti,usb8041.yaml
```yaml
# SPDX-License-Identifier: GPL-2.0-only OR BSD-2-Clause
%YAML 1.2
---
$id: http://devicetree.org/schemas/usb/ti,usb8041.yaml#
$schema: http://devicetree.org/meta-schemas/core.yaml#

title: TI USB8041 USB 3.0 hub controller

maintainers:
  - Alexander Stein <alexander.stein@ew.tq-group.com>

allOf:
  - $ref: usb-device.yaml#

properties:
  compatible:
    enum:
      - usb451,8140
      - usb451,8142

  reg: true

  reset-gpios:
    items:
      - description: GPIO specifier for GRST# pin.

  vdd-supply:
    description:
      VDD power supply to the hub

  peer-hub:
    $ref: /schemas/types.yaml#/definitions/phandle
    description:
      phandle to the peer hub on the controller.

required:
  - compatible
  - reg
  - peer-hub

additionalProperties: false

examples:
  - |
    #include <dt-bindings/gpio/gpio.h>

    usb {
        dr_mode = "host";
        #address-cells = <1>;
        #size-cells = <0>;

        /* 2.0 hub on port 1 */
        hub_2_0: hub@1 {
            compatible = "usb451,8142";
            reg = <1>;
            peer-hub = <&hub_3_0>;
            reset-gpios = <&gpio1 11 GPIO_ACTIVE_LOW>;
        };

        /* 3.0 hub on port 2 */
        hub_3_0: hub@2 {
            compatible = "usb451,8140";
            reg = <2>;
            peer-hub = <&hub_2_0>;
            reset-gpios = <&gpio1 11 GPIO_ACTIVE_LOW>;
        };
    };
```

## Documentation/devicetree/bindings/usb/twlxxxx-usb.txt
```
USB COMPARATOR OF TWL CHIPS

TWL6030 USB COMPARATOR
 - compatible : Should be "ti,twl6030-usb"
 - interrupts : Two interrupt numbers to the cpu should be specified. First
   interrupt number is the otg interrupt number that raises ID interrupts when
   the controller has to act as host and the second interrupt number is the
   usb interrupt number that raises VBUS interrupts when the controller has to
   act as device
 - usb-supply : phandle to the regulator device tree node. It should be vusb
   if it is twl6030 or ldousb if it is twl6025 subclass.

twl6030-usb {
	compatible = "ti,twl6030-usb";
	interrupts = < 4 10 >;
};

Board specific device node entry
&twl6030-usb {
	usb-supply = <&vusb>;
};

TWL4030 USB PHY AND COMPARATOR
 - compatible : Should be "ti,twl4030-usb"
 - interrupts : The interrupt numbers to the cpu should be specified. First
   interrupt number is the otg interrupt number that raises ID interrupts
   and VBUS interrupts. The second interrupt number is optional.
 - <supply-name>-supply : phandle to the regulator device tree node.
   <supply-name> should be vusb1v5, vusb1v8 and vusb3v1
 - usb_mode : The mode used by the phy to connect to the controller. "1"
   specifies "ULPI" mode and "2" specifies "CEA2011_3PIN" mode.

twl4030-usb {
	compatible = "ti,twl4030-usb";
	interrupts = < 10 4 >;
	usb1v5-supply = <&vusb1v5>;
	usb1v8-supply = <&vusb1v8>;
	usb3v1-supply = <&vusb3v1>;
	usb_mode = <1>;
};
```

## Documentation/devicetree/bindings/usb/typec-tcpci.txt
```
TCPCI(Typec port cotroller interface) binding
---------------------------------------------

Required properties:
- compatible:       should be set one of following:
		    - "nxp,ptn5110" for NXP USB PD TCPC PHY IC ptn5110.

- reg:              the i2c slave address of typec port controller device.
- interrupt-parent: the phandle to the interrupt controller which provides
                    the interrupt.
- interrupts:       interrupt specification for tcpci alert.

Required sub-node:
- connector: The "usb-c-connector" attached to the tcpci chip, the bindings
  of connector node are specified in
  Documentation/devicetree/bindings/connector/usb-connector.txt

Example:

ptn5110@50 {
	compatible = "nxp,ptn5110";
	reg = <0x50>;
	interrupt-parent = <&gpio3>;
	interrupts = <3 IRQ_TYPE_LEVEL_LOW>;

	usb_con: connector {
		compatible = "usb-c-connector";
		label = "USB-C";
		data-role = "dual";
		power-role = "dual";
		try-power-role = "sink";
		source-pdos = <PDO_FIXED(5000, 2000, PDO_FIXED_USB_COMM)>;
		sink-pdos = <PDO_FIXED(5000, 2000, PDO_FIXED_USB_COMM)
			     PDO_VAR(5000, 12000, 2000)>;
		op-sink-microwatt = <10000000>;

		ports {
			#address-cells = <1>;
			#size-cells = <0>;

			port@1 {
				reg = <1>;
				usb_con_ss: endpoint {
					remote-endpoint = <&usb3_data_ss>;
				};
			};
		};
	};
};
```

## Documentation/devicetree/bindings/usb/udc-xilinx.txt
```
Xilinx USB2 device controller

Required properties:
- compatible		: Should be "xlnx,usb2-device-4.00.a"
- reg			: Physical base address and size of the USB2
			  device registers map.
- interrupts		: Should contain single irq line of USB2 device
			  controller
- xlnx,has-builtin-dma	: if DMA is included

Example:
 		axi-usb2-device@42e00000 {
                        compatible = "xlnx,usb2-device-4.00.a";
                        interrupts = <0x0 0x39 0x1>;
                        reg = <0x42e00000 0x10000>;
                        xlnx,has-builtin-dma;
                };
```

## Documentation/devicetree/bindings/usb/ulpi.txt
```
ULPI bus binding
----------------

Phys that are behind a ULPI connection can be described with the following
binding. The host controller shall have a "ulpi" named node as a child, and
that node shall have one enabled node underneath it representing the ulpi
device on the bus.

EXAMPLE
-------

usb {
	compatible = "vendor,usb-controller";

	ulpi {
		phy {
			compatible = "vendor,phy";
		};
	};
};
```

## Documentation/devicetree/bindings/usb/usb-conn-gpio.txt
```
USB GPIO Based Connection Detection

This is typically used to switch dual role mode from the USB ID pin connected
to an input GPIO, and also used to enable/disable device mode from the USB
Vbus pin connected to an input GPIO.

Required properties:
- compatible : should include "gpio-usb-b-connector" and "usb-b-connector".
- id-gpios, vbus-gpios : input gpios, either one of them must be present,
	and both can be present as well.
	see connector/usb-connector.yaml

Optional properties:
- vbus-supply : can be present if needed when supports dual role mode.
	see connector/usb-connector.yaml

- Sub-nodes:
	- port : can be present.
		see graph.txt

Example:

&mtu3 {
	connector {
		compatible = "gpio-usb-b-connector", "usb-b-connector";
		type = "micro";
		id-gpios = <&pio 12 GPIO_ACTIVE_HIGH>;
		vbus-supply = <&usb_p0_vbus>;
	};
};
```
