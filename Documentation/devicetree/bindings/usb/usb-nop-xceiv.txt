## Documentation/devicetree/bindings/usb/ux500-usb.txt
```
Ux500 MUSB

Required properties:
 - compatible : Should be "stericsson,db8500-musb"
 - reg        : Offset and length of registers
 - interrupts : Interrupt; mode, number and trigger
 - dr_mode    : Dual-role; either host mode "host", peripheral mode "peripheral"
                or both "otg"

Optional properties:
 - dmas       : A list of dma channels;
                dma-controller, event-line, fixed-channel, flags
 - dma-names  : An ordered list of channel names affiliated to the above

Example:

usb_per5@a03e0000 {
	compatible = "stericsson,db8500-musb", "mentor,musb";
	reg = <0xa03e0000 0x10000>;
	interrupts = <0 23 0x4>;
	interrupt-names = "mc";

	dr_mode = "otg";

	dmas = <&dma 38 0 0x2>, /* Logical - DevToMem */
	       <&dma 38 0 0x0>, /* Logical - MemToDev */
	       <&dma 37 0 0x2>, /* Logical - DevToMem */
	       <&dma 37 0 0x0>, /* Logical - MemToDev */
	       <&dma 36 0 0x2>, /* Logical - DevToMem */
	       <&dma 36 0 0x0>, /* Logical - MemToDev */
	       <&dma 19 0 0x2>, /* Logical - DevToMem */
	       <&dma 19 0 0x0>, /* Logical - MemToDev */
	       <&dma 18 0 0x2>, /* Logical - DevToMem */
	       <&dma 18 0 0x0>, /* Logical - MemToDev */
	       <&dma 17 0 0x2>, /* Logical - DevToMem */
	       <&dma 17 0 0x0>, /* Logical - MemToDev */
	       <&dma 16 0 0x2>, /* Logical - DevToMem */
	       <&dma 16 0 0x0>, /* Logical - MemToDev */
	       <&dma 39 0 0x2>, /* Logical - DevToMem */
	       <&dma 39 0 0x0>; /* Logical - MemToDev */

	dma-names = "iep_1_9",  "oep_1_9",
		    "iep_2_10", "oep_2_10",
		    "iep_3_11", "oep_3_11",
		    "iep_4_12", "oep_4_12",
		    "iep_5_13", "oep_5_13",
		    "iep_6_14", "oep_6_14",
		    "iep_7_15", "oep_7_15",
		    "iep_8",    "oep_8";
};
```

## Documentation/devicetree/bindings/usb/via,vt8500-ehci.txt
```
VIA/Wondermedia VT8500 EHCI Controller
-----------------------------------------------------

Required properties:
- compatible : "via,vt8500-ehci"
- reg : Should contain 1 register ranges(address and length)
- interrupts : ehci controller interrupt

Example:

	ehci@d8007900 {
		compatible = "via,vt8500-ehci";
		reg = <0xd8007900 0x200>;
		interrupts = <43>;
	};
```

## Documentation/devicetree/bindings/usb/vialab,vl817.yaml
```yaml
# SPDX-License-Identifier: GPL-2.0-only OR BSD-2-Clause
%YAML 1.2
---
$id: http://devicetree.org/schemas/usb/vialab,vl817.yaml#
$schema: http://devicetree.org/meta-schemas/core.yaml#

title: Via labs VL817 USB 3.1 hub controller

maintainers:
  - Anand Moon <linux.amoon@gmail.com>

allOf:
  - $ref: usb-device.yaml#

properties:
  compatible:
    enum:
      - usb2109,2817
      - usb2109,817

  reg: true

  reset-gpios:
    maxItems: 1
    description:
      GPIO controlling the RESET# pin.

  vdd-supply:
    description:
      phandle to the regulator that provides power to the hub.

  peer-hub:
    $ref: /schemas/types.yaml#/definitions/phandle
    description:
      phandle to the peer hub on the controller.

required:
  - compatible
  - reg
  - reset-gpios
  - vdd-supply
  - peer-hub

additionalProperties: false

examples:
  - |
    #include <dt-bindings/gpio/gpio.h>

    usb {
        #address-cells = <1>;
        #size-cells = <0>;

        /* 2.0 hub on port 1 */
        hub_2_0: hub@1 {
            compatible = "usb2109,2817";
            reg = <1>;
            vdd-supply = <&vcc_5v>;
            peer-hub = <&hub_3_0>;
            reset-gpios = <&gpio 20 GPIO_ACTIVE_LOW>;
        };

        /* 3.1 hub on port 4 */
        hub_3_0: hub@2 {
            compatible = "usb2109,817";
            reg = <2>;
            vdd-supply = <&vcc_5v>;
            peer-hub = <&hub_2_0>;
            reset-gpios = <&gpio 20 GPIO_ACTIVE_LOW>;
        };
    };
```

## Documentation/devicetree/bindings/usb/vt8500-ehci.txt
```
VIA VT8500 and Wondermedia WM8xxx SoC USB controllers.

Required properties:
 - compatible: Should be "via,vt8500-ehci" or "wm,prizm-ehci".
 - reg: Address range of the ehci registers. size should be 0x200
 - interrupts: Should contain the ehci interrupt.

usb: ehci@D8007100 {
	compatible = "wm,prizm-ehci", "usb-ehci";
	reg = <0xD8007100 0x200>;
	interrupts = <1>;
};
```

## Documentation/devicetree/bindings/usb/wch,ch334.yaml
```yaml
# SPDX-License-Identifier: GPL-2.0-only OR BSD-2-Clause
%YAML 1.2
---
$id: http://devicetree.org/schemas/usb/wch,ch334.yaml#
$schema: http://devicetree.org/meta-schemas/core.yaml#

title: WCH CH334/CH335 USB 2.0 Hub Controller

maintainers:
  - Chaoyi Chen <kernel@airkyi.com>

allOf:
  - $ref: usb-hub.yaml#

properties:
  compatible:
    enum:
      - usb1a86,8091

  reg: true

  reset-gpios:
    description: GPIO controlling the RESET# pin.

  vdd33-supply:
    description:
      The regulator that provides 3.3V core power to the hub.

  v5-supply:
    description:
      The regulator that provides 3.3V or 5V power to the hub.

  ports:
    $ref: /schemas/graph.yaml#/properties/ports

    patternProperties:
      '^port@':
        $ref: /schemas/graph.yaml#/properties/port

        properties:
          reg:
            minimum: 1
            maximum: 4

required:
  - compatible
  - reg

additionalProperties: false

examples:
  - |
    #include <dt-bindings/gpio/gpio.h>
    usb {
        #address-cells = <1>;
        #size-cells = <0>;

        hub: hub@1 {
            compatible = "usb1a86,8091";
            reg = <1>;
            reset-gpios = <&gpio0 2 GPIO_ACTIVE_LOW>;
            v5-supply = <&vcc_3v3>;
            vdd33-supply = <&vcc_3v3>;
        };
    };
```

## Documentation/devicetree/bindings/usb/willsemi,wusb3801.yaml
```yaml
# SPDX-License-Identifier: (GPL-2.0-only OR BSD-2-Clause)
%YAML 1.2
---
$id: http://devicetree.org/schemas/usb/willsemi,wusb3801.yaml#
$schema: http://devicetree.org/meta-schemas/core.yaml#

title: WUSB3801 Type-C port controller

description:
  The Will Semiconductor WUSB3801 is a USB Type-C port controller which
  supports role and plug orientation detection using the CC pins. It is
  compatible with the USB Type-C Cable and Connector Specification v1.2.

maintainers:
  - Samuel Holland <samuel@sholland.org>

properties:
  compatible:
    enum:
      - willsemi,wusb3801

  reg:
    maxItems: 1

  interrupts:
    maxItems: 1

  connector:
    type: object
    $ref: ../connector/usb-connector.yaml#
    unevaluatedProperties: false
    description:
      The managed USB Type-C connector. Since WUSB3801 does not support
      Power Delivery, the node should have the "pd-disable" property.

    properties:
      compatible:
        const: usb-c-connector

    required:
      - pd-disable

required:
  - compatible
  - reg
  - interrupts
  - connector

additionalProperties: false

examples:
  - |
    #include <dt-bindings/interrupt-controller/irq.h>

    i2c {
      #address-cells = <1>;
      #size-cells = <0>;

      tcpc@60 {
        compatible = "willsemi,wusb3801";
        reg = <0x60>;
        interrupt-parent = <&gpio0>;
        interrupts = <4 IRQ_TYPE_LEVEL_LOW>;

        connector {
          compatible = "usb-c-connector";
          label = "USB-C";
          vbus-supply = <&otg_switch>;
          power-role = "dual";
          try-power-role = "sink";
          data-role = "dual";
          typec-power-opmode = "default";
          pd-disable;
        };
      };
    };
```

## Documentation/devicetree/bindings/usb/xlnx,usb2.yaml
```yaml
# SPDX-License-Identifier: (GPL-2.0-only OR BSD-2-Clause)
%YAML 1.2
---
$id: http://devicetree.org/schemas/usb/xlnx,usb2.yaml#
$schema: http://devicetree.org/meta-schemas/core.yaml#

title: Xilinx udc controller

maintainers:
  - Piyush Mehta <piyush.mehta@amd.com>

properties:
  compatible:
    const: xlnx,usb2-device-4.00.a

  reg:
    maxItems: 1

  interrupts:
    maxItems: 1

  xlnx,has-builtin-dma:
    description:
      If present, hardware has dma capability.
    type: boolean

  clocks:
    minItems: 1

  clock-names:
    const: s_axi_aclk

required:
  - compatible
  - reg
  - interrupts

additionalProperties: false

examples:
  - |
    axi-usb2-device@42e00000 {
        compatible = "xlnx,usb2-device-4.00.a";
        interrupts = <0x0 0x39 0x1>;
        reg = <0xee000000 0xc00>;
        xlnx,has-builtin-dma;
    };
```
