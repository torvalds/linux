## Documentation/devicetree/bindings/usb/usb-nop-xceiv.txt
```
USB NOP PHY

Required properties:
- compatible: should be usb-nop-xceiv
- #phy-cells: Must be 0

Optional properties:
- clocks: phandle to the PHY clock. Use as per Documentation/devicetree
  /bindings/clock/clock-bindings.txt
  This property is required if clock-frequency is specified.

- clock-names: Should be "main_clk"

- clock-frequency: the clock frequency (in Hz) that the PHY clock must
  be configured to.

- vcc-supply: phandle to the regulator that provides power to the PHY.

- reset-gpios: Should specify the GPIO for reset.

- vbus-detect-gpio: should specify the GPIO detecting a VBus insertion
                    (see Documentation/devicetree/bindings/gpio/gpio.txt)
- vbus-regulator : should specifiy the regulator supplying current drawn from
  the VBus line (see Documentation/devicetree/bindings/regulator/regulator.txt).

Example:

	hsusb1_phy {
		compatible = "usb-nop-xceiv";
		clock-frequency = <19200000>;
		clocks = <&osc 0>;
		clock-names = "main_clk";
		vcc-supply = <&hsusb1_vcc_regulator>;
		reset-gpios = <&gpio1 7 GPIO_ACTIVE_LOW>;
		vbus-detect-gpio = <&gpio2 13 GPIO_ACTIVE_HIGH>;
		vbus-regulator = <&vbus_regulator>;
		#phy-cells = <0>;
	};

hsusb1_phy is a NOP USB PHY device that gets its clock from an oscillator
and expects that clock to be configured to 19.2MHz by the NOP PHY driver.
hsusb1_vcc_regulator provides power to the PHY and GPIO 7 controls RESET.
GPIO 13 detects VBus insertion, and accordingly notifies the vbus-regulator.
```

## Documentation/devicetree/bindings/usb/usb-nop-xceiv.yaml
```yaml
# SPDX-License-Identifier: GPL-2.0
%YAML 1.2
---
$id: http://devicetree.org/schemas/usb/usb-nop-xceiv.yaml#
$schema: http://devicetree.org/meta-schemas/core.yaml#

title: USB NOP PHY

maintainers:
  - Rob Herring <robh@kernel.org>

properties:
  compatible:
    const: usb-nop-xceiv

  clocks:
    maxItems: 1

  clock-names:
    const: main_clk

  clock-frequency: true

  '#phy-cells':
    const: 0

  vcc-supply:
    description: phandle to the regulator that provides power to the PHY.

  power-domains:
    maxItems: 1

  reset-gpios:
    maxItems: 1

  vbus-detect-gpio:
    description: Should specify the GPIO detecting a VBus insertion
    maxItems: 1

  vbus-supply:
    description: regulator supplying VBUS. It will be enabled and disabled
                 dynamically in OTG mode. If the regulator is controlled by a
                 GPIO line, this should be modeled as a regulator-fixed and
                 referenced by this supply.

  wakeup-source:
    description:
      Specify if the USB phy can detect the remote wakeup signal
      while the system sleep.

required:
  - compatible
  - '#phy-cells'

additionalProperties: false

examples:
  - |
    #include <dt-bindings/gpio/gpio.h>

    hsusb1_phy {
        compatible = "usb-nop-xceiv";
        clock-frequency = <19200000>;
        clocks = <&osc 0>;
        clock-names = "main_clk";
        vcc-supply = <&hsusb1_vcc_regulator>;
        reset-gpios = <&gpio1 7 GPIO_ACTIVE_LOW>;
        vbus-detect-gpio = <&gpio2 13 GPIO_ACTIVE_HIGH>;
        vbus-supply = <&vbus_regulator>;
        #phy-cells = <0>;
    };

...
```

## Documentation/devicetree/bindings/usb/usb-ohci.txt
```
USB OHCI controllers

Required properties:
- compatible : "generic-ohci"
- reg : ohci controller register range (address and length)
- interrupts : ohci controller interrupt

Optional properties:
- big-endian-regs : boolean, set this for hcds with big-endian registers
- big-endian-desc : boolean, set this for hcds with big-endian descriptors
- big-endian : boolean, for hcds with big-endian-regs + big-endian-desc
- no-big-frame-no : boolean, set if frame_no lives in bits [15:0] of HCCA
- remote-wakeup-connected: remote wakeup is wired on the platform
- num-ports : u32, to override the detected port count
- clocks : a list of phandle + clock specifier pairs
- phys : phandle + phy specifier pair
- phy-names : "usb"
- resets : a list of phandle + reset specifier pairs

Example:

	ohci0: usb@01c14400 {
		compatible = "allwinner,sun4i-a10-ohci", "generic-ohci";
		reg = <0x01c14400 0x100>;
		interrupts = <64>;
		clocks = <&usb_clk 6>, <&ahb_gates 2>;
		phys = <&usbphy 1>;
		phy-names = "usb";
	};
```

## Documentation/devicetree/bindings/usb/usb-phy.txt
```
USB PHY

OMAP USB2 PHY

Required properties:
 - compatible: Should be "ti,omap-usb2"
 - reg : Address and length of the register set for the device.
 - #phy-cells: determine the number of cells that should be given in the
   phandle while referencing this phy.

Optional properties:
 - ctrl-module : phandle of the control module used by PHY driver to power on
   the PHY.

This is usually a subnode of ocp2scp to which it is connected.

usb2phy@4a0ad080 {
	compatible = "ti,omap-usb2";
	reg = <0x4a0ad080 0x58>;
	ctrl-module = <&omap_control_usb>;
	#phy-cells = <0>;
};

OMAP USB3 PHY

Required properties:
 - compatible: Should be "ti,omap-usb3"
 - reg : Address and length of the register set for the device.
 - reg-names: The names of the register addresses corresponding to the registers
   filled in "reg".
 - #phy-cells: determine the number of cells that should be given in the
   phandle while referencing this phy.

Optional properties:
 - ctrl-module : phandle of the control module used by PHY driver to power on
   the PHY.

This is usually a subnode of ocp2scp to which it is connected.

usb3phy@4a084400 {
	compatible = "ti,omap-usb3";
	reg = <0x4a084400 0x80>,
	      <0x4a084800 0x64>,
	      <0x4a084c00 0x40>;
	reg-names = "phy_rx", "phy_tx", "pll_ctrl";
	ctrl-module = <&omap_control_usb>;
	#phy-cells = <0>;
};
```

## Documentation/devicetree/bindings/usb/usb-switch-ports.yaml
```yaml
# SPDX-License-Identifier: (GPL-2.0-only OR BSD-2-Clause)
%YAML 1.2
---
$id: http://devicetree.org/schemas/usb/usb-switch-ports.yaml#
$schema: http://devicetree.org/meta-schemas/core.yaml#

title: USB Orientation and Mode Switches Ports Graph Properties

maintainers:
  - Greg Kroah-Hartman <gregkh@linuxfoundation.org>

description:
  Ports Graph properties for devices handling USB mode and orientation switching.

properties:
  port:
    $ref: /schemas/graph.yaml#/$defs/port-base
    description:
      A port node to link the device to a TypeC controller for the purpose of
      handling altmode muxing and orientation switching.

    properties:
      endpoint:
        $ref: /schemas/graph.yaml#/$defs/endpoint-base
        unevaluatedProperties: false
        properties:
          data-lanes:
            $ref: /schemas/types.yaml#/definitions/uint32-array
            minItems: 1
            maxItems: 8
            uniqueItems: true
            items:
              maximum: 8

  ports:
    $ref: /schemas/graph.yaml#/properties/ports
    properties:
      port@0:
        $ref: /schemas/graph.yaml#/properties/port
        description:
          Super Speed (SS) Output endpoint to the Type-C connector

      port@1:
        $ref: /schemas/graph.yaml#/$defs/port-base
        description:
          Super Speed (SS) Input endpoint from the Super-Speed PHY
        unevaluatedProperties: false

        properties:
          endpoint:
            $ref: /schemas/graph.yaml#/$defs/endpoint-base
            unevaluatedProperties: false
            properties:
              data-lanes:
                $ref: /schemas/types.yaml#/definitions/uint32-array
                minItems: 1
                maxItems: 8
                uniqueItems: true
                items:
                  maximum: 8

oneOf:
  - required:
      - port
  - required:
      - ports

additionalProperties: true
```

## Documentation/devicetree/bindings/usb/usb-switch.yaml
```yaml
# SPDX-License-Identifier: (GPL-2.0-only OR BSD-2-Clause)
%YAML 1.2
---
$id: http://devicetree.org/schemas/usb/usb-switch.yaml#
$schema: http://devicetree.org/meta-schemas/core.yaml#

title: USB Orientation and Mode Switches Common Properties

maintainers:
  - Greg Kroah-Hartman <gregkh@linuxfoundation.org>

description:
  Common properties for devices handling USB mode and orientation switching.

properties:
  mode-switch:
    description: Possible handler of altmode switching
    type: boolean

  orientation-switch:
    description: Possible handler of orientation switching
    type: boolean

  retimer-switch:
    description: Possible handler of SuperSpeed signals retiming
    type: boolean

additionalProperties: true
```

## Documentation/devicetree/bindings/usb/usb-uhci.txt
```
Generic Platform UHCI Controller
-----------------------------------------------------

Required properties:
- compatible : "generic-uhci" (deprecated: "platform-uhci")
- reg : Should contain 1 register ranges(address and length)
- interrupts : UHCI controller interrupt

additionally the properties from usb-hcd.yaml (in the current directory) are
supported.

Example:

	uhci@d8007b00 {
		compatible = "generic-uhci";
		reg = <0xd8007b00 0x200>;
		interrupts = <43>;
	};
```

## Documentation/devicetree/bindings/usb/usb-uhci.yaml
```yaml
# SPDX-License-Identifier: (GPL-2.0-only OR BSD-2-Clause)
%YAML 1.2
---
$id: http://devicetree.org/schemas/usb/usb-uhci.yaml#
$schema: http://devicetree.org/meta-schemas/core.yaml#

title: Generic Platform UHCI Controller

maintainers:
  - Greg Kroah-Hartman <gregkh@linuxfoundation.org>

properties:
  compatible:
    oneOf:
      - const: generic-uhci
      - const: platform-uhci
        deprecated: true
      - items:
          - enum:
              - aspeed,ast2400-uhci
              - aspeed,ast2500-uhci
              - aspeed,ast2600-uhci
          - const: generic-uhci

  reg:
    maxItems: 1

  interrupts:
    maxItems: 1

  '#ports':
    $ref: /schemas/types.yaml#/definitions/uint32

  clocks:
    maxItems: 1

required:
  - compatible
  - reg
  - interrupts

allOf:
  - $ref: usb-hcd.yaml
  - if:
      properties:
        compatible:
          contains:
            const: generic-uhci
    then:
      required:
        - clocks

unevaluatedProperties: false

examples:
  - |
    #include <dt-bindings/clock/aspeed-clock.h>

    usb@d8007b00 {
        compatible = "generic-uhci";
        reg = <0xd8007b00 0x200>;
        interrupts = <43>;
        clocks = <&syscon ASPEED_CLK_GATE_USBUHCICLK>;
    };
  - |
    #include <dt-bindings/clock/aspeed-clock.h>

    usb@1e6b0000 {
        compatible = "aspeed,ast2500-uhci", "generic-uhci";
        reg = <0x1e6b0000 0x100>;
        interrupts = <14>;
        #ports = <2>;
        clocks = <&syscon ASPEED_CLK_GATE_USBUHCICLK>;
    };
...
```

## Documentation/devicetree/bindings/usb/usb-xhci.txt
```
USB xHCI controllers

Required properties:
  - compatible: should be one or more of

    - "generic-xhci" for generic XHCI device
    - "marvell,armada3700-xhci" for Armada 37xx SoCs
    - "marvell,armada-375-xhci" for Armada 375 SoCs
    - "marvell,armada-380-xhci" for Armada 38x SoCs
    - "brcm,bcm7445-xhci" for Broadcom STB SoCs with XHCI
    - "xhci-platform" (deprecated)

    When compatible with the generic version, nodes must list the
    SoC-specific version corresponding to the platform first
    followed by the generic version.

  - reg: should contain address and length of the standard XHCI
    register set for the device.
  - interrupts: one XHCI interrupt should be described here.

Optional properties:
  - clocks: reference to the clocks
  - clock-names: mandatory if there is a second clock, in this case
    the name must be "core" for the first clock and "reg" for the
    second one
  - usb2-lpm-disable: indicate if we don't want to enable USB2 HW LPM
  - usb3-lpm-capable: determines if platform is USB3 LPM capable
  - quirk-broken-port-ped: set if the controller has broken port disable mechanism
  - imod-interval-ns: default interrupt moderation interval is 5000ns
  - phys : see usb-hcd.yaml in the current directory
  - offload: supporting USB offload feature, 0: disabled, 1: audio

additionally the properties from usb-hcd.yaml (in the current directory) are
supported.


Example:
	usb@f0931000 {
		compatible = "generic-xhci";
		reg = <0xf0931000 0x8c8>;
		interrupts = <0x0 0x4e 0x0>;
	};
```

## Documentation/devicetree/bindings/usb/usb-xhci.yaml
```yaml
# SPDX-License-Identifier: GPL-2.0
%YAML 1.2
---
$id: http://devicetree.org/schemas/usb/usb-xhci.yaml#
$schema: http://devicetree.org/meta-schemas/core.yaml#

title: Generic USB xHCI Controller

maintainers:
  - Mathias Nyman <mathias.nyman@intel.com>

allOf:
  - $ref: "usb-hcd.yaml#"

properties:
  usb2-lpm-disable:
    description: Indicates if we don't want to enable USB2 HW LPM
    type: boolean

  usb3-lpm-capable:
    description: Determines if platform is USB3 LPM capable
    type: boolean

  quirk-broken-port-ped:
    description: Set if the controller has broken port disable mechanism
    type: boolean

  imod-interval-ns:
    description: Interrupt moderation interval
    default: 5000

additionalProperties: true

examples:
  - |
    usb@f0930000 {
      compatible = "generic-xhci";
      reg = <0xf0930000 0x8c8>;
      interrupts = <0x0 0x4e 0x0>;
      usb2-lpm-disable;
      usb3-lpm-capable;
    };
```

## Documentation/devicetree/bindings/usb/usb.yaml
```yaml
# SPDX-License-Identifier: GPL-2.0
%YAML 1.2
---
$id: http://devicetree.org/schemas/usb/usb.yaml#
$schema: http://devicetree.org/meta-schemas/core.yaml#

title: Generic USB Controller Device Tree Bindings

maintainers:
  - Greg Kroah-Hartman <gregkh@linuxfoundation.org>

select: false

properties:
  $nodename:
    pattern: "^usb(@.*)?"

  phys:
    description:
      List of all the USB PHYs on this HCD

  phy-names:
    description:
      Name specifier for the USB PHY

  usb-phy:
    $ref: /schemas/types.yaml#/definitions/phandle-array
    description:
      List of all the USB PHYs on this HCD to be accepted by the legacy USB
      Physical Layer subsystem.
    deprecated: true

  phy_type:
    description:
      Tells USB controllers that we want to configure the core to support a
      UTMI+ PHY with an 8- or 16-bit interface if UTMI+ is selected, UTMI+ low
      pin interface if ULPI is specified, Serial core/PHY interconnect if
      serial is specified and High-Speed Inter-Chip feature if HSIC is
      selected. In case this isn't passed via DT, USB controllers should
      default to HW capability.
    $ref: /schemas/types.yaml#/definitions/string
    enum: [utmi, utmi_wide, ulpi, serial, hsic]

  maximum-speed:
    description:
      Tells USB controllers we want to work up to a certain speed. In case this
      isn't passed via DT, USB controllers should default to their maximum HW
      capability.
    $ref: /schemas/types.yaml#/definitions/string
    enum:
      - low-speed
      - full-speed
      - high-speed
      - super-speed
      - super-speed-plus
      - super-speed-plus-gen2x1
      - super-speed-plus-gen1x2
      - super-speed-plus-gen2x2

additionalProperties: true

...
```
