## Documentation/devicetree/bindings/arm/marvell,berlin.yaml
```yaml
# SPDX-License-Identifier: (GPL-2.0-only OR BSD-2-Clause)
%YAML 1.2
---
$id: http://devicetree.org/schemas/arm/marvell,berlin.yaml#
$schema: http://devicetree.org/meta-schemas/core.yaml#

title: Synaptics/Marvell Berlin SoC

maintainers:
  - Jisheng Zhang <jszhang@kernel.org>

description:
  According to https://www.synaptics.com/company/news/conexant-marvell
  Synaptics has acquired the Multimedia Solutions Business of Marvell, so
  Berlin SoCs are now Synaptics' SoCs.

properties:
  $nodename:
    const: '/'
  compatible:
    oneOf:
      - items:
          - enum:
              - sony,nsz-gs7
          - const: marvell,berlin2
          - const: marvell,berlin
      - items:
          - enum:
              - google,chromecast
              - valve,steamlink
          - const: marvell,berlin2cd
          - const: marvell,berlin
      - items:
          - enum:
              - marvell,berlin2q-dmp
          - const: marvell,berlin2q
          - const: marvell,berlin
      - items:
          - enum:
              - marvell,berlin4ct-dmp
              - marvell,berlin4ct-stb
          - const: marvell,berlin4ct
          - const: marvell,berlin

additionalProperties: true
```

## Documentation/devicetree/bindings/arm/marvell,kirkwood.txt
```
Marvell Kirkwood SoC Family Device Tree Bindings
------------------------------------------------

Boards with a SoC of the Marvell Kirkwook family, eg 88f6281

* Required root node properties:
compatible: must contain "marvell,kirkwood"

In addition, the above compatible shall be extended with the specific
SoC. Currently known SoC compatibles are:

"marvell,kirkwood-88f6192"
"marvell,kirkwood-88f6281"
"marvell,kirkwood-88f6282"
"marvell,kirkwood-88f6283"
"marvell,kirkwood-88f6702"
"marvell,kirkwood-98DX4122"

And in addition, the compatible shall be extended with the specific
board. Currently known boards are:

"buffalo,lschlv2"
"buffalo,lswvl"
"buffalo,lswxl"
"buffalo,lsxhl"
"buffalo,lsxl"
"cloudengines,pogo02"
"cloudengines,pogoplugv4"
"dlink,dns-320"
"dlink,dns-320-a1"
"dlink,dns-325"
"dlink,dns-325-a1"
"dlink,dns-kirkwood"
"excito,b3"
"globalscale,dreamplug-003-ds2001"
"globalscale,guruplug"
"globalscale,guruplug-server-plus"
"globalscale,sheevaplug"
"globalscale,sheevaplug"
"globalscale,sheevaplug-esata"
"globalscale,sheevaplug-esata-rev13"
"iom,iconnect"
"iom,iconnect-1.1"
"iom,ix2-200"
"keymile,km_kirkwood"
"lacie,cloudbox"
"lacie,inetspace_v2"
"lacie,laplug"
"lacie,nas2big"
"lacie,netspace_lite_v2"
"lacie,netspace_max_v2"
"lacie,netspace_mini_v2"
"lacie,netspace_v2"
"marvell,db-88f6281-bp"
"marvell,db-88f6282-bp"
"marvell,mv88f6281gtw-ge"
"marvell,rd88f6281"
"marvell,rd88f6281"
"marvell,rd88f6281-a0"
"marvell,rd88f6281-a1"
"mpl,cec4"
"mpl,cec4-10"
"netgear,readynas"
"netgear,readynas"
"netgear,readynas-duo-v2"
"netgear,readynas-nv+-v2"
"plathome,openblocks-a6"
"plathome,openblocks-a7"
"raidsonic,ib-nas6210"
"raidsonic,ib-nas6210-b"
"raidsonic,ib-nas6220"
"raidsonic,ib-nas6220-b"
"raidsonic,ib-nas62x0"
"seagate,dockstar"
"seagate,goflexnet"
"synology,ds109"
"synology,ds110jv10"
"synology,ds110jv20"
"synology,ds110jv30"
"synology,ds111"
"synology,ds209"
"synology,ds210jv10"
"synology,ds210jv20"
"synology,ds212"
"synology,ds212jv10"
"synology,ds212jv20"
"synology,ds212pv10"
"synology,ds409"
"synology,ds409slim"
"synology,ds410j"
"synology,ds411"
"synology,ds411j"
"synology,ds411slim"
"synology,ds413jv10"
"synology,rs212"
"synology,rs409"
"synology,rs411"
"synology,rs812"
"usi,topkick"
"usi,topkick-1281P2"
"zyxel,nsa310"
"zyxel,nsa310a"
```
