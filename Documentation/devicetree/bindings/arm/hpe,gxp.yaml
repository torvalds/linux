## Documentation/devicetree/bindings/arm/mali-coresight-source.txt
```
# SPDX-License-Identifier: GPL-2.0 WITH Linux-syscall-note
#
# (C) COPYRIGHT 2022 ARM Limited. All rights reserved.
#
# This program is free software and is provided to you under the terms of the
# GNU General Public License version 2 as published by the Free Software
# Foundation, and any use by you of this program is subject to the terms
# of such GNU license.
#
# This program is distributed in the hope that it will be useful,
# but WITHOUT ANY WARRANTY; without even the implied warranty of
# MERCHANTABILITY or FITNESS FOR A PARTICULAR PURPOSE. See the
# GNU General Public License for more details.
#
# You should have received a copy of the GNU General Public License
# along with this program; if not, you can access it online at
# http://www.gnu.org/licenses/gpl-2.0.html.
#
#
=====================================
ARM CoreSight Mali Source integration
=====================================

See Documentation/trace/coresight/coresight.rst for detailed information
about Coresight.

This documentation will cover Mali specific devicetree integration.

References to Sink ports are given as examples. Access to Sink is specific
to an implementation and would require dedicated kernel modules.

ARM Coresight Mali Source ITM
=============================

Required properties
-------------------

- compatible: Has to be "arm,coresight-mali-source-itm"
- gpu : phandle to a Mali GPU definition
- port:
  - endpoint:
    - remote-endpoint: phandle to a Coresight sink port

Example
-------

mali-source-itm {
  compatible = "arm,coresight-mali-source-itm";
  gpu = <&gpu>;
  port {
    mali_source_itm_out_port0: endpoint {
      remote-endpoint = <&mali_sink_in_port0>;
    };
  };
};

ARM Coresight Mali Source ETM
=============================

Required properties
-------------------

- compatible: Has to be "arm,coresight-mali-source-etm"
- gpu : phandle to a Mali GPU definition
- port:
  - endpoint:
    - remote-endpoint: phandle to a Coresight sink port

Example
-------

mali-source-etm {
  compatible = "arm,coresight-mali-source-etm";
  gpu = <&gpu>;
  port {
    mali_source_etm_out_port0: endpoint {
      remote-endpoint = <&mali_sink_in_port1>;
    };
  };
};

ARM Coresight Mali Source ELA
=============================

Required properties
-------------------

- compatible: Has to be "arm,coresight-mali-source-ela"
- gpu : phandle to a Mali GPU definition
- signal-groups: Signal groups indexed from 0 to 5.
                 Used to configure the signal channels.
  - sgN: Types of signals attached to one channel.
         It can be more than one type in the case of
         JCN request/response.

         Types:
           - "jcn-request": Can share the channel with "jcn-response"
           - "jcn-response": Can share the channel with "jcn-request"
           - "ceu-execution": Cannot share the channel with other types
           - "ceu-commands": Cannot share the channel with other types
           - "mcu-ahbp": Cannot share the channel with other types
           - "host-axi": Cannot share the channel with other types


         If the HW implementation shares a common channel
         for JCN response and request (total of 4 channels),
         Refer to:
           - "Example: Shared JCN request/response channel"
         Otherwise (total of 5 channels), refer to:
           - "Example: Split JCN request/response channel"
- port:
  - endpoint:
    - remote-endpoint: phandle to a Coresight sink port

Example: Split JCN request/response channel
--------------------------------------------

This examples applies to implementations with a total of 5 signal groups,
where JCN request and response are assigned to independent channels.

mali-source-ela {
  compatible = "arm,coresight-mali-source-ela";
  gpu = <&gpu>;
  signal-groups {
    sg0 = "jcn-request";
    sg1 = "jcn-response";
    sg2 = "ceu-execution";
    sg3 = "ceu-commands";
    sg4 = "mcu-ahbp";
    sg5 = "host-axi";
  };
  port {
    mali_source_ela_out_port0: endpoint {
      remote-endpoint = <&mali_sink_in_port2>;
    };
  };
};

Example: Shared JCN request/response channel
--------------------------------------------

This examples applies to implementations with a total of 4 signal groups,
where JCN request and response are assigned to the same channel.

mali-source-ela {
  compatible = "arm,coresight-mali-source-ela";
  gpu = <&gpu>;
  signal-groups {
    sg0 = "jcn-request", "jcn-response";
    sg1 = "ceu-execution";
    sg2 = "ceu-commands";
    sg3 = "mcu-ahbp";
    sg4 = "host-axi";
  };
  port {
    mali_source_ela_out_port0: endpoint {
      remote-endpoint = <&mali_sink_in_port1>;
    };
  };
};
```

## Documentation/devicetree/bindings/arm/mali-midgard.txt
```
#
# (C) COPYRIGHT 2013-2017 ARM Limited. All rights reserved.
#
# This program is free software and is provided to you under the terms of the
# GNU General Public License version 2 as published by the Free Software
# Foundation, and any use by you of this program is subject to the terms
# of such GNU licence.
#
# A copy of the licence is included with the program, and can also be obtained
# from Free Software Foundation, Inc., 51 Franklin Street, Fifth Floor,
# Boston, MA  02110-1301, USA.
#
#


* ARM Mali Midgard devices


Required properties:

- compatible : Should be mali<chip>, replacing digits with x from the back,
until malit<Major>xx, ending with arm,mali-midgard, the latter not optional.
- reg : Physical base address of the device and length of the register area.
- interrupts : Contains the three IRQ lines required by T-6xx devices
- interrupt-names : Contains the names of IRQ resources in the order they were
provided in the interrupts property. Must contain: "JOB, "MMU", "GPU".

Optional:

- clocks : Phandle to clock for the Mali T-6xx device.
- clock-names : Shall be "clk_mali".
- mali-supply : Phandle to regulator for the Mali device. Refer to
Documentation/devicetree/bindings/regulator/regulator.txt for details.
- operating-points : Refer to Documentation/devicetree/bindings/power/opp.txt
for details.
- jm_config : For T860/T880. Sets job manager configuration. An array containing:
	- 1 to override the TIMESTAMP value, 0 otherwise.
	- 1 to override clock gate, forcing them to be always on, 0 otherwise.
	- 1 to enable job throttle, limiting the number of cores that can be started
	  simultaneously, 0 otherwise.
	- Value between 0 and 63 (including). If job throttle is enabled, this is one
	  less than the number of cores that can be started simultaneously.
- power_model : Sets power model parameters. Note that this model was designed for the Juno
	        platform, and may not be suitable for other platforms. A structure containing :
	- compatible: Should be arm,mali-simple-power-model
	- dynamic-coefficient: Coefficient, in pW/(Hz V^2), which is multiplied
	  by v^2*f to calculate the dynamic power consumption.
	- static-coefficient: Coefficient, in uW/V^3, which is multiplied by
	  v^3 to calculate the static power consumption.
	- ts: An array containing coefficients for the temperature scaling
	  factor. This is used to scale the static power by a factor of
	  tsf/1000000, where tsf = ts[3]*T^3 + ts[2]*T^2 + ts[1]*T + ts[0],
	  and T = temperature in degrees.
	- thermal-zone: A string identifying the thermal zone used for the GPU
- system-coherency : Sets the coherency protocol to be used for coherent
		     accesses made from the GPU.
		     If not set then no coherency is used.
	- 0  : ACE-Lite
	- 1  : ACE
	- 31 : No coherency
- ipa-model : Sets the IPA model to be used for power management. GPU probe will fail if the
	      model is not found in the registered models list. If no model is specified here,
	      a gpu-id based model is picked if available, otherwise the default model is used.
	- mali-simple-power-model: Default model used on mali
- protected-mode-switcher : Phandle to device implemented protected mode switching functionality.
Refer to Documentation/devicetree/bindings/arm/smc-protected-mode-switcher.txt for one implementation.

Example for a Mali-T602:

gpu@0xfc010000 {
	compatible = "arm,malit602", "arm,malit60x", "arm,malit6xx", "arm,mali-midgard";
	reg = <0xfc010000 0x4000>;
	interrupts = <0 36 4>, <0 37 4>, <0 38 4>;
	interrupt-names = "JOB", "MMU", "GPU";

	clocks = <&pclk_mali>;
	clock-names = "clk_mali";
	mali-supply = <&vdd_mali>;
	operating-points = <
		/* KHz   uV */
		533000 1250000,
		450000 1150000,
		400000 1125000,
		350000 1075000,
		266000 1025000,
		160000  925000,
		100000  912500,
	>;
	power_model {
		compatible = "arm,mali-simple-power-model";
		static-coefficient = <2427750>;
		dynamic-coefficient = <4687>;
		ts = <20000 2000 (-20) 2>;
		thermal-zone = "gpu";
	};
};
```

## Documentation/devicetree/bindings/arm/mali-utgard.txt
```
/*
 * Copyright (C) 2014, 2016-2017 ARM Limited. All rights reserved.
 * 
 * This program is free software and is provided to you under the terms of the GNU General Public License version 2
 * as published by the Free Software Foundation, and any use by you of this program is subject to the terms of such GNU licence.
 * 
 * A copy of the licence is included with the program, and can also be obtained from Free Software
 * Foundation, Inc., 51 Franklin Street, Fifth Floor, Boston, MA  02110-1301, USA.
 */
* ARM Mali-300/400/450 GPU

Required properties:
- compatible:
	At least one of these: "arm,mali-300", "arm,mali-400", "arm,mali-450"
	Always: "arm,mali-utgard"
	Mali-450 can also include "arm,mali-400" as it is compatible.
	- "arm,mali-400", "arm,mali-utgard" for any Mali-400 GPU.
	- "arm,mali-450", "arm,mali-400", "arm,mali-utgard" for any Mali-450 GPU.
- reg:
	Physical base address and length of the GPU's registers.
- interrupts:
	- List of all Mali interrupts.
	- This list must match the number of and the order of entries in
		interrupt-names.
- interrupt-names:
	- IRQPP<X> - Name for PP interrupts.
	- IRQPPMMU<X> -  Name for interrupts from the PP MMU.
	- IRQPP - Name for the PP broadcast interrupt (Mali-450 only).
	- IRQGP - Name for the GP interrupt.
	- IRQGPMMU - Name for the interrupt from the GP MMU.
	- IRQPMU - Name for the PMU interrupt (If pmu is implemented in HW, it must be contained).

Optional properties:
- pmu_domain_config:
	- If the Mali internal PMU is present and the PMU IRQ is specified in
		interrupt/interrupt-names ("IRQPMU").This contains the mapping of
		Mali HW units to the PMU power domain.
	-Mali Dynamic power domain configuration in sequence from 0-11, like:
		<GP PP0 PP1 PP2 PP3  PP4 PP5 PP6 PP7 L2$0 L2$1 L2$2>.
- pmu-switch-delay:
	- Only needed if the power gates are connected to the PMU in a high fanout
		network. This value is the number of Mali clock cycles it takes to
		enable the power gates and turn on the power mesh. This value will
		have no effect if a daisy chain implementation is used.

Platform related properties:
- clocks: Phandle to clock for Mali utgard device.
- clock-names: the corresponding names of clock in clocks property.
- regulator: Phandle to regulator which is power supplier of mali device.

Example for a Mali400_MP1_PMU device:

/ {
	...

	gpu@12300000 {
		compatible = "arm,mali-400", "arm,mali-utgard";
		reg = <0x12300000 0x30000>;
		interrupts = <0 55 4>, <0 56 4>, <0 57 4>, <0 58 4>, <0 59 4>;
		interrupt-names = "IRQGP", "IRQGPMMU", "IRQPP0", "IRQPPMMU0", "IRQPMU";

		pmu_domain_config = <0x1 0x4 0x0 0x0 0x0 0x0 0x0 0x0 0x0 0x2 0x0 0x0>;
		pmu_switch_delay = <0xff>;
		clocks = <clock 122>, <clock 123>;
		clock-names = "mali_parent", "mali";
		vdd_g3d-supply = <regulator_Phandle>;
	};
}
```

## Documentation/devicetree/bindings/arm/marvell,berlin.txt
```
Marvell Berlin SoC Family Device Tree Bindings
---------------------------------------------------------------

Work in progress statement:

Device tree files and bindings applying to Marvell Berlin SoCs and boards are
considered "unstable". Any Marvell Berlin device tree binding may change at any
time. Be sure to use a device tree binary and a kernel image generated from the
same source tree.

Please refer to Documentation/devicetree/bindings/ABI.txt for a definition of a
stable binding/ABI.

---------------------------------------------------------------

Boards with a SoC of the Marvell Berlin family, e.g. Armada 1500
shall have the following properties:

* Required root node properties:
compatible: must contain "marvell,berlin"

In addition, the above compatible shall be extended with the specific
SoC and board used. Currently known SoC compatibles are:
    "marvell,berlin2"      for Marvell Armada 1500 (BG2, 88DE3100),
    "marvell,berlin2cd"    for Marvell Armada 1500-mini (BG2CD, 88DE3005)
    "marvell,berlin2ct"    for Marvell Armada ? (BG2CT, 88DE????)
    "marvell,berlin2q"     for Marvell Armada 1500-pro (BG2Q, 88DE3114)
    "marvell,berlin3"      for Marvell Armada ? (BG3, 88DE????)

* Example:

/ {
	model = "Sony NSZ-GS7";
	compatible = "sony,nsz-gs7", "marvell,berlin2", "marvell,berlin";

	...
}

* Marvell Berlin CPU control bindings

CPU control register allows various operations on CPUs, like resetting them
independently.

Required properties:
- compatible: should be "marvell,berlin-cpu-ctrl"
- reg: address and length of the register set

Example:

cpu-ctrl@f7dd0000 {
	compatible = "marvell,berlin-cpu-ctrl";
	reg = <0xf7dd0000 0x10000>;
};

* Marvell Berlin2 chip control binding

Marvell Berlin SoCs have a chip control register set providing several
individual registers dealing with pinmux, padmux, clock, reset, and secondary
CPU boot address. Unfortunately, the individual registers are spread among the
chip control registers, so there should be a single DT node only providing the
different functions which are described below.

Required properties:
- compatible:
	* the first value should be one of:
		"marvell,berlin2-chip-ctrl" for BG2
		"marvell,berlin2cd-chip-ctrl" for BG2CD
		"marvell,berlin2q-chip-ctrl" for BG2Q
	* the second and third values must be:
		"simple-mfd", "syscon"
- reg: address and length of following register sets for
  BG2/BG2CD: chip control register set
  BG2Q: chip control register set and cpu pll registers

* Marvell Berlin2 system control binding

Marvell Berlin SoCs have a system control register set providing several
individual registers dealing with pinmux, padmux, and reset.

Required properties:
- compatible:
	* the first value should be one of:
		"marvell,berlin2-system-ctrl" for BG2
		"marvell,berlin2cd-system-ctrl" for BG2CD
		"marvell,berlin2q-system-ctrl" for BG2Q
	* the second and third values must be:
		"simple-mfd", "syscon"
- reg: address and length of the system control register set

* Clock provider binding

As clock related registers are spread among the chip control registers, the
chip control node also provides the clocks. Marvell Berlin2 (BG2, BG2CD, BG2Q)
SoCs share the same IP for PLLs and clocks, with some minor differences in
features and register layout.

Required properties:
- #clock-cells: shall be set to 1
- clocks: clock specifiers referencing the core clock input clocks
- clock-names: array of strings describing the input clock specifiers above.
    Allowed clock-names for the reference clocks are
      "refclk" for the SoCs osciallator input on all SoCs,
    and SoC-specific input clocks for
      BG2/BG2CD: "video_ext0" for the external video clock input

Clocks provided by core clocks shall be referenced by a clock specifier
indexing one of the provided clocks. Refer to dt-bindings/clock/berlin<soc>.h
for the corresponding index mapping.

Example:

chip: chip-control@ea0000 {
	compatible = "marvell,berlin2-chip-ctrl", "simple-mfd", "syscon";
	#clock-cells = <1>;
	reg = <0xea0000 0x400>;
	clocks = <&refclk>, <&externaldev 0>;
	clock-names = "refclk", "video_ext0";
};

sysctrl: system-controller@d000 {
	compatible = "marvell,berlin2-system-ctrl", "simple-mfd", "syscon";
	reg = <0xd000 0x100>;
};
```
