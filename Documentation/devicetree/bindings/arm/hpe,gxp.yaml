## Documentation/devicetree/bindings/arm/insignal-boards.txt
```
* Insignal's Exynos4210 based Origen evaluation board

Origen low-cost evaluation board is based on Samsung's Exynos4210 SoC.

Required root node properties:
    - compatible = should be one or more of the following.
        (a) "samsung,smdkv310" - for Samsung's SMDKV310 eval board.
        (b) "samsung,exynos4210"  - for boards based on Exynos4210 SoC.
```

## Documentation/devicetree/bindings/arm/intel,keembay.yaml
```yaml
# SPDX-License-Identifier: (GPL-2.0-only OR BSD-2-Clause)
%YAML 1.2
---
$id: http://devicetree.org/schemas/arm/intel,keembay.yaml#
$schema: http://devicetree.org/meta-schemas/core.yaml#

title: Keem Bay platform device tree bindings

maintainers:
  - Paul J. Murphy <paul.j.murphy@intel.com>
  - Daniele Alessandrelli <daniele.alessandrelli@intel.com>

properties:
  compatible:
    items:
      - enum:
          - intel,keembay-evm
      - const: intel,keembay
...
```

## Documentation/devicetree/bindings/arm/intel,socfpga.yaml
```yaml
# SPDX-License-Identifier: (GPL-2.0-only OR BSD-2-Clause)
%YAML 1.2
---
$id: http://devicetree.org/schemas/arm/intel,socfpga.yaml#
$schema: http://devicetree.org/meta-schemas/core.yaml#

title: Intel SoCFPGA platform

maintainers:
  - Dinh Nguyen <dinguyen@kernel.org>

properties:
  $nodename:
    const: "/"
  compatible:
    oneOf:
      - description: AgileX boards
        items:
          - enum:
              - intel,n5x-socdk
              - intel,socfpga-agilex-n6000
              - intel,socfpga-agilex-socdk
          - const: intel,socfpga-agilex

additionalProperties: true

...
```

## Documentation/devicetree/bindings/arm/intel-ixp4xx.yaml
```yaml
# SPDX-License-Identifier: GPL-2.0
%YAML 1.2
---
$id: http://devicetree.org/schemas/arm/intel-ixp4xx.yaml#
$schema: http://devicetree.org/meta-schemas/core.yaml#

title: Intel IXP4xx

maintainers:
  - Linus Walleij <linus.walleij@linaro.org>

properties:
  $nodename:
    const: "/"
  compatible:
    oneOf:
      - items:
          - enum:
              - actiontec,mi424wr-ac
              - actiontec,mi424wr-d
              - adieng,coyote
              - arcom,vulcan
              - dlink,dsm-g600-a
              - freecom,fsg-3
              - gateway,7001
              - gateworks,gw2348
              - goramo,multilink-router
              - intel,ixdp425
              - intel,ixdpg425
              - iom,nas-100d
              - linksys,nslu2
              - netgear,wg302v1
              - netgear,wg302v2
              - usr,8200
              - welltech,epbx100
              - linksys,wrv54g
              - gemtek,gtwx5715
          - const: intel,ixp42x
      - items:
          - enum:
              - gateworks,gw2358
              - intel,kixrp435
          - const: intel,ixp43x

additionalProperties: true
```

## Documentation/devicetree/bindings/arm/juno,scpi.txt
```
System Control and Power Interface (SCPI) Message Protocol
(in addition to the standard binding in [0])

Juyes SRAM and Shared Memory for SCPI
------------------------------------

Required properties:
- compatible : should be "arm,juyes-sram-ns" for Non-secure SRAM

Each sub-yesde represents the reserved area for SCPI.

Required sub-yesde properties:
- reg : The base offset and size of the reserved area with the SRAM
- compatible : should be "arm,juyes-scp-shmem" for Non-secure SRAM based
	       shared memory on Juyes platforms

Sensor bindings for the sensors based on SCPI Message Protocol
--------------------------------------------------------------
Required properties:
- compatible : should be "arm,scpi-sensors".
- #thermal-sensor-cells: should be set to 1.
			 For Juyes R0 and Juyes R1 refer to [1] for the
			 sensor identifiers

[0] Documentation/devicetree/bindings/arm/arm,scpi.txt
[1] http://infocenter.arm.com/help/index.jsp?topic=/com.arm.doc.dui0922b/apas03s22.html
```

## Documentation/devicetree/bindings/arm/keystone/keystone.txt
```
TI Keystone Platforms Device Tree Bindings
-----------------------------------------------

Boards with Keystone2 based devices (TCI66xxK2H) SOC shall have the
following properties.

Required properties:
 - compatible: All TI specific devices present in Keystone SOC should be in
   the form "ti,keystone-*". Generic devices like gic, arch_timers, ns16550
   type UART should use the specified compatible for those devices.

SoC families:

- Keystone 2 generic SoC:
   compatible = "ti,keystone"

SoCs:

- Keystone 2 Hawking/Kepler
   compatible = "ti,k2hk", "ti,keystone"
- Keystone 2 Lamarr
   compatible = "ti,k2l", "ti,keystone"
- Keystone 2 Edison
   compatible = "ti,k2e", "ti,keystone"
- K2G
   compatible = "ti,k2g", "ti,keystone"

Boards:
-  Keystone 2 Hawking/Kepler EVM
   compatible = "ti,k2hk-evm", "ti,k2hk", "ti,keystone"

-  Keystone 2 Lamarr EVM
   compatible = "ti,k2l-evm", "ti, k2l", "ti,keystone"

-  Keystone 2 Edison EVM
   compatible = "ti,k2e-evm", "ti,k2e", "ti,keystone"

-  K2G EVM
   compatible = "ti,k2g-evm", "ti,k2g", "ti-keystone"

-  K2G Industrial Communication Engine EVM
   compatible = "ti,k2g-ice", "ti,k2g", "ti-keystone"
```

## Documentation/devicetree/bindings/arm/keystone/ti,k3-sci-common.yaml
```yaml
# SPDX-License-Identifier: (GPL-2.0-only or BSD-2-Clause)
%YAML 1.2
---
$id: http://devicetree.org/schemas/arm/keystone/ti,k3-sci-common.yaml#
$schema: http://devicetree.org/meta-schemas/core.yaml#

title: Common K3 TI-SCI bindings

maintainers:
  - Nishanth Menon <nm@ti.com>

description: |
  The TI K3 family of SoCs usually have a central System Controller Processor
  that is responsible for managing various SoC-level resources like clocks,
  resets, interrupts etc. The communication with that processor is performed
  through the TI-SCI protocol.

  Each specific device management node like a clock controller node, a reset
  controller node or an interrupt-controller node should define a common set
  of properties that enables them to implement the corresponding functionality
  over the TI-SCI protocol. The following are some of the common properties
  needed by such individual nodes. The required properties for each device
  management node is defined in the respective binding.

properties:
  ti,sci:
    $ref: /schemas/types.yaml#/definitions/phandle
    description:
      Should be a phandle to the TI-SCI System Controller node

  ti,sci-dev-id:
    $ref: /schemas/types.yaml#/definitions/uint32
    description: |
      Should contain the TI-SCI device id corresponding to the device. Please
      refer to the corresponding System Controller documentation for valid
      values for the desired device.

  ti,sci-proc-ids:
    description: Should contain a single tuple of <proc_id host_id>.
    $ref: /schemas/types.yaml#/definitions/uint32-array
    items:
      - description: TI-SCI processor id for the remote processor device
      - description: TI-SCI host id to which processor control ownership
                     should be transferred to
```

## Documentation/devicetree/bindings/arm/keystone/ti,sci.txt
```
Texas Instruments System Control Interface (TI-SCI) Message Protocol
--------------------------------------------------------------------

Texas Instrument's processors including those belonging to Keystone generation
of processors have separate hardware entity which is now responsible for the
management of the System on Chip (SoC) system. These include various system
level functions as well.

An example of such an SoC is K2G, which contains the system control hardware
block called Power Management Micro Controller (PMMC). This hardware block is
initialized early into boot process and provides services to Operating Systems
on multiple processors including ones running Linux.

See http://processors.wiki.ti.com/index.php/TISCI for protocol definition.

TI-SCI controller Device Node:
=============================

The TI-SCI node describes the Texas Instrument's System Controller entity node.
This parent node may optionally have additional children nodes which describe
specific functionality such as clocks, power domain, reset or additional
functionality as may be required for the SoC. This hierarchy also describes the
relationship between the TI-SCI parent node to the child node.

Required properties:
-------------------
- compatible:	should be "ti,k2g-sci" for TI 66AK2G SoC
		should be "ti,am654-sci" for for TI AM654 SoC
- mbox-names:
	"rx" - Mailbox corresponding to receive path
	"tx" - Mailbox corresponding to transmit path

- mboxes: Mailboxes corresponding to the mbox-names. Each value of the mboxes
	  property should contain a phandle to the mailbox controller device
	  node and an args specifier that will be the phandle to the intended
	  sub-mailbox child node to be used for communication.

See Documentation/devicetree/bindings/mailbox/mailbox.txt for more details
about the generic mailbox controller and client driver bindings. Also see
Documentation/devicetree/bindings/mailbox/ti,message-manager.txt for typical
controller that is used to communicate with this System controllers.

Optional Properties:
-------------------
- reg-names:
	debug_messages - Map the Debug message region
- reg:  register space corresponding to the debug_messages
- ti,system-reboot-controller: If system reboot can be triggered by SoC reboot
- ti,host-id: Integer value corresponding to the host ID assigned by Firmware
	for identification of host processing entities such as virtual
	machines

Example (K2G):
-------------
	pmmc: pmmc {
		compatible = "ti,k2g-sci";
		ti,host-id = <2>;
		mbox-names = "rx", "tx";
		mboxes= <&msgmgr &msgmgr_proxy_pmmc_rx>,
			<&msgmgr &msgmgr_proxy_pmmc_tx>;
		reg-names = "debug_messages";
		reg = <0x02921800 0x800>;
	};


TI-SCI Client Device Node:
=========================

Client nodes are maintained as children of the relevant TI-SCI device node.

Example (K2G):
-------------
	pmmc: pmmc {
		compatible = "ti,k2g-sci";
		...

		my_clk_node: clk_node {
			...
			...
		};

		my_pd_node: pd_node {
			...
			...
		};
	};
```

## Documentation/devicetree/bindings/arm/keystone/ti,sci.yaml
```yaml
# SPDX-License-Identifier: (GPL-2.0-only OR BSD-2-Clause)
%YAML 1.2
---
$id: http://devicetree.org/schemas/arm/keystone/ti,sci.yaml#
$schema: http://devicetree.org/meta-schemas/core.yaml#

title: TI-SCI controller

maintainers:
  - Nishanth Menon <nm@ti.com>

description: |
  Texas Instrument's processors including those belonging to Keystone generation
  of processors have separate hardware entity which is now responsible for the
  management of the System on Chip (SoC) system. These include various system
  level functions as well.

  An example of such an SoC is K2G, which contains the system control hardware
  block called Power Management Micro Controller (PMMC). This hardware block is
  initialized early into boot process and provides services to Operating Systems
  on multiple processors including ones running Linux.

  See http://processors.wiki.ti.com/index.php/TISCI for protocol definition.

  The TI-SCI node describes the Texas Instrument's System Controller entity node.
  This parent node may optionally have additional children nodes which describe
  specific functionality such as clocks, power domain, reset or additional
  functionality as may be required for the SoC. This hierarchy also describes the
  relationship between the TI-SCI parent node to the child node.

properties:
  $nodename:
    pattern: "^system-controller@[0-9a-f]+$"

  compatible:
    oneOf:
      - description: System controller on TI 66AK2G SoC and other K3 SoCs
        items:
          - const: ti,k2g-sci
      - description: System controller on TI AM654 SoC
        items:
          - const: ti,am654-sci

  reg-names:
    description: |
      Specifies the debug messages memory mapped region that is optionally
      made available from TI-SCI controller.
    const: debug_messages

  reg:
    minItems: 1

  mbox-names:
    description: |
      Specifies the mailboxes used to communicate with TI-SCI Controller
      made available from TI-SCI controller.
    items:
      - const: rx
      - const: tx

  mboxes:
    minItems: 2

  ti,system-reboot-controller:
    description: Determines If system reboot can be triggered by SoC reboot
    type: boolean

  ti,host-id:
    $ref: /schemas/types.yaml#/definitions/uint32
    description: |
      Value corresponding to the host ID assigned by Firmware
      for identification of host processing entities such as virtual machines.

  power-controller:
    type: object
    $ref: /schemas/soc/ti/sci-pm-domain.yaml#

  clock-controller:
    type: object
    $ref: /schemas/clock/ti,sci-clk.yaml#

  reset-controller:
    type: object
    $ref: /schemas/reset/ti,sci-reset.yaml#

required:
  - compatible
  - mbox-names
  - mboxes

additionalProperties: false

examples:
  - |
    pmmc: system-controller@2921800 {
      compatible = "ti,k2g-sci";
      ti,system-reboot-controller;
      mbox-names = "rx", "tx";
      mboxes = <&msgmgr 5 2>,
               <&msgmgr 0 0>;
      reg-names = "debug_messages";
      reg = <0x02921800 0x800>;
    };

  - |
    dmsc: system-controller@44083000 {
      compatible = "ti,k2g-sci";
      ti,host-id = <12>;
      mbox-names = "rx", "tx";
      mboxes = <&secure_proxy_main 11>,
               <&secure_proxy_main 13>;
      reg-names = "debug_messages";
      reg = <0x44083000 0x1000>;

      k3_pds: power-controller {
        compatible = "ti,sci-pm-domain";
        #power-domain-cells = <2>;
      };

      k3_clks: clock-controller {
        compatible = "ti,k2g-sci-clk";
        #clock-cells = <2>;
      };

      k3_reset: reset-controller {
        compatible = "ti,sci-reset";
        #reset-cells = <2>;
      };
    };
```

## Documentation/devicetree/bindings/arm/kirkwood.txt
```
Marvell Kirkwood Platforms Device Tree Bindings
-----------------------------------------------

Boards with a SoC of the Marvell Kirkwood
shall have the following property:

Required root node property:

compatible: must contain "marvell,kirkwood";

In order to support the kirkwood cpufreq driver, there must be a node
cpus/cpu@0 with three clocks, "cpu_clk", "ddrclk" and "powersave",
where the "powersave" clock is a gating clock used to switch the CPU
between the "cpu_clk" and the "ddrclk".

Example:

	cpus {
		#address-cells = <1>;
		#size-cells = <0>;

		cpu@0 {
		      device_type = "cpu";
		      compatible = "marvell,sheeva-88SV131";
		      clocks = <&core_clk 1>, <&core_clk 3>, <&gate_clk 11>;
		      clock-names = "cpu_clk", "ddrclk", "powersave";
		};
```
