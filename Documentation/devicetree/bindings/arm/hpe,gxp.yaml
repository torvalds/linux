## Documentation/devicetree/bindings/arm/hpe,gxp.yaml
```yaml
# SPDX-License-Identifier: (GPL-2.0-only OR BSD-2-Clause)
%YAML 1.2
---
$id: http://devicetree.org/schemas/arm/hpe,gxp.yaml#
$schema: http://devicetree.org/meta-schemas/core.yaml#

title: HPE BMC GXP platforms

maintainers:
  - Nick Hawkins <nick.hawkins@hpe.com>
  - Jean-Marie Verdun <verdun@hpe.com>

properties:
  compatible:
    oneOf:
      - description: GXP Based Boards
        items:
          - enum:
              - hpe,gxp-dl360gen10
          - const: hpe,gxp

required:
  - compatible

additionalProperties: true

...
```

## Documentation/devicetree/bindings/arm/i2se.txt
```
I2SE Device Tree Bindings
-------------------------

Duckbill Board
Required root node properties:
    - compatible = "i2se,duckbill", "fsl,imx28";

Duckbill 2 Board
Required root node properties:
    - compatible = "i2se,duckbill-2", "fsl,imx28";

Duckbill 2 485 Board
Required root node properties:
    - compatible = "i2se,duckbill-2-485", "i2se,duckbill-2", "fsl,imx28";

Duckbill 2 EnOcean Board
Required root node properties:
    - compatible = "i2se,duckbill-2-enocean", "i2se,duckbill-2", "fsl,imx28";

Duckbill 2 SPI Board
Required root node properties:
    - compatible = "i2se,duckbill-2-spi", "i2se,duckbill-2", "fsl,imx28";
```
