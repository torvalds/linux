## Documentation/devicetree/bindings/arm/omap/timer.txt
```
OMAP Timer bindings

Required properties:
- compatible:		Should be set to one of the below. Please note that
			OMAP44xx devices have timer instances that are 100%
			register compatible with OMAP3xxx devices as well as
			newer timers that are not 100% register compatible.
			So for OMAP44xx devices timer instances may use
			different compatible strings.

			ti,omap2420-timer (applicable to OMAP24xx devices)
			ti,omap3430-timer (applicable to OMAP3xxx/44xx devices)
			ti,omap4430-timer (applicable to OMAP44xx devices)
			ti,omap5430-timer (applicable to OMAP543x devices)
			ti,am335x-timer	(applicable to AM335x devices)
			ti,am335x-timer-1ms (applicable to AM335x devices)

- reg:			Contains timer register address range (base address and
			length).
- interrupts: 		Contains the interrupt information for the timer. The
			format is being dependent on which interrupt controller
			the OMAP device uses.
- ti,hwmods:		Name of the hwmod associated to the timer, "timer<X>",
			where <X> is the instance number of the timer from the
			HW spec.

Optional properties:
- ti,timer-alwon:	Indicates the timer is in an alway-on power domain.
- ti,timer-dsp:		Indicates the timer can interrupt the on-chip DSP in
			addition to the ARM CPU.
- ti,timer-pwm: 	Indicates the timer can generate a PWM output.
- ti,timer-secure: 	Indicates the timer is reserved on a secure OMAP device
			and therefore cannot be used by the kernel.

Example:

timer12: timer@48304000 {
	compatible = "ti,omap3430-timer";
	reg = <0x48304000 0x400>;
	interrupts = <95>;
	ti,hwmods = "timer12"
	ti,timer-alwon;
	ti,timer-secure;
};
```

## Documentation/devicetree/bindings/arm/oxnas.txt
```
Oxford Semiconductor OXNAS SoCs Family device tree bindings
-------------------------------------------

Boards with the OX810SE SoC shall have the following properties:
  Required root node property:
    compatible: "oxsemi,ox810se"

Boards with the OX820 SoC shall have the following properties:
  Required root node property:
    compatible: "oxsemi,ox820"

Board compatible values:
  - "wd,mbwe" (OX810SE)
  - "cloudengines,pogoplugv3" (OX820)
```

## Documentation/devicetree/bindings/arm/picoxcell.txt
```
Picochip picoXcell device tree bindings.
========================================

Required root node properties:
    - compatible:
	- "picochip,pc7302-pc3x3" : PC7302 development board with PC3X3 device.
	- "picochip,pc7302-pc3x2" : PC7302 development board with PC3X2 device.
	- "picochip,pc3x3" : picoXcell PC3X3 device based board.
	- "picochip,pc3x2" : picoXcell PC3X2 device based board.

Timers required properties:
    - compatible = "picochip,pc3x2-timer"
    - interrupts : The single IRQ line for the timer.
    - clock-freq : The frequency in HZ of the timer.
    - reg : The register bank for the timer.

Note: two timers are required - one for the scheduler clock and one for the
event tick/NOHZ.

VIC required properties:
    - compatible = "arm,pl192-vic".
    - interrupt-controller.
    - reg : The register bank for the device.
    - #interrupt-cells : Must be 1.
```

## Documentation/devicetree/bindings/arm/pmu.txt
```
* ARM Performance Monitor Units

ARM cores often have a PMU for counting cpu and cache events like cache misses
and hits. The interface to the PMU is part of the ARM ARM. The ARM PMU
representation in the device tree should be done as under:-

Required properties:

- compatible : should be one of
	"arm,armv8-pmuv3"
	"arm.cortex-a57-pmu"
	"arm.cortex-a53-pmu"
	"arm,cortex-a17-pmu"
	"arm,cortex-a15-pmu"
	"arm,cortex-a12-pmu"
	"arm,cortex-a9-pmu"
	"arm,cortex-a8-pmu"
	"arm,cortex-a7-pmu"
	"arm,cortex-a5-pmu"
	"arm,arm11mpcore-pmu"
	"arm,arm1176-pmu"
	"arm,arm1136-pmu"
	"qcom,scorpion-pmu"
	"qcom,scorpion-mp-pmu"
	"qcom,krait-pmu"
- interrupts : 1 combined interrupt or 1 per core. If the interrupt is a per-cpu
               interrupt (PPI) then 1 interrupt should be specified.

Optional properties:

- interrupt-affinity : When using SPIs, specifies a list of phandles to CPU
                       nodes corresponding directly to the affinity of
		       the SPIs listed in the interrupts property.

                       When using a PPI, specifies a list of phandles to CPU
		       nodes corresponding to the set of CPUs which have
		       a PMU of this type signalling the PPI listed in the
		       interrupts property.

                       This property should be present when there is more than
		       a single SPI.


- qcom,no-pc-write : Indicates that this PMU doesn't support the 0xc and 0xd
                     events.

Example:

pmu {
        compatible = "arm,cortex-a9-pmu";
        interrupts = <100 101>;
};
```

## Documentation/devicetree/bindings/arm/pmu.yaml
```yaml
# SPDX-License-Identifier: GPL-2.0
%YAML 1.2
---
$id: http://devicetree.org/schemas/arm/pmu.yaml#
$schema: http://devicetree.org/meta-schemas/core.yaml#

title: ARM Performance Monitor Units

maintainers:
  - Mark Rutland <mark.rutland@arm.com>
  - Will Deacon <will.deacon@arm.com>

description: |+
  ARM cores often have a PMU for counting cpu and cache events like cache misses
  and hits. The interface to the PMU is part of the ARM ARM. The ARM PMU
  representation in the device tree should be done as under:-

properties:
  compatible:
    items:
      - enum:
          - apm,potenza-pmu
          - apple,avalanche-pmu
          - apple,blizzard-pmu
          - apple,firestorm-pmu
          - apple,icestorm-pmu
          - arm,armv8-pmuv3 # Only for s/w models
          - arm,arm1136-pmu
          - arm,arm1176-pmu
          - arm,arm11mpcore-pmu
          - arm,cortex-a5-pmu
          - arm,cortex-a7-pmu
          - arm,cortex-a8-pmu
          - arm,cortex-a9-pmu
          - arm,cortex-a12-pmu
          - arm,cortex-a15-pmu
          - arm,cortex-a17-pmu
          - arm,cortex-a32-pmu
          - arm,cortex-a34-pmu
          - arm,cortex-a35-pmu
          - arm,cortex-a53-pmu
          - arm,cortex-a55-pmu
          - arm,cortex-a57-pmu
          - arm,cortex-a65-pmu
          - arm,cortex-a72-pmu
          - arm,cortex-a73-pmu
          - arm,cortex-a75-pmu
          - arm,cortex-a76-pmu
          - arm,cortex-a77-pmu
          - arm,cortex-a78-pmu
          - arm,cortex-a510-pmu
          - arm,cortex-a520-pmu
          - arm,cortex-a710-pmu
          - arm,cortex-a715-pmu
          - arm,cortex-a720-pmu
          - arm,cortex-a725-pmu
          - arm,cortex-x1-pmu
          - arm,cortex-x2-pmu
          - arm,cortex-x3-pmu
          - arm,cortex-x4-pmu
          - arm,cortex-x925-pmu
          - arm,neoverse-e1-pmu
          - arm,neoverse-n1-pmu
          - arm,neoverse-n2-pmu
          - arm,neoverse-n3-pmu
          - arm,neoverse-v1-pmu
          - arm,neoverse-v2-pmu
          - arm,neoverse-v3-pmu
          - arm,neoverse-v3ae-pmu
          - brcm,vulcan-pmu
          - cavium,thunder-pmu
          - nvidia,denver-pmu
          - nvidia,carmel-pmu
          - qcom,krait-pmu
          - qcom,scorpion-pmu
          - qcom,scorpion-mp-pmu

  interrupts:
    # Don't know how many CPUs, so no constraints to specify
    description: 1 per-cpu interrupt (PPI) or 1 interrupt per core.

  interrupt-affinity:
    $ref: /schemas/types.yaml#/definitions/phandle-array
    items:
      maxItems: 1
    description:
      When using SPIs, specifies a list of phandles to CPU
      nodes corresponding directly to the affinity of
      the SPIs listed in the interrupts property.

      When using a PPI, specifies a list of phandles to CPU
      nodes corresponding to the set of CPUs which have
      a PMU of this type signalling the PPI listed in the
      interrupts property, unless this is already specified
      by the PPI interrupt specifier itself (in which case
      the interrupt-affinity property shouldn't be present).

      This property should be present when there is more than
      a single SPI.

  qcom,no-pc-write:
    type: boolean
    description:
      Indicates that this PMU doesn't support the 0xc and 0xd events.

  secure-reg-access:
    type: boolean
    description:
      Indicates that the ARMv7 Secure Debug Enable Register
      (SDER) is accessible. This will cause the driver to do
      any setup required that is only possible in ARMv7 secure
      state. If not present the ARMv7 SDER will not be touched,
      which means the PMU may fail to operate unless external
      code (bootloader or security monitor) has performed the
      appropriate initialisation. Note that this property is
      not valid for non-ARMv7 CPUs or ARMv7 CPUs booting Linux
      in Non-secure state.

required:
  - compatible

additionalProperties: false

...
```

## Documentation/devicetree/bindings/arm/primecell.txt
```
* ARM Primecell Peripherals

ARM, Ltd. Primecell peripherals have a standard id register that can be used to
identify the peripheral type, vendor, and revision. This value can be used for
driver matching.

Required properties:

- compatible : should be a specific name for the peripheral and
               "arm,primecell".  The specific name will match the ARM
               engineering name for the logic block in the form: "arm,pl???"

Optional properties:

- arm,primecell-periphid : Value to override the h/w value with
- clocks : From common clock binding. First clock is phandle to clock for apb
	pclk. Additional clocks are optional and specific to those peripherals.
- clock-names : From common clock binding. Shall be "apb_pclk" for first clock.
- dmas : From common DMA binding. If present, refers to one or more dma channels.
- dma-names : From common DMA binding, needs to match the 'dmas' property.
              Devices with exactly one receive and transmit channel shall name
              these "rx" and "tx", respectively.
- pinctrl-<n> : Pinctrl states as described in bindings/pinctrl/pinctrl-bindings.txt
- pinctrl-names : Names corresponding to the numbered pinctrl states
- interrupts : one or more interrupt specifiers
- interrupt-names : names corresponding to the interrupts properties

Example:

serial@fff36000 {
	compatible = "arm,pl011", "arm,primecell";
	arm,primecell-periphid = <0x00341011>;

	clocks = <&pclk>;
	clock-names = "apb_pclk";

	dmas = <&dma-controller 4>, <&dma-controller 5>;
	dma-names = "rx", "tx";	

	pinctrl-0 = <&uart0_default_mux>, <&uart0_default_mode>;
	pinctrl-1 = <&uart0_sleep_mode>;
	pinctrl-names = "default","sleep";

	interrupts = <0 11 0x4>;
};
```

## Documentation/devicetree/bindings/arm/primecell.yaml
```yaml
# SPDX-License-Identifier: GPL-2.0
%YAML 1.2
---
$id: http://devicetree.org/schemas/arm/primecell.yaml#
$schema: http://devicetree.org/meta-schemas/core.yaml#

title: ARM Primecell Peripherals

maintainers:
  - Rob Herring <robh@kernel.org>

description: |+
  ARM, Ltd. Primecell peripherals have a standard id register that can be used to
  identify the peripheral type, vendor, and revision. This value can be used for
  driver matching.

properties:
  compatible:
    contains:
      const: arm,primecell
    description:
      Should be a specific name for the peripheral followed by "arm,primecell".
      The specific name will match the ARM engineering name for the logic block
      in the form "arm,pl???"

  arm,primecell-periphid:
    $ref: /schemas/types.yaml#/definitions/uint32
    description: Value to override the h/w ID value
  clocks:
    minItems: 1
    maxItems: 32
  clock-names:
    contains:
      const: apb_pclk
    additionalItems: true
...
```

## Documentation/devicetree/bindings/arm/priority_control_manager.txt
```
# SPDX-License-Identifier: GPL-2.0 WITH Linux-syscall-note
#
# (C) COPYRIGHT 2020-2021 ARM Limited. All rights reserved.
#
# This program is free software and is provided to you under the terms of the
# GNU General Public License version 2 as published by the Free Software
# Foundation, and any use by you of this program is subject to the terms
# of such GNU license.
#
# This program is distributed in the hope that it will be useful,
# but WITHOUT ANY WARRANTY; without even the implied warranty of
# MERCHANTABILITY or FITNESS FOR A PARTICULAR PURPOSE. See the
# GNU General Public License for more details.
#
# You should have received a copy of the GNU General Public License
# along with this program; if not, you can access it online at
# http://www.gnu.org/licenses/gpl-2.0.html.
#
#

* Arm priority control manager for Mali GPU device drivers

Required properties:

- compatible: Must be "arm,priority-control-manager"

An example node:

        gpu_priority_control_manager: priority-control-manager {
                compatible = "arm,priority-control-manager";
        };

It must be referenced by the GPU as well, see priority-control-manager:

	gpu: gpu@0x6e000000 {
		compatible = "arm,mali-midgard";
		reg = <0x0 0x6e000000 0x0 0x200000>;
		interrupts = <0 168 4>, <0 168 4>, <0 168 4>;
		interrupt-names = "JOB", "MMU", "GPU";
		clocks = <&scpi_dvfs 2>;
		clock-names = "clk_mali";
		system-coherency = <31>;
		priority-control-manager = <&gpu_priority_control_manager>;
		operating-points = <
			/* KHz uV */
			50000 820000
		>;
	};
```

## Documentation/devicetree/bindings/arm/protected_memory_allocator.txt
```
# SPDX-License-Identifier: GPL-2.0 WITH Linux-syscall-note
#
# (C) COPYRIGHT 2019-2021 ARM Limited. All rights reserved.
#
# This program is free software and is provided to you under the terms of the
# GNU General Public License version 2 as published by the Free Software
# Foundation, and any use by you of this program is subject to the terms
# of such GNU license.
#
# This program is distributed in the hope that it will be useful,
# but WITHOUT ANY WARRANTY; without even the implied warranty of
# MERCHANTABILITY or FITNESS FOR A PARTICULAR PURPOSE. See the
# GNU General Public License for more details.
#
# You should have received a copy of the GNU General Public License
# along with this program; if not, you can access it online at
# http://www.gnu.org/licenses/gpl-2.0.html.
#
#

* Arm protected memory allocator for Mali GPU device drivers

Required properties:

- compatible: Must be "arm,protected-memory-allocator"

The protected memory allocator manages allocation of physical pages of a
reserved memory region of protected memory, therefore its device node shall
reference a reserved memory region.

In addition to that, the protected memory allocator shall be referenced
by the GPU.

A complete example configuration for the device tree:

	reserved-memory {
		#address-cells = <2>;
		#size-cells = <2>;
		ranges;

		mali_protected: mali_protected@c0000000 {
			compatible = "mali-reserved";
			reg = <0x0 0xc0000000 0x0 0x1000000>;
		};
	};

	gpu_protected_memory_allocator: protected-memory-allocator {
		compatible = "arm,protected-memory-allocator";
		memory-region = <&mali_protected>;
	};

	gpu_fpga: gpu@0x6e000000 {
		compatible = "arm,mali-midgard";
		reg = <0x0 0x6e000000 0x0 0x200000>;
		interrupts = <0 168 4>, <0 168 4>, <0 168 4>;
		interrupt-names = "JOB", "MMU", "GPU";
		clocks = <&scpi_dvfs 2>;
		clock-names = "clk_mali";
		protected-memory-allocator = <&gpu_protected_memory_allocator>;
		operating-points = <
			/* KHz uV */
			50000 820000
		>;
	};

The protected memory allocator is gpu_protected_memory_allocator.
It references the mali_protected reserved memory region and, in turn,
it is referenced by the GPU as protected-memory-allocator.
```
