## Documentation/devicetree/bindings/arm/qcom,coresight-remote-etm.yaml
```yaml
# SPDX-License-Identifier: GPL-2.0-only OR BSD-2-Clause
%YAML 1.2
---
$id: http://devicetree.org/schemas/arm/qcom,coresight-remote-etm.yaml#
$schema: http://devicetree.org/meta-schemas/core.yaml#

title: Qualcomm Coresight Remote ETM(Embedded Trace Macrocell)

maintainers:
  - Jinlong Mao <quic_jinlmao@quicinc.com>
  - Tao Zhang <quic_taozha@quicinc.com>

description:
  Support for ETM trace collection on remote processor using coresight
  framework. Enabling this will allow turning on ETM tracing on remote
  processor like modem processor via sysfs and collecting the trace
  via coresight TMC sinks.

properties:
  compatible:
    const: qcom,coresight-remote-etm

  label:
    description:
      Description of a coresight device.

  out-ports:
    $ref: /schemas/graph.yaml#/properties/ports
    additionalProperties: false

    properties:
      port:
        description: Output connection to the CoreSight Trace bus.
        $ref: /schemas/graph.yaml#/properties/port

required:
  - compatible
  - out-ports

additionalProperties: false

examples:
  - |
    etm {
        compatible = "qcom,coresight-remote-etm";

        out-ports {
            port {
                modem_etm0_out_funnel_modem: endpoint {
                    remote-endpoint = <&funnel_modem_in_modem_etm0>;
                };
            };
        };
    };
...
```
