## Documentation/devicetree/bindings/arm/omap/crossbar.txt
```
Some socs have a large number of interrupts requests to service
the needs of its many peripherals and subsystems. All of the
interrupt lines from the subsystems are not needed at the same
time, so they have to be muxed to the irq-controller appropriately.
In such places a interrupt controllers are preceded by an CROSSBAR
that provides flexibility in muxing the device requests to the controller
inputs.

Required properties:
- compatible : Should be "ti,irq-crossbar"
- reg: Base address and the size of the crossbar registers.
- interrupt-controller: indicates that this block is an interrupt controller.
- interrupt-parent: the interrupt controller this block is connected to.
- ti,max-irqs: Total number of irqs available at the parent interrupt controller.
- ti,max-crossbar-sources: Maximum number of crossbar sources that can be routed.
- ti,reg-size: Size of a individual register in bytes. Every individual
	    register is assumed to be of same size. Valid sizes are 1, 2, 4.
- ti,irqs-reserved: List of the reserved irq lines that are not muxed using
		 crossbar. These interrupt lines are reserved in the soc,
		 so crossbar bar driver should not consider them as free
		 lines.

Optional properties:
- ti,irqs-skip: This is similar to "ti,irqs-reserved", but these are for
  SOC-specific hard-wiring of those irqs which unexpectedly bypasses the
  crossbar. These irqs have a crossbar register, but still cannot be used.

- ti,irqs-safe-map: integer which maps to a safe configuration to use
  when the interrupt controller irq is unused (when not provided, default is 0)

Examples:
		crossbar_mpu: crossbar@4a002a48 {
			compatible = "ti,irq-crossbar";
			reg = <0x4a002a48 0x130>;
			ti,max-irqs = <160>;
			ti,max-crossbar-sources = <400>;
			ti,reg-size = <2>;
			ti,irqs-reserved = <0 1 2 3 5 6 131 132>;
			ti,irqs-skip = <10 133 139 140>;
		};

Consumer:
========
See Documentation/devicetree/bindings/interrupt-controller/interrupts.txt and
Documentation/devicetree/bindings/interrupt-controller/arm,gic.txt for
further details.

An interrupt consumer on an SoC using crossbar will use:
	interrupts = <GIC_SPI request_number interrupt_level>

Example:
	device_x@4a023000 {
		/* Crossbar 8 used */
		interrupts = <GIC_SPI 8 IRQ_TYPE_LEVEL_HIGH>;
		...
	};
```

## Documentation/devicetree/bindings/arm/omap/ctrl.txt
```
OMAP Control Module bindings

Control Module contains miscellaneous features under it based on SoC type.
Pincontrol is one common feature, and it has a specialized support
described in [1]. Typically some clock nodes are also under control module.
Syscon is used to share register level access to drivers external to
control module driver itself.

See [2] for documentation about clock/clockdomain nodes.

[1] Documentation/devicetree/bindings/pinctrl/pinctrl-single.yaml
[2] Documentation/devicetree/bindings/clock/ti/*

Required properties:
- compatible:	Must be one of:
		"ti,am3-scm"
		"ti,am4-scm"
		"ti,dm814-scrm"
		"ti,dm816-scrm"
		"ti,omap2-scm"
		"ti,omap3-scm"
		"ti,omap4-scm-core"
		"ti,omap4-scm-padconf-core"
		"ti,omap4-scm-wkup"
		"ti,omap4-scm-padconf-wkup"
		"ti,omap5-scm-core"
		"ti,omap5-scm-padconf-core"
		"ti,omap5-scm-wkup-pad-conf"
		"ti,dra7-scm-core"
- reg:		Contains Control Module register address range
		(base address and length)

Optional properties:
- clocks:	clocks for this module
- clockdomains:	clockdomains for this module

Examples:

scm: scm@2000 {
	compatible = "ti,omap3-scm", "simple-bus";
	reg = <0x2000 0x2000>;
	#address-cells = <1>;
	#size-cells = <1>;
	ranges = <0 0x2000 0x2000>;

	omap3_pmx_core: pinmux@30 {
		compatible = "ti,omap3-padconf",
			     "pinctrl-single";
		reg = <0x30 0x230>;
		#address-cells = <1>;
		#size-cells = <0>;
		#interrupt-cells = <1>;
		interrupt-controller;
		pinctrl-single,register-width = <16>;
		pinctrl-single,function-mask = <0xff1f>;
	};

	scm_conf: scm_conf@270 {
		compatible = "syscon";
		reg = <0x270 0x330>;
		#address-cells = <1>;
		#size-cells = <1>;

		scm_clocks: clocks {
			#address-cells = <1>;
			#size-cells = <0>;
		};
	};

	scm_clockdomains: clockdomains {
	};
}

&scm_clocks {
	mcbsp5_mux_fck: mcbsp5_mux_fck {
		#clock-cells = <0>;
		compatible = "ti,composite-mux-clock";
		clocks = <&core_96m_fck>, <&mcbsp_clks>;
		ti,bit-shift = <4>;
		reg = <0x02d8>;
	};
};
```

## Documentation/devicetree/bindings/arm/omap/dmm.txt
```
OMAP Dynamic Memory Manager (DMM) bindings

The dynamic memory manager (DMM) is a module located immediately in front of the
SDRAM controllers (called EMIFs on OMAP). DMM manages various aspects of memory
accesses such as priority generation amongst initiators, configuration of SDRAM
interleaving, optimizing transfer of 2D block objects, and provide MMU-like page
translation for initiators which need contiguous dma bus addresses.

Required properties:
- compatible:	Should contain "ti,omap4-dmm" for OMAP4 family
		Should contain "ti,omap5-dmm" for OMAP5 and DRA7x family
- reg:		Contains DMM register address range (base address and length)
- interrupts:	Should contain an interrupt-specifier for DMM_IRQ.
- ti,hwmods:	Name of the hwmod associated to DMM, which is typically "dmm"

Example:

dmm@4e000000 {
	compatible = "ti,omap4-dmm";
	reg = <0x4e000000 0x800>;
	ti,hwmods = "dmm";
};
```

## Documentation/devicetree/bindings/arm/omap/dsp.txt
```
* TI - DSP (Digital Signal Processor)

TI DSP included in OMAP SoC

Required properties:
- compatible : Should be "ti,omap3-c64" for OMAP3 & 4
- ti,hwmods: "dsp"

Examples:

dsp {
    compatible = "ti,omap3-c64";
    ti,hwmods = "dsp";
};
```

## Documentation/devicetree/bindings/arm/omap/iva.txt
```
* TI - IVA (Imaging and Video Accelerator) subsystem

The IVA contain various audio, video or imaging HW accelerator
depending of the version.

Required properties:
- compatible : Should be:
  - "ti,ivahd" for OMAP4
  - "ti,iva2.2" for OMAP3
  - "ti,iva2.1" for OMAP2430
  - "ti,iva1" for OMAP2420
- ti,hwmods: "iva"

Examples:

iva {
    compatible = "ti,ivahd", "ti,iva";
    ti,hwmods = "iva";
};
```

## Documentation/devicetree/bindings/arm/omap/l3-noc.txt
```
* TI - L3 Network On Chip (NoC)

This version is an implementation of the generic NoC IP
provided by Arteris.

Required properties:
- compatible : Should be "ti,omap3-l3-smx" for OMAP3 family
               Should be "ti,omap4-l3-noc" for OMAP4 family
               Should be "ti,omap5-l3-noc" for OMAP5 family
	       Should be "ti,dra7-l3-noc" for DRA7 family
               Should be "ti,am4372-l3-noc" for AM43 family
- reg:	Contains L3 register address range for each noc domain.
- ti,hwmods: "l3_main_1", ... One hwmod for each noc domain.

Examples:

ocp {
	compatible = "ti,omap4-l3-noc", "simple-bus";
	#address-cells = <1>;
	#size-cells = <1>;
	ranges;
	ti,hwmods = "l3_main_1", "l3_main_2", "l3_main_3";
};
```

## Documentation/devicetree/bindings/arm/omap/l4.txt
```
L4 interconnect bindings

These bindings describe the OMAP SoCs L4 interconnect bus.

Required properties:
- compatible : Should be "ti,omap2-l4" for OMAP2 family l4 core bus
	       Should be "ti,omap2-l4-wkup" for OMAP2 family l4 wkup bus
	       Should be "ti,omap3-l4-core" for OMAP3 family l4 core bus
	       Should be "ti,omap4-l4-cfg" for OMAP4 family l4 cfg bus
	       Should be "ti,omap4-l4-per" for OMAP4 family l4 per bus
	       Should be "ti,omap4-l4-wkup" for OMAP4 family l4 wkup bus
	       Should be "ti,omap5-l4-cfg" for OMAP5 family l4 cfg bus
	       Should be "ti,omap5-l4-wkup" for OMAP5 family l4 wkup bus
	       Should be "ti,dra7-l4-cfg" for DRA7 family l4 cfg bus
	       Should be "ti,dra7-l4-wkup" for DRA7 family l4 wkup bus
	       Should be "ti,am3-l4-wkup" for AM33xx family l4 wkup bus
	       Should be "ti,am4-l4-wkup" for AM43xx family l4 wkup bus
- ranges : contains the IO map range for the bus
- reg : registers link agent and interconnect agent and access protection
- reg-names : "la" for link agent, "ia0" to "ia3" for one to three
              interconnect agent instances, "ap" for access if it exists

Examples:

l4: interconnect@48000000 {
	compatible "ti,omap4-l4-per", "simple-bus";
	reg = <0x48000000 0x800>,
	      <0x48000800 0x800>,
	      <0x48001000 0x400>,
	      <0x48001400 0x400>,
	      <0x48001800 0x400>,
	      <0x48001c00 0x400>;
	reg-names = "ap", "la", "ia0", "ia1", "ia2", "ia3";
	#address-cells = <1>;
	#size-cells = <1>;
	ranges = <0 0x48000000 0x100000>;
};
```

## Documentation/devicetree/bindings/arm/omap/mpu.txt
```
* TI - MPU (Main Processor Unit) subsystem

The MPU subsystem contain one or several ARM cores
depending of the version.
The MPU contain CPUs, GIC, L2 cache and a local PRCM.

Required properties:
- compatible : Should be "ti,omap3-mpu" for OMAP3
               Should be "ti,omap4-mpu" for OMAP4
	       Should be "ti,omap5-mpu" for OMAP5
- ti,hwmods: "mpu"

Optional properties:
- sram:	Phandle to the ocmcram node

am335x and am437x only:
- pm-sram: Phandles to ocmcram nodes to be used for power management.
	   First should be type 'protect-exec' for the driver to use to copy
	   and run PM functions, second should be regular pool to be used for
	   data region for code. See Documentation/devicetree/bindings/sram/sram.yaml
	   for more details.

Examples:

- For an OMAP5 SMP system:

mpu {
    compatible = "ti,omap5-mpu";
    ti,hwmods = "mpu"
};

- For an OMAP4 SMP system:

mpu {
    compatible = "ti,omap4-mpu";
    ti,hwmods = "mpu";
};


- For an OMAP3 monocore system:

mpu {
    compatible = "ti,omap3-mpu";
    ti,hwmods = "mpu";
};

- For an AM335x system:

mpu {
	compatible = "ti,omap3-mpu";
	ti,hwmods = "mpu";
	pm-sram = <&pm_sram_code
		   &pm_sram_data>;
};
```

## Documentation/devicetree/bindings/arm/omap/omap.txt
```
* Texas Instruments OMAP

OMAP is currently using a static file per SoC family to describe the
IPs present in the SoC.
On top of that an omap_device is created to extend the platform_device
capabilities and to allow binding with one or several hwmods.
The hwmods will contain all the information to build the device:
address range, irq lines, dma lines, interconnect, PRCM register,
clock domain, input clocks.
For the moment just point to the existing hwmod, the next step will be
to move data from hwmod to device-tree representation.


Required properties:
- compatible: Every devices present in OMAP SoC should be in the
  form: "ti,XXX"
- ti,hwmods: list of hwmod names (ascii strings), that comes from the OMAP
  HW documentation, attached to a device. Must contain at least
  one hwmod.

Optional properties:
- ti,no_idle_on_suspend: When present, it prevents the PM to idle the module
  during suspend.
- ti,no-reset-on-init: When present, the module should not be reset at init
- ti,no-idle-on-init: When present, the module should not be idled at init
- ti,no-idle: When present, the module is never allowed to idle.

Example:

spinlock@1 {
    compatible = "ti,omap4-spinlock";
    ti,hwmods = "spinlock";
};

SoC Type (optional):

- General Purpose devices
  compatible = "ti,gp"
- High Security devices
  compatible = "ti,hs"

SoC Families:

- DRA7 generic - defaults to DRA742
  compatible = "ti,dra7"
- AM33x generic
  compatible = "ti,am33xx"
- AM43x generic - defaults to AM4372
  compatible = "ti,am43"

SoCs:

- DRA762
  compatible = "ti,dra762", "ti,dra7"

- DRA742
  compatible = "ti,dra742", "ti,dra74", "ti,dra7"

- DRA722
  compatible = "ti,dra722", "ti,dra72", "ti,dra7"

- DRA718
  compatible = "ti,dra718", "ti,dra722", "ti,dra72", "ti,dra7"

- AM5748
  compatible = "ti,am5748", "ti,dra762", "ti,dra7"

- AM5728
  compatible = "ti,am5728", "ti,dra742", "ti,dra74", "ti,dra7"

- AM5726
  compatible = "ti,am5726", "ti,dra742", "ti,dra74", "ti,dra7"

- AM5718
  compatible = "ti,am5718", "ti,dra722", "ti,dra72", "ti,dra7"

- AM5716
  compatible = "ti,am5716", "ti,dra722", "ti,dra72", "ti,dra7"

- AM4372
  compatible = "ti,am4372", "ti,am43"

Boards (incomplete list of examples):


- AM437x CM-T43
  compatible = "compulab,am437x-cm-t43", "ti,am4372", "ti,am43"

- AM437x SBC-T43
  compatible = "compulab,am437x-sbc-t43", "compulab,am437x-cm-t43", "ti,am4372", "ti,am43"

- AM43x EPOS EVM
  compatible = "ti,am43x-epos-evm", "ti,am43", "ti,am438x"

- AM437x GP EVM
  compatible = "ti,am437x-gp-evm", "ti,am4372", "ti,am43"

- AM437x SK EVM: AM437x StarterKit Evaluation Module
  compatible = "ti,am437x-sk-evm", "ti,am4372", "ti,am43"

- AM57XX CL-SOM-AM57x
  compatible = "compulab,cl-som-am57x", "ti,am5728", "ti,dra742", "ti,dra74", "ti,dra7"

- AM57XX SBC-AM57x
  compatible = "compulab,sbc-am57x", "compulab,cl-som-am57x", "ti,am5728", "ti,dra742", "ti,dra74", "ti,dra7"

- AM5748 IDK
  compatible = "ti,am5748-idk", "ti,am5748", "ti,dra762", "ti,dra7";

- AM5728 IDK
  compatible = "ti,am5728-idk", "ti,am5728", "ti,dra742", "ti,dra74", "ti,dra7"

- AM5718 IDK
  compatible = "ti,am5718-idk", "ti,am5718", "ti,dra7"

- DRA762 EVM:  Software Development Board for DRA762
  compatible = "ti,dra76-evm", "ti,dra762", "ti,dra7"

- DRA742 EVM:  Software Development Board for DRA742
  compatible = "ti,dra7-evm", "ti,dra742", "ti,dra74", "ti,dra7"

- DRA722 EVM: Software Development Board for DRA722
  compatible = "ti,dra72-evm", "ti,dra722", "ti,dra72", "ti,dra7"

- DRA718 EVM: Software Development Board for DRA718
  compatible = "ti,dra718-evm", "ti,dra718", "ti,dra722", "ti,dra72", "ti,dra7"
```

## Documentation/devicetree/bindings/arm/omap/prcm.txt
```
OMAP PRCM bindings

Power Reset and Clock Manager lists the device clocks and clockdomains under
a DT hierarchy. Each TI SoC can have multiple PRCM entities listed for it,
each describing one module and the clock hierarchy under it. see [1] for
documentation about the individual clock/clockdomain nodes.

[1] Documentation/devicetree/bindings/clock/ti/*

Required properties:
- compatible:	Must be one of:
		"ti,am3-prcm"
		"ti,am3-scrm"
		"ti,am4-prcm"
		"ti,am4-scrm"
		"ti,omap2-prcm"
		"ti,omap2-scrm"
		"ti,omap3-prm"
		"ti,omap3-cm"
		"ti,omap3-scrm"
		"ti,omap4-cm1"
		"ti,omap4-prm"
		"ti,omap4-cm2"
		"ti,omap4-scrm"
		"ti,omap5-prm"
		"ti,omap5-cm-core-aon"
		"ti,omap5-scrm"
		"ti,omap5-cm-core"
		"ti,dra7-prm"
		"ti,dra7-cm-core-aon"
		"ti,dra7-cm-core"
- reg:		Contains PRCM module register address range
		(base address and length)
- clocks:	clocks for this module
- clockdomains:	clockdomains for this module

Example:

cm: cm@48004000 {
	compatible = "ti,omap3-cm";
	reg = <0x48004000 0x4000>;

	cm_clocks: clocks {
		#address-cells = <1>;
		#size-cells = <0>;
	};

	cm_clockdomains: clockdomains {
	};
}

&cm_clocks {
	omap2_32k_fck: omap_32k_fck {
		#clock-cells = <0>;
		compatible = "fixed-clock";
		clock-frequency = <32768>;
	};
};

&cm_clockdomains {
	core_l3_clkdm: core_l3_clkdm {
		compatible = "ti,clockdomain";
		clocks = <&sdrc_ick>;
	};
};
```

## Documentation/devicetree/bindings/arm/omap/prm-inst.txt
```
OMAP PRM instance bindings

Power and Reset Manager is an IP block on OMAP family of devices which
handle the power domains and their current state, and provide reset
handling for the domains and/or separate IP blocks under the power domain
hierarchy.

Required properties:
- compatible:	Must contain one of the following:
		"ti,am3-prm-inst"
		"ti,am4-prm-inst"
		"ti,omap4-prm-inst"
		"ti,omap5-prm-inst"
		"ti,dra7-prm-inst"
		and additionally must contain:
		"ti,omap-prm-inst"
- reg:		Contains PRM instance register address range
		(base address and length)

Optional properties:
- #power-domain-cells:	Should be 0 if the instance is a power domain provider.
- #reset-cells:	Should be 1 if the PRM instance in question supports resets.

Example:

prm_dsp2: prm@1b00 {
	compatible = "ti,dra7-prm-inst", "ti,omap-prm-inst";
	reg = <0x1b00 0x40>;
	#power-domain-cells = <0>;
	#reset-cells = <1>;
};
```
