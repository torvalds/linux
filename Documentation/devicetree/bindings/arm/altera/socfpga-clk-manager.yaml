## Documentation/devicetree/bindings/arm/amlogic.txt
```
Amlogic MesonX device tree bindings
-------------------------------------------

Work in progress statement:

Device tree files and bindings applying to Amlogic SoCs and boards are
considered "unstable". Any Amlogic device tree binding may change at
any time. Be sure to use a device tree binary and a kernel image
generated from the same source tree.

Please refer to Documentation/devicetree/bindings/ABI.txt for a definition of a
stable binding/ABI.

---------------------------------------------------------------

Boards with the Amlogic Meson6 SoC shall have the following properties:
  Required root node property:
    compatible: "amlogic,meson6"

Boards with the Amlogic Meson8 SoC shall have the following properties:
  Required root node property:
    compatible: "amlogic,meson8";

Boards with the Amlogic Meson8b SoC shall have the following properties:
  Required root node property:
    compatible: "amlogic,meson8b";

Boards with the Amlogic Meson8m2 SoC shall have the following properties:
  Required root node property:
    compatible: "amlogic,meson8m2";

Boards with the Amlogic Meson GXBaby SoC shall have the following properties:
  Required root node property:
    compatible: "amlogic,meson-gxbb";

Boards with the Amlogic Meson GXL S905X SoC shall have the following properties:
  Required root node property:
    compatible: "amlogic,s905x", "amlogic,meson-gxl";

Boards with the Amlogic Meson GXL S905D SoC shall have the following properties:
  Required root node property:
    compatible: "amlogic,s905d", "amlogic,meson-gxl";

Boards with the Amlogic Meson GXL S805X SoC shall have the following properties:
  Required root node property:
    compatible: "amlogic,s805x", "amlogic,meson-gxl";

Boards with the Amlogic Meson GXL S905W SoC shall have the following properties:
  Required root node property:
    compatible: "amlogic,s905w", "amlogic,meson-gxl";

Boards with the Amlogic Meson GXM S912 SoC shall have the following properties:
  Required root node property:
    compatible: "amlogic,s912", "amlogic,meson-gxm";

Boards with the Amlogic Meson AXG A113D SoC shall have the following properties:
  Required root node property:
    compatible: "amlogic,a113d", "amlogic,meson-axg";

Boards with the Amlogic Meson G12A S905D2 SoC shall have the following properties:
  Required root node property:
    compatible: "amlogic,g12a";

Board compatible values (alphabetically, grouped by SoC):

  - "geniatech,atv1200" (Meson6)

  - "minix,neo-x8" (Meson8)

  - "hardkernel,odroid-c1" (Meson8b)
  - "tronfy,mxq" (Meson8b)

  - "tronsmart,mxiii-plus" (Meson8m2)

  - "amlogic,p200" (Meson gxbb)
  - "amlogic,p201" (Meson gxbb)
  - "friendlyarm,nanopi-k2" (Meson gxbb)
  - "hardkernel,odroid-c2" (Meson gxbb)
  - "nexbox,a95x" (Meson gxbb or Meson gxl s905x)
  - "tronsmart,vega-s95-pro", "tronsmart,vega-s95" (Meson gxbb)
  - "tronsmart,vega-s95-meta", "tronsmart,vega-s95" (Meson gxbb)
  - "tronsmart,vega-s95-telos", "tronsmart,vega-s95" (Meson gxbb)
  - "wetek,hub" (Meson gxbb)
  - "wetek,play2" (Meson gxbb)

  - "amlogic,p212" (Meson gxl s905x)
  - "hwacom,amazetv" (Meson gxl s905x)
  - "khadas,vim" (Meson gxl s905x)
  - "libretech,cc" (Meson gxl s905x)

  - "amlogic,p230" (Meson gxl s905d)
  - "amlogic,p231" (Meson gxl s905d)

  - "amlogic,p241" (Meson gxl s805x)

  - "amlogic,p281" (Meson gxl s905w)
  - "oranth,tx3-mini" (Meson gxl s905w)

  - "amlogic,q200" (Meson gxm s912)
  - "amlogic,q201" (Meson gxm s912)
  - "khadas,vim2" (Meson gxm s912)
  - "kingnovel,r-box-pro" (Meson gxm S912)
  - "nexbox,a1" (Meson gxm s912)
  - "tronsmart,vega-s96" (Meson gxm s912)

  - "amlogic,s400" (Meson axg a113d)

  - "amlogic,u200" (Meson g12a s905d2)

Amlogic Meson Firmware registers Interface
------------------------------------------

The Meson SoCs have a register bank with status and data shared with the
secure firmware.

Required properties:
 - compatible: For Meson GX SoCs, must be "amlogic,meson-gx-ao-secure", "syscon"

Properties should indentify components of this register interface :

Meson GX SoC Information
------------------------
A firmware register encodes the SoC type, package and revision information on
the Meson GX SoCs.
If present, the following property should be added :

Optional properties:
  - amlogic,has-chip-id: If present, the interface gives the current SoC version.

Example
-------

ao-secure@140 {
	compatible = "amlogic,meson-gx-ao-secure", "syscon";
	reg = <0x0 0x140 0x0 0x140>;
	amlogic,has-chip-id;
};
```

## Documentation/devicetree/bindings/arm/amlogic.yaml
```yaml
# SPDX-License-Identifier: GPL-2.0
%YAML 1.2
---
$id: http://devicetree.org/schemas/arm/amlogic.yaml#
$schema: http://devicetree.org/meta-schemas/core.yaml#

title: Amlogic SoC based Platforms

maintainers:
  - Neil Armstrong <neil.armstrong@linaro.org>
  - Martin Blumenstingl <martin.blumenstingl@googlemail.com>
  - Jerome Brunet <jbrunet@baylibre.com>
  - Kevin Hilman <khilman@baylibre.com>

properties:
  $nodename:
    const: '/'
  compatible:
    oneOf:
      - description: Boards with the Amlogic Meson6 SoC
        items:
          - enum:
              - geniatech,atv1200
          - const: amlogic,meson6

      - description: Boards with the Amlogic Meson8 SoC
        items:
          - enum:
              - minix,neo-x8
          - const: amlogic,meson8

      - description: Boards with the Amlogic Meson8m2 SoC
        items:
          - enum:
              - tronsmart,mxiii-plus
          - const: amlogic,meson8m2

      - description: Boards with the Amlogic Meson8b SoC
        items:
          - enum:
              - endless,ec100
              - hardkernel,odroid-c1
              - tronfy,mxq
          - const: amlogic,meson8b

      - description: Boards with the Amlogic Meson GXBaby SoC
        items:
          - enum:
              - amlogic,p200
              - amlogic,p201
              - friendlyarm,nanopi-k2
              - hardkernel,odroid-c2
              - nexbox,a95x
              - videostrong,kii-pro
              - wetek,hub
              - wetek,play2
          - const: amlogic,meson-gxbb

      - description: Tronsmart Vega S95 devices
        items:
          - enum:
              - tronsmart,vega-s95-pro
              - tronsmart,vega-s95-meta
              - tronsmart,vega-s95-telos
          - const: tronsmart,vega-s95
          - const: amlogic,meson-gxbb

      - description: Boards with the Amlogic Meson GXL S805X SoC
        items:
          - enum:
              - amlogic,p241
              - libretech,aml-s805x-ac
          - const: amlogic,s805x
          - const: amlogic,meson-gxl

      - description: Boards with the Amlogic Meson GXL S905W SoC
        items:
          - enum:
              - amlogic,p281
              - oranth,tx3-mini
              - jethome,jethub-j80
          - const: amlogic,s905w
          - const: amlogic,meson-gxl

      - description: Boards with the Amlogic Meson GXL S905X SoC
        items:
          - enum:
              - amlogic,p212
              - hwacom,amazetv
              - khadas,vim
              - libretech,aml-s905x-cc
              - libretech,aml-s905x-cc-v2
              - nexbox,a95x
              - osmc,vero4k
          - const: amlogic,s905x
          - const: amlogic,meson-gxl

      - description: Boards with the Amlogic Meson GXL S905D SoC
        items:
          - enum:
              - amlogic,p230
              - amlogic,p231
              - libretech,aml-s905d-pc
              - osmc,vero4k-plus
              - phicomm,n1
              - smartlabs,sml5442tw
              - videostrong,gxl-kii-pro
          - const: amlogic,s905d
          - const: amlogic,meson-gxl

      - description: Boards with the Amlogic Meson GXLX S905L SoC
        items:
          - enum:
              - amlogic,p271
          - const: amlogic,s905l
          - const: amlogic,meson-gxlx

      - description: Boards with the Amlogic Meson GXM S912 SoC
        items:
          - enum:
              - amlogic,q200
              - amlogic,q201
              - azw,gt1-ultimate
              - khadas,vim2
              - kingnovel,r-box-pro
              - libretech,aml-s912-pc
              - minix,neo-u9h
              - nexbox,a1
              - tronsmart,vega-s96
              - videostrong,gxm-kiii-pro
              - wetek,core2
          - const: amlogic,s912
          - const: amlogic,meson-gxm

      - description: Boards with the Amlogic Meson AXG A113D SoC
        items:
          - enum:
              - amlogic,s400
              - jethome,jethub-j100
              - jethome,jethub-j110
          - const: amlogic,a113d
          - const: amlogic,meson-axg

      - description: Boards with the Amlogic Meson G12A S905D2/X2/Y2 SoC
        items:
          - enum:
              - amediatech,x96-max
              - amlogic,u200
              - freebox,fbx8am
              - radxa,zero
              - seirobotics,sei510
          - const: amlogic,g12a

      - description: Boards with the Amlogic Meson G12B A311D SoC
        items:
          - enum:
              - bananapi,bpi-m2s
              - khadas,vim3
              - libretech,aml-a311d-cc
              - radxa,zero2
          - const: amlogic,a311d
          - const: amlogic,g12b

      - description: Boards using the BPI-CM4 module with Amlogic Meson G12B A311D SoC
        items:
          - enum:
              - bananapi,bpi-cm4io
              - mntre,reform2-cm4
          - const: bananapi,bpi-cm4
          - const: amlogic,a311d
          - const: amlogic,g12b

      - description: Boards with the Amlogic Meson G12B S922X SoC
        items:
          - enum:
              - azw,gsking-x
              - azw,gtking
              - azw,gtking-pro
              - bananapi,bpi-m2s
              - dream,dreambox-one
              - dream,dreambox-two
              - hardkernel,odroid-go-ultra
              - hardkernel,odroid-n2
              - hardkernel,odroid-n2l
              - hardkernel,odroid-n2-plus
              - khadas,vim3
              - ugoos,am6
          - const: amlogic,s922x
          - const: amlogic,g12b

      - description: Boards with the Amlogic Meson SM1 S905X3/D3/Y3 SoC
        items:
          - enum:
              - amediatech,x96-air
              - amediatech,x96-air-gbit
              - bananapi,bpi-m2-pro
              - bananapi,bpi-m5
              - cyx,a95xf3-air
              - cyx,a95xf3-air-gbit
              - hardkernel,odroid-c4
              - hardkernel,odroid-hc4
              - haochuangyi,h96-max
              - khadas,vim3l
              - libretech,aml-s905d3-cc
              - seirobotics,sei610
          - const: amlogic,sm1

      - description: Boards with the Amlogic Meson A1 A113L SoC
        items:
          - enum:
              - amlogic,ad401
              - amlogic,ad402
          - const: amlogic,a1

      - description: Boards with the Amlogic A4 A113L2 SoC
        items:
          - enum:
              - amlogic,ba400
          - const: amlogic,a4

      - description: Boards with the Amlogic A5 A113X2 SoC
        items:
          - enum:
              - amlogic,av400
          - const: amlogic,a5

      - description: Boards with the Amlogic C3 C302X/C308L SoC
        items:
          - enum:
              - amlogic,aw409
              - amlogic,aw419
          - const: amlogic,c3

      - description: Boards with the Amlogic Meson S4 S805X2 SoC
        items:
          - enum:
              - amlogic,aq222
          - const: amlogic,s4

      - description: Boards with the Amlogic T7 A311D2 SoC
        items:
          - enum:
              - amlogic,an400
              - khadas,vim4
          - const: amlogic,a311d2
          - const: amlogic,t7

additionalProperties: true

...
```

## Documentation/devicetree/bindings/arm/amlogic/amlogic,meson-gx-ao-secure.txt
```
Amlogic Meson Firmware registers Interface
------------------------------------------

The Meson SoCs have a register bank with status and data shared with the
secure firmware.

Required properties:
 - compatible: For Meson GX SoCs, must be "amlogic,meson-gx-ao-secure", "syscon"

Properties should indentify components of this register interface :

Meson GX SoC Information
------------------------
A firmware register encodes the SoC type, package and revision information on
the Meson GX SoCs.
If present, the following property should be added :

Optional properties:
  - amlogic,has-chip-id: If present, the interface gives the current SoC version.

Example
-------

ao-secure@140 {
	compatible = "amlogic,meson-gx-ao-secure", "syscon";
	reg = <0x0 0x140 0x0 0x140>;
	amlogic,has-chip-id;
};
```

## Documentation/devicetree/bindings/arm/amlogic/amlogic,meson-gx-ao-secure.yaml
```yaml
# SPDX-License-Identifier: (GPL-2.0 OR BSD-2-Clause)
# Copyright 2019 BayLibre, SAS
%YAML 1.2
---
$id: http://devicetree.org/schemas/arm/amlogic/amlogic,meson-gx-ao-secure.yaml#
$schema: http://devicetree.org/meta-schemas/core.yaml#

title: Amlogic Meson Firmware registers Interface

maintainers:
  - Neil Armstrong <neil.armstrong@linaro.org>

description: |
  The Meson SoCs have a register bank with status and data shared with the
  secure firmware.

# We need a select here so we don't match all nodes with 'syscon'
select:
  properties:
    compatible:
      contains:
        const: amlogic,meson-gx-ao-secure
  required:
    - compatible

properties:
  compatible:
    oneOf:
      - items:
          - const: amlogic,meson-gx-ao-secure
          - const: syscon
      - items:
          - enum:
              - amlogic,a4-ao-secure
              - amlogic,c3-ao-secure
              - amlogic,s4-ao-secure
              - amlogic,t7-ao-secure
          - const: amlogic,meson-gx-ao-secure
          - const: syscon
  reg:
    maxItems: 1

  amlogic,has-chip-id:
    description: |
      A firmware register encodes the SoC type, package and revision
      information on the Meson GX SoCs. If present, the interface gives
      the current SoC version.
    type: boolean

required:
  - compatible
  - reg

additionalProperties: false

examples:
  - |
    ao-secure@140 {
          compatible = "amlogic,meson-gx-ao-secure", "syscon";
          reg = <0x140 0x140>;
          amlogic,has-chip-id;
    };
```

## Documentation/devicetree/bindings/arm/amlogic/amlogic,meson-mx-secbus2.yaml
```yaml
# SPDX-License-Identifier: (GPL-2.0-only OR BSD-2-Clause)
%YAML 1.2
---
$id: http://devicetree.org/schemas/arm/amlogic/amlogic,meson-mx-secbus2.yaml#
$schema: http://devicetree.org/meta-schemas/core.yaml#

title: Amlogic Meson8/Meson8b/Meson8m2 SECBUS2 register interface

maintainers:
  - Martin Blumenstingl <martin.blumenstingl@googlemail.com>

description: |
  The Meson8/Meson8b/Meson8m2 SoCs have a register bank called SECBUS2 which
  contains registers for various IP blocks such as pin-controller bits for
  the BSD_EN and TEST_N GPIOs as well as some AO ARC core control bits.
  The registers can be accessed directly when not running in "secure mode".
  When "secure mode" is enabled then these registers have to be accessed
  through secure monitor calls.

properties:
  compatible:
    items:
      - enum:
          - amlogic,meson8-secbus2
          - amlogic,meson8b-secbus2
      - const: syscon

  reg:
    maxItems: 1

required:
  - compatible
  - reg

additionalProperties: false

examples:
  - |
    secbus2: system-controller@4000 {
      compatible = "amlogic,meson8-secbus2", "syscon";
      reg = <0x4000 0x2000>;
    };
```
