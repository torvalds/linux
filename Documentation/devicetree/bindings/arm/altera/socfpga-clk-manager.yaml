## Documentation/devicetree/bindings/arm/amlogic/analog-top.txt
```
Amlogic Meson8 and Meson8b "analog top" registers:
--------------------------------------------------

The analog top registers contain information about the so-called
"metal revision" (which encodes the "minor version") of the SoC.

Required properties:
- reg: the register range of the analog top registers
- compatible: depending on the SoC this should be one of:
		- "amlogic,meson8-analog-top"
		- "amlogic,meson8b-analog-top"
		along with "syscon"


Example:

	analog_top: analog-top@81a8 {
		compatible = "amlogic,meson8-analog-top", "syscon";
		reg = <0x81a8 0x14>;
	};
```

## Documentation/devicetree/bindings/arm/amlogic/assist.txt
```
Amlogic Meson6/Meson8/Meson8b assist registers:
-----------------------------------------------

The assist registers contain basic information about the SoC,
for example the encoded SoC part number.

Required properties:
- reg: the register range of the assist registers
- compatible: should be "amlogic,meson-mx-assist" along with "syscon"


Example:

	assist: assist@7c00 {
		compatible = "amlogic,meson-mx-assist", "syscon";
		reg = <0x7c00 0x200>;
	};
```

## Documentation/devicetree/bindings/arm/amlogic/bootrom.txt
```
Amlogic Meson6/Meson8/Meson8b bootrom:
--------------------------------------

The bootrom register area can be used to access SoC specific
information, such as the "misc version".

Required properties:
- reg: the register range of the bootrom registers
- compatible: should be "amlogic,meson-mx-bootrom" along with "syscon"


Example:

	bootrom: bootrom@d9040000 {
		compatible = "amlogic,meson-mx-bootrom", "syscon";
		reg = <0xd9040000 0x10000>;
	};
```

## Documentation/devicetree/bindings/arm/amlogic/pmu.txt
```
Amlogic Meson8 and Meson8b power-management-unit:
-------------------------------------------------

The pmu is used to turn off and on different power domains of the SoCs
This includes the power to the CPU cores.

Required node properties:
- compatible value : depending on the SoC this should be one of:
			"amlogic,meson8-pmu"
			"amlogic,meson8b-pmu"
- reg : physical base address and the size of the registers window

Example:

	pmu@c81000e4 {
		compatible = "amlogic,meson8b-pmu", "syscon";
		reg = <0xc81000e0 0x18>;
	};
```

## Documentation/devicetree/bindings/arm/amlogic/smp-sram.txt
```
Amlogic Meson8 and Meson8b SRAM for smp bringup:
------------------------------------------------

Amlogic's SMP-capable SoCs use part of the sram for the bringup of the cores.
Once the core gets powered up it executes the code that is residing at a
specific location.

Therefore a reserved section sub-node has to be added to the mmio-sram
declaration.

Required sub-node properties:
- compatible : depending on the SoC this should be one of:
		"amlogic,meson8-smp-sram"
		"amlogic,meson8b-smp-sram"

The rest of the properties should follow the generic mmio-sram discription
found in ../../misc/sram.txt

Example:

	sram: sram@d9000000 {
		compatible = "mmio-sram";
		reg = <0xd9000000 0x20000>;
		#address-cells = <1>;
		#size-cells = <1>;
		ranges = <0 0xd9000000 0x20000>;

		smp-sram@1ff80 {
			compatible = "amlogic,meson8b-smp-sram";
			reg = <0x1ff80 0x8>;
		};
	};
```

## Documentation/devicetree/bindings/arm/apm.yaml
```yaml
# SPDX-License-Identifier: (GPL-2.0-only OR BSD-2-Clause)
%YAML 1.2
---
$id: http://devicetree.org/schemas/arm/apm.yaml#
$schema: http://devicetree.org/meta-schemas/core.yaml#

title: APM X-Gene SoC Platforms

maintainers:
  - Khuong Dinh <khuong@os.amperecomputing.com>

properties:
  $nodename:
    const: "/"
  compatible:
    oneOf:
      - description: Boards with X-Gene1 Soc
        items:
          - const: apm,mustang
          - const: apm,xgene-storm

      - description: Boards with X-Gene2 SoC
        items:
          - const: apm,merlin
          - const: apm,xgene-shadowcat

additionalProperties: true
...
```
