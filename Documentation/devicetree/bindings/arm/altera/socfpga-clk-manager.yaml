## Documentation/devicetree/bindings/arm/altera/socfpga-clk-manager.yaml
```yaml
# SPDX-License-Identifier: GPL-2.0
%YAML 1.2
---
$id: http://devicetree.org/schemas/arm/altera/socfpga-clk-manager.yaml#
$schema: http://devicetree.org/meta-schemas/core.yaml#

title: Altera SOCFPGA Clock Manager

maintainers:
  - Dinh Nguyen <dinguyen@kernel.org>

description:
  This binding describes the Altera SOCFGPA Clock Manager and its associated
  tree of clocks, pll's, and clock gates for the Cyclone5, Arria5 and Arria10
  chip families.

properties:
  compatible:
    items:
      - const: altr,clk-mgr

  reg:
    maxItems: 1

  clocks:
    type: object
    additionalProperties: false

    properties:
      "#address-cells":
        const: 1

      "#size-cells":
        const: 0

    patternProperties:
      "^osc[0-9]$":
        type: object

      "^[a-z0-9,_]+(clk|pll|clk_gate|clk_divided)(@[a-f0-9]+)?$":
        type: object
        $ref: '#/$defs/clock-props'
        unevaluatedProperties: false

        properties:
          compatible:
            enum:
              - altr,socfpga-pll-clock
              - altr,socfpga-perip-clk
              - altr,socfpga-gate-clk
              - altr,socfpga-a10-pll-clock
              - altr,socfpga-a10-perip-clk
              - altr,socfpga-a10-gate-clk
              - fixed-clock

          clocks:
            description: one or more phandles to input clock
            minItems: 1
            maxItems: 5

          "#address-cells":
            const: 1

          "#size-cells":
            const: 0

        patternProperties:
          "^[a-z0-9,_]+(clk|pll)(@[a-f0-9]+)?$":
            type: object
            $ref: '#/$defs/clock-props'
            unevaluatedProperties: false

            properties:
              compatible:
                enum:
                  - altr,socfpga-perip-clk
                  - altr,socfpga-gate-clk
                  - altr,socfpga-a10-perip-clk
                  - altr,socfpga-a10-gate-clk

              clocks:
                description: one or more phandles to input clock
                minItems: 1
                maxItems: 4

            required:
              - compatible
              - clocks
              - "#clock-cells"

        required:
          - compatible
          - "#clock-cells"

required:
  - compatible
  - reg

additionalProperties: false

$defs:
  clock-props:
    properties:
      reg:
        maxItems: 1

      "#clock-cells":
        const: 0

      clk-gate:
        $ref: /schemas/types.yaml#/definitions/uint32-array
        items:
          - description: gating register offset
          - description: bit index

      div-reg:
        $ref: /schemas/types.yaml#/definitions/uint32-array
        items:
          - description: divider register offset
          - description: bit shift
          - description: bit width

      fixed-divider:
        $ref: /schemas/types.yaml#/definitions/uint32

examples:
  - |
    clkmgr@ffd04000 {
      compatible = "altr,clk-mgr";
      reg = <0xffd04000 0x1000>;
    };

...
```

## Documentation/devicetree/bindings/arm/altera/socfpga-eccmgr.txt
```
Altera SoCFPGA ECC Manager
This driver uses the EDAC framework to implement the SOCFPGA ECC Manager.
The ECC Manager counts and corrects single bit errors and counts/handles
double bit errors which are uncorrectable.

Cyclone5 and Arria5 ECC Manager
Required Properties:
- compatible : Should be "altr,socfpga-ecc-manager"
- #address-cells: must be 1
- #size-cells: must be 1
- ranges : standard definition, should translate from local addresses

Subcomponents:

L2 Cache ECC
Required Properties:
- compatible : Should be "altr,socfpga-l2-ecc"
- reg : Address and size for ECC error interrupt clear registers.
- interrupts : Should be single bit error interrupt, then double bit error
	interrupt. Note the rising edge type.

On Chip RAM ECC
Required Properties:
- compatible : Should be "altr,socfpga-ocram-ecc"
- reg : Address and size for ECC error interrupt clear registers.
- iram : phandle to On-Chip RAM definition.
- interrupts : Should be single bit error interrupt, then double bit error
	interrupt. Note the rising edge type.

Example:

	eccmgr: eccmgr@ffd08140 {
		compatible = "altr,socfpga-ecc-manager";
		#address-cells = <1>;
		#size-cells = <1>;
		ranges;

		l2-ecc@ffd08140 {
			compatible = "altr,socfpga-l2-ecc";
			reg = <0xffd08140 0x4>;
			interrupts = <0 36 1>, <0 37 1>;
		};

		ocram-ecc@ffd08144 {
			compatible = "altr,socfpga-ocram-ecc";
			reg = <0xffd08144 0x4>;
			iram = <&ocram>;
			interrupts = <0 178 1>, <0 179 1>;
		};
	};

Arria10 SoCFPGA ECC Manager
The Arria10 SoC ECC Manager handles the IRQs for each peripheral
in a shared register instead of individual IRQs like the Cyclone5
and Arria5. Therefore the device tree is different as well.

Required Properties:
- compatible : Should be "altr,socfpga-a10-ecc-manager"
- altr,sysgr-syscon : phandle to Arria10 System Manager Block
	containing the ECC manager registers.
- #address-cells: must be 1
- #size-cells: must be 1
- interrupts : Should be single bit error interrupt, then double bit error
	interrupt. Note the rising edge type.
- ranges : standard definition, should translate from local addresses

Subcomponents:

L2 Cache ECC
Required Properties:
- compatible : Should be "altr,socfpga-a10-l2-ecc"
- reg : Address and size for ECC error interrupt clear registers.

On-Chip RAM ECC
Required Properties:
- compatible : Should be "altr,socfpga-a10-ocram-ecc"
- reg        : Address and size for ECC block registers.

Example:

	eccmgr: eccmgr@ffd06000 {
		compatible = "altr,socfpga-a10-ecc-manager";
		altr,sysmgr-syscon = <&sysmgr>;
		#address-cells = <1>;
		#size-cells = <1>;
		interrupts = <0 2 IRQ_TYPE_LEVEL_HIGH>,
			     <0 0 IRQ_TYPE_LEVEL_HIGH>;
		ranges;

		l2-ecc@ffd06010 {
			compatible = "altr,socfpga-a10-l2-ecc";
			reg = <0xffd06010 0x4>;
		};

		ocram-ecc@ff8c3000 {
			compatible = "altr,socfpga-a10-ocram-ecc";
			reg = <0xff8c3000 0x90>;
		};
	};
```

## Documentation/devicetree/bindings/arm/altera/socfpga-l2-ecc.txt
```
Altera SoCFPGA L2 cache Error Detection and Correction [EDAC]

Required Properties:
- compatible : Should be "altr,l2-edac"
- reg : Address and size for ECC error interrupt clear registers.
- interrupts : Should be single bit error interrupt, then double bit error
	interrupt. Note the rising edge type.

Example:

	l2edac@xffd08140 {
		compatible = "altr,l2-edac";
		reg = <0xffd08140 0x4>;
		interrupts = <0 36 1>, <0 37 1>;
	};
```

## Documentation/devicetree/bindings/arm/altera/socfpga-l3.txt
```
Altera SOCFPGA L3 Interconnect (NIC-301)

Required properties:
- compatible : "altr,l3regs", "syscon";
                Note that syscon is invoked for this device to support the FPGA
		bridge driver and possibly other devices in the future.  See
		also Documentation/devicetree/bindings/mfd/syscon.txt
- reg : Should contain 1 register ranges(address and length)

Example:
	l3regs@0xff800000 {
		compatible = "altr,l3regs", "syscon";
		reg = <0xff800000 0x1000>;
	};
```

## Documentation/devicetree/bindings/arm/altera/socfpga-ocram-ecc.txt
```
Altera SoCFPGA On-Chip RAM Error Detection and Correction [EDAC]

OCRAM ECC Required Properties:
- compatible : Should be "altr,ocram-edac"
- reg : Address and size for ECC error interrupt clear registers.
- iram : phandle to On-Chip RAM definition.
- interrupts : Should be single bit error interrupt, then double bit error
	interrupt. Note the rising edge type.

Example:
	ocramedac@ffd08144 {
		compatible = "altr,ocram-edac";
		reg = <0xffd08144 0x4>;
		iram = <&ocram>;
		interrupts = <0 178 1>, <0 179 1>;
	};
```

## Documentation/devicetree/bindings/arm/altera/socfpga-reset.txt
```
Altera SOCFPGA Reset Manager

Required properties:
- compatible : "altr,rst-mgr"
- reg : Should contain 1 register ranges(address and length)

Example:
	 rstmgr@ffd05000 {
		compatible = "altr,rst-mgr";
		reg = <0xffd05000 0x1000>;
	};
```

## Documentation/devicetree/bindings/arm/altera/socfpga-sdram-controller.txt
```
Altera SOCFPGA SDRAM Controller

Required properties:
- compatible : Should contain "altr,sdr-ctl" and "syscon".
  syscon is required by the Altera SOCFPGA SDRAM EDAC.
- reg : Should contain 1 register range (address and length)

Example:
	sdr: sdr@ffc25000 {
		compatible = "altr,sdr-ctl", "syscon";
		reg = <0xffc25000 0x1000>;
	};
```

## Documentation/devicetree/bindings/arm/altera/socfpga-sdram-edac.txt
```
Altera SOCFPGA SDRAM Error Detection & Correction [EDAC]
The EDAC accesses a range of registers in the SDRAM controller.

Required properties:
- compatible : should contain "altr,sdram-edac";
- altr,sdr-syscon : phandle of the sdr module
- interrupts : Should contain the SDRAM ECC IRQ in the
	appropriate format for the IRQ controller.

Example:
	sdramedac {
		compatible = "altr,sdram-edac";
		altr,sdr-syscon = <&sdr>;
		interrupts = <0 39 4>;
	};
```

## Documentation/devicetree/bindings/arm/altera/socfpga-sdram.txt
```
Altera SOCFPGA SDRAM Controller

Required properties:
- compatible : "altr,sdr-ctl", "syscon";
                Note that syscon is invoked for this device to support the FPGA
		bridge driver and possibly other devices in the future.  See
		also Documentation/devicetree/bindings/mfd/syscon.txt
- reg : Should contain 1 register ranges(address and length)

Example:
	sdrctl@0xffc25000 {
		compatible = "altr,sdr-ctl", "syscon";
		reg = <0xffc25000 0x1000>;
	};
```

## Documentation/devicetree/bindings/arm/altera/socfpga-system.txt
```
Altera SOCFPGA System Manager

Required properties:
- compatible : "altr,sys-mgr"
- reg : Should contain 1 register ranges(address and length)
- cpu1-start-addr : CPU1 start address in hex.

Example:
	 sysmgr@ffd08000 {
		compatible = "altr,sys-mgr";
		reg = <0xffd08000 0x1000>;
		cpu1-start-addr = <0xffd080c4>;
	};

ARM64 - Stratix10
Required properties:
- compatible : "altr,sys-mgr-s10"
- reg : Should contain 1 register range(address and length)
        for system manager register.

Example:
	 sysmgr@ffd12000 {
		compatible = "altr,sys-mgr-s10";
		reg = <0xffd12000 0x228>;
	};
```

## Documentation/devicetree/bindings/arm/amazon,al.yaml
```yaml
# SPDX-License-Identifier: GPL-2.0
%YAML 1.2
---
$id: http://devicetree.org/schemas/arm/amazon,al.yaml#
$schema: http://devicetree.org/meta-schemas/core.yaml#

title: Amazon's Annapurna Labs Alpine Platform Device Tree Bindings

maintainers:
  - Hanna Hawa <hhhawa@amazon.com>
  - Talel Shenhar <talel@amazon.com>, <talelshenhar@gmail.com>
  - Ronen Krupnik <ronenk@amazon.com>

properties:
  compatible:
    oneOf:
      - description: Boards with Alpine V1 SoC
        items:
          - const: al,alpine

      - description: Boards with Alpine V2 SoC
        items:
          - enum:
              - al,alpine-v2-evp
          - const: al,alpine-v2

      - description: Boards with Alpine V3 SoC
        items:
          - enum:
              - amazon,al-alpine-v3-evp
          - const: amazon,al-alpine-v3

additionalProperties: true

...
```

## Documentation/devicetree/bindings/arm/amd,pensando.yaml
```yaml
# SPDX-License-Identifier: (GPL-2.0-only OR BSD-2-Clause)
%YAML 1.2
---
$id: http://devicetree.org/schemas/arm/amd,pensando.yaml#
$schema: http://devicetree.org/meta-schemas/core.yaml#

title: AMD Pensando SoC Platforms

maintainers:
  - Brad Larson <blarson@amd.com>

properties:
  $nodename:
    const: "/"
  compatible:
    oneOf:

      - description: Boards with Pensando Elba SoC
        items:
          - enum:
              - amd,pensando-elba-ortano
          - const: amd,pensando-elba

additionalProperties: true

...
```

## Documentation/devicetree/bindings/arm/amd,seattle.yaml
```yaml
# SPDX-License-Identifier: (GPL-2.0-only OR BSD-2-Clause)
%YAML 1.2
---
$id: http://devicetree.org/schemas/arm/amd,seattle.yaml#
$schema: http://devicetree.org/meta-schemas/core.yaml#

title: AMD Seattle SoC Platforms

maintainers:
  - Suravee Suthikulpanit <suravee.suthikulpanit@amd.com>
  - Tom Lendacky <thomas.lendacky@amd.com>

properties:
  $nodename:
    const: "/"
  compatible:
    oneOf:
      - description: Boards with AMD Seattle SoC
        items:
          - const: amd,seattle-overdrive
          - const: amd,seattle

additionalProperties: true
...
```

## Documentation/devicetree/bindings/arm/amlogic,scpi.txt
```
System Control and Power Interface (SCPI) Message Protocol
(in addition to the standard binding in [0])
----------------------------------------------------------
Required properties

- compatible : should be "amlogic,meson-gxbb-scpi"

Sensor bindings for the sensors based on SCPI Message Protocol
--------------------------------------------------------------
SCPI provides an API to access the various sensors on the SoC.

Required properties:
- compatible : should be "amlogic,meson-gxbb-scpi-sensors".

[0] Documentation/devicetree/bindings/arm/arm,scpi.txt
```
