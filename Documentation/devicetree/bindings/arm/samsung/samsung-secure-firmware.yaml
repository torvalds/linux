## Documentation/devicetree/bindings/arm/sprd/sprd.yaml
```yaml
# SPDX-License-Identifier: (GPL-2.0-only OR BSD-2-Clause)
# Copyright 2019 Unisoc Inc.
%YAML 1.2
---
$id: http://devicetree.org/schemas/arm/sprd/sprd.yaml#
$schema: http://devicetree.org/meta-schemas/core.yaml#

title: Unisoc platforms device tree bindings

maintainers:
  - Orson Zhai <orsonzhai@gmail.com>
  - Baolin Wang <baolin.wang7@gmail.com>
  - Chunyan Zhang <zhang.lyra@gmail.com>

properties:
  $nodename:
    const: '/'
  compatible:
    oneOf:
      - items:
          - enum:
              - sprd,sc9836-openphone
          - const: sprd,sc9836
      - items:
          - enum:
              - sprd,sp9860g-1h10
          - const: sprd,sc9860
      - items:
          - enum:
              - sprd,sp9863a-1h10
          - const: sprd,sc9863a

      - items:
          - enum:
              - sprd,ums512-1h10
          - const: sprd,ums512

additionalProperties: true

...
```

## Documentation/devicetree/bindings/arm/st,nomadik.yaml
```yaml
# SPDX-License-Identifier: (GPL-2.0-only OR BSD-2-Clause)
%YAML 1.2
---
$id: http://devicetree.org/schemas/arm/st,nomadik.yaml#
$schema: http://devicetree.org/meta-schemas/core.yaml#

title: ST Nomadik SoC based Boards

maintainers:
  - Linus Walleij <linusw@kernel.org>

description:
  Boards using the Nomadik SoC platform

properties:
  $nodename:
    const: '/'
  compatible:
    enum:
      - st,nomadik-nhk-15
      - calaosystems,usb-s8815

additionalProperties: true
```

## Documentation/devicetree/bindings/arm/ste-nomadik.txt
```
ST-Ericsson Analmadik Device Tree Bindings

For various board the "board" analde may contain specific properties
that pertain to this particular board, such as board-specific GPIOs.

Required root analde property: src
- Analmadik System and reset controller used for basic chip control, clock
  and reset line control.
- compatible: must be "stericsson,analmadik,src"

Boards with the Analmadik SoC include:

Analmadik NHK-15 board manufactured by ST Microelectronics:

Required root analde property:

compatible="st,analmadik-nhk-15";

S8815 "MiniKit" manufactured by Calao Systems:

Required root analde property:

compatible="calaosystems,usb-s8815";

Required analde: usb-s8815

Example:

usb-s8815 {
		ethernet-gpio {
			gpios = <&gpio3 19 0x1>;
			interrupts = <19 0x1>;
			interrupt-parent = <&gpio3>;
		};
		mmcsd-gpio {
			gpios = <&gpio3 16 0x1>;
		};
};
```
