## Documentation/devicetree/bindings/arm/socionext/cache-uniphier.txt
```
UniPhier outer cache controller

UniPhier SoCs are integrated with a full-custom outer cache controller system.
All of them have a level 2 cache controller, and some have a level 3 cache
controller as well.

Required properties:
- compatible: should be "socionext,uniphier-system-cache"
- reg: offsets and lengths of the register sets for the device.  It should
  contain 3 regions: control register, revision register, operation register,
  in this order.
- cache-unified: specifies the cache is a unified cache.
- cache-size: specifies the size in bytes of the cache
- cache-sets: specifies the number of associativity sets of the cache
- cache-line-size: specifies the line size in bytes
- cache-level: specifies the level in the cache hierarchy.  The value should
  be 2 for L2 cache, 3 for L3 cache, etc.

Optional properties:
- next-level-cache: phandle to the next level cache if present.  The next level
  cache should be also compatible with "socionext,uniphier-system-cache".

The L2 cache must exist to use the L3 cache; the cache hierarchy must be
indicated correctly with "next-level-cache" properties.

Example 1 (system with L2):
	l2: l2-cache@500c0000 {
		compatible = "socionext,uniphier-system-cache";
		reg = <0x500c0000 0x2000>, <0x503c0100 0x4>,
		      <0x506c0000 0x400>;
		cache-unified;
		cache-size = <0x80000>;
		cache-sets = <256>;
		cache-line-size = <128>;
		cache-level = <2>;
	};

Example 2 (system with L2 and L3):
	l2: l2-cache@500c0000 {
		compatible = "socionext,uniphier-system-cache";
		reg = <0x500c0000 0x2000>, <0x503c0100 0x8>,
		      <0x506c0000 0x400>;
		cache-unified;
		cache-size = <0x200000>;
		cache-sets = <512>;
		cache-line-size = <128>;
		cache-level = <2>;
		next-level-cache = <&l3>;
	};

	l3: l3-cache@500c8000 {
		compatible = "socionext,uniphier-system-cache";
		reg = <0x500c8000 0x2000>, <0x503c8100 0x8>,
		      <0x506c8000 0x400>;
		cache-unified;
		cache-size = <0x400000>;
		cache-sets = <512>;
		cache-line-size = <256>;
		cache-level = <3>;
	};
```

## Documentation/devicetree/bindings/arm/socionext/milbeaut.yaml
```yaml
# SPDX-License-Identifier: GPL-2.0
%YAML 1.2
---
$id: http://devicetree.org/schemas/arm/socionext/milbeaut.yaml#
$schema: http://devicetree.org/meta-schemas/core.yaml#

title: Milbeaut platforms

maintainers:
  - Taichi Sugaya <sugaya.taichi@socionext.com>
  - Takao Orito <orito.takao@socionext.com>

properties:
  $nodename:
    const: '/'
  compatible:
    oneOf:
      - items:
          - enum:
              - socionext,milbeaut-m10v-evb
          - const: socionext,sc2000a

additionalProperties: true

...
```

## Documentation/devicetree/bindings/arm/socionext/socionext,uniphier-system-cache.yaml
```yaml
# SPDX-License-Identifier: GPL-2.0-only OR BSD-2-Clause
%YAML 1.2
---
$id: http://devicetree.org/schemas/arm/socionext/socionext,uniphier-system-cache.yaml#
$schema: http://devicetree.org/meta-schemas/core.yaml#

title: UniPhier outer cache controller

description: |
  UniPhier ARM 32-bit SoCs are integrated with a full-custom outer cache
  controller system. All of them have a level 2 cache controller, and some
  have a level 3 cache controller as well.

maintainers:
  - Masahiro Yamada <yamada.masahiro@socionext.com>

properties:
  compatible:
    const: socionext,uniphier-system-cache

  reg:
    description: |
      should contain 3 regions: control register, revision register,
      operation register, in this order.
    maxItems: 3

  interrupts:
    description: |
      Interrupts can be used to notify the completion of cache operations.
      The number of interrupts should match to the number of CPU cores.
      The specified interrupts correspond to CPU0, CPU1, ... in this order.
    minItems: 1
    maxItems: 4

  cache-unified: true

  cache-size: true

  cache-sets: true

  cache-line-size: true

  cache-level:
    minimum: 2
    maximum: 3

  next-level-cache: true

allOf:
  - $ref: /schemas/cache-controller.yaml#

additionalProperties: false

required:
  - compatible
  - reg
  - interrupts
  - cache-unified
  - cache-size
  - cache-sets
  - cache-line-size
  - cache-level

examples:
  - |
    // System with L2.
    cache-controller@500c0000 {
        compatible = "socionext,uniphier-system-cache";
        reg = <0x500c0000 0x2000>, <0x503c0100 0x4>, <0x506c0000 0x400>;
        interrupts = <0 174 4>, <0 175 4>, <0 190 4>, <0 191 4>;
        cache-unified;
        cache-size = <0x140000>;
        cache-sets = <512>;
        cache-line-size = <128>;
        cache-level = <2>;
    };
  - |
    // System with L2 and L3.
    //   L2 should specify the next level cache by 'next-level-cache'.
    l2: cache-controller@500c0000 {
        compatible = "socionext,uniphier-system-cache";
        reg = <0x500c0000 0x2000>, <0x503c0100 0x8>, <0x506c0000 0x400>;
        interrupts = <0 190 4>, <0 191 4>;
        cache-unified;
        cache-size = <0x200000>;
        cache-sets = <512>;
        cache-line-size = <128>;
        cache-level = <2>;
        next-level-cache = <&l3>;
    };

    l3: cache-controller@500c8000 {
        compatible = "socionext,uniphier-system-cache";
        reg = <0x500c8000 0x2000>, <0x503c8100 0x8>, <0x506c8000 0x400>;
        interrupts = <0 174 4>, <0 175 4>;
        cache-unified;
        cache-size = <0x200000>;
        cache-sets = <512>;
        cache-line-size = <256>;
        cache-level = <3>;
    };
```

## Documentation/devicetree/bindings/arm/socionext/synquacer.yaml
```yaml
# SPDX-License-Identifier: GPL-2.0-only OR BSD-2-Clause
%YAML 1.2
---
$id: http://devicetree.org/schemas/arm/socionext/synquacer.yaml#
$schema: http://devicetree.org/meta-schemas/core.yaml#

title: Socionext Synquacer platform

maintainers:
  - Masahisa Kojima <masahisa.kojima@linaro.org>
  - Jassi Brar <jaswinder.singh@linaro.org>

description:
  Socionext SC2A11B (Synquacer) SoC based boards

properties:
  $nodename:
    const: '/'
  compatible:
    oneOf:
      - items:
          - enum:
              - socionext,developer-box
          - const: socionext,synquacer

additionalProperties: true

...
```

## Documentation/devicetree/bindings/arm/socionext/uniphier.txt
```
Socionext UniPhier SoC family
-----------------------------

Required properties in the root node:
  - compatible: should contain board and SoC compatible strings

SoC and board compatible strings:
  (sorted chronologically)

  - LD4 SoC:  "socionext,uniphier-ld4"
      - Reference Board: "socionext,uniphier-ld4-ref"

  - Pro4 SoC: "socionext,uniphier-pro4"
      - Reference Board: "socionext,uniphier-pro4-ref"
      - Ace Board:       "socionext,uniphier-pro4-ace"
      - Sanji Board:     "socionext,uniphier-pro4-sanji"

  - sLD8 SoC: "socionext,uniphier-sld8"
      - Reference Board: "socionext,uniphier-sld8-ref"

  - PXs2 SoC: "socionext,uniphier-pxs2"
      - Gentil Board:    "socionext,uniphier-pxs2-gentil"
      - Vodka Board:     "socionext,uniphier-pxs2-vodka"

  - LD6b SoC: "socionext,uniphier-ld6b"
      - Reference Board: "socionext,uniphier-ld6b-ref"

  - LD11 SoC: "socionext,uniphier-ld11"
      - Reference Board: "socionext,uniphier-ld11-ref"
      - Global Board:    "socionext,uniphier-ld11-global"

  - LD20 SoC: "socionext,uniphier-ld20"
      - Reference Board: "socionext,uniphier-ld20-ref"
      - Global Board:    "socionext,uniphier-ld20-global"

  - PXs3 SoC: "socionext,uniphier-pxs3"
      - Reference Board: "socionext,uniphier-pxs3-ref"

Example:

/dts-v1/;

/ {
	compatible = "socionext,uniphier-ld20-ref", "socionext,uniphier-ld20";

	...
};
```

## Documentation/devicetree/bindings/arm/socionext/uniphier.yaml
```yaml
# SPDX-License-Identifier: GPL-2.0-only OR BSD-2-Clause
%YAML 1.2
---
$id: http://devicetree.org/schemas/arm/socionext/uniphier.yaml#
$schema: http://devicetree.org/meta-schemas/core.yaml#

title: Socionext UniPhier platform device tree bindings

maintainers:
  - Masahiro Yamada <yamada.masahiro@socionext.com>

properties:
  $nodename:
    const: /
  compatible:
    oneOf:
      - description: LD4 SoC boards
        items:
          - enum:
            - socionext,uniphier-ld4-ref
          - const: socionext,uniphier-ld4
      - description: Pro4 SoC boards
        items:
          - enum:
            - socionext,uniphier-pro4-ace
            - socionext,uniphier-pro4-ref
            - socionext,uniphier-pro4-sanji
          - const: socionext,uniphier-pro4
      - description: sLD8 SoC boards
        items:
          - enum:
            - socionext,uniphier-sld8-ref
          - const: socionext,uniphier-sld8
      - description: PXs2 SoC boards
        items:
          - enum:
            - socionext,uniphier-pxs2-gentil
            - socionext,uniphier-pxs2-vodka
          - const: socionext,uniphier-pxs2
      - description: LD6b SoC boards
        items:
          - enum:
            - socionext,uniphier-ld6b-ref
          - const: socionext,uniphier-ld6b
      - description: LD11 SoC boards
        items:
          - enum:
            - socionext,uniphier-ld11-global
            - socionext,uniphier-ld11-ref
          - const: socionext,uniphier-ld11
      - description: LD20 SoC boards
        items:
          - enum:
            - socionext,uniphier-ld20-akebi96
            - socionext,uniphier-ld20-global
            - socionext,uniphier-ld20-ref
          - const: socionext,uniphier-ld20
      - description: PXs3 SoC boards
        items:
          - enum:
            - socionext,uniphier-pxs3-ref
          - const: socionext,uniphier-pxs3
```

## Documentation/devicetree/bindings/arm/sp810.txt
```
SP810 System Controller
-----------------------

Required properties:

- compatible:	standard compatible string for a Primecell peripheral,
		see Documentation/devicetree/bindings/arm/primecell.txt
		for more details
		should be: "arm,sp810", "arm,primecell"

- reg:		standard registers property, physical address and size
		of the control registers

- clock-names:	from the common clock bindings, for more details see
		Documentation/devicetree/bindings/clock/clock-bindings.txt;
		should be: "refclk", "timclk", "apb_pclk"

- clocks:	from the common clock bindings, phandle and clock
		specifier pairs for the entries of clock-names property

- #clock-cells: from the common clock bindings;
		should be: <1>

- clock-output-names: from the common clock bindings;
		should be: "timerclken0", "timerclken1", "timerclken2", "timerclken3"

- assigned-clocks: from the common clock binding;
		should be: clock specifier for each output clock of this
		provider node

- assigned-clock-parents: from the common clock binding;
		should be: phandle of input clock listed in clocks
		property with the highest frequency

Example:
	v2m_sysctl: sysctl@020000 {
		compatible = "arm,sp810", "arm,primecell";
		reg = <0x020000 0x1000>;
		clocks = <&v2m_refclk32khz>, <&v2m_refclk1mhz>, <&smbclk>;
		clock-names = "refclk", "timclk", "apb_pclk";
		#clock-cells = <1>;
		clock-output-names = "timerclken0", "timerclken1", "timerclken2", "timerclken3";
		assigned-clocks = <&v2m_sysctl 0>, <&v2m_sysctl 1>, <&v2m_sysctl 3>, <&v2m_sysctl 3>;
		assigned-clock-parents = <&v2m_refclk1mhz>, <&v2m_refclk1mhz>, <&v2m_refclk1mhz>, <&v2m_refclk1mhz>;

	};
```

## Documentation/devicetree/bindings/arm/sp810.yaml
```yaml
# SPDX-License-Identifier: (GPL-2.0-only OR BSD-2-Clause)
%YAML 1.2
---
$id: http://devicetree.org/schemas/arm/sp810.yaml#
$schema: http://devicetree.org/meta-schemas/core.yaml#

title: ARM Versatile Express SP810 System Controller bindings

maintainers:
  - Andre Przywara <andre.przywara@arm.com>

description:
  The Arm SP810 system controller provides clocks, timers and a watchdog.

# We need a select here so we don't match all nodes with 'arm,primecell'
select:
  properties:
    compatible:
      contains:
        const: arm,sp810
  required:
    - compatible

properties:
  compatible:
    items:
      - const: arm,sp810
      - const: arm,primecell

  reg:
    maxItems: 1

  clock-names:
    items:
      - const: refclk
      - const: timclk
      - const: apb_pclk

  clocks:
    items:
      - description: reference clock
      - description: timer clock
      - description: APB register access clock

  "#clock-cells":
    const: 1

  clock-output-names:
    maxItems: 4

  assigned-clocks:
    maxItems: 4

  assigned-clock-parents:
    maxItems: 4

additionalProperties: false

required:
  - compatible
  - reg
  - clocks
  - clock-names
  - "#clock-cells"

examples:
  - |
    sysctl@20000 {
        compatible = "arm,sp810", "arm,primecell";
        reg = <0x020000 0x1000>;
        clocks = <&v2m_refclk32khz>, <&v2m_refclk1mhz>, <&smbclk>;
        clock-names = "refclk", "timclk", "apb_pclk";
        #clock-cells = <1>;
        clock-output-names = "timerclken0", "timerclken1",
                             "timerclken2", "timerclken3";
        assigned-clocks = <&v2m_sysctl 0>, <&v2m_sysctl 1>,
                          <&v2m_sysctl 3>, <&v2m_sysctl 3>;
        assigned-clock-parents = <&v2m_refclk1mhz>, <&v2m_refclk1mhz>,
                                 <&v2m_refclk1mhz>, <&v2m_refclk1mhz>;
    };
```

## Documentation/devicetree/bindings/arm/spe-pmu.txt
```
* ARMv8.2 Statistical Profiling Extension (SPE) Performance Monitor Units (PMU)

ARMv8.2 introduces the optional Statistical Profiling Extension for collecting
performance sample data using an in-memory trace buffer.

** SPE Required properties:

- compatible : should be one of:
	       "arm,statistical-profiling-extension-v1"

- interrupts : Exactly 1 PPI must be listed. For heterogeneous systems where
               SPE is only supported on a subset of the CPUs, please consult
	       the arm,gic-v3 binding for details on describing a PPI partition.

** Example:

spe-pmu {
        compatible = "arm,statistical-profiling-extension-v1";
        interrupts = <GIC_PPI 05 IRQ_TYPE_LEVEL_HIGH &part1>;
};
```

## Documentation/devicetree/bindings/arm/spear-misc.txt
```
SPEAr Misc configuration
===========================
SPEAr SOCs have some miscellaneous registers which are used to configure
few properties of different peripheral controllers.

misc node required properties:

- compatible Should be	"st,spear1340-misc", "syscon".
- reg: Address range of misc space up to 8K
```

## Documentation/devicetree/bindings/arm/spear.txt
```
ST SPEAr Platforms Device Tree Bindings
---------------------------------------

Boards with the ST SPEAr600 SoC shall have the following properties:

Required root node property:

compatible = "st,spear600";
```

## Documentation/devicetree/bindings/arm/spear.yaml
```yaml
# SPDX-License-Identifier: GPL-2.0
%YAML 1.2
---
$id: http://devicetree.org/schemas/arm/spear.yaml#
$schema: http://devicetree.org/meta-schemas/core.yaml#

title: ST SPEAr Platforms

maintainers:
  - Viresh Kumar <vireshk@kernel.org>
  - Stefan Roese <sr@denx.de>

properties:
  $nodename:
    const: '/'
  compatible:
    items:
      - enum:
          - st,spear600
          - st,spear300
          - st,spear310
          - st,spear320
          - st,spear1310
          - st,spear1340

additionalProperties: true

...
```

## Documentation/devicetree/bindings/arm/sprd.txt
```
Spreadtrum SoC Platforms Device Tree Bindings
----------------------------------------------------

SC9836 openphone Board
Required root node properties:
	- compatible = "sprd,sc9836-openphone", "sprd,sc9836";

SC9860 SoC
Required root node properties:
	- compatible = "sprd,sc9860"

SP9860G 3GFHD Board
Required root node properties:
	- compatible = "sprd,sp9860g-1h10", "sprd,sc9860";
```
