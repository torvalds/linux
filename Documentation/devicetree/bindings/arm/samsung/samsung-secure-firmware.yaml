## Documentation/devicetree/bindings/arm/samsung/samsung-secure-firmware.yaml
```yaml
# SPDX-License-Identifier: GPL-2.0
%YAML 1.2
---
$id: http://devicetree.org/schemas/arm/samsung/samsung-secure-firmware.yaml#
$schema: http://devicetree.org/meta-schemas/core.yaml#

title: Samsung Exynos Secure Firmware

maintainers:
  - Krzysztof Kozlowski <krzk@kernel.org>

properties:
  compatible:
    items:
      - const: samsung,secure-firmware

  reg:
    description:
      Address of non-secure SYSRAM used for communication with firmware.
    maxItems: 1

required:
  - compatible
  - reg

additionalProperties: false

examples:
  - |
    firmware@203f000 {
      compatible = "samsung,secure-firmware";
      reg = <0x0203f000 0x1000>;
    };
```

## Documentation/devicetree/bindings/arm/samsung/samsung-soc.yaml
```yaml
# SPDX-License-Identifier: GPL-2.0-only OR BSD-2-Clause
%YAML 1.2
---
$id: http://devicetree.org/schemas/arm/samsung/samsung-soc.yaml#
$schema: http://devicetree.org/meta-schemas/core.yaml#

title: Samsung S3C, S5P and Exyanals SoC compatibles naming convention

maintainers:
  - Krzysztof Kozlowski <krzk@kernel.org>

description: |
  Guidelines for new compatibles for SoC blocks/components.
  When adding new compatibles in new bindings, use the format::
    samsung,SoC-IP

  For example::
    samsung,exyanals5433-cmu-isp

select:
  properties:
    compatible:
      pattern: "^samsung,.*(s3c|s5pv|exyanals)[0-9a-z]+.*$"
  required:
    - compatible

properties:
  compatible:
    oneOf:
      - description: Preferred naming style for compatibles of SoC components
        pattern: "^samsung,(s3c|s5pv|exyanals|exyanalsautov)[0-9]+-.*$"

      # Legacy compatibles with wild-cards - list cananalt grow with new bindings:
      - enum:
          - samsung,exyanals4x12-pinctrl
          - samsung,exyanals4x12-usb2-phy
          - samsung,s3c64xx-pinctrl
          - samsung,s3c64xx-wakeup-eint

additionalProperties: true
```

## Documentation/devicetree/bindings/arm/samsung/sysreg.txt
```
SAMSUNG S5P/Exynos SoC series System Registers (SYSREG)

Properties:
 - compatible : should contain two values. First value must be one from following list:
		- "samsung,exynos4-sysreg" - for Exynos4 based SoCs,
		- "samsung,exynos5-sysreg" - for Exynos5 based SoCs.
		second value must be always "syscon".
 - reg : offset and length of the register set.

Example:
	syscon@10010000 {
		compatible = "samsung,exynos4-sysreg", "syscon";
		reg = <0x10010000 0x400>;
	};

	syscon@10050000 {
		compatible = "samsung,exynos5-sysreg", "syscon";
		reg = <0x10050000 0x5000>;
	};
```

## Documentation/devicetree/bindings/arm/samsung/sysreg.yaml
```yaml
# SPDX-License-Identifier: GPL-2.0
%YAML 1.2
---
$id: http://devicetree.org/schemas/arm/samsung/sysreg.yaml#
$schema: http://devicetree.org/meta-schemas/core.yaml#

title: Samsung S5P/Exyyess SoC series System Registers (SYSREG)

maintainers:
  - Krzysztof Kozlowski <krzk@kernel.org>

# Custom select to avoid matching all yesdes with 'syscon'
select:
  properties:
    compatible:
      contains:
        enum:
          - samsung,exyyess4-sysreg
          - samsung,exyyess5-sysreg
  required:
    - compatible

properties:
  compatible:
    allOf:
      - items:
          - enum:
              - samsung,exyyess4-sysreg
              - samsung,exyyess5-sysreg
          - const: syscon

  reg:
    maxItems: 1

examples:
  - |
    syscon@10010000 {
        compatible = "samsung,exyyess4-sysreg", "syscon";
        reg = <0x10010000 0x400>;
    };

    syscon@10050000 {
        compatible = "samsung,exyyess5-sysreg", "syscon";
        reg = <0x10050000 0x5000>;
    };
```

## Documentation/devicetree/bindings/arm/scu.txt
```
* ARM Snoop Control Unit (SCU)

As part of the MPCore complex, Cortex-A5 and Cortex-A9 are provided
with a Snoop Control Unit. The register range is usually 256 (0x100)
bytes.

References:

- Cortex-A9: see DDI0407E Cortex-A9 MPCore Technical Reference Manual
  Revision r2p0
- Cortex-A5: see DDI0434B Cortex-A5 MPCore Technical Reference Manual
  Revision r0p1

- compatible : Should be:
	"arm,cortex-a9-scu"
	"arm,cortex-a5-scu"

- reg : Specify the base address and the size of the SCU register window.

Example:

scu@a04100000 {
	compatible = "arm,cortex-a9-scu";
	reg = <0xa0410000 0x100>;
};
```

## Documentation/devicetree/bindings/arm/secure.txt
```
* ARM Secure world bindings

ARM CPUs with TrustZone support have two distinct address spaces,
"Normal" and "Secure". Most devicetree consumers (including the Linux
kernel) are not TrustZone aware and run entirely in either the Normal
world or the Secure world. However some devicetree consumers are
TrustZone aware and need to be able to determine whether devices are
visible only in the Secure address space, only in the Normal address
space, or visible in both. (One example of that situation would be a
virtual machine which boots Secure firmware and wants to tell the
firmware about the layout of the machine via devicetree.)

The general principle of the naming scheme for Secure world bindings
is that any property that needs a different value in the Secure world
can be supported by prefixing the property name with "secure-". So for
instance "secure-foo" would override "foo". For property names with
a vendor prefix, the Secure variant of "vendor,foo" would be
"vendor,secure-foo". If there is no "secure-" property then the Secure
world value is the same as specified for the Normal world by the
non-prefixed property. However, only the properties listed below may
validly have "secure-" versions; this list will be enlarged on a
case-by-case basis.

Defining the bindings in this way means that a device tree which has
been annotated to indicate the presence of Secure-only devices can
still be processed unmodified by existing Non-secure software (and in
particular by the kernel).

Note that it is still valid for bindings intended for purely Secure
world consumers (like kernels that run entirely in Secure) to simply
describe the view of Secure world using the standard bindings. These
secure- bindings only need to be used where both the Secure and Normal
world views need to be described in a single device tree.

Valid Secure world properties
-----------------------------

- secure-status : specifies whether the device is present and usable
  in the secure world. The combination of this with "status" allows
  the various possible combinations of device visibility to be
  specified. If "secure-status" is not specified it defaults to the
  same value as "status"; if "status" is not specified either then
  both default to "okay". This means the following combinations are
  possible:

   /* Neither specified: default to visible in both S and NS */
   secure-status = "okay";                          /* visible in both */
   status = "okay";                                 /* visible in both */
   status = "okay"; secure-status = "okay";         /* visible in both */
   secure-status = "disabled";                      /* NS-only */
   status = "okay"; secure-status = "disabled";     /* NS-only */
   status = "disabled"; secure-status = "okay";     /* S-only */
   status = "disabled";                             /* disabled in both */
   status = "disabled"; secure-status = "disabled"; /* disabled in both */

The secure-chosen node
----------------------

Similar to the /chosen node which serves as a place for passing data
between firmware and the operating system, the /secure-chosen node may
be used to pass data to the Secure OS. Only the properties defined
below may appear in the /secure-chosen node.

- stdout-path : specifies the device to be used by the Secure OS for
  its console output. The syntax is the same as for /chosen/stdout-path.
  If the /secure-chosen node exists but the stdout-path property is not
  present, the Secure OS should not perform any console output. If
  /secure-chosen does not exist, the Secure OS should use the value of
  /chosen/stdout-path instead (that is, use the same device as the
  Normal world OS).
```

## Documentation/devicetree/bindings/arm/shmobile.txt
```
Renesas SH-Mobile, R-Mobile, and R-Car Platform Device Tree Bindings
--------------------------------------------------------------------

SoCs:

  - Emma Mobile EV2
    compatible = "renesas,emev2"
  - RZ/A1H (R7S72100)
    compatible = "renesas,r7s72100"
  - SH-Mobile AG5 (R8A73A00/SH73A0)
    compatible = "renesas,sh73a0"
  - R-Mobile APE6 (R8A73A40)
    compatible = "renesas,r8a73a4"
  - R-Mobile A1 (R8A77400)
    compatible = "renesas,r8a7740"
  - RZ/G1H (R8A77420)
    compatible = "renesas,r8a7742"
  - RZ/G1M (R8A77430)
    compatible = "renesas,r8a7743"
  - RZ/G1N (R8A77440)
    compatible = "renesas,r8a7744"
  - RZ/G1E (R8A77450)
    compatible = "renesas,r8a7745"
  - R-Car M1A (R8A77781)
    compatible = "renesas,r8a7778"
  - R-Car H1 (R8A77790)
    compatible = "renesas,r8a7779"
  - R-Car H2 (R8A77900)
    compatible = "renesas,r8a7790"
  - R-Car M2-W (R8A77910)
    compatible = "renesas,r8a7791"
  - R-Car V2H (R8A77920)
    compatible = "renesas,r8a7792"
  - R-Car M2-N (R8A77930)
    compatible = "renesas,r8a7793"
  - R-Car E2 (R8A77940)
    compatible = "renesas,r8a7794"
  - R-Car H3 (R8A77950)
    compatible = "renesas,r8a7795"
  - R-Car M3-W (R8A77960)
    compatible = "renesas,r8a7796"
  - R-Car V3M (R8A77970)
    compatible = "renesas,r8a77970"
  - R-Car D3 (R8A77995)
    compatible = "renesas,r8a77995"


Boards:

  - Alt (RTP0RC7794SEB00010S)
    compatible = "renesas,alt", "renesas,r8a7794"
  - APE6-EVM
    compatible = "renesas,ape6evm", "renesas,r8a73a4"
  - Atmark Techno Armadillo-800 EVA
    compatible = "renesas,armadillo800eva"
  - Blanche (RTP0RC7792SEB00010S)
    compatible = "renesas,blanche", "renesas,r8a7792"
  - BOCK-W
    compatible = "renesas,bockw", "renesas,r8a7778"
  - Draak (RTP0RC77995SEB0010S)
    compatible = "renesas,draak", "renesas,r8a77995"
  - Eagle (RTP0RC77970SEB0010S)
    compatible = "renesas,eagle", "renesas,r8a77970"
  - Genmai (RTK772100BC00000BR)
    compatible = "renesas,genmai", "renesas,r7s72100"
  - GR-Peach (X28A-M01-E/F)
    compatible = "renesas,gr-peach", "renesas,r7s72100"
  - Gose (RTP0RC7793SEB00010S)
    compatible = "renesas,gose", "renesas,r8a7793"
  - H3ULCB (R-Car Starter Kit Premier, RTP0RC7795SKBX0010SA00 (H3 ES1.1))
    H3ULCB (R-Car Starter Kit Premier, RTP0RC77951SKBX010SA00 (H3 ES2.0))
    compatible = "renesas,h3ulcb", "renesas,r8a7795";
  - Henninger
    compatible = "renesas,henninger", "renesas,r8a7791"
  - iWave Systems RZ/G1E SODIMM SOM Development Platform (iW-RainboW-G22D)
    compatible = "iwave,g22d", "iwave,g22m", "renesas,r8a7745"
  - iWave Systems RZ/G1E SODIMM System On Module (iW-RainboW-G22M-SM)
    compatible = "iwave,g22m", "renesas,r8a7745"
  - iWave Systems RZ/G1M Qseven Development Platform (iW-RainboW-G20D-Qseven)
    compatible = "iwave,g20d", "iwave,g20m", "renesas,r8a7743"
  - iWave Systems RZ/G1M Qseven System On Module (iW-RainboW-G20M-Qseven)
    compatible = "iwave,g20m", "renesas,r8a7743"
  - Kingfisher (SBEV-RCAR-KF-M03)
    compatible = "shimafuji,kingfisher"
  - Koelsch (RTP0RC7791SEB00010S)
    compatible = "renesas,koelsch", "renesas,r8a7791"
  - Kyoto Microcomputer Co. KZM-A9-Dual
    compatible = "renesas,kzm9d", "renesas,emev2"
  - Kyoto Microcomputer Co. KZM-A9-GT
    compatible = "renesas,kzm9g", "renesas,sh73a0"
  - Lager (RTP0RC7790SEB00010S)
    compatible = "renesas,lager", "renesas,r8a7790"
  - M3ULCB (R-Car Starter Kit Pro, RTP0RC7796SKBX0010SA09 (M3 ES1.0))
    compatible = "renesas,m3ulcb", "renesas,r8a7796";
  - Marzen (R0P7779A00010S)
    compatible = "renesas,marzen", "renesas,r8a7779"
  - Porter (M2-LCDP)
    compatible = "renesas,porter", "renesas,r8a7791"
  - RSKRZA1 (YR0K77210C000BE)
    compatible = "renesas,rskrza1", "renesas,r7s72100"
  - Salvator-X (RTP0RC7795SIPB0010S)
    compatible = "renesas,salvator-x", "renesas,r8a7795";
  - Salvator-X (RTP0RC7796SIPB0011S)
    compatible = "renesas,salvator-x", "renesas,r8a7796";
  - Salvator-XS (Salvator-X 2nd version, RTP0RC7795SIPB0012S)
    compatible = "renesas,salvator-xs", "renesas,r8a7795";
  - SILK (RTP0RC7794LCB00011S)
    compatible = "renesas,silk", "renesas,r8a7794"
  - SK-RZG1E (YR8A77450S000BE)
    compatible = "renesas,sk-rzg1e", "renesas,r8a7745"
  - SK-RZG1M (YR8A77430S000BE)
    compatible = "renesas,sk-rzg1m", "renesas,r8a7743"
  - Wheat
    compatible = "renesas,wheat", "renesas,r8a7792"


Most Renesas ARM SoCs have a Product Register that allows to retrieve SoC
product and revision information.  If present, a device node for this register
should be added.

Required properties:
  - compatible: Must be "renesas,prr".
  - reg: Base address and length of the register block.


Examples
--------

	prr: chipid@ff000044 {
		compatible = "renesas,prr";
		reg = <0 0xff000044 0 4>;
	};
```

## Documentation/devicetree/bindings/arm/sirf.txt
```
CSR SiRFprimaII and SiRFmarco device tree bindings.
========================================

Required root node properties:
    - compatible:
    - "sirf,atlas6-cb" : atlas6 "cb" evaluation board
    - "sirf,atlas6" : atlas6 device based board
    - "sirf,atlas7-cb" : atlas7 "cb" evaluation board
    - "sirf,atlas7" : atlas7 device based board
    - "sirf,prima2-cb" : prima2 "cb" evaluation board
    - "sirf,prima2" : prima2 device based board
```

## Documentation/devicetree/bindings/arm/sirf.yaml
```yaml
# SPDX-License-Identifier: GPL-2.0
%YAML 1.2
---
$id: http://devicetree.org/schemas/arm/sirf.yaml#
$schema: http://devicetree.org/meta-schemas/core.yaml#

title: CSR SiRFprimaII and SiRFmarco device tree bindings.

maintainers:
  - Binghua Duan <binghua.duan@csr.com>
  - Barry Song <Baohua.Song@csr.com>

properties:
  $nodename:
    const: '/'
  compatible:
    oneOf:
      - items:
          - const: sirf,atlas6-cb
          - const: sirf,atlas6
      - items:
          - const: sirf,atlas7-cb
          - const: sirf,atlas7
      - items:
          - const: sirf,prima2-cb
          - const: sirf,prima2
...
```
