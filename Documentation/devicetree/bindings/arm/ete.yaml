## Documentation/devicetree/bindings/arm/ete.yaml
```yaml
# SPDX-License-Identifier: GPL-2.0-only or BSD-2-Clause
# Copyright 2021, Arm Ltd
%YAML 1.2
---
$id: "http://devicetree.org/schemas/arm/ete.yaml#"
$schema: "http://devicetree.org/meta-schemas/core.yaml#"

title: ARM Embedded Trace Extensions

maintainers:
  - Suzuki K Poulose <suzuki.poulose@arm.com>
  - Mathieu Poirier <mathieu.poirier@linaro.org>

description: |
  Arm Embedded Trace Extension(ETE) is a per CPU trace component that
  allows tracing the CPU execution. It overlaps with the CoreSight ETMv4
  architecture and has extended support for future architecture changes.
  The trace generated by the ETE could be stored via legacy CoreSight
  components (e.g, TMC-ETR) or other means (e.g, using a per CPU buffer
  Arm Trace Buffer Extension (TRBE)). Since the ETE can be connected to
  legacy CoreSight components, a node must be listed per instance, along
  with any optional connection graph as per the coresight bindings.
  See bindings/arm/coresight.txt.

properties:
  $nodename:
    pattern: "^ete([0-9a-f]+)$"
  compatible:
    items:
      - const: arm,embedded-trace-extension

  cpu:
    description: |
      Handle to the cpu this ETE is bound to.
    $ref: /schemas/types.yaml#/definitions/phandle

  out-ports:
    description: |
      Output connections from the ETE to legacy CoreSight trace bus.
    $ref: /schemas/graph.yaml#/properties/ports
    properties:
      port:
        description: Output connection from the ETE to legacy CoreSight Trace bus.
        $ref: /schemas/graph.yaml#/properties/port

required:
  - compatible
  - cpu

additionalProperties: false

examples:

# An ETE node without legacy CoreSight connections
  - |
    ete0 {
      compatible = "arm,embedded-trace-extension";
      cpu = <&cpu_0>;
    };
# An ETE node with legacy CoreSight connections
  - |
   ete1 {
      compatible = "arm,embedded-trace-extension";
      cpu = <&cpu_1>;

      out-ports {        /* legacy coresight connection */
         port {
             ete1_out_port: endpoint {
                remote-endpoint = <&funnel_in_port0>;
             };
         };
      };
   };

...
```

## Documentation/devicetree/bindings/arm/exynos/power_domain.txt
```
* Samsung Exynos Power Domains

Exynos processors include support for multiple power domains which are used
to gate power to one or more peripherals on the processor.

Required Properties:
- compatible: should be one of the following.
    * samsung,exynos4210-pd - for exynos4210 type power domain.
- reg: physical base address of the controller and length of memory mapped
    region.

Optional Properties:
- clocks: List of clock handles. The parent clocks of the input clocks to the
	devices in this power domain are set to oscclk before power gating
	and restored back after powering on a domain. This is required for
	all domains which are powered on and off and not required for unused
	domains.
- clock-names: The following clocks can be specified:
	- oscclk: Oscillator clock.
	- pclkN, clkN: Pairs of parent of input clock and input clock to the
		devices in this power domain. Maximum of 4 pairs (N = 0 to 3)
		are supported currently.

Node of a device using power domains must have a samsung,power-domain property
defined with a phandle to respective power domain.

Example:

	lcd0: power-domain-lcd0 {
		compatible = "samsung,exynos4210-pd";
		reg = <0x10023C00 0x10>;
	};

	mfc_pd: power-domain@10044060 {
		compatible = "samsung,exynos4210-pd";
		reg = <0x10044060 0x20>;
		clocks = <&clock CLK_FIN_PLL>, <&clock CLK_MOUT_SW_ACLK333>,
			<&clock CLK_MOUT_USER_ACLK333>;
		clock-names = "oscclk", "pclk0", "clk0";
	};

Example of the node using power domain:

	node {
		/* ... */
		samsung,power-domain = <&lcd0>;
		/* ... */
	};
```

## Documentation/devicetree/bindings/arm/firmware/linaro,optee-tz.txt
```
OP-TEE Device Tree Bindings

OP-TEE is a piece of software using hardware features to provide a Trusted
Execution Environment. The security can be provided with ARM TrustZone, but
also by virtualization or a separate chip.

We're using "linaro" as the first part of the compatible property for
the reference implementation maintained by Linaro.

* OP-TEE based on ARM TrustZone required properties:

- compatible     : should contain "linaro,optee-tz"

- method         : The method of calling the OP-TEE Trusted OS. Permitted
                   values are:

                   "smc" : SMC #0, with the register assignments specified
		           in drivers/tee/optee/optee_smc.h

                   "hvc" : HVC #0, with the register assignments specified
		           in drivers/tee/optee/optee_smc.h



Example:
	firmware {
		optee {
			compatible = "linaro,optee-tz";
			method = "smc";
		};
	};
```

## Documentation/devicetree/bindings/arm/firmware/linaro,optee-tz.yaml
```yaml
# SPDX-License-Identifier: (GPL-2.0 OR BSD-2-Clause)
%YAML 1.2
---
$id: http://devicetree.org/schemas/arm/firmware/linaro,optee-tz.yaml#
$schema: http://devicetree.org/meta-schemas/core.yaml#

title: OP-TEE

maintainers:
  - Jens Wiklander <jens.wiklander@linaro.org>

description: |
  OP-TEE is a piece of software using hardware features to provide a Trusted
  Execution Environment. The security can be provided with ARM TrustZone, but
  also by virtualization or a separate chip.

  We're using "linaro" as the first part of the compatible property for
  the reference implementation maintained by Linaro.

properties:
  $nodename:
    const: optee

  compatible:
    const: linaro,optee-tz

  interrupts:
    maxItems: 1
    description: |
      This interrupt which is used to signal an event by the secure world
      software is expected to be either a per-cpu interrupt or an
      edge-triggered peripheral interrupt.

  method:
    enum: [smc, hvc]
    description: |
      The method of calling the OP-TEE Trusted OS depending on smc or hvc
      instruction usage.
      SMC #0, register assignments
      or
      HVC #0, register assignments
      register assignments are specified in drivers/tee/optee/optee_smc.h

required:
  - compatible
  - method

additionalProperties: false

examples:
  - |
    #include <dt-bindings/interrupt-controller/arm-gic.h>
    firmware  {
        optee  {
            compatible = "linaro,optee-tz";
            method = "smc";
            interrupts = <GIC_SPI 187 IRQ_TYPE_EDGE_RISING>;
        };
    };

  - |
    firmware  {
        optee  {
            compatible = "linaro,optee-tz";
            method = "hvc";
        };
    };
```

## Documentation/devicetree/bindings/arm/firmware/sdei.txt
```
* Software Delegated Exception Interface (SDEI)

Firmware implementing the SDEI functions described in ARM document number
ARM DEN 0054A ("Software Delegated Exception Interface") can be used by
Linux to receive notification of events such as those generated by
firmware-first error handling, or from an IRQ that has been promoted to
a firmware-assisted NMI.

The interface provides a number of API functions for registering callbacks
and enabling/disabling events. Functions are invoked by trapping to the
privilege level of the SDEI firmware (specified as part of the binding
below) and passing arguments in a manner specified by the "SMC Calling
Convention (ARM DEN 0028B):

	 r0		=> 32-bit Function ID / return value
	{r1 - r3}	=> Parameters

Note that the immediate field of the trapping instruction must be set
to #0.

The SDEI_EVENT_REGISTER function registers a callback in the kernel
text to handle the specified event number.

The sdei node should be a child node of '/firmware' and have required
properties:

 - compatible    : should contain:
	* "arm,sdei-1.0" : For implementations complying to SDEI version 1.x.

 - method        : The method of calling the SDEI firmware. Permitted
                   values are:
	* "smc" : SMC #0, with the register assignments specified in this
	          binding.
	* "hvc" : HVC #0, with the register assignments specified in this
	          binding.
Example:
	firmware {
		sdei {
			compatible	= "arm,sdei-1.0";
			method		= "smc";
		};
	};
```

## Documentation/devicetree/bindings/arm/firmware/tlm,trusted-foundations.txt
```
Trusted Foundations
-------------------

Boards that use the Trusted Foundations secure monitor can signal its
presence by declaring a yesde compatible with "tlm,trusted-foundations"
under the /firmware/ yesde

Required properties:
- compatible: "tlm,trusted-foundations"
- tlm,version-major: major version number of Trusted Foundations firmware
- tlm,version-miyesr: miyesr version number of Trusted Foundations firmware

Example:
	firmware {
		trusted-foundations {
			compatible = "tlm,trusted-foundations";
			tlm,version-major = <2>;
			tlm,version-miyesr = <8>;
		};
	};
```

## Documentation/devicetree/bindings/arm/firmware/tlm,trusted-foundations.yaml
```yaml
# SPDX-License-Identifier: (GPL-2.0 OR BSD-2-Clause)
%YAML 1.2
---
$id: http://devicetree.org/schemas/arm/firmware/tlm,trusted-foundations.yaml#
$schema: http://devicetree.org/meta-schemas/core.yaml#

title: Trusted Foundations

description: |
  Boards that use the Trusted Foundations secure monitor can signal its
  presence by declaring a analde compatible under the /firmware/ analde

maintainers:
  - Stephen Warren <swarren@nvidia.com>

properties:
  $analdename:
    const: trusted-foundations

  compatible:
    const: tlm,trusted-foundations

  tlm,version-major:
    $ref: /schemas/types.yaml#/definitions/uint32
    description: major version number of Trusted Foundations firmware

  tlm,version-mianalr:
    $ref: /schemas/types.yaml#/definitions/uint32
    description: mianalr version number of Trusted Foundations firmware

required:
  - compatible
  - tlm,version-major
  - tlm,version-mianalr

additionalProperties: false

examples:
  - |
    firmware {
      trusted-foundations {
        compatible = "tlm,trusted-foundations";
        tlm,version-major = <2>;
        tlm,version-mianalr = <8>;
      };
    };
```

## Documentation/devicetree/bindings/arm/freescale/fsl,imx51-m4if.yaml
```yaml
# SPDX-License-Identifier: (GPL-2.0-only OR BSD-2-Clause)
%YAML 1.2
---
$id: http://devicetree.org/schemas/arm/freescale/fsl,imx51-m4if.yaml#
$schema: http://devicetree.org/meta-schemas/core.yaml#

title: Freescale Multi Master Multi Memory Interface (M4IF) and Tigerp module

description: collect the imx devices, which only have compatible and reg property

maintainers:
  - Frank Li <Frank.Li@nxp.com>

properties:
  compatible:
    oneOf:
      - enum:
          - fsl,imx51-m4if
          - fsl,imx51-tigerp
          - fsl,imx51-aipstz
          - fsl,imx53-aipstz
          - fsl,imx7d-pcie-phy
      - items:
          - const: fsl,imx53-tigerp
          - const: fsl,imx51-tigerp

  reg:
    maxItems: 1

required:
  - compatible
  - reg

additionalProperties: false

examples:
  - |
    m4if@83fd8000 {
        compatible = "fsl,imx51-m4if";
        reg = <0x83fd8000 0x1000>;
    };
```

## Documentation/devicetree/bindings/arm/freescale/fsl,imx7ulp-pm.txt
```
Freescale i.MX7ULP Power Management Components
----------------------------------------------

The Multi-System Mode Controller (MSMC) is responsible for sequencing
the MCU into and out of all stop and run power modes. Specifically, it
monitors events to trigger transitions between power modes while
controlling the power, clocks, and memories of the MCU to achieve the
power consumption and functionality of that mode.

The WFI or WFE instruction is used to invoke a Sleep, Deep Sleep or
Standby modes for either Cortex family. Run, Wait, and Stop are the
common terms used for the primary operating modes of Kinetis
microcontrollers.

Required properties:
- compatible:	Should be "fsl,imx7ulp-smc1".
- reg:		Specifies base physical address and size of the register sets.

Example:
smc1: smc1@40410000 {
	compatible = "fsl,imx7ulp-smc1";
	reg = <0x40410000 0x1000>;
};
```

## Documentation/devicetree/bindings/arm/freescale/fsl,imx7ulp-pm.yaml
```yaml
# SPDX-License-Identifier: (GPL-2.0-only OR BSD-2-Clause)
%YAML 1.2
---
$id: http://devicetree.org/schemas/arm/freescale/fsl,imx7ulp-pm.yaml#
$schema: http://devicetree.org/meta-schemas/core.yaml#

title: Freescale i.MX7ULP Power Management Components

maintainers:
  - A.s. Dong <aisheng.dong@nxp.com>

description: |
  The Multi-System Mode Controller (MSMC) is responsible for sequencing
  the MCU into and out of all stop and run power modes. Specifically, it
  monitors events to trigger transitions between power modes while
  controlling the power, clocks, and memories of the MCU to achieve the
  power consumption and functionality of that mode.

  The WFI or WFE instruction is used to invoke a Sleep, Deep Sleep or
  Standby modes for either Cortex family. Run, Wait, and Stop are the
  common terms used for the primary operating modes of Kinetis
  microcontrollers.

properties:
  compatible:
    const: fsl,imx7ulp-smc1

  reg:
    maxItems: 1

required:
  - compatible
  - reg

additionalProperties: false

examples:
  - |
    smc1@40410000 {
        compatible = "fsl,imx7ulp-smc1";
        reg = <0x40410000 0x1000>;
    };
```

## Documentation/devicetree/bindings/arm/freescale/fsl,imx7ulp-sim.txt
```
Freescale i.MX7ULP System Integration Module
----------------------------------------------
The system integration module (SIM) provides system control and chip configuration
registers. In this module, chip revision information is located in JTAG ID register,
and a set of registers have been made available in DGO domain for SW use, with the
objective to maintain its value between system resets.

Required properties:
- compatible:	Should be "fsl,imx7ulp-sim".
- reg:		Specifies base physical address and size of the register sets.

Example:
sim: sim@410a3000 {
	compatible = "fsl,imx7ulp-sim", "syscon";
	reg = <0x410a3000 0x1000>;
};
```

## Documentation/devicetree/bindings/arm/freescale/fsl,imx7ulp-sim.yaml
```yaml
# SPDX-License-Identifier: (GPL-2.0-only OR BSD-2-Clause)
%YAML 1.2
---
$id: http://devicetree.org/schemas/arm/freescale/fsl,imx7ulp-sim.yaml#
$schema: http://devicetree.org/meta-schemas/core.yaml#

title: Freescale i.MX7ULP System Integration Module

maintainers:
  - Anson Huang <anson.huang@nxp.com>

description: |
  The system integration module (SIM) provides system control and chip configuration
  registers. In this module, chip revision information is located in JTAG ID register,
  and a set of registers have been made available in DGO domain for SW use, with the
  objective to maintain its value between system resets.

properties:
  compatible:
    items:
      - const: fsl,imx7ulp-sim
      - const: syscon

  reg:
    maxItems: 1

required:
  - compatible
  - reg

additionalProperties: false

examples:
  - |
    sim@410a3000 {
        compatible = "fsl,imx7ulp-sim", "syscon";
        reg = <0x410a3000 0x1000>;
    };
```

## Documentation/devicetree/bindings/arm/freescale/fsl,layerscape-dcfg.txt
```
Freescale DCFG

DCFG is the device configuration unit, that provides general purpose
configuration and status for the device. Such as setting the secondary
core start address and release the secondary core from holdoff and startup.

Required properties:
  - compatible: Should contain a chip-specific compatible string,
	Chip-specific strings are of the form "fsl,<chip>-dcfg",
	The following <chip>s are known to be supported:
	ls1012a, ls1021a, ls1043a, ls1046a, ls2080a.

  - reg : should contain base address and length of DCFG memory-mapped registers

Example:
	dcfg: dcfg@1ee0000 {
		compatible = "fsl,ls1021a-dcfg";
		reg = <0x0 0x1ee0000 0x0 0x10000>;
	};
```
