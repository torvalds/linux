## Documentation/devicetree/bindings/arm/freescale/fsl,layerscape-scfg.txt
```
Freescale SCFG

SCFG is the supplemental configuration unit, that provides SoC specific
configuration and status registers for the chip. Such as getting PEX port
status.

Required properties:
  - compatible: Should contain a chip-specific compatible string,
	Chip-specific strings are of the form "fsl,<chip>-scfg",
	The following <chip>s are known to be supported:
	ls1012a, ls1021a, ls1043a, ls1046a, ls2080a.

  - reg: should contain base address and length of SCFG memory-mapped registers

Example:
	scfg: scfg@1570000 {
		compatible = "fsl,ls1021a-scfg";
		reg = <0x0 0x1570000 0x0 0x10000>;
	};
```

## Documentation/devicetree/bindings/arm/freescale/fsl,scu.txt
```
NXP i.MX System Controller Firmware (SCFW)
--------------------------------------------------------------------

The System Controller Firmware (SCFW) is a low-level system function
which runs on a dedicated Cortex-M core to provide power, clock, and
resource management. It exists on some i.MX8 processors. e.g. i.MX8QM
(QM, QP), and i.MX8QX (QXP, DX).

The AP communicates with the SC using a multi-ported MU module found
in the LSIO subsystem. The current definition of this MU module provides
5 remote AP connections to the SC to support up to 5 execution environments
(TZ, HV, standard Linux, etc.). The SC side of this MU module interfaces
with the LSIO DSC IP bus. The SC firmware will communicate with this MU
using the MSI bus.

System Controller Device Node:
============================================================

The scu node with the following properties shall be under the /firmware/ node.

Required properties:
-------------------
- compatible:	should be "fsl,imx-scu".
- mbox-names:	should include "tx0", "tx1", "tx2", "tx3",
			       "rx0", "rx1", "rx2", "rx3";
		include "gip3" if want to support general MU interrupt.
- mboxes:	List of phandle of 4 MU channels for tx, 4 MU channels for
		rx, and 1 optional MU channel for general interrupt.
		All MU channels must be in the same MU instance.
		Cross instances are not allowed. The MU instance can only
		be one of LSIO MU0~M4 for imx8qxp and imx8qm. Users need
		to make sure use the one which is not conflict with other
		execution environments. e.g. ATF.
		Note:
		Channel 0 must be "tx0" or "rx0".
		Channel 1 must be "tx1" or "rx1".
		Channel 2 must be "tx2" or "rx2".
		Channel 3 must be "tx3" or "rx3".
		General interrupt rx channel must be "gip3".
		e.g.
		mboxes = <&lsio_mu1 0 0
			  &lsio_mu1 0 1
			  &lsio_mu1 0 2
			  &lsio_mu1 0 3
			  &lsio_mu1 1 0
			  &lsio_mu1 1 1
			  &lsio_mu1 1 2
			  &lsio_mu1 1 3
			  &lsio_mu1 3 3>;
		See Documentation/devicetree/bindings/mailbox/fsl,mu.yaml
		for detailed mailbox binding.

Note: Each mu which supports general interrupt should have an alias correctly
numbered in "aliases" node.
e.g.
aliases {
	mu1 = &lsio_mu1;
};

i.MX SCU Client Device Node:
============================================================

Client nodes are maintained as children of the relevant IMX-SCU device node.

RTC bindings based on SCU Message Protocol
------------------------------------------------------------

Required properties:
- compatible: should be "fsl,imx8qxp-sc-rtc";

Watchdog bindings based on SCU Message Protocol
------------------------------------------------------------

Required properties:
- compatible: should be:
              "fsl,imx8qxp-sc-wdt"
              followed by "fsl,imx-sc-wdt";
Optional properties:
- timeout-sec: contains the watchdog timeout in seconds.

Thermal bindings based on SCU Message Protocol
------------------------------------------------------------

Required properties:
- compatible:			Should be :
				  "fsl,imx8qxp-sc-thermal"
				followed by "fsl,imx-sc-thermal";

- #thermal-sensor-cells:	See Documentation/devicetree/bindings/thermal/thermal-sensor.yaml
				for a description.

Example (imx8qxp):
-------------
aliases {
	mu1 = &lsio_mu1;
};

lsio_mu1: mailbox@5d1c0000 {
	...
	#mbox-cells = <2>;
};

firmware {
	scu {
		compatible = "fsl,imx-scu";
		mbox-names = "tx0", "tx1", "tx2", "tx3",
			     "rx0", "rx1", "rx2", "rx3",
			     "gip3";
		mboxes = <&lsio_mu1 0 0
			  &lsio_mu1 0 1
			  &lsio_mu1 0 2
			  &lsio_mu1 0 3
			  &lsio_mu1 1 0
			  &lsio_mu1 1 1
			  &lsio_mu1 1 2
			  &lsio_mu1 1 3
			  &lsio_mu1 3 3>;

		rtc: rtc {
			compatible = "fsl,imx8qxp-sc-rtc";
		};

		watchdog {
			compatible = "fsl,imx8qxp-sc-wdt", "fsl,imx-sc-wdt";
			timeout-sec = <60>;
		};

		tsens: thermal-sensor {
			compatible = "fsl,imx8qxp-sc-thermal", "fsl,imx-sc-thermal";
			#thermal-sensor-cells = <1>;
		};
	};
};

serial@5a060000 {
	...
};
```

## Documentation/devicetree/bindings/arm/freescale/fsl,vf610-mscm-cpucfg.txt
```
Freescale Vybrid Miscellaneous System Control - CPU Configuration

The MSCM IP contains multiple sub modules, this binding describes the first
block of registers which contains CPU configuration information.

Required properties:
- compatible:	"fsl,vf610-mscm-cpucfg", "syscon"
- reg:		the register range of the MSCM CPU configuration registers

Example:
	mscm_cpucfg: cpucfg@40001000 {
		compatible = "fsl,vf610-mscm-cpucfg", "syscon";
		reg = <0x40001000 0x800>;
	}
```

## Documentation/devicetree/bindings/arm/freescale/fsl,vf610-mscm-ir.txt
```
Freescale Vybrid Miscellaneous System Control - Interrupt Router

The MSCM IP contains multiple sub modules, this binding describes the second
block of registers which control the interrupt router. The interrupt router
allows to configure the recipient of each peripheral interrupt. Furthermore
it controls the directed processor interrupts. The module is available in all
Vybrid SoC's but is only really useful in dual core configurations (VF6xx
which comes with a Cortex-A5/Cortex-M4 combination).

Required properties:
- compatible:		"fsl,vf610-mscm-ir"
- reg:			the register range of the MSCM Interrupt Router
- fsl,cpucfg:		The handle to the MSCM CPU configuration node, required
			to get the current CPU ID
- interrupt-controller:	Identifies the node as an interrupt controller
- #interrupt-cells:	Two cells, interrupt number and cells.
			The hardware interrupt number according to interrupt
			assignment of the interrupt router is required.
			Flags get passed only when using GIC as parent. Flags
			encoding as documented by the GIC bindings.
- interrupt-parent:	Should be the phandle for the interrupt controller of
			the CPU the device tree is intended to be used on. This
			is either the node of the GIC or NVIC controller.

Example:
	mscm_ir: interrupt-controller@40001800 {
		compatible = "fsl,vf610-mscm-ir";
		reg = <0x40001800 0x400>;
		fsl,cpucfg = <&mscm_cpucfg>;
		interrupt-controller;
		#interrupt-cells = <2>;
		interrupt-parent = <&intc>;
	}
```

## Documentation/devicetree/bindings/arm/freescale/m4if.txt
```
* Freescale Multi Master Multi Memory Interface (M4IF) module

Required properties:
- compatible : Should be "fsl,imx51-m4if"
- reg : Address and length of the register set for the device

Example:

m4if: m4if@83fd8000 {
	compatible = "fsl,imx51-m4if";
	reg = <0x83fd8000 0x1000>;
};
```

## Documentation/devicetree/bindings/arm/freescale/tigerp.txt
```
* Freescale Tigerp platform module

Required properties:
- compatible : Should be "fsl,imx51-tigerp"
- reg : Address and length of the register set for the device

Example:

tigerp: tigerp@83fa0000 {
	compatible = "fsl,imx51-tigerp";
	reg = <0x83fa0000 0x28>;
};
```

## Documentation/devicetree/bindings/arm/fsl.txt
```
Freescale i.MX Platforms Device Tree Bindings
-----------------------------------------------

i.MX23 Evaluation Kit
Required root node properties:
    - compatible = "fsl,imx23-evk", "fsl,imx23";

i.MX25 Product Development Kit
Required root node properties:
    - compatible = "fsl,imx25-pdk", "fsl,imx25";

i.MX27 Product Development Kit
Required root node properties:
    - compatible = "fsl,imx27-pdk", "fsl,imx27";

i.MX28 Evaluation Kit
Required root node properties:
    - compatible = "fsl,imx28-evk", "fsl,imx28";

i.MX51 Babbage Board
Required root node properties:
    - compatible = "fsl,imx51-babbage", "fsl,imx51";

i.MX53 Automotive Reference Design Board
Required root node properties:
    - compatible = "fsl,imx53-ard", "fsl,imx53";

i.MX53 Evaluation Kit
Required root node properties:
    - compatible = "fsl,imx53-evk", "fsl,imx53";

i.MX53 Quick Start Board
Required root node properties:
    - compatible = "fsl,imx53-qsb", "fsl,imx53";

i.MX53 Smart Mobile Reference Design Board
Required root node properties:
    - compatible = "fsl,imx53-smd", "fsl,imx53";

i.MX6 Quad Armadillo2 Board
Required root node properties:
    - compatible = "fsl,imx6q-arm2", "fsl,imx6q";

i.MX6 Quad SABRE Lite Board
Required root node properties:
    - compatible = "fsl,imx6q-sabrelite", "fsl,imx6q";

i.MX6 Quad SABRE Smart Device Board
Required root node properties:
    - compatible = "fsl,imx6q-sabresd", "fsl,imx6q";

i.MX6 Quad SABRE Automotive Board
Required root node properties:
    - compatible = "fsl,imx6q-sabreauto", "fsl,imx6q";

i.MX6SLL EVK board
Required root node properties:
    - compatible = "fsl,imx6sll-evk", "fsl,imx6sll";

i.MX6 Quad Plus SABRE Smart Device Board
Required root node properties:
    - compatible = "fsl,imx6qp-sabresd", "fsl,imx6qp";

i.MX6 Quad Plus SABRE Automotive Board
Required root node properties:
    - compatible = "fsl,imx6qp-sabreauto", "fsl,imx6qp";

i.MX6 DualLite SABRE Smart Device Board
Required root node properties:
    - compatible = "fsl,imx6dl-sabresd", "fsl,imx6dl";

i.MX6 DualLite/Solo SABRE Automotive Board
Required root node properties:
    - compatible = "fsl,imx6dl-sabreauto", "fsl,imx6dl";

i.MX6 SoloLite EVK Board
Required root node properties:
    - compatible = "fsl,imx6sl-evk", "fsl,imx6sl";

i.MX6 UltraLite 14x14 EVK Board
Required root node properties:
    - compatible = "fsl,imx6ul-14x14-evk", "fsl,imx6ul";

i.MX6 UltraLiteLite 14x14 EVK Board
Required root node properties:
    - compatible = "fsl,imx6ull-14x14-evk", "fsl,imx6ull";

i.MX6 ULZ 14x14 EVK Board
Required root node properties:
    - compatible = "fsl,imx6ulz-14x14-evk", "fsl,imx6ull", "fsl,imx6ulz";

i.MX6 SoloX SDB Board
Required root node properties:
    - compatible = "fsl,imx6sx-sdb", "fsl,imx6sx";

i.MX6 SoloX Sabre Auto Board
Required root node properties:
    - compatible = "fsl,imx6sx-sabreauto", "fsl,imx6sx";

i.MX7 SabreSD Board
Required root node properties:
    - compatible = "fsl,imx7d-sdb", "fsl,imx7d";

i.MX7ULP Evaluation Kit
Required root node properties:
    - compatible = "fsl,imx7ulp-evk", "fsl,imx7ulp";

Generic i.MX boards
-------------------

No iomux setup is done for these boards, so this must have been configured
by the bootloader for boards to work with the generic bindings.

i.MX27 generic board
Required root node properties:
    - compatible = "fsl,imx27";

i.MX51 generic board
Required root node properties:
    - compatible = "fsl,imx51";

i.MX53 generic board
Required root node properties:
    - compatible = "fsl,imx53";

i.MX6q generic board
Required root node properties:
    - compatible = "fsl,imx6q";

i.MX7ULP generic board
Required root node properties:
    - compatible = "fsl,imx7ulp";

Freescale Vybrid Platform Device Tree Bindings
----------------------------------------------

For the Vybrid SoC familiy all variants with DDR controller are supported,
which is the VF5xx and VF6xx series. Out of historical reasons, in most
places the kernel uses vf610 to refer to the whole familiy.
The compatible string "fsl,vf610m4" is used for the secondary Cortex-M4
core support.

Required root node compatible property (one of them):
    - compatible = "fsl,vf500";
    - compatible = "fsl,vf510";
    - compatible = "fsl,vf600";
    - compatible = "fsl,vf610";
    - compatible = "fsl,vf610m4";

Freescale LS1021A Platform Device Tree Bindings
------------------------------------------------

Required root node compatible properties:
  - compatible = "fsl,ls1021a";

Freescale ARMv8 based Layerscape SoC family Device Tree Bindings
----------------------------------------------------------------

LS1012A SoC
Required root node properties:
    - compatible = "fsl,ls1012a";

LS1012A ARMv8 based RDB Board
Required root node properties:
    - compatible = "fsl,ls1012a-rdb", "fsl,ls1012a";

LS1012A ARMv8 based FRDM Board
Required root node properties:
    - compatible = "fsl,ls1012a-frdm", "fsl,ls1012a";

LS1012A ARMv8 based QDS Board
Required root node properties:
    - compatible = "fsl,ls1012a-qds", "fsl,ls1012a";

LS1043A SoC
Required root node properties:
    - compatible = "fsl,ls1043a";

LS1043A ARMv8 based RDB Board
Required root node properties:
    - compatible = "fsl,ls1043a-rdb", "fsl,ls1043a";

LS1043A ARMv8 based QDS Board
Required root node properties:
    - compatible = "fsl,ls1043a-qds", "fsl,ls1043a";

LS1046A SoC
Required root node properties:
    - compatible = "fsl,ls1046a";

LS1046A ARMv8 based QDS Board
Required root node properties:
    - compatible = "fsl,ls1046a-qds", "fsl,ls1046a";

LS1046A ARMv8 based RDB Board
Required root node properties:
    - compatible = "fsl,ls1046a-rdb", "fsl,ls1046a";

LS1088A SoC
Required root node properties:
    - compatible = "fsl,ls1088a";

LS1088A ARMv8 based QDS Board
Required root node properties:
    - compatible = "fsl,ls1088a-qds", "fsl,ls1088a";

LS1088A ARMv8 based RDB Board
Required root node properties:
    - compatible = "fsl,ls1088a-rdb", "fsl,ls1088a";

LS2080A SoC
Required root node properties:
    - compatible = "fsl,ls2080a";

LS2080A ARMv8 based Simulator model
Required root node properties:
    - compatible = "fsl,ls2080a-simu", "fsl,ls2080a";

LS2080A ARMv8 based QDS Board
Required root node properties:
    - compatible = "fsl,ls2080a-qds", "fsl,ls2080a";

LS2080A ARMv8 based RDB Board
Required root node properties:
    - compatible = "fsl,ls2080a-rdb", "fsl,ls2080a";

LS2088A SoC
Required root node properties:
    - compatible = "fsl,ls2088a";

LS2088A ARMv8 based QDS Board
Required root node properties:
    - compatible = "fsl,ls2088a-qds", "fsl,ls2088a";

LS2088A ARMv8 based RDB Board
Required root node properties:
    - compatible = "fsl,ls2088a-rdb", "fsl,ls2088a";
```

## Documentation/devicetree/bindings/arm/fw-cfg.txt
```
* QEMU Firmware Configuration bindings for ARM

QEMU's arm-softmmu and aarch64-softmmu emulation / virtualization targets
provide the following Firmware Configuration interface on the "virt" machine
type:

- A write-only, 16-bit wide selector (or control) register,
- a read-write, 64-bit wide data register.

QEMU exposes the control and data register to ARM guests as memory mapped
registers; their location is communicated to the guest's UEFI firmware in the
DTB that QEMU places at the bottom of the guest's DRAM.

The authoritative guest-side hardware interface documentation to the fw_cfg
device can be found in "docs/specs/fw_cfg.txt" in the QEMU source tree.


Required properties:

- compatible: "qemu,fw-cfg-mmio".

- reg: the MMIO region used by the device.
  * Bytes 0x0 to 0x7 cover the data register.
  * Bytes 0x8 to 0x9 cover the selector register.
  * Further registers may be appended to the region in case of future interface
    revisions / feature bits.

Example:

/ {
	#size-cells = <0x2>;
	#address-cells = <0x2>;

	fw-cfg@9020000 {
		compatible = "qemu,fw-cfg-mmio";
		reg = <0x0 0x9020000 0x0 0xa>;
	};
};
```
