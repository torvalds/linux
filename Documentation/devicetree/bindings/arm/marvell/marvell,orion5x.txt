## Documentation/devicetree/bindings/arm/mediatek/mediatek,audsys.yaml
```yaml
# SPDX-License-Identifier: (GPL-2.0 OR BSD-2-Clause)
%YAML 1.2
---
$id: http://devicetree.org/schemas/arm/mediatek/mediatek,audsys.yaml#
$schema: http://devicetree.org/meta-schemas/core.yaml#

title: MediaTek AUDSYS controller

maintainers:
  - Eugen Hristev <eugen.hristev@collabora.com>

description:
  The MediaTek AUDSYS controller provides various clocks to the system.

properties:
  compatible:
    oneOf:
      - items:
          - enum:
              - mediatek,mt2701-audsys
              - mediatek,mt6765-audsys
              - mediatek,mt6779-audsys
              - mediatek,mt7622-audsys
              - mediatek,mt8167-audsys
              - mediatek,mt8173-audsys
              - mediatek,mt8183-audiosys
              - mediatek,mt8183-audsys
              - mediatek,mt8186-audsys
              - mediatek,mt8192-audsys
              - mediatek,mt8516-audsys
          - const: syscon
      - items:
          # Special case for mt7623 for backward compatibility
          - const: mediatek,mt7623-audsys
          - const: mediatek,mt2701-audsys
          - const: syscon

  reg:
    maxItems: 1

  '#clock-cells':
    const: 1

  audio-controller:
    type: object

required:
  - compatible
  - '#clock-cells'

if:
  properties:
    compatible:
      contains:
        const: mediatek,mt8183-audiosys
then:
  properties:
    audio-controller:
      $ref: /schemas/sound/mediatek,mt8183-audio.yaml#
else:
  properties:
    audio-controller:
      $ref: /schemas/sound/mediatek,mt2701-audio.yaml#

additionalProperties: false

examples:
  - |
    #include <dt-bindings/interrupt-controller/arm-gic.h>
    #include <dt-bindings/interrupt-controller/irq.h>
    #include <dt-bindings/power/mt2701-power.h>
    #include <dt-bindings/clock/mt2701-clk.h>
    soc {
        #address-cells = <2>;
        #size-cells = <2>;
        audsys: clock-controller@11220000 {
            compatible = "mediatek,mt7622-audsys", "syscon";
            reg = <0 0x11220000 0 0x2000>;
            #clock-cells = <1>;

            afe: audio-controller {
                compatible = "mediatek,mt2701-audio";
                interrupts = <GIC_SPI 104 IRQ_TYPE_LEVEL_LOW>,
                             <GIC_SPI 132 IRQ_TYPE_LEVEL_LOW>;
                interrupt-names = "afe", "asys";
                power-domains = <&scpsys MT2701_POWER_DOMAIN_IFR_MSC>;

                clocks = <&infracfg CLK_INFRA_AUDIO>,
                         <&topckgen CLK_TOP_AUD_MUX1_SEL>,
                         <&topckgen CLK_TOP_AUD_MUX2_SEL>,
                         <&topckgen CLK_TOP_AUD_48K_TIMING>,
                         <&topckgen CLK_TOP_AUD_44K_TIMING>,
                         <&topckgen CLK_TOP_AUD_K1_SRC_SEL>,
                         <&topckgen CLK_TOP_AUD_K2_SRC_SEL>,
                         <&topckgen CLK_TOP_AUD_K3_SRC_SEL>,
                         <&topckgen CLK_TOP_AUD_K4_SRC_SEL>,
                         <&topckgen CLK_TOP_AUD_K1_SRC_DIV>,
                         <&topckgen CLK_TOP_AUD_K2_SRC_DIV>,
                         <&topckgen CLK_TOP_AUD_K3_SRC_DIV>,
                         <&topckgen CLK_TOP_AUD_K4_SRC_DIV>,
                         <&topckgen CLK_TOP_AUD_I2S1_MCLK>,
                         <&topckgen CLK_TOP_AUD_I2S2_MCLK>,
                         <&topckgen CLK_TOP_AUD_I2S3_MCLK>,
                         <&topckgen CLK_TOP_AUD_I2S4_MCLK>,
                         <&audsys CLK_AUD_I2SO1>,
                         <&audsys CLK_AUD_I2SO2>,
                         <&audsys CLK_AUD_I2SO3>,
                         <&audsys CLK_AUD_I2SO4>,
                         <&audsys CLK_AUD_I2SIN1>,
                         <&audsys CLK_AUD_I2SIN2>,
                         <&audsys CLK_AUD_I2SIN3>,
                         <&audsys CLK_AUD_I2SIN4>,
                         <&audsys CLK_AUD_ASRCO1>,
                         <&audsys CLK_AUD_ASRCO2>,
                         <&audsys CLK_AUD_ASRCO3>,
                         <&audsys CLK_AUD_ASRCO4>,
                         <&audsys CLK_AUD_AFE>,
                         <&audsys CLK_AUD_AFE_CONN>,
                         <&audsys CLK_AUD_A1SYS>,
                         <&audsys CLK_AUD_A2SYS>,
                         <&audsys CLK_AUD_AFE_MRGIF>;

                clock-names = "infra_sys_audio_clk",
                              "top_audio_mux1_sel",
                              "top_audio_mux2_sel",
                              "top_audio_a1sys_hp",
                              "top_audio_a2sys_hp",
                              "i2s0_src_sel",
                              "i2s1_src_sel",
                              "i2s2_src_sel",
                              "i2s3_src_sel",
                              "i2s0_src_div",
                              "i2s1_src_div",
                              "i2s2_src_div",
                              "i2s3_src_div",
                              "i2s0_mclk_en",
                              "i2s1_mclk_en",
                              "i2s2_mclk_en",
                              "i2s3_mclk_en",
                              "i2so0_hop_ck",
                              "i2so1_hop_ck",
                              "i2so2_hop_ck",
                              "i2so3_hop_ck",
                              "i2si0_hop_ck",
                              "i2si1_hop_ck",
                              "i2si2_hop_ck",
                              "i2si3_hop_ck",
                              "asrc0_out_ck",
                              "asrc1_out_ck",
                              "asrc2_out_ck",
                              "asrc3_out_ck",
                              "audio_afe_pd",
                              "audio_afe_conn_pd",
                              "audio_a1sys_pd",
                              "audio_a2sys_pd",
                              "audio_mrgif_pd";

                assigned-clocks = <&topckgen CLK_TOP_AUD_MUX1_SEL>,
                                  <&topckgen CLK_TOP_AUD_MUX2_SEL>,
                                  <&topckgen CLK_TOP_AUD_MUX1_DIV>,
                                  <&topckgen CLK_TOP_AUD_MUX2_DIV>;
                assigned-clock-parents = <&topckgen CLK_TOP_AUD1PLL_98M>,
                                         <&topckgen CLK_TOP_AUD2PLL_90M>;
                assigned-clock-rates = <0>, <0>, <49152000>, <45158400>;
            };
        };
    };
```

## Documentation/devicetree/bindings/arm/mediatek/mediatek,bdpsys.txt
```
Mediatek bdpsys controller
============================

The Mediatek bdpsys controller provides various clocks to the system.

Required Properties:

- compatible: Should be:
	- "mediatek,mt2701-bdpsys", "syscon"
	- "mediatek,mt2712-bdpsys", "syscon"
- #clock-cells: Must be 1

The bdpsys controller uses the common clk binding from
Documentation/devicetree/bindings/clock/clock-bindings.txt
The available clocks are defined in dt-bindings/clock/mt*-clk.h.

Example:

bdpsys: clock-controller@1c000000 {
	compatible = "mediatek,mt2701-bdpsys", "syscon";
	reg = <0 0x1c000000 0 0x1000>;
	#clock-cells = <1>;
};
```

## Documentation/devicetree/bindings/arm/mediatek/mediatek,camsys.txt
```
MediaTek CAMSYS controller
============================

The MediaTek camsys controller provides various clocks to the system.

Required Properties:

- compatible: Should be one of:
	- "mediatek,mt8183-camsys", "syscon"
- #clock-cells: Must be 1

The camsys controller uses the common clk binding from
Documentation/devicetree/bindings/clock/clock-bindings.txt
The available clocks are defined in dt-bindings/clock/mt*-clk.h.

Example:

camsys: camsys@1a000000  {
	compatible = "mediatek,mt8183-camsys", "syscon";
	reg = <0 0x1a000000  0 0x1000>;
	#clock-cells = <1>;
};
```

## Documentation/devicetree/bindings/arm/mediatek/mediatek,ethsys.txt
```
Mediatek ethsys controller
============================

The Mediatek ethsys controller provides various clocks to the system.

Required Properties:

- compatible: Should be:
	- "mediatek,mt2701-ethsys", "syscon"
	- "mediatek,mt7622-ethsys", "syscon"
	- "mediatek,mt7623-ethsys", "mediatek,mt2701-ethsys", "syscon"
	- "mediatek,mt7629-ethsys", "syscon"
	- "mediatek,mt7986-ethsys", "syscon"
- #clock-cells: Must be 1
- #reset-cells: Must be 1

The ethsys controller uses the common clk binding from
Documentation/devicetree/bindings/clock/clock-bindings.txt
The available clocks are defined in dt-bindings/clock/mt*-clk.h.

Example:

ethsys: clock-controller@1b000000 {
	compatible = "mediatek,mt2701-ethsys", "syscon";
	reg = <0 0x1b000000 0 0x1000>;
	#clock-cells = <1>;
	#reset-cells = <1>;
};
```

## Documentation/devicetree/bindings/arm/mediatek/mediatek,g3dsys.txt
```
MediaTek g3dsys controller
============================

The MediaTek g3dsys controller provides various clocks and reset controller to
the GPU.

Required Properties:

- compatible: Should be:
	- "mediatek,mt2701-g3dsys", "syscon":
		for MT2701 SoC
	- "mediatek,mt7623-g3dsys", "mediatek,mt2701-g3dsys", "syscon":
		for MT7623 SoC
- #clock-cells: Must be 1
- #reset-cells: Must be 1

The g3dsys controller uses the common clk binding from
Documentation/devicetree/bindings/clock/clock-bindings.txt
The available clocks are defined in dt-bindings/clock/mt*-clk.h.

Example:

g3dsys: clock-controller@13000000 {
	compatible = "mediatek,mt7623-g3dsys",
		     "mediatek,mt2701-g3dsys",
		     "syscon";
	reg = <0 0x13000000 0 0x200>;
	#clock-cells = <1>;
	#reset-cells = <1>;
};
```

## Documentation/devicetree/bindings/arm/mediatek/mediatek,hifsys.txt
```
Mediatek hifsys controller
============================

The Mediatek hifsys controller provides various clocks and reset
outputs to the system.

Required Properties:

- compatible: Should be:
	- "mediatek,mt2701-hifsys", "syscon"
- #clock-cells: Must be 1

The hifsys controller uses the common clk binding from
Documentation/devicetree/bindings/clock/clock-bindings.txt
The available clocks are defined in dt-bindings/clock/mt*-clk.h.

Example:

hifsys: clock-controller@1a000000 {
	compatible = "mediatek,mt2701-hifsys", "syscon";
	reg = <0 0x1a000000 0 0x1000>;
	#clock-cells = <1>;
	#reset-cells = <1>;
};
```

## Documentation/devicetree/bindings/arm/mediatek/mediatek,imgsys.txt
```
Mediatek imgsys controller
============================

The Mediatek imgsys controller provides various clocks to the system.

Required Properties:

- compatible: Should be one of:
	- "mediatek,mt2701-imgsys", "syscon"
	- "mediatek,mt2712-imgsys", "syscon"
	- "mediatek,mt6797-imgsys", "syscon"
	- "mediatek,mt7623-imgsys", "mediatek,mt2701-imgsys", "syscon"
	- "mediatek,mt8173-imgsys", "syscon"
- #clock-cells: Must be 1

The imgsys controller uses the common clk binding from
Documentation/devicetree/bindings/clock/clock-bindings.txt
The available clocks are defined in dt-bindings/clock/mt*-clk.h.

Example:

imgsys: clock-controller@15000000 {
	compatible = "mediatek,mt8173-imgsys", "syscon";
	reg = <0 0x15000000 0 0x1000>;
	#clock-cells = <1>;
};
```

## Documentation/devicetree/bindings/arm/mediatek/mediatek,infracfg.txt
```
Mediatek infracfg controller
============================

The Mediatek infracfg controller provides various clocks and reset
outputs to the system.

Required Properties:

- compatible: Should be one of:
	- "mediatek,mt2701-infracfg", "syscon"
	- "mediatek,mt2712-infracfg", "syscon"
	- "mediatek,mt6797-infracfg", "syscon"
	- "mediatek,mt7622-infracfg", "syscon"
	- "mediatek,mt7623-infracfg", "mediatek,mt2701-infracfg", "syscon"
	- "mediatek,mt8135-infracfg", "syscon"
	- "mediatek,mt8173-infracfg", "syscon"
- #clock-cells: Must be 1
- #reset-cells: Must be 1

The infracfg controller uses the common clk binding from
Documentation/devicetree/bindings/clock/clock-bindings.txt
The available clocks are defined in dt-bindings/clock/mt*-clk.h.
Also it uses the common reset controller binding from
Documentation/devicetree/bindings/reset/reset.txt.
The available reset outputs are defined in
dt-bindings/reset/mt*-resets.h

Example:

infracfg: power-controller@10001000 {
	compatible = "mediatek,mt8173-infracfg", "syscon";
	reg = <0 0x10001000 0 0x1000>;
	#clock-cells = <1>;
	#reset-cells = <1>;
};
```

## Documentation/devicetree/bindings/arm/mediatek/mediatek,infracfg.yaml
```yaml
# SPDX-License-Identifier: (GPL-2.0 OR BSD-2-Clause)
%YAML 1.2
---
$id: "http://devicetree.org/schemas/arm/mediatek/mediatek,infracfg.yaml#"
$schema: "http://devicetree.org/meta-schemas/core.yaml#"

title: MediaTek Infrastructure System Configuration Controller

maintainers:
  - Matthias Brugger <matthias.bgg@gmail.com>

description:
  The Mediatek infracfg controller provides various clocks and reset outputs
  to the system. The clock values can be found in <dt-bindings/clock/mt*-clk.h>,
  and reset values in <dt-bindings/reset/mt*-reset.h> and
  <dt-bindings/reset/mt*-resets.h>.

properties:
  compatible:
    oneOf:
      - items:
          - enum:
              - mediatek,mt2701-infracfg
              - mediatek,mt2712-infracfg
              - mediatek,mt6765-infracfg
              - mediatek,mt6795-infracfg
              - mediatek,mt6779-infracfg_ao
              - mediatek,mt6797-infracfg
              - mediatek,mt7622-infracfg
              - mediatek,mt7629-infracfg
              - mediatek,mt7981-infracfg
              - mediatek,mt7986-infracfg
              - mediatek,mt8135-infracfg
              - mediatek,mt8167-infracfg
              - mediatek,mt8173-infracfg
              - mediatek,mt8183-infracfg
              - mediatek,mt8516-infracfg
          - const: syscon
      - items:
          - const: mediatek,mt7623-infracfg
          - const: mediatek,mt2701-infracfg
          - const: syscon

  reg:
    maxItems: 1

  '#clock-cells':
    const: 1

  '#reset-cells':
    const: 1

required:
  - compatible
  - reg
  - '#clock-cells'

if:
  properties:
    compatible:
      contains:
        enum:
          - mediatek,mt2701-infracfg
          - mediatek,mt2712-infracfg
          - mediatek,mt6795-infracfg
          - mediatek,mt7622-infracfg
          - mediatek,mt7986-infracfg
          - mediatek,mt8135-infracfg
          - mediatek,mt8173-infracfg
          - mediatek,mt8183-infracfg
then:
  required:
    - '#reset-cells'

additionalProperties: false

examples:
  - |
    infracfg: clock-controller@10001000 {
        compatible = "mediatek,mt8173-infracfg", "syscon";
        reg = <0x10001000 0x1000>;
        #clock-cells = <1>;
        #reset-cells = <1>;
    };
```

## Documentation/devicetree/bindings/arm/mediatek/mediatek,ipesys.txt
```
Mediatek ipesys controller
============================

The Mediatek ipesys controller provides various clocks to the system.

Required Properties:

- compatible: Should be one of:
	- "mediatek,mt6779-ipesys", "syscon"
- #clock-cells: Must be 1

The ipesys controller uses the common clk binding from
Documentation/devicetree/bindings/clock/clock-bindings.txt
The available clocks are defined in dt-bindings/clock/mt*-clk.h.

Example:

ipesys: clock-controller@1b000000 {
	compatible = "mediatek,mt6779-ipesys", "syscon";
	reg = <0 0x1b000000 0 0x1000>;
	#clock-cells = <1>;
};
```
