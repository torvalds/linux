## Documentation/devicetree/bindings/arm/marvell/marvell,orion5x.txt
```
Marvell Orion SoC Family Device Tree Bindings
---------------------------------------------

Boards with a SoC of the Marvell Orion family, eg 88f5181

* Required root node properties:
compatible: must contain "marvell,orion5x"

In addition, the above compatible shall be extended with the specific
SoC. Currently known SoC compatibles are:

"marvell,orion5x-88f5181"
"marvell,orion5x-88f5182"

And in addition, the compatible shall be extended with the specific
board. Currently known boards are:

"buffalo,lsgl"
"buffalo,lswsgl"
"buffalo,lswtgl"
"lacie,ethernet-disk-mini-v2"
"lacie,d2-network"
"marvell,rd-88f5182-nas"
"maxtor,shared-storage-2"
"netgear,wnr854t"
```

## Documentation/devicetree/bindings/arm/marvell/marvell,orion5x.yaml
```yaml
# SPDX-License-Identifier: (GPL-2.0-only OR BSD-2-Clause)
%YAML 1.2
---
$id: http://devicetree.org/schemas/arm/marvell/marvell,orion5x.yaml#
$schema: http://devicetree.org/meta-schemas/core.yaml#

title: Marvell Orion5x SoC Family

maintainers:
  - Andrew Lunn <andrew@lunn.ch>
  - Gregory Clement <gregory.clement@bootlin.com>

properties:
  $nodename:
    const: '/'
  compatible:
    oneOf:
      - items:
          - enum:
              - netgear,wnr854t
          - const: marvell,orion5x-88f5181
          - const: marvell,orion5x
      - items:
          - enum:
              - buffalo,kurobox-pro
              - buffalo,lschl
              - buffalo,lsgl
              - buffalo,lswsgl
              - buffalo,lswtgl
              - lacie,ethernet-disk-mini-v2
              - lacie,d2-network
              - marvell,rd-88f5182-nas
              - maxtor,shared-storage-2
          - const: marvell,orion5x-88f5182
          - const: marvell,orion5x

additionalProperties: true
```

## Documentation/devicetree/bindings/arm/marvell/mvebu-cpu-config.txt
```
MVEBU CPU Config registers
--------------------------

MVEBU (Marvell SOCs: Armada 370/XP)

Required properties:

- compatible: one of:
	- "marvell,armada-370-cpu-config"
	- "marvell,armada-xp-cpu-config"

- reg: Should contain CPU config registers location and length, in
  their per-CPU variant

Example:

	cpu-config@21000 {
		compatible = "marvell,armada-xp-cpu-config";
		reg = <0x21000 0x8>;
	};
```

## Documentation/devicetree/bindings/arm/mediatek.txt
```
MediaTek SoC based Platforms Device Tree Bindings

Boards with a MediaTek SoC shall have the following property:

Required root node property:

compatible: Must contain one of
   "mediatek,mt2701"
   "mediatek,mt2712"
   "mediatek,mt6580"
   "mediatek,mt6589"
   "mediatek,mt6592"
   "mediatek,mt6755"
   "mediatek,mt6795"
   "mediatek,mt6797"
   "mediatek,mt7622"
   "mediatek,mt7623" which is referred to MT7623N SoC
   "mediatek,mt7623a"
   "mediatek,mt8127"
   "mediatek,mt8135"
   "mediatek,mt8173"


Supported boards:

- Evaluation board for MT2701:
    Required root node properties:
      - compatible = "mediatek,mt2701-evb", "mediatek,mt2701";
- Evaluation board for MT2712:
    Required root node properties:
      - compatible = "mediatek,mt2712-evb", "mediatek,mt2712";
- Evaluation board for MT6580:
    Required root node properties:
      - compatible = "mediatek,mt6580-evbp1", "mediatek,mt6580";
- bq Aquaris5 smart phone:
    Required root node properties:
      - compatible = "mundoreader,bq-aquaris5", "mediatek,mt6589";
- Evaluation board for MT6592:
    Required root node properties:
      - compatible = "mediatek,mt6592-evb", "mediatek,mt6592";
- Evaluation phone for MT6755(Helio P10):
    Required root node properties:
      - compatible = "mediatek,mt6755-evb", "mediatek,mt6755";
- Evaluation board for MT6795(Helio X10):
    Required root node properties:
      - compatible = "mediatek,mt6795-evb", "mediatek,mt6795";
- Evaluation board for MT6797(Helio X20):
    Required root node properties:
      - compatible = "mediatek,mt6797-evb", "mediatek,mt6797";
- Reference board variant 1 for MT7622:
    Required root node properties:
      - compatible = "mediatek,mt7622-rfb1", "mediatek,mt7622";
- Reference board for MT7623a with eMMC:
    Required root node properties:
      - compatible = "mediatek,mt7623a-rfb-emmc", "mediatek,mt7623";
- Reference board for MT7623a with NAND:
    Required root node properties:
      - compatible = "mediatek,mt7623a-rfb-nand", "mediatek,mt7623";
- Reference board for MT7623n with eMMC:
    Required root node properties:
      - compatible = "mediatek,mt7623n-rfb-emmc", "mediatek,mt7623";
- Reference  board for MT7623n with NAND:
    Required root node properties:
      - compatible = "mediatek,mt7623n-rfb-nand", "mediatek,mt7623";
- Bananapi BPI-R2 board:
      - compatible = "bananapi,bpi-r2", "mediatek,mt7623";
- MTK mt8127 tablet moose EVB:
    Required root node properties:
      - compatible = "mediatek,mt8127-moose", "mediatek,mt8127";
- MTK mt8135 tablet EVB:
    Required root node properties:
      - compatible = "mediatek,mt8135-evbp1", "mediatek,mt8135";
- MTK mt8173 tablet EVB:
    Required root node properties:
      - compatible = "mediatek,mt8173-evb", "mediatek,mt8173";
```

## Documentation/devicetree/bindings/arm/mediatek.yaml
```yaml
# SPDX-License-Identifier: GPL-2.0
%YAML 1.2
---
$id: http://devicetree.org/schemas/arm/mediatek.yaml#
$schema: http://devicetree.org/meta-schemas/core.yaml#

title: MediaTek SoC based Platforms Device Tree Bindings

maintainers:
  - Sean Wang <sean.wang@mediatek.com>
  - Matthias Brugger <matthias.bgg@gmail.com>
description: |
  Boards with a MediaTek SoC shall have the following properties.

properties:
  $nodename:
    const: '/'
  compatible:
    oneOf:
      - items:
          - enum:
              - mediatek,mt2701-evb
          - const: mediatek,mt2701

      - items:
          - enum:
              - mediatek,mt2712-evb
          - const: mediatek,mt2712
      - items:
          - enum:
              - mediatek,mt6580-evbp1
          - const: mediatek,mt6580
      - items:
          - enum:
              - prestigio,pmt5008-3g
          - const: mediatek,mt6582
      - items:
          - enum:
              - fairphone,fp1
              - mundoreader,bq-aquaris5
          - const: mediatek,mt6589
      - items:
          - enum:
              - mediatek,mt6592-evb
          - const: mediatek,mt6592
      - items:
          - enum:
              - mediatek,mt6755-evb
          - const: mediatek,mt6755
      - items:
          - enum:
              - mediatek,mt6765-evb
          - const: mediatek,mt6765
      - items:
          - enum:
              - mediatek,mt6779-evb
          - const: mediatek,mt6779
      - items:
          - enum:
              - mediatek,mt6795-evb
          - const: mediatek,mt6795
      - items:
          - enum:
              - archermind,mt6797-x20-dev
              - mediatek,mt6797-evb
          - const: mediatek,mt6797
      - items:
          - enum:
              - bananapi,bpi-r64
              - mediatek,mt7622-rfb1
          - const: mediatek,mt7622
      - items:
          - enum:
              - mediatek,mt7623a-rfb-emmc
              - mediatek,mt7623a-rfb-nand
              - mediatek,mt7623n-rfb-emmc
              - bananapi,bpi-r2
          - const: mediatek,mt7623

      - items:
          - enum:
              - mediatek,mt7629-rfb
          - const: mediatek,mt7629
      - items:
          - enum:
              - mediatek,mt7986a-rfb
          - const: mediatek,mt7986a
      - items:
          - enum:
              - mediatek,mt7986b-rfb
          - const: mediatek,mt7986b
      - items:
          - enum:
              - mediatek,mt8127-moose
          - const: mediatek,mt8127
      - items:
          - enum:
              - mediatek,mt8135-evbp1
          - const: mediatek,mt8135
      - items:
          - enum:
              - mediatek,mt8167-pumpkin
          - const: mediatek,mt8167
      - description: Google Elm (Acer Chromebook R13)
        items:
          - const: google,elm-rev8
          - const: google,elm-rev7
          - const: google,elm-rev6
          - const: google,elm-rev5
          - const: google,elm-rev4
          - const: google,elm-rev3
          - const: google,elm
          - const: mediatek,mt8173
      - description: Google Hana (Lenovo Chromebook N23 Yoga, C330, 300e,...)
        items:
          - const: google,hana-rev6
          - const: google,hana-rev5
          - const: google,hana-rev4
          - const: google,hana-rev3
          - const: google,hana
          - const: mediatek,mt8173
      - description: Google Hana rev7 (Poin2 Chromebook 11C)
        items:
          - const: google,hana-rev7
          - const: mediatek,mt8173
      - items:
          - enum:
              - mediatek,mt8173-evb
          - const: mediatek,mt8173
      - items:
          - enum:
              - mediatek,mt8183-evb
          - const: mediatek,mt8183
      - description: Google Hayato
        items:
          - const: google,hayato-rev1
          - const: google,hayato
          - const: mediatek,mt8192
      - description: Google Spherion (Acer Chromebook 514)
        items:
          - const: google,spherion-rev3
          - const: google,spherion-rev2
          - const: google,spherion-rev1
          - const: google,spherion-rev0
          - const: google,spherion
          - const: mediatek,mt8192
      - description: Acer Tomato (Acer Chromebook Spin 513 CP513-2H)
        items:
          - enum:
              - google,tomato-rev2
              - google,tomato-rev1
          - const: google,tomato
          - const: mediatek,mt8195
      - description: Acer Tomato rev3 - 4 (Acer Chromebook Spin 513 CP513-2H)
        items:
          - const: google,tomato-rev4
          - const: google,tomato-rev3
          - const: google,tomato
          - const: mediatek,mt8195
      - items:
          - enum:
              - mediatek,mt8186-evb
          - const: mediatek,mt8186
      - items:
          - enum:
              - mediatek,mt8192-evb
          - const: mediatek,mt8192
      - items:
          - enum:
              - mediatek,mt8195-demo
              - mediatek,mt8195-evb
          - const: mediatek,mt8195
      - description: Google Burnet (HP Chromebook x360 11MK G3 EE)
        items:
          - const: google,burnet
          - const: mediatek,mt8183
      - description: Google Krane (Lenovo IdeaPad Duet, 10e,...)
        items:
          - enum:
              - google,krane-sku0
              - google,krane-sku176
          - const: google,krane
          - const: mediatek,mt8183
      - description: Google Cozmo (Acer Chromebook 314)
        items:
          - const: google,cozmo
          - const: mediatek,mt8183
      - description: Google Damu (ASUS Chromebook Flip CM3)
        items:
          - const: google,damu
          - const: mediatek,mt8183
      - description: Google Fennel (Lenovo IdeaPad 3 Chromebook)
        items:
          - enum:
              - google,fennel-sku0
              - google,fennel-sku1
              - google,fennel-sku2
              - google,fennel-sku6
              - google,fennel-sku7
          - const: google,fennel
          - const: mediatek,mt8183
      - description: Google Juniper (Acer Chromebook Spin 311) / Kenzo (Acer Chromebook 311)
        items:
          - enum:
              - google,juniper-sku16
              - google,juniper-sku17
          - const: google,juniper
          - const: mediatek,mt8183
      - description: Google Kakadu (ASUS Chromebook Detachable CM3)
        items:
          - const: google,kakadu-rev3
          - const: google,kakadu-rev2
          - const: google,kakadu
          - const: mediatek,mt8183
      - description: Google Kakadu (ASUS Chromebook Detachable CM3)
        items:
          - const: google,kakadu-rev3-sku22
          - const: google,kakadu-rev2-sku22
          - const: google,kakadu
          - const: mediatek,mt8183
      - description: Google Kappa (HP Chromebook 11a)
        items:
          - const: google,kappa
          - const: mediatek,mt8183
      - description: Google Kodama (Lenovo 10e Chromebook Tablet)
        items:
          - enum:
              - google,kodama-sku16
              - google,kodama-sku272
              - google,kodama-sku288
              - google,kodama-sku32
          - const: google,kodama
          - const: mediatek,mt8183
      - description: Google Willow (Acer Chromebook 311 C722/C722T)
        items:
          - enum:
              - google,willow-sku0
              - google,willow-sku1
          - const: google,willow
          - const: mediatek,mt8183
      - items:
          - enum:
              - mediatek,mt8183-pumpkin
          - const: mediatek,mt8183
      - items:
          - enum:
              - mediatek,mt8516-pumpkin
          - const: mediatek,mt8516

additionalProperties: true

...
```

## Documentation/devicetree/bindings/arm/mediatek/mediatek,apmixedsys.txt
```
Mediatek apmixedsys controller
==============================

The Mediatek apmixedsys controller provides the PLLs to the system.

Required Properties:

- compatible: Should be one of:
	- "mediatek,mt2701-apmixedsys"
	- "mediatek,mt2712-apmixedsys", "syscon"
	- "mediatek,mt6765-apmixedsys", "syscon"
	- "mediatek,mt6779-apmixedsys", "syscon"
	- "mediatek,mt6797-apmixedsys"
	- "mediatek,mt7622-apmixedsys"
	- "mediatek,mt7623-apmixedsys", "mediatek,mt2701-apmixedsys"
	- "mediatek,mt7629-apmixedsys"
	- "mediatek,mt7986-apmixedsys"
	- "mediatek,mt8135-apmixedsys"
	- "mediatek,mt8167-apmixedsys", "syscon"
	- "mediatek,mt8173-apmixedsys"
	- "mediatek,mt8183-apmixedsys", "syscon"
	- "mediatek,mt8516-apmixedsys"
- #clock-cells: Must be 1

The apmixedsys controller uses the common clk binding from
Documentation/devicetree/bindings/clock/clock-bindings.txt
The available clocks are defined in dt-bindings/clock/mt*-clk.h.

Example:

apmixedsys: clock-controller@10209000 {
	compatible = "mediatek,mt8173-apmixedsys";
	reg = <0 0x10209000 0 0x1000>;
	#clock-cells = <1>;
};
```

## Documentation/devicetree/bindings/arm/mediatek/mediatek,audsys.txt
```
MediaTek AUDSYS controller
============================

The MediaTek AUDSYS controller provides various clocks to the system.

Required Properties:

- compatible: Should be one of:
	- "mediatek,mt2701-audsys", "syscon"
	- "mediatek,mt7622-audsys", "syscon"
	- "mediatek,mt7623-audsys", "mediatek,mt2701-audsys", "syscon"
	- "mediatek,mt8183-audiosys", "syscon"
	- "mediatek,mt8516-audsys", "syscon"
- #clock-cells: Must be 1

The AUDSYS controller uses the common clk binding from
Documentation/devicetree/bindings/clock/clock-bindings.txt
The available clocks are defined in dt-bindings/clock/mt*-clk.h.

Required sub-nodes:
-------
For common binding part and usage, refer to
../sonud/mt2701-afe-pcm.txt.

Example:

	audsys: clock-controller@11220000 {
		compatible = "mediatek,mt7622-audsys", "syscon";
		reg = <0 0x11220000 0 0x2000>;
		#clock-cells = <1>;

		afe: audio-controller {
			...
		};
	};
```
