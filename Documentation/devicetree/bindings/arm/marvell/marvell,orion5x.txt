## Documentation/devicetree/bindings/arm/mediatek/mediatek,ipu.txt
```
Mediatek IPU controller
============================

The Mediatek ipu controller provides various clocks to the system.

Required Properties:

- compatible: Should be one of:
	- "mediatek,mt8183-ipu_conn", "syscon"
	- "mediatek,mt8183-ipu_adl", "syscon"
	- "mediatek,mt8183-ipu_core0", "syscon"
	- "mediatek,mt8183-ipu_core1", "syscon"
- #clock-cells: Must be 1

The ipu controller uses the common clk binding from
Documentation/devicetree/bindings/clock/clock-bindings.txt
The available clocks are defined in dt-bindings/clock/mt*-clk.h.

Example:

ipu_conn: syscon@19000000 {
	compatible = "mediatek,mt8183-ipu_conn", "syscon";
	reg = <0 0x19000000 0 0x1000>;
	#clock-cells = <1>;
};

ipu_adl: syscon@19010000 {
	compatible = "mediatek,mt8183-ipu_adl", "syscon";
	reg = <0 0x19010000 0 0x1000>;
	#clock-cells = <1>;
};

ipu_core0: syscon@19180000 {
	compatible = "mediatek,mt8183-ipu_core0", "syscon";
	reg = <0 0x19180000 0 0x1000>;
	#clock-cells = <1>;
};

ipu_core1: syscon@19280000 {
	compatible = "mediatek,mt8183-ipu_core1", "syscon";
	reg = <0 0x19280000 0 0x1000>;
	#clock-cells = <1>;
};
```

## Documentation/devicetree/bindings/arm/mediatek/mediatek,jpgdecsys.txt
```
Mediatek jpgdecsys controller
============================

The Mediatek jpgdecsys controller provides various clocks to the system.

Required Properties:

- compatible: Should be:
	- "mediatek,mt2712-jpgdecsys", "syscon"
- #clock-cells: Must be 1

The jpgdecsys controller uses the common clk binding from
Documentation/devicetree/bindings/clock/clock-bindings.txt
The available clocks are defined in dt-bindings/clock/mt*-clk.h.

Example:

jpgdecsys: syscon@19000000 {
	compatible = "mediatek,mt2712-jpgdecsys", "syscon";
	reg = <0 0x19000000 0 0x1000>;
	#clock-cells = <1>;
};
```

## Documentation/devicetree/bindings/arm/mediatek/mediatek,mcucfg.txt
```
Mediatek mcucfg controller
============================

The Mediatek mcucfg controller provides various clocks to the system.

Required Properties:

- compatible: Should be one of:
	- "mediatek,mt2712-mcucfg", "syscon"
	- "mediatek,mt8183-mcucfg", "syscon"
- #clock-cells: Must be 1

The mcucfg controller uses the common clk binding from
Documentation/devicetree/bindings/clock/clock-bindings.txt
The available clocks are defined in dt-bindings/clock/mt*-clk.h.

Example:

mcucfg: syscon@10220000 {
	compatible = "mediatek,mt2712-mcucfg", "syscon";
	reg = <0 0x10220000 0 0x1000>;
	#clock-cells = <1>;
};
```

## Documentation/devicetree/bindings/arm/mediatek/mediatek,mfgcfg.txt
```
Mediatek mfgcfg controller
============================

The Mediatek mfgcfg controller provides various clocks to the system.

Required Properties:

- compatible: Should be one of:
	- "mediatek,mt2712-mfgcfg", "syscon"
- #clock-cells: Must be 1

The mfgcfg controller uses the common clk binding from
Documentation/devicetree/bindings/clock/clock-bindings.txt
The available clocks are defined in dt-bindings/clock/mt*-clk.h.

Example:

mfgcfg: syscon@13000000 {
	compatible = "mediatek,mt2712-mfgcfg", "syscon";
	reg = <0 0x13000000 0 0x1000>;
	#clock-cells = <1>;
};
```

## Documentation/devicetree/bindings/arm/mediatek/mediatek,mipi0a.txt
```
Mediatek mipi0a (mipi_rx_ana_csi0a) controller
============================

The Mediatek mipi0a controller provides various clocks
to the system.

Required Properties:

- compatible: Should be one of:
	- "mediatek,mt6765-mipi0a", "syscon"
- #clock-cells: Must be 1

The mipi0a controller uses the common clk binding from
Documentation/devicetree/bindings/clock/clock-bindings.txt
The available clocks are defined in dt-bindings/clock/mt*-clk.h.

The mipi0a controller also uses the common power domain from
Documentation/devicetree/bindings/soc/mediatek/scpsys.txt
The available power doamins are defined in dt-bindings/power/mt*-power.h.

Example:

mipi0a: clock-controller@11c10000 {
	compatible = "mediatek,mt6765-mipi0a", "syscon";
	reg = <0 0x11c10000 0 0x1000>;
	power-domains = <&scpsys MT6765_POWER_DOMAIN_CAM>;
	#clock-cells = <1>;
};
```

## Documentation/devicetree/bindings/arm/mediatek/mediatek,mmsys.txt
```
Mediatek mmsys controller
============================

The Mediatek mmsys system controller provides clock control, routing control,
and miscellaneous control in mmsys partition.

Required Properties:

- compatible: Should be one of:
	- "mediatek,mt2701-mmsys", "syscon"
	- "mediatek,mt2712-mmsys", "syscon"
	- "mediatek,mt6779-mmsys", "syscon"
	- "mediatek,mt6797-mmsys", "syscon"
	- "mediatek,mt7623-mmsys", "mediatek,mt2701-mmsys", "syscon"
	- "mediatek,mt8173-mmsys", "syscon"
	- "mediatek,mt8183-mmsys", "syscon"
- #clock-cells: Must be 1

For the clock control, the mmsys controller uses the common clk binding from
Documentation/devicetree/bindings/clock/clock-bindings.txt
The available clocks are defined in dt-bindings/clock/mt*-clk.h.

Example:

mmsys: syscon@14000000 {
	compatible = "mediatek,mt8173-mmsys", "syscon";
	reg = <0 0x14000000 0 0x1000>;
	#clock-cells = <1>;
};
```

## Documentation/devicetree/bindings/arm/mediatek/mediatek,mmsys.yaml
```yaml
# SPDX-License-Identifier: (GPL-2.0 OR BSD-2-Clause)
%YAML 1.2
---
$id: http://devicetree.org/schemas/arm/mediatek/mediatek,mmsys.yaml#
$schema: http://devicetree.org/meta-schemas/core.yaml#

title: MediaTek mmsys controller

maintainers:
  - Matthias Brugger <matthias.bgg@gmail.com>

description:
  The MediaTek mmsys system controller provides clock control, routing control,
  and miscellaneous control in mmsys partition.

properties:
  $nodename:
    pattern: "^syscon@[0-9a-f]+$"

  compatible:
    oneOf:
      - items:
          - enum:
              - mediatek,mt2701-mmsys
              - mediatek,mt2712-mmsys
              - mediatek,mt6765-mmsys
              - mediatek,mt6779-mmsys
              - mediatek,mt6795-mmsys
              - mediatek,mt6797-mmsys
              - mediatek,mt8167-mmsys
              - mediatek,mt8173-mmsys
              - mediatek,mt8183-mmsys
              - mediatek,mt8186-mmsys
              - mediatek,mt8188-vdosys0
              - mediatek,mt8192-mmsys
              - mediatek,mt8195-vdosys1
              - mediatek,mt8195-vppsys0
              - mediatek,mt8195-vppsys1
              - mediatek,mt8365-mmsys
          - const: syscon

      - description: vdosys0 and vdosys1 are 2 display HW pipelines,
                     so mt8195 binding should be deprecated.
        deprecated: true
        items:
          - const: mediatek,mt8195-mmsys
          - const: syscon

      - items:
          - const: mediatek,mt7623-mmsys
          - const: mediatek,mt2701-mmsys
          - const: syscon

      - items:
          - const: mediatek,mt8195-vdosys0
          - const: mediatek,mt8195-mmsys
          - const: syscon

  reg:
    maxItems: 1

  power-domains:
    description:
      A phandle and PM domain specifier as defined by bindings
      of the power controller specified by phandle. See
      Documentation/devicetree/bindings/power/power-domain.yaml for details.

  mboxes:
    description:
      Using mailbox to communicate with GCE, it should have this
      property and list of phandle, mailbox specifiers. See
      Documentation/devicetree/bindings/mailbox/mediatek,gce-mailbox.yaml
      for details.
    $ref: /schemas/types.yaml#/definitions/phandle-array

  mediatek,gce-client-reg:
    description:
      The register of client driver can be configured by gce with 4 arguments
      defined in this property, such as phandle of gce, subsys id,
      register offset and size.
      Each subsys id is mapping to a base address of display function blocks
      register which is defined in the gce header
      include/dt-bindings/gce/<chip>-gce.h.
    $ref: /schemas/types.yaml#/definitions/phandle-array
    maxItems: 1

  "#clock-cells":
    const: 1

  '#reset-cells':
    const: 1

required:
  - compatible
  - reg
  - "#clock-cells"

additionalProperties: false

examples:
  - |
    #include <dt-bindings/power/mt8173-power.h>
    #include <dt-bindings/gce/mt8173-gce.h>

    mmsys: syscon@14000000 {
        compatible = "mediatek,mt8173-mmsys", "syscon";
        reg = <0x14000000 0x1000>;
        power-domains = <&spm MT8173_POWER_DOMAIN_MM>;
        #clock-cells = <1>;
        #reset-cells = <1>;
        mboxes = <&gce 0 CMDQ_THR_PRIO_HIGHEST>,
                 <&gce 1 CMDQ_THR_PRIO_HIGHEST>;
        mediatek,gce-client-reg = <&gce SUBSYS_1400XXXX 0 0x1000>;
    };
```

## Documentation/devicetree/bindings/arm/mediatek/mediatek,mt7622-pcie-mirror.yaml
```yaml
# SPDX-License-Identifier: (GPL-2.0 OR BSD-2-Clause)
%YAML 1.2
---
$id: http://devicetree.org/schemas/arm/mediatek/mediatek,mt7622-pcie-mirror.yaml#
$schema: http://devicetree.org/meta-schemas/core.yaml#

title: MediaTek PCIE Mirror Controller for MT7622

maintainers:
  - Lorenzo Bianconi <lorenzo@kernel.org>
  - Felix Fietkau <nbd@nbd.name>

description:
  The mediatek PCIE mirror provides a configuration interface for PCIE
  controller on MT7622 soc.

properties:
  compatible:
    items:
      - enum:
          - mediatek,mt7622-pcie-mirror
      - const: syscon

  reg:
    maxItems: 1

required:
  - compatible
  - reg

additionalProperties: false

examples:
  - |
    soc {
      #address-cells = <2>;
      #size-cells = <2>;
      pcie_mirror: pcie-mirror@10000400 {
        compatible = "mediatek,mt7622-pcie-mirror", "syscon";
        reg = <0 0x10000400 0 0x10>;
      };
    };
```
