## Documentation/devicetree/bindings/arm/marvell/98dx3236-resume-ctrl.txt
```
Resume Control
--------------
Available on Marvell SOCs: 98DX3336 and 98DX4251

Required properties:

- compatible: must be "marvell,98dx3336-resume-ctrl"

- reg: Should contain resume control registers location and length

Example:

resume@20980 {
	compatible = "marvell,98dx3336-resume-ctrl";
	reg = <0x20980 0x10>;
};
```

## Documentation/devicetree/bindings/arm/marvell/98dx3236.txt
```
Marvell 98DX3236, 98DX3336 and 98DX4251 Platforms Device Tree Bindings
----------------------------------------------------------------------

Boards with a SoC of the Marvell 98DX3236, 98DX3336 and 98DX4251 families
shall have the following property:

Required root node property:

compatible: must contain "marvell,armadaxp-98dx3236"

In addition, boards using the Marvell 98DX3336 SoC shall have the
following property:

Required root node property:

compatible: must contain "marvell,armadaxp-98dx3336"

In addition, boards using the Marvell 98DX4251 SoC shall have the
following property:

Required root node property:

compatible: must contain "marvell,armadaxp-98dx4251"
```

## Documentation/devicetree/bindings/arm/marvell/ap806-system-controller.txt
```
Marvell Armada AP806 System Controller
======================================

The AP806 is one of the two core HW blocks of the Marvell Armada 7K/8K
SoCs. It contains system controllers, which provide several registers
giving access to numerous features: clocks, pin-muxing and many other
SoC configuration items. This DT binding allows to describe these
system controllers.

For the top level node:
 - compatible: must be: "syscon", "simple-mfd";
 - reg: register area of the AP806 system controller

SYSTEM CONTROLLER 0
===================

Clocks:
-------


The Device Tree node representing the AP806 system controller provides
a number of clocks:

 - 0: clock of CPU cluster 0
 - 1: clock of CPU cluster 1
 - 2: fixed PLL at 1200 Mhz
 - 3: MSS clock, derived from the fixed PLL

Required properties:

 - compatible: must be: "marvell,ap806-clock"
 - #clock-cells: must be set to 1

Pinctrl:
--------

For common binding part and usage, refer to
Documentation/devicetree/bindings/pinctrl/marvell,mvebu-pinctrl.txt.

Required properties:
- compatible must be "marvell,ap806-pinctrl",

Available mpp pins/groups and functions:
Note: brackets (x) are not part of the mpp name for marvell,function and given
only for more detailed description in this document.

name	pins	functions
================================================================================
mpp0	0	gpio, sdio(clk), spi0(clk)
mpp1	1	gpio, sdio(cmd), spi0(miso)
mpp2	2	gpio, sdio(d0), spi0(mosi)
mpp3	3	gpio, sdio(d1), spi0(cs0n)
mpp4	4	gpio, sdio(d2), i2c0(sda)
mpp5	5	gpio, sdio(d3), i2c0(sdk)
mpp6	6	gpio, sdio(ds)
mpp7	7	gpio, sdio(d4), uart1(rxd)
mpp8	8	gpio, sdio(d5), uart1(txd)
mpp9	9	gpio, sdio(d6), spi0(cs1n)
mpp10	10	gpio, sdio(d7)
mpp11	11	gpio, uart0(txd)
mpp12	12	gpio, sdio(pw_off), sdio(hw_rst)
mpp13	13	gpio
mpp14	14	gpio
mpp15	15	gpio
mpp16	16	gpio
mpp17	17	gpio
mpp18	18	gpio
mpp19	19	gpio, uart0(rxd), sdio(pw_off)

GPIO:
-----
For common binding part and usage, refer to
Documentation/devicetree/bindings/gpio/gpio-mvebu.txt.

Required properties:

- compatible: "marvell,armada-8k-gpio"

- offset: offset address inside the syscon block

Example:
ap_syscon: system-controller@6f4000 {
	compatible = "syscon", "simple-mfd";
	reg = <0x6f4000 0x1000>;

	ap_clk: clock {
		compatible = "marvell,ap806-clock";
		#clock-cells = <1>;
	};

	ap_pinctrl: pinctrl {
		compatible = "marvell,ap806-pinctrl";
	};

	ap_gpio: gpio {
		compatible = "marvell,armada-8k-gpio";
		offset = <0x1040>;
		ngpios = <19>;
		gpio-controller;
		#gpio-cells = <2>;
		gpio-ranges = <&ap_pinctrl 0 0 19>;
	};
};

SYSTEM CONTROLLER 1
===================

Thermal:
--------

For common binding part and usage, refer to
Documentation/devicetree/bindings/thermal/thermal.txt

The thermal IP can probe the temperature all around the processor. It
may feature several channels, each of them wired to one sensor.

Required properties:
- compatible: must be one of:
  * marvell,armada-ap806-thermal
- reg: register range associated with the thermal functions.

Optional properties:
- #thermal-sensor-cells: shall be <1> when thermal-zones subnodes refer
  to this IP and represents the channel ID. There is one sensor per
  channel. O refers to the thermal IP internal channel, while positive
  IDs refer to each CPU.

Example:
ap_syscon1: system-controller@6f8000 {
	compatible = "syscon", "simple-mfd";
	reg = <0x6f8000 0x1000>;

	ap_thermal: thermal-sensor@80 {
		compatible = "marvell,armada-ap806-thermal";
		reg = <0x80 0x10>;
		#thermal-sensor-cells = <1>;
	};
};
```

## Documentation/devicetree/bindings/arm/marvell/ap80x-system-controller.txt
```
Marvell Armada AP80x System Controller
======================================

The AP806/AP807 is one of the two core HW blocks of the Marvell Armada
7K/8K/931x SoCs. It contains system controllers, which provide several
registers giving access to numerous features: clocks, pin-muxing and
many other SoC configuration items. This DT binding allows to describe
these system controllers.

For the top level node:
 - compatible: must be: "syscon", "simple-mfd";
 - reg: register area of the AP80x system controller

SYSTEM CONTROLLER 0
===================

Clocks:
-------


The Device Tree node representing the AP806/AP807 system controller
provides a number of clocks:

 - 0: reference clock of CPU cluster 0
 - 1: reference clock of CPU cluster 1
 - 2: fixed PLL at 1200 Mhz
 - 3: MSS clock, derived from the fixed PLL

Required properties:

 - compatible: must be one of:
   * "marvell,ap806-clock"
   * "marvell,ap807-clock"
 - #clock-cells: must be set to 1

Pinctrl:
--------

For common binding part and usage, refer to
Documentation/devicetree/bindings/pinctrl/marvell,mvebu-pinctrl.txt.

Required properties:
- compatible must be "marvell,ap806-pinctrl",

Available mpp pins/groups and functions:
Note: brackets (x) are not part of the mpp name for marvell,function and given
only for more detailed description in this document.

name	pins	functions
================================================================================
mpp0	0	gpio, sdio(clk), spi0(clk)
mpp1	1	gpio, sdio(cmd), spi0(miso)
mpp2	2	gpio, sdio(d0), spi0(mosi)
mpp3	3	gpio, sdio(d1), spi0(cs0n)
mpp4	4	gpio, sdio(d2), i2c0(sda)
mpp5	5	gpio, sdio(d3), i2c0(sdk)
mpp6	6	gpio, sdio(ds)
mpp7	7	gpio, sdio(d4), uart1(rxd)
mpp8	8	gpio, sdio(d5), uart1(txd)
mpp9	9	gpio, sdio(d6), spi0(cs1n)
mpp10	10	gpio, sdio(d7)
mpp11	11	gpio, uart0(txd)
mpp12	12	gpio, sdio(pw_off), sdio(hw_rst)
mpp13	13	gpio
mpp14	14	gpio
mpp15	15	gpio
mpp16	16	gpio
mpp17	17	gpio
mpp18	18	gpio
mpp19	19	gpio, uart0(rxd), sdio(pw_off)

GPIO:
-----
For common binding part and usage, refer to
Documentation/devicetree/bindings/gpio/gpio-mvebu.yaml.

Required properties:

- compatible: "marvell,armada-8k-gpio"

- offset: offset address inside the syscon block

Optional properties:

- marvell,pwm-offset: offset address of PWM duration control registers inside
  the syscon block

Example:
ap_syscon: system-controller@6f4000 {
	compatible = "syscon", "simple-mfd";
	reg = <0x6f4000 0x1000>;

	ap_clk: clock {
		compatible = "marvell,ap806-clock";
		#clock-cells = <1>;
	};

	ap_pinctrl: pinctrl {
		compatible = "marvell,ap806-pinctrl";
	};

	ap_gpio: gpio {
		compatible = "marvell,armada-8k-gpio";
		offset = <0x1040>;
		ngpios = <19>;
		gpio-controller;
		#gpio-cells = <2>;
		gpio-ranges = <&ap_pinctrl 0 0 19>;
		marvell,pwm-offset = <0x10c0>;
		#pwm-cells = <2>;
		clocks = <&ap_clk 3>;
	};
};

SYSTEM CONTROLLER 1
===================

Thermal:
--------

For common binding part and usage, refer to
Documentation/devicetree/bindings/thermal/thermal*.yaml

The thermal IP can probe the temperature all around the processor. It
may feature several channels, each of them wired to one sensor.

It is possible to setup an overheat interrupt by giving at least one
critical point to any subnode of the thermal-zone node.

Required properties:
- compatible: must be one of:
  * marvell,armada-ap806-thermal
- reg: register range associated with the thermal functions.

Optional properties:
- interrupts: overheat interrupt handle. Should point to line 18 of the
  SEI irqchip. See interrupt-controller/interrupts.txt
- #thermal-sensor-cells: shall be <1> when thermal-zones subnodes refer
  to this IP and represents the channel ID. There is one sensor per
  channel. O refers to the thermal IP internal channel, while positive
  IDs refer to each CPU.

Example:
ap_syscon1: system-controller@6f8000 {
	compatible = "syscon", "simple-mfd";
	reg = <0x6f8000 0x1000>;

	ap_thermal: thermal-sensor@80 {
		compatible = "marvell,armada-ap806-thermal";
		reg = <0x80 0x10>;
		interrupt-parent = <&sei>;
		interrupts = <18>;
		#thermal-sensor-cells = <1>;
	};
};

Cluster clocks:
---------------

Device Tree Clock bindings for cluster clock of Marvell
AP806/AP807. Each cluster contain up to 2 CPUs running at the same
frequency.

Required properties:
 - compatible: must be one of:
   * "marvell,ap806-cpu-clock"
   * "marvell,ap807-cpu-clock"
- #clock-cells : should be set to 1.

- clocks : shall be the input parent clock(s) phandle for the clock
           (one per cluster)

- reg: register range associated with the cluster clocks

ap_syscon1: system-controller@6f8000 {
	compatible = "marvell,armada-ap806-syscon1", "syscon", "simple-mfd";
	reg = <0x6f8000 0x1000>;

	cpu_clk: clock-cpu@278 {
		compatible = "marvell,ap806-cpu-clock";
		clocks = <&ap_clk 0>, <&ap_clk 1>;
		#clock-cells = <1>;
		reg = <0x278 0xa30>;
	};
};
```

## Documentation/devicetree/bindings/arm/marvell/armada-370-xp-pmsu.txt
```
Power Management Service Unit(PMSU)
-----------------------------------
Available on Marvell SOCs: Armada 370, Armada 38x and Armada XP

Required properties:

- compatible: should be one of:
  - "marvell,armada-370-pmsu" for Armada 370 or Armada XP
  - "marvell,armada-380-pmsu" for Armada 38x
  - "marvell,armada-370-xp-pmsu" was used for Armada 370/XP but is now
    deprecated and will be removed

- reg: Should contain PMSU registers location and length.

Example:

armada-370-xp-pmsu@22000 {
	compatible = "marvell,armada-370-pmsu";
	reg = <0x22000 0x1000>;
};
```

## Documentation/devicetree/bindings/arm/marvell/armada-37xx.txt
```
Power management
----------------

For power management (particularly DVFS and AVS), the North Bridge
Power Management component is needed:

Required properties:
- compatible     : should contain "marvell,armada-3700-nb-pm", "syscon";
- reg            : the register start and length for the North Bridge
		    Power Management

Example:

nb_pm: syscon@14000 {
	compatible = "marvell,armada-3700-nb-pm", "syscon";
	reg = <0x14000 0x60>;
}

AVS
---

For AVS an other component is needed:

Required properties:
- compatible     : should contain "marvell,armada-3700-avs", "syscon";
- reg            : the register start and length for the AVS

Example:
avs: avs@11500 {
	compatible = "marvell,armada-3700-avs", "syscon";
	reg = <0x11500 0x40>;
}
```

## Documentation/devicetree/bindings/arm/marvell/armada-37xx.yaml
```yaml
# SPDX-License-Identifier: (GPL-2.0-only OR BSD-2-Clause)
%YAML 1.2
---
$id: http://devicetree.org/schemas/arm/marvell/armada-37xx.yaml#
$schema: http://devicetree.org/meta-schemas/core.yaml#

title: Marvell Armada 37xx Platforms

maintainers:
  - Robert Marko <robert.marko@sartura.hr>

properties:
  $nodename:
    const: '/'
  compatible:
    oneOf:
      - description: Armada 3720 SoC boards
        items:
          - enum:
              - cznic,turris-mox
              - glinet,gl-mv1000
              - globalscale,espressobin
              - marvell,armada-3720-db
              - methode,edpu
              - methode,udpu
              - ripe,atlas-v5
          - const: marvell,armada3720
          - const: marvell,armada3710

      - description: Globalscale Espressobin boards
        items:
          - enum:
              - globalscale,espressobin-emmc
              - globalscale,espressobin-ultra
              - globalscale,espressobin-v7
          - const: globalscale,espressobin
          - const: marvell,armada3720
          - const: marvell,armada3710

      - description: Globalscale Espressobin V7 boards
        items:
          - enum:
              - globalscale,espressobin-v7-emmc
          - const: globalscale,espressobin-v7
          - const: globalscale,espressobin
          - const: marvell,armada3720
          - const: marvell,armada3710

additionalProperties: true
```

## Documentation/devicetree/bindings/arm/marvell/armada-380-mpcore-soc-ctrl.txt
```
Marvell Armada 38x CA9 MPcore SoC Controller
============================================

Required properties:

- compatible: Should be "marvell,armada-380-mpcore-soc-ctrl".

- reg: should be the register base and length as documented in the
  datasheet for the CA9 MPcore SoC Control registers

mpcore-soc-ctrl@20d20 {
	compatible = "marvell,armada-380-mpcore-soc-ctrl";
	reg = <0x20d20 0x6c>;
};
```

## Documentation/devicetree/bindings/arm/marvell/armada-38x.yaml
```yaml
# SPDX-License-Identifier: (GPL-2.0-only OR BSD-2-Clause)
%YAML 1.2
---
$id: http://devicetree.org/schemas/arm/marvell/armada-38x.yaml#
$schema: http://devicetree.org/meta-schemas/core.yaml#

title: Marvell Armada 38x Platforms

maintainers:
  - Gregory CLEMENT <gregory.clement@bootlin.com>

properties:
  $nodename:
    const: '/'
  compatible:
    oneOf:

      - description:
          Netgear Armada 380 GS110EM Managed Switch.
        items:
          - const: netgear,gs110emx
          - const: marvell,armada380

      - description:
          Marvell Armada 385 Development Boards.
        items:
          - enum:
              - marvell,a385-db-amc
              - marvell,a385-db-ap
          - const: marvell,armada385
          - const: marvell,armada380

      - description:
          SolidRun Armada 385 based single-board computers.
        items:
          - enum:
              - solidrun,clearfog-gtr-l8
              - solidrun,clearfog-gtr-s4
          - const: marvell,armada385
          - const: marvell,armada380

      - description:
          Kobol Armada 388 based Helios-4 NAS.
        items:
          - const: kobol,helios4
          - const: marvell,armada388
          - const: marvell,armada385
          - const: marvell,armada380

      - description:
          Marvell Armada 388 Development Boards.
        items:
          - enum:
              - marvell,a388-gp
          - const: marvell,armada388
          - const: marvell,armada385
          - const: marvell,armada380

      - description:
          SolidRun Armada 388 clearfog family single-board computers.
        items:
          - enum:
              - solidrun,clearfog-base-a1
              - solidrun,clearfog-pro-a1
          - const: solidrun,clearfog-a1
          - const: marvell,armada388
          - const: marvell,armada385
          - const: marvell,armada380

additionalProperties: true
```
