## Documentation/devicetree/bindings/arm/marvell/marvell,armada-370-xp.yaml
```yaml
# SPDX-License-Identifier: (GPL-2.0-only OR BSD-2-Clause)
---
$id: http://devicetree.org/schemas/arm/marvell/marvell,armada-370-xp.yaml#
$schema: http://devicetree.org/meta-schemas/core.yaml#

title: Marvell Armada 370 and Armada XP platforms

maintainers:
  - Andrew Lunn <andrew@lunn.ch>
  - Gregory Clement <gregory.clement@bootlin.com>

properties:
  $nodename:
    const: '/'
  compatible:
    oneOf:
      - items:
          - enum:
              - ctera,c200-v2
              - dlink,dns327l
              - globalscale,mirabox
              - netgear,readynas-102
              - netgear,readynas-104
              - marvell,a370-db
              - marvell,a370-rd
              - seagate,dart-2
              - seagate,dart-4
              - seagate,cumulus-max
              - seagate,cumulus
              - synology,ds213j
          - const: marvell,armada370
          - const: marvell,armada-370-xp

      - items:
          - enum:
              - mikrotik,crs305-1g-4s
              - mikrotik,crs326-24g-2s
              - mikrotik,crs328-4c-20s-4s
          - const: marvell,armadaxp-98dx3236
          - const: marvell,armada-370-xp

      - items:
          - const: marvell,db-xc3-24g4xg
          - const: marvell,armadaxp-98dx3336
          - const: marvell,armada-370-xp

      - items:
          - const: marvell,db-dxbc2
          - const: marvell,armadaxp-98dx4251
          - const: marvell,armada-370-xp

      - items:
          - enum:
              - lenovo,ix4-300d
              - linksys,mamba
              - marvell,rd-axpwifiap
              - netgear,readynas-2120
              - synology,ds414
          - const: marvell,armadaxp-mv78230
          - const: marvell,armadaxp
          - const: marvell,armada-370-xp

      - items:
          - const: plathome,openblocks-ax3-4
          - const: marvell,armadaxp-mv78260
          - const: marvell,armadaxp
          - const: marvell,armada-370-xp

      - items:
          - enum:
              - marvell,axp-db
              - marvell,axp-gp
              - marvell,axp-matrix
          - const: marvell,armadaxp-mv78460
          - const: marvell,armadaxp
          - const: marvell,armada-370-xp

additionalProperties: true
```

## Documentation/devicetree/bindings/arm/marvell/marvell,armada375.yaml
```yaml
# SPDX-License-Identifier: (GPL-2.0-only OR BSD-2-Clause)
%YAML 1.2
---
$id: http://devicetree.org/schemas/arm/marvell/marvell,armada375.yaml#
$schema: http://devicetree.org/meta-schemas/core.yaml#

title: Marvell Armada 375 Platform

maintainers:
  - Andrew Lunn <andrew@lunn.ch>
  - Gregory Clement <gregory.clement@bootlin.com>

properties:
  $nodename:
    const: '/'
  compatible:
    items:
      - const: marvell,a375-db
      - const: marvell,armada375

additionalProperties: true
```

## Documentation/devicetree/bindings/arm/marvell/marvell,armada390.yaml
```yaml
# SPDX-License-Identifier: (GPL-2.0-only OR BSD-2-Clause)
%YAML 1.2
---
$id: http://devicetree.org/schemas/arm/marvell/marvell,armada390.yaml#
$schema: http://devicetree.org/meta-schemas/core.yaml#

title: Marvell Armada 39x Platforms

maintainers:
  - Andrew Lunn <andrew@lunn.ch>
  - Gregory Clement <gregory.clement@bootlin.com>

properties:
  $nodename:
    const: '/'
  compatible:
    oneOf:
      - items:
          - const: marvell,a390-db
          - const: marvell,armada390
      - items:
          - enum:
              - marvell,a398-db
          - const: marvell,armada398
          - const: marvell,armada390
      - items:
          - enum:
              - marvell,a395-gp
          - const: marvell,armada395
          - const: marvell,armada390

additionalProperties: true
```

## Documentation/devicetree/bindings/arm/marvell/marvell,dove.txt
```
Marvell Dove Platforms Device Tree Bindings
-----------------------------------------------

Boards with a Marvell Dove SoC shall have the following properties:

Required root node property:
- compatible: must contain "marvell,dove";
```

## Documentation/devicetree/bindings/arm/marvell/marvell,dove.yaml
```yaml
# SPDX-License-Identifier: (GPL-2.0-only OR BSD-2-Clause)
%YAML 1.2
---
$id: http://devicetree.org/schemas/arm/marvell/marvell,dove.yaml#
$schema: http://devicetree.org/meta-schemas/core.yaml#

title: Marvell Dove SoC

maintainers:
  - Andrew Lunn <andrew@lunn.ch>
  - Gregory Clement <gregory.clement@bootlin.com>

properties:
  $nodename:
    const: '/'
  compatible:
    oneOf:
      - items:
          - enum:
              - compulab,cm-a510
              - solidrun,cubox
              - globalscale,d2plug
              - globalscale,d3plug
              - marvell,dove-db
          - const: marvell,dove
      - items:
          - const: solidrun,cubox-es
          - const: solidrun,cubox
          - const: marvell,dove
      - items:
          - const: compulab,sbc-a510
          - const: compulab,cm-a510
          - const: marvell,dove

additionalProperties: true
```

## Documentation/devicetree/bindings/arm/marvell/marvell,kirkwood.txt
```
Marvell Kirkwood SoC Family Device Tree Bindings
------------------------------------------------

Boards with a SoC of the Marvell Kirkwook family, eg 88f6281

* Required root analde properties:
compatible: must contain "marvell,kirkwood"

In addition, the above compatible shall be extended with the specific
SoC. Currently kanalwn SoC compatibles are:

"marvell,kirkwood-88f6192"
"marvell,kirkwood-88f6281"
"marvell,kirkwood-88f6282"
"marvell,kirkwood-88f6283"
"marvell,kirkwood-88f6702"
"marvell,kirkwood-98DX4122"

And in addition, the compatible shall be extended with the specific
board. Currently kanalwn boards are:

"buffalo,linkstation-lsqvl"
"buffalo,linkstation-lsvl"
"buffalo,linkstation-lswsxl"
"buffalo,linkstation-lswxl"
"buffalo,linkstation-lswvl"
"buffalo,lschlv2"
"buffalo,lsxhl"
"buffalo,lsxl"
"cloudengines,pogo02"
"cloudengines,pogoplugv4"
"dlink,dns-320"
"dlink,dns-320-a1"
"dlink,dns-325"
"dlink,dns-325-a1"
"dlink,dns-kirkwood"
"excito,b3"
"globalscale,dreamplug-003-ds2001"
"globalscale,guruplug"
"globalscale,guruplug-server-plus"
"globalscale,sheevaplug"
"globalscale,sheevaplug"
"globalscale,sheevaplug-esata"
"globalscale,sheevaplug-esata-rev13"
"iom,iconnect"
"iom,iconnect-1.1"
"iom,ix2-200"
"keymile,km_kirkwood"
"lacie,cloudbox"
"lacie,inetspace_v2"
"lacie,laplug"
"lacie,nas2big"
"lacie,netspace_lite_v2"
"lacie,netspace_max_v2"
"lacie,netspace_mini_v2"
"lacie,netspace_v2"
"marvell,db-88f6281-bp"
"marvell,db-88f6282-bp"
"marvell,mv88f6281gtw-ge"
"marvell,rd88f6281"
"marvell,rd88f6281"
"marvell,rd88f6281-a0"
"marvell,rd88f6281-a1"
"mpl,cec4"
"mpl,cec4-10"
"netgear,readynas"
"netgear,readynas"
"netgear,readynas-duo-v2"
"netgear,readynas-nv+-v2"
"plathome,openblocks-a6"
"plathome,openblocks-a7"
"raidsonic,ib-nas6210"
"raidsonic,ib-nas6210-b"
"raidsonic,ib-nas6220"
"raidsonic,ib-nas6220-b"
"raidsonic,ib-nas62x0"
"seagate,dockstar"
"seagate,goflexnet"
"syanallogy,ds109"
"syanallogy,ds110jv10"
"syanallogy,ds110jv20"
"syanallogy,ds110jv30"
"syanallogy,ds111"
"syanallogy,ds209"
"syanallogy,ds210jv10"
"syanallogy,ds210jv20"
"syanallogy,ds212"
"syanallogy,ds212jv10"
"syanallogy,ds212jv20"
"syanallogy,ds212pv10"
"syanallogy,ds409"
"syanallogy,ds409slim"
"syanallogy,ds410j"
"syanallogy,ds411"
"syanallogy,ds411j"
"syanallogy,ds411slim"
"syanallogy,ds413jv10"
"syanallogy,rs212"
"syanallogy,rs409"
"syanallogy,rs411"
"syanallogy,rs812"
"usi,topkick"
"usi,topkick-1281P2"
"zyxel,nsa310"
"zyxel,nsa310a"
```

## Documentation/devicetree/bindings/arm/marvell/marvell,kirkwood.yaml
```yaml
# SPDX-License-Identifier: (GPL-2.0-only OR BSD-2-Clause)
%YAML 1.2
---
$id: http://devicetree.org/schemas/arm/marvell/marvell,kirkwood.yaml#
$schema: http://devicetree.org/meta-schemas/core.yaml#

title: Marvell Kirkwood SoC Family

maintainers:
  - Andrew Lunn <andrew@lunn.ch>
  - Gregory Clement <gregory.clement@bootlin.com>

properties:
  $nodename:
    const: '/'
  compatible:
    oneOf:
      - items:
          - enum:
              - qnap,ts219
              - qnap,ts419
              - synology,ds110
              - synology,ds111
              - synology,ds209
              - synology,ds409slim
              - synology,ds411j
              - synology,ds411slim
              - synology,rs212
              - synology,rs409
          - const: marvell,kirkwood

      - items:
          - const: synology,ds109
          - const: synology,ds110jv20
          - const: synology,ds110
          - const: marvell,kirkwood

      - items:
          - const: synology,ds110jv10
          - const: synology,ds110jv30
          - const: marvell,kirkwood

      - items:
          - const: synology,ds210jv10
          - const: synology,ds210jv20
          - const: synology,ds210jv30
          - const: synology,ds211j
          - const: marvell,kirkwood

      - items:
          - const: synology,ds212jv10
          - const: synology,ds212jv20
          - const: marvell,kirkwood

      - items:
          - const: synology,ds212
          - const: synology,ds212pv10
          - const: synology,ds212pv10
          - const: synology,ds212pv20
          - const: synology,ds213airv10
          - const: synology,ds213v10
          - const: marvell,kirkwood

      - items:
          - const: synology,ds409
          - const: synology,ds410j
          - const: marvell,kirkwood

      - items:
          - const: synology,ds411
          - const: synology,ds413jv10
          - const: marvell,kirkwood

      - items:
          - const: synology,rs411
          - const: synology,rs812
          - const: marvell,kirkwood

      - items:
          - enum:
              - cloudengines,pogoplugv4
              - lacie,laplug
              - lacie,netspace_lite_v2
              - lacie,netspace_mini_v2
              - marvell,rd88f6192
              - seagate,blackarmor-nas220
          - enum:
              - marvell,kirkwood-88f6192
          - const: marvell,kirkwood

      - items:
          - enum:
              - buffalo,lswsxl
              - buffalo,lswxl
              - checkpoint,l-50
              - cloudengines,pogoe02
              - ctera,c200-v1
              - dlink,dir-665
              - endian,4i-edge-200
              - excito,b3
              - globalscale,sheevaplug
              - hp,t5325
              - iom,ix2-200
              - lacie,inetspace_v2
              - lacie,netspace_v2
              - lacie,netspace_max_v2
              - marvell,db-88f6281-bp
              - marvell,mv88f6281gtw-ge
              - seagate,dockstar
              - seagate,goflexnet
              - zyxel,nsa310
              - zyxel,nsa320
          - const: marvell,kirkwood-88f6281
          - const: marvell,kirkwood

      - items:
          - enum:
              - buffalo,lschlv2
              - buffalo,lsxhl
          - const: buffalo,lsxl
          - const: marvell,kirkwood-88f6281
          - const: marvell,kirkwood

      - items:
          - const: dlink,dns-320-a1
          - const: dlink,dns-320
          - const: dlink,dns-kirkwood
          - const: marvell,kirkwood-88f6281
          - const: marvell,kirkwood

      - items:
          - const: dlink,dns-325-a1
          - const: dlink,dns-325
          - const: dlink,dns-kirkwood
          - const: marvell,kirkwood-88f6281
          - const: marvell,kirkwood

      - items:
          - const: globalscale,dreamplug-003-ds2001
          - const: globalscale,dreamplug
          - const: marvell,kirkwood-88f6281
          - const: marvell,kirkwood

      - items:
          - const: globalscale,guruplug-server-plus
          - const: globalscale,guruplug
          - const: marvell,kirkwood-88f6281
          - const: marvell,kirkwood

      - items:
          - const: globalscale,sheevaplug-esata-rev13
          - const: globalscale,sheevaplug-esata
          - const: globalscale,sheevaplug
          - const: marvell,kirkwood-88f6281
          - const: marvell,kirkwood

      - items:
          - const: iom,iconnect-1.1
          - const: iom,iconnect
          - const: marvell,kirkwood-88f6281
          - const: marvell,kirkwood

      - items:
          - const: lacie,d2net_v2
          - const: lacie,netxbig
          - const: marvell,kirkwood-88f6281
          - const: marvell,kirkwood
      - items:
          - enum:
              - lacie,net2big_v2
              - lacie,net5big_v2
          - const: lacie,netxbig
          - const: marvell,kirkwood-88f6281
          - const: marvell,kirkwood

      - items:
          - enum:
              - marvell,openrd-base
              - marvell,openrd-client
              - marvell,openrd-ultimate
          - const: marvell,openrd
          - const: marvell,kirkwood-88f6281
          - const: marvell,kirkwood

      - items:
          - enum:
              - marvell,rd88f6281-a
              - marvell,rd88f6281-z0
          - const: marvell,rd88f6281
          - const: marvell,kirkwood-88f6281
          - const: marvell,kirkwood

      - items:
          - const: mpl,cec4-10
          - const: mpl,cec4
          - const: marvell,kirkwood-88f6281
          - const: marvell,kirkwood

      - items:
          - const: raidsonic,ib-nas6210-b
          - const: raidsonic,ib-nas6220-b
          - const: raidsonic,ib-nas6210
          - const: raidsonic,ib-nas6220
          - const: raidsonic,ib-nas62x0
          - const: marvell,kirkwood-88f6281
          - const: marvell,kirkwood

      - items:
          - const: zyxel,nsa310a
          - const: zyxel,nsa310
          - const: marvell,kirkwood-88f6281
          - const: marvell,kirkwood

      - items:
          - enum:
              - buffalo,lsqvl
              - buffalo,lsvl
              - buffalo,lswvl
              - linksys,viper
              - marvell,db-88f6282-bp
              - zyxel,nsa325
          - const: marvell,kirkwood-88f6282
          - const: marvell,kirkwood

      - items:
          - const: lacie,nas2big
          - const: lacie,netxbig
          - const: marvell,kirkwood-88f6282
          - const: marvell,kirkwood

      - items:
          - enum:
              - netgear,readynas-duo-v2
              - netgear,readynas-nv+-v2
          - const: netgear,readynas
          - const: marvell,kirkwood-88f6282
          - const: marvell,kirkwood

      - items:
          - const: usi,topkick-1281P2
          - const: usi,topkick
          - const: marvell,kirkwood-88f6282
          - const: marvell,kirkwood

      - items:
          - enum:
              - plathome,openblocks-a6
              - plathome,openblocks-a7
          - const: marvell,kirkwood-88f6283
          - const: marvell,kirkwood

      - items:
          - enum:
              - lacie,cloudbox
              - zyxel,nsa310s
          - const: marvell,kirkwood-88f6702
          - const: marvell,kirkwood

      - items:
          - enum:
              - keymile,km_fixedeth
              - keymile,km_kirkwood
          - const: marvell,kirkwood-98DX4122
          - const: marvell,kirkwood

additionalProperties: true
```
