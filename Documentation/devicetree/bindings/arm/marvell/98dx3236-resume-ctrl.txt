## Documentation/devicetree/bindings/arm/marvell/armada-39x.txt
```
Marvell Armada 39x Platforms Device Tree Bindings
-------------------------------------------------

Boards with a SoC of the Marvell Armada 39x family shall have the
following property:

Required root node property:

 - compatible: must contain "marvell,armada390"

In addition, boards using the Marvell Armada 395 SoC shall have the
following property before the common "marvell,armada390" one:

Required root node property:

compatible: must contain "marvell,armada395"

Example:

compatible = "marvell,a395-gp", "marvell,armada395", "marvell,armada390";

Boards using the Marvell Armada 398 SoC shall have the following
property before the common "marvell,armada390" one:

Required root node property:

compatible: must contain "marvell,armada398"

Example:

compatible = "marvell,a398-db", "marvell,armada398", "marvell,armada390";
```

## Documentation/devicetree/bindings/arm/marvell/armada-7k-8k.txt
```
Marvell Armada 7K/8K Platforms Device Tree Bindings
---------------------------------------------------

Boards using a SoC of the Marvell Armada 7K or 8K families must carry
the following root node property:

 - compatible, with one of the following values:

   - "marvell,armada7020", "marvell,armada-ap806-dual", "marvell,armada-ap806"
      when the SoC being used is the Armada 7020

   - "marvell,armada7040", "marvell,armada-ap806-quad", "marvell,armada-ap806"
      when the SoC being used is the Armada 7040

   - "marvell,armada8020", "marvell,armada-ap806-dual", "marvell,armada-ap806"
      when the SoC being used is the Armada 8020

   - "marvell,armada8040", "marvell,armada-ap806-quad", "marvell,armada-ap806"
      when the SoC being used is the Armada 8040

Example:

compatible = "marvell,armada7040-db", "marvell,armada7040",
             "marvell,armada-ap806-quad", "marvell,armada-ap806";
```

## Documentation/devicetree/bindings/arm/marvell/armada-7k-8k.yaml
```yaml
# SPDX-License-Identifier: (GPL-2.0+ OR X11)
%YAML 1.2
---
$id: http://devicetree.org/schemas/arm/marvell/armada-7k-8k.yaml#
$schema: http://devicetree.org/meta-schemas/core.yaml#

title: Marvell Armada 7K/8K Platforms Device Tree Bindings

maintainers:
  - Gregory CLEMENT <gregory.clement@bootlin.com>

properties:
  $nodename:
    const: '/'
  compatible:
    oneOf:

      - description: Armada 7020 SoC
        items:
          - const: marvell,armada7020
          - const: marvell,armada-ap806-dual
          - const: marvell,armada-ap806

      - description: Armada 7040 SoC
        items:
          - const: marvell,armada7040
          - const: marvell,armada-ap806-quad
          - const: marvell,armada-ap806

      - description: Armada 8020 SoC
        items:
          - const: marvell,armada8020
          - const: marvell,armada-ap806-dual
          - const: marvell,armada-ap806

      - description: Armada 8040 SoC
        items:
          - const: marvell,armada8040
          - const: marvell,armada-ap806-quad
          - const: marvell,armada-ap806

      - description: Armada CN9130 SoC with no external CP
        items:
          - const: marvell,cn9130
          - const: marvell,armada-ap807-quad
          - const: marvell,armada-ap807

      - description: Armada CN9131 SoC with one external CP
        items:
          - const: marvell,cn9131
          - const: marvell,cn9130
          - const: marvell,armada-ap807-quad
          - const: marvell,armada-ap807

      - description: Armada CN9132 SoC with two external CPs
        items:
          - const: marvell,cn9132
          - const: marvell,cn9131
          - const: marvell,cn9130
          - const: marvell,armada-ap807-quad
          - const: marvell,armada-ap807

additionalProperties: true
```

## Documentation/devicetree/bindings/arm/marvell/armada-8kp.txt
```
Marvell Armada 8KPlus Platforms Device Tree Bindings
----------------------------------------------------

Boards using a SoC of the Marvell Armada 8KP families must carry
the following root node property:

 - compatible, with one of the following values:

   - "marvell,armada-8080", "marvell,armada-ap810-octa", "marvell,armada-ap810"
     when the SoC being used is the Armada 8080

Example:

compatible = "marvell,armada-8080-db", "marvell,armada-8080",
	     "marvell,armada-ap810-octa", "marvell,armada-ap810"
```

## Documentation/devicetree/bindings/arm/marvell/armada-cpu-reset.txt
```
Marvell Armada CPU reset controller
===================================

Required properties:

- compatible: Should be "marvell,armada-370-cpu-reset".

- reg: should be register base and length as documented in the
  datasheet for the CPU reset registers

cpurst: cpurst@20800 {
       compatible = "marvell,armada-370-cpu-reset";
       reg = <0x20800 0x20>;
};
```

## Documentation/devicetree/bindings/arm/marvell/coherency-fabric.txt
```
Coherency fabric
----------------
Available on Marvell SOCs: Armada 370, Armada 375, Armada 38x and Armada XP

Required properties:

- compatible: the possible values are:

 * "marvell,coherency-fabric", to be used for the coherency fabric of
   the Armada 370 and Armada XP.

 * "marvell,armada-375-coherency-fabric", for the Armada 375 coherency
   fabric.

 * "marvell,armada-380-coherency-fabric", for the Armada 38x coherency
   fabric.

- reg: Should contain coherency fabric registers location and
  length.

 * For "marvell,coherency-fabric", the first pair for the coherency
   fabric registers, second pair for the per-CPU fabric registers.

 * For "marvell,armada-375-coherency-fabric", only one pair is needed
   for the per-CPU fabric registers.

 * For "marvell,armada-380-coherency-fabric", only one pair is needed
   for the per-CPU fabric registers.

Optional properties:

- broken-idle: boolean to set when the Idle mode is not supported by the
  hardware.

Examples:

coherency-fabric@d0020200 {
	compatible = "marvell,coherency-fabric";
	reg = <0xd0020200 0xb0>,
		<0xd0021810 0x1c>;

};

coherency-fabric@21810 {
	compatible = "marvell,armada-375-coherency-fabric";
	reg = <0x21810 0x1c>;
};
```
