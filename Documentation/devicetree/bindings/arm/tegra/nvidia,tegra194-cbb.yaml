## Documentation/devicetree/bindings/arm/ti/omap.yaml
```yaml
# SPDX-License-Identifier: (GPL-2.0 OR BSD-2-Clause)
%YAML 1.2
---
$id: http://devicetree.org/schemas/arm/ti/omap.yaml#
$schema: http://devicetree.org/meta-schemas/core.yaml#

title: Texas Instruments OMAP SoC architecture

maintainers:
  - Tony Lindgren <tony@atomide.com>

description: Platforms based on Texas Instruments OMAP SoC architecture.

properties:
  $nodename:
    const: '/'
  compatible:
    oneOf:

      - description: TI OMAP2420 SoC based platforms
        items:
          - enum:
              - nokia,n800
              - nokia,n810
              - nokia,n810-wimax
              - ti,omap2420-h4
          - const: ti,omap2420
          - const: ti,omap2

      - description: TI OMAP2430 SoC based platforms
        items:
          - enum:
              - ti,omap2430-sdp # TI OMAP2430 SDP
          - const: ti,omap2430
          - const: ti,omap2

      - description: TI OMAP3430 SoC based platforms
        items:
          - enum:
              - compulab,omap3-cm-t3530
              - logicpd,dm3730-som-lv-devkit  # LogicPD Zoom OMAP35xx SOM-LV Development Kit
              - logicpd,dm3730-torpedo-devkit # LogicPD Zoom OMAP35xx Torpedo Development Kit
              - nokia,omap3-n900
              - openpandora,omap3-pandora-600mhz
              - ti,omap3430-sdp
              - ti,omap3-beagle
              - ti,omap3-evm                  # TI OMAP35XX EVM (TMDSEVM3530)
              - ti,omap3-ldp                  # TI OMAP3430 LDP (Zoom1 Labrador)
              - timll,omap3-devkit8000
          - const: ti,omap3430
          - const: ti,omap3

      - description: Early BeagleBoard revisions A to B4 with a timer quirk
        items:
          - const: ti,omap3-beagle-ab4
          - const: ti,omap3-beagle
          - const: ti,omap3430
          - const: ti,omap3

      - description: Gumstix Overo TI OMAP 3430/3630 boards + expansion boards
        items:
          - enum:
              - gumstix,omap3-overo-alto35
              - gumstix,omap3-overo-chestnut43
              - gumstix,omap3-overo-gallop43
              - gumstix,omap3-overo-palo35
              - gumstix,omap3-overo-palo43
              - gumstix,omap3-overo-summit
              - gumstix,omap3-overo-tobi
              - gumstix,omap3-overo-tobiduo
          - const: gumstix,omap3-overo
          - enum:
              - ti,omap3430
              - ti,omap3630

      - description: TI OMAP3630 SoC based platforms
        items:
          - enum:
              - amazon,omap3-echo             # Amazon Echo (first generation)
              - compulab,omap3-cm-t3730
              - goldelico,gta04
              - lg,omap3-sniper               # LG Optimus Black
              - logicpd,dm3730-som-lv-devkit  # LogicPD Zoom DM3730 SOM-LV Development Kit
              - logicpd,dm3730-torpedo-devkit # LogicPD Zoom DM3730 Torpedo + Wireless Development Kit
              - nokia,omap3-n9
              - nokia,omap3-n950
              - openpandora,omap3-pandora-1ghz
              - ti,omap3-beagle-xm
              - ti,omap3-evm-37xx             # TI OMAP37XX EVM (TMDSEVM3730)
              - ti,omap3-zoom3
          - const: ti,omap3630
          - const: ti,omap3

      - description: TI AM35 SoC based platforms
        items:
          - enum:
              - compulab,omap3-sbc-t3517 # CompuLab SBC-T3517 with CM-T3517
              - teejet,mt_ventoux
              - ti,am3517-craneboard     # TI AM3517 CraneBoard (TMDSEVM3517)
              - ti,am3517-evm            # TI AM3517 EVM (AM3517/05 TMDSEVM3517)
          - const: ti,am3517
          - const: ti,omap3

      - description: TI AM33 based platform
        items:
          - enum:
              - compulab,cm-t335
              - moxa,uc-8100-me-t
              - novatech,am335x-lxm
              - seeed,am335x-bone-green-eco
              - ti,am335x-bone
              - ti,am335x-evm
              - ti,am3359-icev2
          - const: ti,am33xx

      - description: Compulab board variants based on TI AM33
        items:
          - enum:
              - compulab,sbc-t335
          - const: compulab,cm-t335
          - const: ti,am33xx

      - description: Phytec boards based on TI AM33
        items:
          - enum:
              - phytec,am335x-wega
              - phytec,am335x-pcm-953
              - phytec,am335x-regor
          - const: phytec,am335x-phycore-som
          - const: ti,am33xx

      - description: TI OMAP4430 SoC based platforms
        items:
          - enum:
              - amazon,omap4-kc1        # Amazon Kindle Fire (first generation)
              - motorola,droid4         # Motorola Droid 4 XT894
              - motorola,droid-bionic   # Motorola Droid Bionic XT875
              - motorola,xyboard-mz609
              - motorola,xyboard-mz617
              - ti,omap4-panda
              - ti,omap4-sdp
          - const: ti,omap4430
          - const: ti,omap4

      - description: OMAP4 PandaBoard Revision A4 and later
        items:
          - const: ti,omap4-panda-a4
          - const: ti,omap4-panda
          - const: ti,omap4430
          - const: ti,omap4

      - description: OMAP4 DuoVero with Parlor expansion board/daughter board
        items:
          - const: gumstix,omap4-duovero-parlor
          - const: gumstix,omap4-duovero
          - const: ti,omap4430
          - const: ti,omap4

      - description: TI OMAP4460 SoC based platforms
        items:
          - enum:
              - epson,embt2ws    # Epson Moverio BT-200
              - ti,omap4-panda-es
          - const: ti,omap4460
          - const: ti,omap4

      - description: VAR-OM44 boards
        items:
          - enum:
              - variscite,var-dvk-om44
              - variscite,var-stk-om44
          - const: variscite,var-som-om44
          - const: ti,omap4460
          - const: ti,omap4

      - description: TI OMAP5 SoC based platforms
        items:
          - enum:
              - compulab,omap5-cm-t54
              - isee,omap5-igep0050
              - ti,omap5-uevm
          - const: ti,omap5

additionalProperties: true

...
```

## Documentation/devicetree/bindings/arm/ti/ti,davinci.yaml
```yaml
# SPDX-License-Identifier: GPL-2.0
%YAML 1.2
---
$id: http://devicetree.org/schemas/arm/ti/ti,davinci.yaml#
$schema: http://devicetree.org/meta-schemas/core.yaml#

title: Texas Instruments DaVinci Platforms Device Tree Bindings

maintainers:
  - Sekhar Nori <nsekhar@ti.com>

description:
  DA850/OMAP-L138/AM18x based boards

properties:
  $nodename:
    const: '/'
  compatible:
    items:
      - enum:
          - ti,da850-evm    # DA850/OMAP-L138/AM18x Evaluation Module (EVM) board
          - ti,da850-lcdk   # DA850/OMAP-L138/AM18x L138/C6748 Development Kit (LCDK) board
          - enbw,cmc        # EnBW AM1808 based CMC board
          - lego,ev3        # LEGO MINDSTORMS EV3 (AM1808 based)
      - const: ti,da850
...
```

## Documentation/devicetree/bindings/arm/ti/ti,keystone.yaml
```yaml
# SPDX-License-Identifier: (GPL-2.0-only OR BSD-2-Clause)
%YAML 1.2
---
$id: http://devicetree.org/schemas/arm/ti/ti,keystone.yaml#
$schema: http://devicetree.org/meta-schemas/core.yaml#

title: TI Keystone Platforms

maintainers:
  - Nishanth Menon <nm@ti.com>
  - Santosh Shilimkar <ssantosh@kernel.org>

properties:
  compatible:
    oneOf:
      - description: K2G
        items:
          - enum:
              - ti,k2g-evm
              - ti,k2g-ice
          - const: ti,k2g
          - const: ti,keystone
      - description: Keystone 2 Edison
        items:
          - enum:
              - ti,k2e-evm
          - const: ti,k2e
          - const: ti,keystone
      - description: Keystone 2 Lamarr
        items:
          - enum:
              - ti,k2l-evm
          - const: ti,k2l
          - const: ti,keystone
      - description: Keystone 2 Hawking/Kepler
        items:
          - enum:
              - ti,k2hk-evm
          - const: ti,k2hk
          - const: ti,keystone

additionalProperties: true
```

## Documentation/devicetree/bindings/arm/ti/ti,omap-prm-inst.yaml
```yaml
# SPDX-License-Identifier: GPL-2.0-only
%YAML 1.2
---
$id: http://devicetree.org/schemas/arm/ti/ti,omap-prm-inst.yaml#
$schema: http://devicetree.org/meta-schemas/core.yaml#

title: OMAP PRM instances

maintainers:
  - Aaro Koskinen <aaro.koskinen@iki.fi>
  - Andreas Kemnade <andreas@kemnade.info>
  - Kevin Hilman <khilman@baylibre.com>
  - Roger Quadros <rogerq@kernel.org>
  - Tony Lindgren <tony@atomide.com>

description:
  Power and Reset Manager is an IP block on OMAP family of devices which
  handle the power domains and their current state, and provide reset
  handling for the domains and/or separate IP blocks under the power domain
  hierarchy.

properties:
  compatible:
    items:
      - enum:
          - ti,am3-prm-inst
          - ti,am4-prm-inst
          - ti,omap4-prm-inst
          - ti,omap5-prm-inst
          - ti,dra7-prm-inst
      - const: ti,omap-prm-inst

  reg:
    maxItems: 1

  "#power-domain-cells":
    const: 0

  "#reset-cells":
    const: 1

required:
  - compatible
  - reg

additionalProperties: false

examples:
  - |
    reset-controller@1b00 {
        compatible = "ti,dra7-prm-inst", "ti,omap-prm-inst";
        reg = <0x1b00 0x40>;
        #power-domain-cells = <0>;
        #reset-cells = <1>;
    };
```

## Documentation/devicetree/bindings/arm/toshiba.yaml
```yaml
# SPDX-License-Identifier: GPL-2.0-only OR BSD-2-Clause
%YAML 1.2
---
$id: http://devicetree.org/schemas/arm/toshiba.yaml#
$schema: http://devicetree.org/meta-schemas/core.yaml#

title: Toshiba Visconti Platform

maintainers:
  - Nobuhiro Iwamatsu <nobuhiro1.iwamatsu@toshiba.co.jp>

properties:
  $nodename:
    const: '/'
  compatible:
    oneOf:
      - description: Visconti5 TMPV7708
        items:
          - enum:
              - toshiba,tmpv7708-rm-mbrc  # TMPV7708 RM main board
              - toshiba,tmpv7708-visrobo-vrb  # TMPV7708 VisROBO VRB board
          - const: toshiba,tmpv7708

additionalProperties: true

...
```

## Documentation/devicetree/bindings/arm/trbe.yaml
```yaml
# SPDX-License-Identifier: GPL-2.0-only or BSD-2-Clause
# Copyright 2021, Arm Ltd
%YAML 1.2
---
$id: "http://devicetree.org/schemas/arm/trbe.yaml#"
$schema: "http://devicetree.org/meta-schemas/core.yaml#"

title: ARM Trace Buffer Extensions

maintainers:
  - Anshuman Khandual <anshuman.khandual@arm.com>

description: |
  Arm Trace Buffer Extension (TRBE) is a per CPU component
  for storing trace generated on the CPU to memory. It is
  accessed via CPU system registers. The software can verify
  if it is permitted to use the component by checking the
  TRBIDR register.

properties:
  $nodename:
    const: "trbe"
  compatible:
    items:
      - const: arm,trace-buffer-extension

  interrupts:
    description: |
       Exactly 1 PPI must be listed. For heterogeneous systems where
       TRBE is only supported on a subset of the CPUs, please consult
       the arm,gic-v3 binding for details on describing a PPI partition.
    maxItems: 1

required:
  - compatible
  - interrupts

additionalProperties: false

examples:

  - |
   #include <dt-bindings/interrupt-controller/arm-gic.h>

   trbe {
     compatible = "arm,trace-buffer-extension";
     interrupts = <GIC_PPI 15 IRQ_TYPE_LEVEL_HIGH>;
   };
...
```

## Documentation/devicetree/bindings/arm/twd.txt
```
* ARM Timer Watchdog

ARM 11MP, Cortex-A5 and Cortex-A9 are often associated with a per-core
Timer-Watchdog (aka TWD), which provides both a per-cpu local timer
and watchdog.

The TWD is usually attached to a GIC to deliver its two per-processor
interrupts.

** Timer node required properties:

- compatible : Should be one of:
	"arm,cortex-a9-twd-timer"
	"arm,cortex-a5-twd-timer"
	"arm,arm11mp-twd-timer"

- interrupts : One interrupt to each core

- reg : Specify the base address and the size of the TWD timer
	register window.

Optional

- always-on : a boolean property. If present, the timer is powered through
  an always-on power domain, therefore it never loses context.

Example:

	twd-timer@2c000600 {
		compatible = "arm,arm11mp-twd-timer"";
		reg = <0x2c000600 0x20>;
		interrupts = <1 13 0xf01>;
	};

** Watchdog node properties:

- compatible : Should be one of:
	"arm,cortex-a9-twd-wdt"
	"arm,cortex-a5-twd-wdt"
	"arm,arm11mp-twd-wdt"

- interrupts : One interrupt to each core

- reg : Specify the base address and the size of the TWD watchdog
	register window.

Example:

	twd-watchdog@2c000620 {
		compatible = "arm,arm11mp-twd-wdt";
		reg = <0x2c000620 0x20>;
		interrupts = <1 14 0xf01>;
	};
```

## Documentation/devicetree/bindings/arm/ux500.yaml
```yaml
# SPDX-License-Identifier: GPL-2.0-only
%YAML 1.2
---
$id: http://devicetree.org/schemas/arm/ux500.yaml#
$schema: http://devicetree.org/meta-schemas/core.yaml#

title: Ux500 platforms

maintainers:
  - Linus Walleij <linus.walleij@linaro.org>

properties:
  $nodename:
    const: '/'
  compatible:
    oneOf:

      - description: ST-Ericsson HREF (pre-v60)
        items:
          - const: st-ericsson,mop500
          - const: st-ericsson,u8500

      - description: ST-Ericsson HREF520
        items:
          - const: st-ericsson,href520
          - const: st-ericsson,u8500

      - description: ST-Ericsson HREF (v60+)
        items:
          - const: st-ericsson,hrefv60+
          - const: st-ericsson,u8500

      - description: Calao Systems Snowball
        items:
          - const: calaosystems,snowball-a9500
          - const: st-ericsson,u9500

      - description: Samsung Galaxy Ace 2 (GT-I8160)
        items:
          - const: samsung,codina
          - const: st-ericsson,u8500

      - description: Samsung Galaxy Exhibit (SGH-T599)
        items:
          - const: samsung,codina-tmo
          - const: st-ericsson,u8500

      - description: Samsung Galaxy Beam (GT-I8530)
        items:
          - const: samsung,gavini
          - const: st-ericsson,u8500

      - description: Samsung Galaxy S III mini (GT-I8190)
        items:
          - const: samsung,golden
          - const: st-ericsson,u8500

      - description: Samsung Galaxy S Advance (GT-I9070)
        items:
          - const: samsung,janice
          - const: st-ericsson,u8500

      - description: Samsung Galaxy Amp (SGH-I407)
        items:
          - const: samsung,kyle
          - const: st-ericsson,u8500

      - description: Samsung Galaxy XCover 2 (GT-S7710)
        items:
          - const: samsung,skomer
          - const: st-ericsson,u8500

additionalProperties: true
```
