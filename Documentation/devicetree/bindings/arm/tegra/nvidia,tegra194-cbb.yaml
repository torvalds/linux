## Documentation/devicetree/bindings/arm/ux500/boards.txt
```
ST-Ericsson Ux500 boards
------------------------

Required properties (in root node) one of these:
	compatible = "st-ericsson,mop500" (legacy)
	compatible = "st-ericsson,u8500"

Required node (under root node):

soc: represents the system-on-chip and contains the chip
peripherals

Required property of soc node, one of these:
	compatible = "stericsson,db8500"

Required subnodes under soc node:

backupram: (used for CPU spin tables and for storing data
during retention, system won't boot without this):
	compatible = "ste,dbx500-backupram"

scu:
	see binding for arm/scu.txt

interrupt-controller:
	see binding for interrupt-controller/arm,gic.txt

timer:
	see binding for timer/arm,twd.txt

clocks:
	see binding for clocks/ux500.txt

Example:

/dts-v1/;

/ {
        model = "ST-Ericsson HREF (pre-v60) and ST UIB";
        compatible = "st-ericsson,mop500", "st-ericsson,u8500";

        soc {
		#address-cells = <1>;
		#size-cells = <1>;
		compatible = "stericsson,db8500";
		interrupt-parent = <&intc>;
		ranges;

		backupram@80150000 {
			compatible = "ste,dbx500-backupram";
			reg = <0x80150000 0x2000>;
		};

		intc: interrupt-controller@a0411000 {
			compatible = "arm,cortex-a9-gic";
			#interrupt-cells = <3>;
			#address-cells = <1>;
			interrupt-controller;
			reg = <0xa0411000 0x1000>,
			      <0xa0410100 0x100>;
		};

		scu@a0410000 {
			compatible = "arm,cortex-a9-scu";
			reg = <0xa0410000 0x100>;
		};

		timer@a0410600 {
			compatible = "arm,cortex-a9-twd-timer";
			reg = <0xa0410600 0x20>;
			interrupts = <1 13 0x304>; /* IRQ level high per-CPU */
			clocks = <&smp_twd_clk>;
		};

		clocks {
			compatible = "stericsson,u8500-clks";

			smp_twd_clk: smp-twd-clock {
				#clock-cells = <0>;
			};
		};
        };
};
```

## Documentation/devicetree/bindings/arm/ux500/power_domain.txt
```
* ST-Ericsson UX500 PM Domains

UX500 supports multiple PM domains which are used to gate power to one or
more peripherals on the SOC.

The implementation of PM domains for UX500 are based upon the generic PM domain
and use the corresponding DT bindings.

==PM domain providers==

Required properties:
 - compatible: Must be "stericsson,ux500-pm-domains".
 - #power-domain-cells : Number of cells in a power domain specifier, must be 1.

Example:
	pm_domains: pm_domains0 {
		compatible = "stericsson,ux500-pm-domains";
		#power-domain-cells = <1>;
	};

==PM domain consumers==

Required properties:
 - power-domains: A phandle and PM domain specifier. Below are the list of
		valid specifiers:

		Index	Specifier
		-----	---------
		0	DOMAIN_VAPE

Example:
	sdi0_per1@80126000 {
		compatible = "arm,pl18x", "arm,primecell";
		power-domains = <&pm_domains DOMAIN_VAPE>
	};
```

## Documentation/devicetree/bindings/arm/versatile-sysreg.txt
```
ARM Versatile system registers
--------------------------------------

This is a system control registers block, providing multiple low level
platform functions like board detection and identification, software
interrupt generation, MMC and NOR Flash control etc.

Required node properties:
- compatible value : = "arm,versatile-sysreg", "syscon"
- reg : physical base address and the size of the registers window
```

## Documentation/devicetree/bindings/arm/vexpress-config.yaml
```yaml
# SPDX-License-Identifier: (GPL-2.0-only OR BSD-2-Clause)
%YAML 1.2
---
$id: http://devicetree.org/schemas/arm/vexpress-config.yaml#
$schema: http://devicetree.org/meta-schemas/core.yaml#

title: ARM Versatile Express configuration bus

maintainers:
  - Andre Przywara <andre.przywara@arm.com>

description:
  This is a system control register block, acting as a bridge to the
  platform's configuration bus via "system control" interface, addressing
  devices with site number, position in the board stack, config controller,
  function and device numbers - see motherboard's TRM for more details.

properties:
  compatible:
    const: arm,vexpress,config-bus

  arm,vexpress,config-bridge:
    $ref: /schemas/types.yaml#/definitions/phandle
    description:
      Phandle to the sysreg node.

  muxfpga:
    type: object
    properties:
      compatible:
        const: arm,vexpress-muxfpga

      arm,vexpress-sysreg,func:
        description: FPGA specifier
        $ref: /schemas/types.yaml#/definitions/uint32-array
        items:
          - const: 7
          - description: device number

    additionalProperties: false
    required:
      - compatible
      - arm,vexpress-sysreg,func

  shutdown:
    type: object
    properties:
      compatible:
        const: arm,vexpress-shutdown

      arm,vexpress-sysreg,func:
        description: shutdown identifier
        $ref: /schemas/types.yaml#/definitions/uint32-array
        items:
          - const: 8
          - description: device number

    additionalProperties: false
    required:
      - compatible
      - arm,vexpress-sysreg,func

  reboot:
    type: object
    properties:
      compatible:
        const: arm,vexpress-reboot

      arm,vexpress-sysreg,func:
        description: reboot identifier
        $ref: /schemas/types.yaml#/definitions/uint32-array
        items:
          - const: 9
          - description: device number

    additionalProperties: false
    required:
      - compatible
      - arm,vexpress-sysreg,func

  dvimode:
    type: object
    properties:
      compatible:
        const: arm,vexpress-dvimode

      arm,vexpress-sysreg,func:
        description: DVI mode identifier
        $ref: /schemas/types.yaml#/definitions/uint32-array
        items:
          - const: 11
          - description: device number

    additionalProperties: false
    required:
      - compatible
      - arm,vexpress-sysreg,func

additionalProperties: false

required:
  - compatible
  - arm,vexpress,config-bridge

patternProperties:
  'clk[0-9]*$':
    type: object
    description:
      clocks

    properties:
      compatible:
        const: arm,vexpress-osc

      arm,vexpress-sysreg,func:
        description: clock specifier
        $ref: /schemas/types.yaml#/definitions/uint32-array
        items:
          - const: 1
          - description: clock number

      freq-range:
        $ref: /schemas/types.yaml#/definitions/uint32-array
        items:
          - description: minimal clock frequency
          - description: maximum clock frequency

      "#clock-cells":
        const: 0

      clock-output-names:
        maxItems: 1

    additionalProperties: false
    required:
      - compatible
      - arm,vexpress-sysreg,func
      - "#clock-cells"

  "^volt-.+$":
    $ref: /schemas/regulator/regulator.yaml#
    properties:
      compatible:
        const: arm,vexpress-volt

      arm,vexpress-sysreg,func:
        description: regulator specifier
        $ref: /schemas/types.yaml#/definitions/uint32-array
        items:
          - const: 2
          - description: device number

      label:
        maxItems: 1

    unevaluatedProperties: false
    required:
      - compatible
      - arm,vexpress-sysreg,func

  "^amp-.+$":
    type: object
    properties:
      compatible:
        const: arm,vexpress-amp

      arm,vexpress-sysreg,func:
        description: current sensor identifier
        $ref: /schemas/types.yaml#/definitions/uint32-array
        items:
          - const: 3
          - description: device number

      label:
        maxItems: 1

    additionalProperties: false
    required:
      - compatible
      - arm,vexpress-sysreg,func

  "^temp-.+$":
    type: object
    properties:
      compatible:
        const: arm,vexpress-temp

      arm,vexpress-sysreg,func:
        description: temperature sensor identifier
        $ref: /schemas/types.yaml#/definitions/uint32-array
        items:
          - const: 4
          - description: device number

      label:
        maxItems: 1

    additionalProperties: false
    required:
      - compatible
      - arm,vexpress-sysreg,func

  "^reset[0-9]*$":
    type: object
    properties:
      compatible:
        const: arm,vexpress-reset

      arm,vexpress-sysreg,func:
        description: reset specifier
        $ref: /schemas/types.yaml#/definitions/uint32-array
        items:
          - const: 5
          - description: reset device number

    additionalProperties: false
    required:
      - compatible
      - arm,vexpress-sysreg,func

  "^power-.+$":
    type: object
    properties:
      compatible:
        const: arm,vexpress-power

      arm,vexpress-sysreg,func:
        description: power sensor identifier
        $ref: /schemas/types.yaml#/definitions/uint32-array
        items:
          - const: 12
          - description: device number

      label:
        maxItems: 1

    additionalProperties: false
    required:
      - compatible
      - arm,vexpress-sysreg,func

  "^energy(-.+)?$":
    type: object
    properties:
      compatible:
        const: arm,vexpress-energy

      arm,vexpress-sysreg,func:
        description: energy sensor identifier
        $ref: /schemas/types.yaml#/definitions/uint32-array
        oneOf:
          - items:
              - const: 13
              - description: device number
          - items:
              - const: 13
              - description: device number
              - const: 13
              - description: second device number

      label:
        maxItems: 1

    additionalProperties: false
    required:
      - compatible
      - arm,vexpress-sysreg,func

examples:
  - |
    mcc {
        compatible = "arm,vexpress,config-bus";
        arm,vexpress,config-bridge = <&v2m_sysreg>;

        clk0 {
            compatible = "arm,vexpress-osc";
            arm,vexpress-sysreg,func = <1 0>;
            #clock-cells = <0>;
        };

        energy {
            compatible = "arm,vexpress-energy";
            arm,vexpress-sysreg,func = <13 0>, <13 1>;
        };
    };
```
