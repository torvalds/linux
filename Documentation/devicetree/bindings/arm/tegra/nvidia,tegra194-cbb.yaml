## Documentation/devicetree/bindings/arm/tegra/nvidia,tegra234-cbb.yaml
```yaml
# SPDX-License-Identifier: (GPL-2.0-only OR BSD-2-Clause)
%YAML 1.2
---
$id: "http://devicetree.org/schemas/arm/tegra/nvidia,tegra234-cbb.yaml#"
$schema: "http://devicetree.org/meta-schemas/core.yaml#"

title: NVIDIA Tegra CBB 2.0

maintainers:
  - Sumit Gupta <sumitg@nvidia.com>

description: |+
  The Control Backbone (CBB) is comprised of the physical path from an
  initiator to a target's register configuration space. CBB 2.0 consists
  of multiple sub-blocks connected to each other to create a topology.
  The Tegra234 SoC has different fabrics based on CBB 2.0 architecture
  which include cluster fabrics BPMP, AON, PSC, SCE, RCE, DCE, FSI and
  "CBB central fabric".

  In CBB 2.0, each initiator which can issue transactions connects to a
  Root Master Node (MN) before it connects to any other element of the
  fabric. Each Root MN contains a Error Monitor (EM) which detects and
  logs error. Interrupts from various EM blocks are collated by Error
  Notifier (EN) which is per fabric and presents a single interrupt from
  fabric to the SoC interrupt controller.

  The driver handles errors from CBB due to illegal register accesses
  and prints debug information about failed transaction on receiving
  the interrupt from EN. Debug information includes Error Code, Error
  Description, MasterID, Fabric, SlaveID, Address, Cache, Protection,
  Security Group etc on receiving error notification.

  If the Error Response Disable (ERD) is set/enabled for an initiator,
  then SError or Data abort exception error response is masked and an
  interrupt is used for reporting errors due to illegal accesses from
  that initiator. The value returned on read failures is '0xFFFFFFFF'
  for compatibility with PCIE.

properties:
  $nodename:
    pattern: "^[a-z]+-fabric@[0-9a-f]+$"

  compatible:
    enum:
      - nvidia,tegra234-aon-fabric
      - nvidia,tegra234-bpmp-fabric
      - nvidia,tegra234-cbb-fabric
      - nvidia,tegra234-dce-fabric
      - nvidia,tegra234-rce-fabric
      - nvidia,tegra234-sce-fabric

  reg:
    maxItems: 1

  interrupts:
    items:
      - description: secure interrupt from error notifier

additionalProperties: false

required:
  - compatible
  - reg
  - interrupts

examples:
  - |
    #include <dt-bindings/interrupt-controller/arm-gic.h>

    cbb-fabric@1300000 {
      compatible = "nvidia,tegra234-cbb-fabric";
      reg = <0x13a00000 0x400000>;
      interrupts = <GIC_SPI 231 IRQ_TYPE_LEVEL_HIGH>;
    };
```

## Documentation/devicetree/bindings/arm/tegra/nvidia,tegra30-actmon.txt
```
NVIDIA Tegra Activity Monitor

The activity monitor block collects statistics about the behaviour of other
components in the system. This information can be used to derive the rate at
which the external memory needs to be clocked in order to serve all requests
from the monitored clients.

Required properties:
- compatible: should be "nvidia,tegra<chip>-actmon"
- reg: offset and length of the register set for the device
- interrupts: standard interrupt property
- clocks: Must contain a phandle and clock specifier pair for each entry in
clock-names. See ../../clock/clock-bindings.txt for details.
- clock-names: Must include the following entries:
  - actmon
  - emc
- resets: Must contain an entry for each entry in reset-names. See
../../reset/reset.txt for details.
- reset-names: Must include the following entries:
  - actmon
- operating-points-v2: See ../bindings/opp/opp.txt for details.
- interconnects: Should contain entries for memory clients sitting on
                 MC->EMC memory interconnect path.
- interconnect-names: Should include name of the interconnect path for each
                      interconnect entry. Consult TRM documentation for
                      information about available memory clients, see MEMORY
                      CONTROLLER section.

For each opp entry in 'operating-points-v2' table:
- opp-supported-hw: bitfield indicating SoC speedo ID mask
- opp-peak-kBps: peak bandwidth of the memory channel

Example:
	dfs_opp_table: opp-table {
		compatible = "operating-points-v2";

		opp@12750000 {
			opp-hz = /bits/ 64 <12750000>;
			opp-supported-hw = <0x000F>;
			opp-peak-kBps = <51000>;
		};
		...
	};

	actmon@6000c800 {
		compatible = "nvidia,tegra124-actmon";
		reg = <0x0 0x6000c800 0x0 0x400>;
		interrupts = <GIC_SPI 45 IRQ_TYPE_LEVEL_HIGH>;
		clocks = <&tegra_car TEGRA124_CLK_ACTMON>,
			 <&tegra_car TEGRA124_CLK_EMC>;
		clock-names = "actmon", "emc";
		resets = <&tegra_car 119>;
		reset-names = "actmon";
		operating-points-v2 = <&dfs_opp_table>;
		interconnects = <&mc TEGRA124_MC_MPCORER &emc>;
		interconnect-names = "cpu";
	};
```

## Documentation/devicetree/bindings/arm/tegra/nvidia,tegra30-mc.txt
```
NVIDIA Tegra30 MC(Memory Controller)

Required properties:
- compatible : "nvidia,tegra30-mc"
- reg : Should contain 4 register ranges(address and length); see the
  example below. Note that the MC registers are interleaved with the
  SMMU registers, and hence must be represented as multiple ranges.
- interrupts : Should contain MC General interrupt.

Example:
	memory-controller {
		compatible = "nvidia,tegra30-mc";
		reg = <0x7000f000 0x010
		       0x7000f03c 0x1b4
		       0x7000f200 0x028
		       0x7000f284 0x17c>;
		interrupts = <0 77 0x04>;
	};
```

## Documentation/devicetree/bindings/arm/tesla.yaml
```yaml
# SPDX-License-Identifier: GPL-2.0-only OR BSD-2-Clause
%YAML 1.2
---
$id: http://devicetree.org/schemas/arm/tesla.yaml#
$schema: http://devicetree.org/meta-schemas/core.yaml#

title: Tesla Full Self Driving(FSD) platforms device tree bindings

maintainers:
  - Alim Akhtar <alim.akhtar@samsung.com>
  - linux-fsd@tesla.com

properties:
  $nodename:
    const: '/'
  compatible:
    oneOf:

      - description: FSD SoC board
        items:
          - enum:
              - tesla,fsd-evb   # Tesla FSD Evaluation
          - const: tesla,fsd

additionalProperties: true

...
```

## Documentation/devicetree/bindings/arm/ti/k3.txt
```
Texas Instruments K3 Multicore SoC architecture device tree bindings
--------------------------------------------------------------------

Platforms based on Texas Instruments K3 Multicore SoC architecture
shall follow the following scheme:

SoCs
----

Each device tree root node must specify which exact SoC in K3 Multicore SoC
architecture it uses, using one of the following compatible values:

- AM654
  compatible = "ti,am654";

- J721E
  compatible = "ti,j721e";

Boards
------

In addition, each device tree root node must specify which one or more
of the following board-specific compatible values:

- AM654 EVM
  compatible = "ti,am654-evm", "ti,am654";
```

## Documentation/devicetree/bindings/arm/ti/k3.yaml
```yaml
# SPDX-License-Identifier: (GPL-2.0 OR BSD-2-Clause)
%YAML 1.2
---
$id: http://devicetree.org/schemas/arm/ti/k3.yaml#
$schema: http://devicetree.org/meta-schemas/core.yaml#

title: Texas Instruments K3 Multicore SoC architecture

maintainers:
  - Nishanth Menon <nm@ti.com>

description: |
  Platforms based on Texas Instruments K3 Multicore SoC architecture
  shall have the following properties.

properties:
  $nodename:
    const: '/'
  compatible:
    oneOf:

      - description: K3 AM62A7 SoC
        items:
          - enum:
              - ti,am62a7-sk
          - const: ti,am62a7

      - description: K3 AM62P5 SoC and Boards
        items:
          - enum:
              - ti,am62p5-sk
          - const: ti,am62p5

      - description: K3 AM625 SoC PHYTEC phyBOARD-Lyra
        items:
          - const: phytec,am625-phyboard-lyra-rdk
          - const: phytec,am62-phycore-som
          - const: ti,am625

      - description: K3 AM625 SoC
        items:
          - enum:
              - beagle,am625-beagleplay
              - ti,am625-sk
              - ti,am62-lp-sk
          - const: ti,am625

      - description: K3 AM62x SoC Toradex Verdin Modules and Carrier Boards
        items:
          - enum:
              - toradex,verdin-am62-nonwifi-dahlia # Verdin AM62 Module on Dahlia
              - toradex,verdin-am62-nonwifi-dev    # Verdin AM62 Module on Verdin Development Board
              - toradex,verdin-am62-nonwifi-yavia  # Verdin AM62 Module on Yavia
          - const: toradex,verdin-am62-nonwifi     # Verdin AM62 Module without Wi-Fi / BT
          - const: toradex,verdin-am62             # Verdin AM62 Module
          - const: ti,am625

      - description: K3 AM62x SoC Toradex Verdin Modules and Carrier Boards with Wi-Fi / BT
        items:
          - enum:
              - toradex,verdin-am62-wifi-dahlia # Verdin AM62 Wi-Fi / BT Module on Dahlia
              - toradex,verdin-am62-wifi-dev    # Verdin AM62 Wi-Fi / BT M. on Verdin Development B.
              - toradex,verdin-am62-wifi-yavia  # Verdin AM62 Wi-Fi / BT Module on Yavia
          - const: toradex,verdin-am62-wifi     # Verdin AM62 Wi-Fi / BT Module
          - const: toradex,verdin-am62          # Verdin AM62 Module
          - const: ti,am625

      - description: K3 AM642 SoC
        items:
          - enum:
              - ti,am642-evm
              - ti,am642-sk
          - const: ti,am642

      - description: K3 AM642 SoC PHYTEC phyBOARD-Electra
        items:
          - const: phytec,am642-phyboard-electra-rdk
          - const: phytec,am64-phycore-som
          - const: ti,am642

      - description: K3 AM642 SoC on TQ-Systems TQMaX4XxL SoM
        items:
          - enum:
              - tq,am642-tqma6442l-mbax4xxl # MBaX4XxL base board
          - const: tq,am642-tqma6442l
          - const: ti,am642

      - description: K3 AM654 SoC
        items:
          - enum:
              - siemens,iot2050-advanced
              - siemens,iot2050-advanced-m2
              - siemens,iot2050-advanced-pg2
              - siemens,iot2050-basic
              - siemens,iot2050-basic-pg2
              - ti,am654-evm
          - const: ti,am654

      - description: K3 J7200 SoC
        oneOf:
          - const: ti,j7200
          - items:
              - enum:
                  - ti,j7200-evm
              - const: ti,j7200

      - description: K3 J721E SoC
        oneOf:
          - const: ti,j721e
          - items:
              - enum:
                  - beagle,j721e-beagleboneai64
                  - ti,j721e-evm
                  - ti,j721e-sk
              - const: ti,j721e

      - description: K3 J721s2 SoC
        items:
          - enum:
              - ti,am68-sk
              - ti,j721s2-evm
          - const: ti,j721s2

      - description: K3 J784s4 SoC
        items:
          - enum:
              - ti,am69-sk
              - ti,j784s4-evm
          - const: ti,j784s4

additionalProperties: true

...
```

## Documentation/devicetree/bindings/arm/ti/nspire.yaml
```yaml
# SPDX-License-Identifier: GPL-2.0
%YAML 1.2
---
$id: http://devicetree.org/schemas/arm/ti/nspire.yaml#
$schema: http://devicetree.org/meta-schemas/core.yaml#

title: TI-NSPIRE calculators

maintainers:
  - Daniel Tang <dt.tangr@gmail.com>

properties:
  $nodename:
    const: '/'
  compatible:
    items:
      - enum:
          # CX models
          - ti,nspire-cx
          # Touchpad models
          - ti,nspire-tp
          # Clickpad models
          - ti,nspire-clp

additionalProperties: true

...
```
