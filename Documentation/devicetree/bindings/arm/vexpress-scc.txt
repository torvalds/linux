## Documentation/devicetree/bindings/arm/vexpress-scc.txt
```
ARM Versatile Express Serial Configuration Controller
-----------------------------------------------------

Test chips for ARM Versatile Express platform implement SCC (Serial
Configuration Controller) interface, used to set initial conditions
for the test chip.

In some cases its registers are also mapped in normal address space
and can be used to obtain runtime information about the chip internals
(like silicon temperature sensors) and as interface to other subsystems
like platform configuration control and power management.

Required properties:

- compatible value: "arm,vexpress-scc,<model>", "arm,vexpress-scc";
		    where <model> is the full tile model name (as used
		    in the tile's Technical Reference Manual),
		    eg. for Coretile Express A15x2 A7x3 (V2P-CA15_A7):
	compatible = "arm,vexpress-scc,v2p-ca15_a7", "arm,vexpress-scc";

Optional properties:

- reg: when the SCC is memory mapped, physical address and size of the
       registers window
- interrupts: when the SCC can generate a system-level interrupt

Example:

	scc@7fff0000 {
		compatible = "arm,vexpress-scc,v2p-ca15_a7", "arm,vexpress-scc";
		reg = <0 0x7fff0000 0 0x1000>;
		interrupts = <0 95 4>;
	};
```

## Documentation/devicetree/bindings/arm/vexpress-sysreg.txt
```
ARM Versatile Express system registers
--------------------------------------

This is a system control registers block, providing multiple low level
platform functions like board detection and identification, software
interrupt generation, MMC and NOR Flash control etc.

Required node properties:
- compatible value : = "arm,vexpress,sysreg";
- reg : physical base address and the size of the registers window

Deprecated properties, replaced by GPIO subnodes (see below):
- gpio-controller : specifies that the node is a GPIO controller
- #gpio-cells : size of the GPIO specifier, should be 2:
  - first cell is the pseudo-GPIO line number:
    0 - MMC CARDIN
    1 - MMC WPROT
    2 - NOR FLASH WPn
  - second cell can take standard GPIO flags (currently ignored).

Control registers providing pseudo-GPIO lines must be represented
by subnodes, each of them requiring the following properties:
- compatible value : one of
			"arm,vexpress-sysreg,sys_led"
			"arm,vexpress-sysreg,sys_mci"
			"arm,vexpress-sysreg,sys_flash"
- gpio-controller : makes the node a GPIO controller
- #gpio-cells : size of the GPIO specifier, must be 2:
  - first cell is the function number:
    - for sys_led : 0..7 = LED 0..7
    - for sys_mci : 0 = MMC CARDIN, 1 = MMC WPROT
    - for sys_flash : 0 = NOR FLASH WPn
  - second cell can take standard GPIO flags (currently ignored).

Example:
	v2m_sysreg: sysreg@10000000 {
 		compatible = "arm,vexpress-sysreg";
 		reg = <0x10000000 0x1000>;

		v2m_led_gpios: sys_led@8 {
			compatible = "arm,vexpress-sysreg,sys_led";
			gpio-controller;
			#gpio-cells = <2>;
		};

		v2m_mmc_gpios: sys_mci@48 {
			compatible = "arm,vexpress-sysreg,sys_mci";
			gpio-controller;
			#gpio-cells = <2>;
		};

		v2m_flash_gpios: sys_flash@4c {
			compatible = "arm,vexpress-sysreg,sys_flash";
			gpio-controller;
			#gpio-cells = <2>;
		};
 	};

This block also can also act a bridge to the platform's configuration
bus via "system control" interface, addressing devices with site number,
position in the board stack, config controller, function and device
numbers - see motherboard's TRM for more details. All configuration
controller accessible via this interface must reference the sysreg
node via "arm,vexpress,config-bridge" phandle and define appropriate
topology properties - see main vexpress node documentation for more
details. Each child of such node describes one function and must
define the following properties:
- compatible value : must be one of (corresponding to the TRM):
	"arm,vexpress-amp"
	"arm,vexpress-dvimode"
	"arm,vexpress-energy"
	"arm,vexpress-muxfpga"
	"arm,vexpress-osc"
	"arm,vexpress-power"
	"arm,vexpress-reboot"
	"arm,vexpress-reset"
	"arm,vexpress-scc"
	"arm,vexpress-shutdown"
	"arm,vexpress-temp"
	"arm,vexpress-volt"
- arm,vexpress-sysreg,func : must contain a set of two cells long groups:
  - first cell of each group defines the function number
    (eg. 1 for clock generator, 2 for voltage regulators etc.)
  - second cell of each group defines device number (eg. osc 0,
    osc 1 etc.)
  - some functions (eg. energy meter, with its 64 bit long counter)
    are using more than one function/device number pair

Example:
	mcc {
		compatible = "arm,vexpress,config-bus";
		arm,vexpress,config-bridge = <&v2m_sysreg>;

		osc@0 {
			compatible = "arm,vexpress-osc";
			arm,vexpress-sysreg,func = <1 0>;
		};

		energy@0 {
			compatible = "arm,vexpress-energy";
			arm,vexpress-sysreg,func = <13 0>, <13 1>;
		};
	};
```

## Documentation/devicetree/bindings/arm/vexpress-sysreg.yaml
```yaml
# SPDX-License-Identifier: (GPL-2.0-only OR BSD-2-Clause)
%YAML 1.2
---
$id: http://devicetree.org/schemas/arm/vexpress-sysreg.yaml#
$schema: http://devicetree.org/meta-schemas/core.yaml#

title: ARM Versatile Express system registers bindings

maintainers:
  - Andre Przywara <andre.przywara@arm.com>

description:
  This is a system control registers block, providing multiple low level
  platform functions like board detection and identification, software
  interrupt generation, MMC and NOR Flash control, etc.

properties:
  compatible:
    const: arm,vexpress-sysreg

  reg:
    maxItems: 1

  "#address-cells":
    const: 1

  "#size-cells":
    const: 1

  ranges: true

  gpio-controller:
    deprecated: true

  "#gpio-cells":
    deprecated: true
    const: 2

additionalProperties: false

patternProperties:
  '^gpio@[0-9a-f]+$':
    type: object
    additionalProperties: false
    description:
      GPIO children

    properties:
      compatible:
        enum:
          - arm,vexpress-sysreg,sys_led
          - arm,vexpress-sysreg,sys_mci
          - arm,vexpress-sysreg,sys_flash

      gpio-controller: true

      "#gpio-cells":
        const: 2
        description: |
          The first cell is the function number:
          for sys_led : 0..7 = LED 0..7
          for sys_mci : 0 = MMC CARDIN, 1 = MMC WPROT
          for sys_flash : 0 = NOR FLASH WPn
          The second cell can take standard GPIO flags.

      reg:
        maxItems: 1

    required:
      - compatible
      - reg
      - gpio-controller
      - "#gpio-cells"

required:
  - compatible
  - reg

examples:
  - |
    sysreg@0 {
        compatible = "arm,vexpress-sysreg";
        reg = <0x00000 0x1000>;
        #address-cells = <1>;
        #size-cells = <1>;
        ranges = <0 0 0x1000>;

        v2m_led_gpios: gpio@8 {
            compatible = "arm,vexpress-sysreg,sys_led";
            reg = <0x008 4>;
            gpio-controller;
            #gpio-cells = <2>;
        };
    };

...
```

## Documentation/devicetree/bindings/arm/vexpress.txt
```
ARM Versatile Express boards family
-----------------------------------

ARM's Versatile Express platform consists of a motherboard and one
or more daughterboards (tiles). The motherboard provides a set of
peripherals. Processor and RAM "live" on the tiles.

The motherboard and each core tile should be described by a separate
Device Tree source file, with the tile's description including
the motherboard file using a /include/ directive. As the motherboard
can be initialized in one of two different configurations ("memory
maps"), care must be taken to include the correct one.


Root node
---------

Required properties in the root node:
- compatible value:
	compatible = "arm,vexpress,<model>", "arm,vexpress";
  where <model> is the full tile model name (as used in the tile's
    Technical Reference Manual), eg.:
    - for Coretile Express A5x2 (V2P-CA5s):
	compatible = "arm,vexpress,v2p-ca5s", "arm,vexpress";
    - for Coretile Express A9x4 (V2P-CA9):
	compatible = "arm,vexpress,v2p-ca9", "arm,vexpress";
  If a tile comes in several variants or can be used in more then one
  configuration, the compatible value should be:
	compatible = "arm,vexpress,<model>,<variant>", \
				"arm,vexpress,<model>", "arm,vexpress";
  eg:
    - Coretile Express A15x2 (V2P-CA15) with Tech Chip 1:
	compatible = "arm,vexpress,v2p-ca15,tc1", \
				"arm,vexpress,v2p-ca15", "arm,vexpress";
    - LogicTile Express 13MG (V2F-2XV6) running Cortex-A7 (3 cores) SMM:
	compatible = "arm,vexpress,v2f-2xv6,ca7x3", \
				"arm,vexpress,v2f-2xv6", "arm,vexpress";

Optional properties in the root node:
- tile model name (use name from the tile's Technical Reference
  Manual, eg. "V2P-CA5s")
	model = "<model>";
- tile's HBI number (unique ARM's board model ID, visible on the
  PCB's silkscreen) in hexadecimal transcription:
	arm,hbi = <0xhbi>
  eg:
  - for Coretile Express A5x2 (V2P-CA5s) HBI-0191:
	arm,hbi = <0x191>;
  - Coretile Express A9x4 (V2P-CA9) HBI-0225:
	arm,hbi = <0x225>;


CPU nodes
---------

Top-level standard "cpus" node is required. It must contain a node
with device_type = "cpu" property for every available core, eg.:

	cpus {
		#address-cells = <1>;
		#size-cells = <0>;

		cpu@0 {
			device_type = "cpu";
			compatible = "arm,cortex-a5";
			reg = <0>;
		};
	};


Configuration infrastructure
----------------------------

The platform has an elaborated configuration system, consisting of
microcontrollers residing on the mother- and daughterboards known
as Motherboard/Daughterboard Configuration Controller (MCC and DCC).
The controllers are responsible for the platform initialization
(reset generation, flash programming, FPGA bitfiles loading etc.)
but also control clock generators, voltage regulators, gather
environmental data like temperature, power consumption etc. Even
the video output switch (FPGA) is controlled that way.

The controllers are not mapped into normal memory address space
and must be accessed through bridges - other devices capable
of generating transactions on the configuration bus.

The nodes describing configuration controllers must define
the following properties:
- compatible value:
	compatible = "arm,vexpress,config-bus";
- bridge phandle:
	arm,vexpress,config-bridge = <phandle>;
and children describing available functions.


Platform topology
-----------------

As Versatile Express can be configured in number of physically
different setups, the device tree should describe platform topology.
Root node and main motherboard node must define the following
property, describing physical location of the children nodes:
- site number:
	arm,vexpress,site = <number>;
  where 0 means motherboard, 1 or 2 are daugtherboard sites,
  0xf means "master" site (site containing main CPU tile)
- when daughterboards are stacked on one site, their position
  in the stack be be described with:
	arm,vexpress,position = <number>;
- when describing tiles consisting more than one DCC, its number
  can be described with:
	arm,vexpress,dcc = <number>;

Any of the numbers above defaults to zero if not defined in
the node or any of its parent.


Motherboard
-----------

The motherboard description file provides a single "motherboard" node
using 2 address cells corresponding to the Static Memory Bus used
between the motherboard and the tile. The first cell defines the Chip
Select (CS) line number, the second cell address offset within the CS.
All interrupt lines between the motherboard and the tile are active
high and are described using single cell.

Optional properties of the "motherboard" node:
- motherboard's memory map variant:
	arm,v2m-memory-map = "<name>";
  where name is one of:
  - "rs1" - for RS1 map (i.a. peripherals on CS3); this map is also
            referred to as "ARM Cortex-A Series memory map":
	arm,v2m-memory-map = "rs1";
  When this property is missing, the motherboard is using the original
  memory map (also known as the "Legacy memory map", primarily used
  with the original CoreTile Express A9x4) with peripherals on CS7.

Motherboard .dtsi files provide a set of labelled peripherals that
can be used to obtain required phandle in the tile's "aliases" node:
- UARTs, note that the numbers correspond to the physical connectors
  on the motherboard's back panel:
	v2m_serial0, v2m_serial1, v2m_serial2 and v2m_serial3
- I2C controllers:
	v2m_i2c_dvi and v2m_i2c_pcie
- SP804 timers:
	v2m_timer01 and v2m_timer23

The tile description should define a "smb" node, describing the
Static Memory Bus between the tile and motherboard. It must define
the following properties:
- "simple-bus" compatible value (to ensure creation of the children)
	compatible = "simple-bus";
- mapping of the SMB CS/offset addresses into main address space:
	#address-cells = <2>;
	#size-cells = <1>;
	ranges = <...>;
- interrupts mapping:
	#interrupt-cells = <1>;
	interrupt-map-mask = <0 0 63>;
	interrupt-map = <...>;


Example of a VE tile description (simplified)
---------------------------------------------

/dts-v1/;

/ {
	model = "V2P-CA5s";
	arm,hbi = <0x225>;
	arm,vexpress,site = <0xf>;
	compatible = "arm,vexpress-v2p-ca5s", "arm,vexpress";
	interrupt-parent = <&gic>;
	#address-cells = <1>;
	#size-cells = <1>;

	chosen { };

	aliases {
		serial0 = &v2m_serial0;
	};

	cpus {
		#address-cells = <1>;
		#size-cells = <0>;

		cpu@0 {
			device_type = "cpu";
			compatible = "arm,cortex-a5";
			reg = <0>;
		};
	};

	gic: interrupt-controller@2c001000 {
		compatible = "arm,cortex-a9-gic";
		#interrupt-cells = <3>;
		#address-cells = <0>;
		interrupt-controller;
		reg = <0x2c001000 0x1000>,
		      <0x2c000100 0x100>;
	};

	dcc {
		compatible = "arm,vexpress,config-bus";
		arm,vexpress,config-bridge = <&v2m_sysreg>;

		osc@0 {
			compatible = "arm,vexpress-osc";
		};
	};

	smb {
		compatible = "simple-bus";

		#address-cells = <2>;
		#size-cells = <1>;
		/* CS0 is visible at 0x08000000 */
		ranges = <0 0 0x08000000 0x04000000>;

		#interrupt-cells = <1>;
		interrupt-map-mask = <0 0 63>;
		/* Active high IRQ 0 is connected to GIC's SPI0 */
		interrupt-map = <0 0 0 &gic 0 0 4>;

		/include/ "vexpress-v2m-rs1.dtsi"
	};
};
```

## Documentation/devicetree/bindings/arm/vic.txt
```
* ARM Vectored Interrupt Controller

One or more Vectored Interrupt Controllers (VIC's) can be connected in an ARM
system for interrupt routing.  For multiple controllers they can either be
nested or have the outputs wire-OR'd together.

Required properties:

- compatible : should be one of
	"arm,pl190-vic"
	"arm,pl192-vic"
- interrupt-controller : Identifies the node as an interrupt controller
- #interrupt-cells : The number of cells to define the interrupts.  Must be 1 as
  the VIC has no configuration options for interrupt sources.  The cell is a u32
  and defines the interrupt number.
- reg : The register bank for the VIC.

Optional properties:

- interrupts : Interrupt source for parent controllers if the VIC is nested.

Example:

	vic0: interrupt-controller@60000 {
		compatible = "arm,pl192-vic";
		interrupt-controller;
		#interrupt-cells = <1>;
		reg = <0x60000 0x1000>;
	};
```

## Documentation/devicetree/bindings/arm/vt8500.txt
```
VIA/Wondermedia VT8500 Platforms Device Tree Bindings
---------------------------------------

Boards with the VIA VT8500 SoC shall have the following properties:
Required root node property:
compatible = "via,vt8500";

Boards with the Wondermedia WM8505 SoC shall have the following properties:
Required root node property:
compatible = "wm,wm8505";

Boards with the Wondermedia WM8650 SoC shall have the following properties:
Required root node property:
compatible = "wm,wm8650";

Boards with the Wondermedia WM8750 SoC shall have the following properties:
Required root node property:
compatible = "wm,wm8750";

Boards with the Wondermedia WM8850 SoC shall have the following properties:
Required root node property:
compatible = "wm,wm8850";
```
