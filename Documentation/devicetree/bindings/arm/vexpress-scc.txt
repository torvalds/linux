## Documentation/devicetree/bindings/ata/ahci-st.txt
```
STMicroelectronics STi SATA controller

This binding describes a SATA device.

Required properties:
 - compatible	   : Must be "st,ahci"
 - reg		   : Physical base addresses and length of register sets
 - interrupts	   : Interrupt associated with the SATA device
 - interrupt-names :   Associated name must be; "hostc"
 - clocks	   : The phandle for the clock
 - clock-names	   :   Associated name must be; "ahci_clk"
 - phys		   : The phandle for the PHY port
 - phy-names	   :   Associated name must be; "ahci_phy"

Optional properties:
 - resets	   : The power-down, soft-reset and power-reset lines of SATA IP
 - reset-names	   :   Associated names must be; "pwr-dwn", "sw-rst" and "pwr-rst"

Example:

	/* Example for stih407 family silicon */
	sata0: sata@9b20000 {
		compatible	= "st,ahci";
		reg		= <0x9b20000 0x1000>;
		interrupts	= <GIC_SPI 159 IRQ_TYPE_NONE>;
		interrupt-names	= "hostc";
		phys		= <&phy_port0 PHY_TYPE_SATA>;
		phy-names	= "ahci_phy";
		resets		= <&powerdown STIH407_SATA0_POWERDOWN>,
				  <&softreset STIH407_SATA0_SOFTRESET>,
				  <&softreset STIH407_SATA0_PWR_SOFTRESET>;
		reset-names	= "pwr-dwn", "sw-rst", "pwr-rst";
		clocks		= <&clk_s_c0_flexgen CLK_ICN_REG>;
		clock-names	= "ahci_clk";
	};
```

## Documentation/devicetree/bindings/ata/allwinner,sun4i-a10-ahci.yaml
```yaml
# SPDX-License-Identifier: GPL-2.0
%YAML 1.2
---
$id: http://devicetree.org/schemas/ata/allwinner,sun4i-a10-ahci.yaml#
$schema: http://devicetree.org/meta-schemas/core.yaml#

title: Allwinner A10 AHCI SATA Controller bindings

maintainers:
  - Chen-Yu Tsai <wens@csie.org>
  - Maxime Ripard <mripard@kernel.org>

properties:
  compatible:
    const: allwinner,sun4i-a10-ahci

  reg:
    maxItems: 1

  clocks:
    items:
      - description: AHCI Bus Clock
      - description: AHCI Module Clock

  interrupts:
    maxItems: 1

  target-supply:
    description: Regulator for SATA target power

required:
  - compatible
  - reg
  - clocks
  - interrupts

additionalProperties: false

examples:
  - |
    ahci: sata@1c18000 {
        compatible = "allwinner,sun4i-a10-ahci";
        reg = <0x01c18000 0x1000>;
        interrupts = <56>;
        clocks = <&pll6 0>, <&ahb_gates 25>;
        target-supply = <&reg_ahci_5v>;
    };
```

## Documentation/devicetree/bindings/ata/allwinner,sun8i-r40-ahci.yaml
```yaml
# SPDX-License-Identifier: GPL-2.0
%YAML 1.2
---
$id: http://devicetree.org/schemas/ata/allwinner,sun8i-r40-ahci.yaml#
$schema: http://devicetree.org/meta-schemas/core.yaml#

title: Allwinner R40 AHCI SATA Controller

maintainers:
  - Chen-Yu Tsai <wens@csie.org>
  - Maxime Ripard <mripard@kernel.org>

properties:
  compatible:
    const: allwinner,sun8i-r40-ahci

  reg:
    maxItems: 1

  clocks:
    items:
      - description: AHCI Bus Clock
      - description: AHCI Module Clock

  interrupts:
    maxItems: 1

  resets:
    maxItems: 1

  reset-names:
    const: ahci

  ahci-supply:
    description: Regulator for the AHCI controller

  phy-supply:
    description: Regulator for the SATA PHY power

required:
  - compatible
  - reg
  - clocks
  - interrupts
  - resets
  - reset-names

additionalProperties: false

examples:
  - |
    #include <dt-bindings/interrupt-controller/arm-gic.h>
    #include <dt-bindings/clock/sun8i-r40-ccu.h>
    #include <dt-bindings/reset/sun8i-r40-ccu.h>

    ahci: sata@1c18000 {
        compatible = "allwinner,sun8i-r40-ahci";
        reg = <0x01c18000 0x1000>;
        interrupts = <GIC_SPI 56 IRQ_TYPE_LEVEL_HIGH>;
        clocks = <&ccu CLK_BUS_SATA>, <&ccu CLK_SATA>;
        resets = <&ccu RST_BUS_SATA>;
        reset-names = "ahci";
        ahci-supply = <&reg_dldo4>;
        phy-supply = <&reg_eldo3>;
    };

...
```
