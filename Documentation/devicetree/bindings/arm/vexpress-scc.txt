## Documentation/devicetree/bindings/arm/vt8500.yaml
```yaml
# SPDX-License-Identifier: GPL-2.0
%YAML 1.2
---
$id: http://devicetree.org/schemas/arm/vt8500.yaml#
$schema: http://devicetree.org/meta-schemas/core.yaml#

title: VIA/Wondermedia VT8500 Platforms Device Tree Bindings

maintainers:
  - Tony Prisk <linux@prisktech.co.nz>
description: test

properties:
  $nodename:
    const: '/'
  compatible:
    items:
      - enum:
          - via,vt8500
          - wm,wm8505
          - wm,wm8650
          - wm,wm8750
          - wm,wm8850
          
additionalProperties: true
```

## Documentation/devicetree/bindings/arm/vt8500/via,vt8500-pmc.txt
```
VIA/Wondermedia VT8500 Power Management Controller
-----------------------------------------------------

Required properties:
- compatible : "via,vt8500-pmc"
- reg : Should contain 1 register ranges(address and length)

Example:

	pmc@d8130000 {
		compatible = "via,vt8500-pmc";
		reg = <0xd8130000 0x1000>;
	};
```

## Documentation/devicetree/bindings/arm/xen.txt
```
* Xen hypervisor device tree bindings

Xen ARM virtual platforms shall have a top-level "hypervisor" node with
the following properties:

- compatible:
	compatible = "xen,xen-<version>", "xen,xen";
  where <version> is the version of the Xen ABI of the platform.

- reg: specifies the base physical address and size of a region in
  memory where the grant table should be mapped to, using an
  HYPERVISOR_memory_op hypercall. The memory region is large enough to map
  the whole grant table (it is larger or equal to gnttab_max_grant_frames()).
  This property is unnecessary when booting Dom0 using ACPI.

- interrupts: the interrupt used by Xen to inject event notifications.
  A GIC node is also required.
  This property is unnecessary when booting Dom0 using ACPI.

To support UEFI on Xen ARM virtual platforms, Xen populates the FDT "uefi" node
under /hypervisor with following parameters:

________________________________________________________________________________
Name                      | Size   | Description
================================================================================
xen,uefi-system-table     | 64-bit | Guest physical address of the UEFI System
			  |	   | Table.
--------------------------------------------------------------------------------
xen,uefi-mmap-start       | 64-bit | Guest physical address of the UEFI memory
			  |	   | map.
--------------------------------------------------------------------------------
xen,uefi-mmap-size        | 32-bit | Size in bytes of the UEFI memory map
                          |        | pointed to in previous entry.
--------------------------------------------------------------------------------
xen,uefi-mmap-desc-size   | 32-bit | Size in bytes of each entry in the UEFI
                          |        | memory map.
--------------------------------------------------------------------------------
xen,uefi-mmap-desc-ver    | 32-bit | Version of the mmap descriptor format.
--------------------------------------------------------------------------------

Example (assuming #address-cells = <2> and #size-cells = <2>):

hypervisor {
	compatible = "xen,xen-4.3", "xen,xen";
	reg = <0 0xb0000000 0 0x20000>;
	interrupts = <1 15 0xf08>;
	uefi {
		xen,uefi-system-table = <0xXXXXXXXX>;
		xen,uefi-mmap-start = <0xXXXXXXXX>;
		xen,uefi-mmap-size = <0xXXXXXXXX>;
		xen,uefi-mmap-desc-size = <0xXXXXXXXX>;
		xen,uefi-mmap-desc-ver = <0xXXXXXXXX>;
        };
};

The format and meaning of the "xen,uefi-*" parameters are similar to those in
Documentation/arm/uefi.txt, which are provided by the regular UEFI stub. However
they differ because they are provided by the Xen hypervisor, together with a set
of UEFI runtime services implemented via hypercalls, see
http://xenbits.xen.org/docs/unstable/hypercall/x86_64/include,public,platform.h.html.
```

## Documentation/devicetree/bindings/arm/xen.yaml
```yaml
# SPDX-License-Identifier: (GPL-2.0-only OR BSD-2-Clause)
%YAML 1.2
---
$id: http://devicetree.org/schemas/arm/xen.yaml#
$schema: http://devicetree.org/meta-schemas/core.yaml#

title: Xen hypervisor

maintainers:
  - Stefano Stabellini <sstabellini@kernel.org>

description:
  Xen ARM virtual platforms shall have a top-level "hypervisor" node with
  the properties defined below.

properties:
  $nodename:
    pattern: '^hypervisor(@[0-9a-f]+)?$'

  compatible:
    description:
      Specifies the Xen hypervisor. The version of the Xen ABI is encoded
      in the first item as "xen,xen-<version>", followed by the generic
      "xen,xen" string.
    items:
      - pattern: '^xen,xen-[0-9]+\.[0-9]+$'
      - const: xen,xen

  reg:
    description: |
      Base physical address and size of the regions in memory where special
      resources should be mapped to, using a HYPERVISOR_memory_op hypercall.

      Region 0 is reserved for mapping the grant table and must always be
      present. The memory region must be large enough to map the whole grant
      table (it is larger or equal to gnttab_max_grant_frames()).

      Regions 1...N are extended regions (unused address space) for mapping
      foreign GFNs and grants. They might be absent if there is nothing to
      expose.
    minItems: 1

  interrupts:
    description:
      The interrupt used by Xen to inject event notifications.
      A GIC node is also required.
    maxItems: 1

  uefi:
    type: object
    description:
      Node populated by Xen to support UEFI on Xen ARM virtual platforms.
      The format and meaning of the "xen,uefi-*" parameters are similar to
      those in Documentation/arch/arm/uefi.rst, but are provided by the Xen
      hypervisor together with a set of UEFI runtime services implemented via
      hypercalls.

    properties:
      xen,uefi-system-table:
        description: Guest physical address of the UEFI System Table.
        $ref: /schemas/types.yaml#/definitions/uint64

      xen,uefi-mmap-start:
        description: Guest physical address of the UEFI memory map.
        $ref: /schemas/types.yaml#/definitions/uint64

      xen,uefi-mmap-size:
        description: Size in bytes of the UEFI memory map pointed to by xen,uefi-mmap-start.
        $ref: /schemas/types.yaml#/definitions/uint32

      xen,uefi-mmap-desc-size:
        description: Size in bytes of each entry in the UEFI memory map.
        $ref: /schemas/types.yaml#/definitions/uint32

      xen,uefi-mmap-desc-ver:
        description: Version of the mmap descriptor format.
        $ref: /schemas/types.yaml#/definitions/uint32

    required:
      - xen,uefi-system-table
      - xen,uefi-mmap-start
      - xen,uefi-mmap-size
      - xen,uefi-mmap-desc-size
      - xen,uefi-mmap-desc-ver

    additionalProperties: false

required:
  - compatible
  - reg
  - interrupts

additionalProperties: false

examples:
  - |
    hypervisor@b0000000 {
        compatible = "xen,xen-4.3", "xen,xen";
        reg = <0xb0000000 0x20000>;
        interrupts = <1 15 0xf08>;

        uefi {
            xen,uefi-system-table = /bits/ 64 <0x1301415>;
            xen,uefi-mmap-start = /bits/ 64 <0x7591400>;
            xen,uefi-mmap-size = <0x1800>;
            xen,uefi-mmap-desc-size = <0x30>;
            xen,uefi-mmap-desc-ver = <1>;
        };
    };
...
```

## Documentation/devicetree/bindings/arm/xilinx.txt
```
Xilinx Zynq Platforms Device Tree Bindings

Boards with Zynq-7000 SOC based on an ARM Cortex A9 processor
shall have the following properties.

Required root node properties:
    - compatible = "xlnx,zynq-7000";

Additional compatible strings:

- Adapteva Parallella board
  "adapteva,parallella"

- Avnet MicroZed board
  "avnet,zynq-microzed"
  "xlnx,zynq-microzed"

- Avnet ZedBoard board
  "avnet,zynq-zed"
  "xlnx,zynq-zed"

- Digilent Zybo board
  "digilent,zynq-zybo"

- Digilent Zybo Z7 board
  "digilent,zynq-zybo-z7"

- Xilinx CC108 internal board
  "xlnx,zynq-cc108"

- Xilinx ZC702 internal board
  "xlnx,zynq-zc702"

- Xilinx ZC706 internal board
  "xlnx,zynq-zc706"

- Xilinx ZC770 internal board, with different FMC cards
  "xlnx,zynq-zc770-xm010"
  "xlnx,zynq-zc770-xm011"
  "xlnx,zynq-zc770-xm012"
  "xlnx,zynq-zc770-xm013"

---------------------------------------------------------------

Xilinx Zynq UltraScale+ MPSoC Platforms Device Tree Bindings

Boards with ZynqMP SOC based on an ARM Cortex A53 processor
shall have the following properties.

Required root node properties:
    - compatible = "xlnx,zynqmp";


Additional compatible strings:

- Xilinx internal board zc1232
  "xlnx,zynqmp-zc1232-revA", "xlnx,zynqmp-zc1232"

- Xilinx internal board zc1254
  "xlnx,zynqmp-zc1254-revA", "xlnx,zynqmp-zc1254"

- Xilinx internal board zc1275
  "xlnx,zynqmp-zc1275-revA", "xlnx,zynqmp-zc1275"

- Xilinx internal board zc1751
  "xlnx,zynqmp-zc1751"

- Xilinx 96boards compatible board zcu100
  "xlnx,zynqmp-zcu100-revC", "xlnx,zynqmp-zcu100"

- Xilinx evaluation board zcu102
  "xlnx,zynqmp-zcu102-revA", "xlnx,zynqmp-zcu102"
  "xlnx,zynqmp-zcu102-revB", "xlnx,zynqmp-zcu102"
  "xlnx,zynqmp-zcu102-rev1.0", "xlnx,zynqmp-zcu102"

- Xilinx evaluation board zcu104
  "xlnx,zynqmp-zcu104-revA", "xlnx,zynqmp-zcu104"

- Xilinx evaluation board zcu106
  "xlnx,zynqmp-zcu106-revA", "xlnx,zynqmp-zcu106"

- Xilinx evaluation board zcu111
  "xlnx,zynqmp-zcu111-revA", "xlnx,zynqmp-zcu111"
```

## Documentation/devicetree/bindings/arm/zte,sysctrl.txt
```
ZTE sysctrl Registers

Registers for 'zte,zx296702' SoC:

System management required properties:
      - compatible = "zte,sysctrl"

Low power management required properties:
      - compatible = "zte,zx296702-pcu"

Bus matrix required properties:
      - compatible = "zte,zx-bus-matrix"


Registers for 'zte,zx296718' SoC:

System management required properties:
      - compatible = "zte,zx296718-aon-sysctrl"
      - compatible = "zte,zx296718-sysctrl"

Example:
aon_sysctrl: aon-sysctrl@116000 {
	compatible = "zte,zx296718-aon-sysctrl", "syscon";
	reg = <0x116000 0x1000>;
};

sysctrl: sysctrl@1463000 {
	compatible = "zte,zx296718-sysctrl", "syscon";
	reg = <0x1463000 0x1000>;
};
```

## Documentation/devicetree/bindings/arm/zte.txt
```
ZTE platforms device tree bindings

---------------------------------------
-  ZX296702 board:
    Required root node properties:
      - compatible = "zte,zx296702-ad1", "zte,zx296702"

---------------------------------------
-  ZX296718 SoC:
    Required root node properties:
      - compatible = "zte,zx296718"

ZX296718 EVB board:
      - "zte,zx296718-evb"
```

## Documentation/devicetree/bindings/arm/zte.yaml
```yaml
# SPDX-License-Identifier: (GPL-2.0-only OR BSD-2-Clause)
%YAML 1.2
---
$id: http://devicetree.org/schemas/arm/zte.yaml#
$schema: http://devicetree.org/meta-schemas/core.yaml#

title: ZTE zx platforms

maintainers:
  - Stefan Dösinger <stefandoesinger@gmail.com>

description: |
  ARM platforms using SoCs designed by ZTE. Currently this supports devices
  based on the zx297520v3 SoC which is found in LTE routers.

properties:
  $nodename:
    const: "/"
  compatible:
    oneOf:
      - items:
          - enum:
              - dlink,dwr932m
          - const: zte,zx297520v3

additionalProperties: true
```

## Documentation/devicetree/bindings/ata/ahci-ceva.txt
```
Binding for CEVA AHCI SATA Controller

Required properties:
  - reg: Physical base address and size of the controller's register area.
  - compatible: Compatibility string. Must be 'ceva,ahci-1v84'.
  - clocks: Input clock specifier. Refer to common clock bindings.
  - interrupts: Interrupt specifier. Refer to interrupt binding.
  - ceva,p0-cominit-params: OOB timing value for COMINIT parameter for port 0.
  - ceva,p1-cominit-params: OOB timing value for COMINIT parameter for port 1.
			The fields for the above parameter must be as shown below:
			ceva,pN-cominit-params = /bits/ 8 <CIBGMN CIBGMX CIBGN CINMP>;
			CINMP : COMINIT Negate Minimum Period.
			CIBGN : COMINIT Burst Gap Nominal.
			CIBGMX: COMINIT Burst Gap Maximum.
			CIBGMN: COMINIT Burst Gap Minimum.
  - ceva,p0-comwake-params: OOB timing value for COMWAKE parameter for port 0.
  - ceva,p1-comwake-params: OOB timing value for COMWAKE parameter for port 1.
			The fields for the above parameter must be as shown below:
			ceva,pN-comwake-params = /bits/ 8 <CWBGMN CWBGMX CWBGN CWNMP>;
			CWBGMN: COMWAKE Burst Gap Minimum.
			CWBGMX: COMWAKE Burst Gap Maximum.
			CWBGN: COMWAKE Burst Gap Nominal.
			CWNMP: COMWAKE Negate Minimum Period.
  - ceva,p0-burst-params: Burst timing value for COM parameter for port 0.
  - ceva,p1-burst-params: Burst timing value for COM parameter for port 1.
			The fields for the above parameter must be as shown below:
			ceva,pN-burst-params = /bits/ 8 <BMX BNM SFD PTST>;
			BMX: COM Burst Maximum.
			BNM: COM Burst Nominal.
			SFD: Signal Failure Detection value.
			PTST: Partial to Slumber timer value.
  - ceva,p0-retry-params: Retry interval timing value for port 0.
  - ceva,p1-retry-params: Retry interval timing value for port 1.
			The fields for the above parameter must be as shown below:
			ceva,pN-retry-params = /bits/ 16 <RIT RCT>;
			RIT:  Retry Interval Timer.
			RCT:  Rate Change Timer.

Optional properties:
  - ceva,broken-gen2: limit to gen1 speed instead of gen2.

Examples:
	ahci@fd0c0000 {
		compatible = "ceva,ahci-1v84";
		reg = <0xfd0c0000 0x200>;
		interrupt-parent = <&gic>;
		interrupts = <0 133 4>;
		clocks = <&clkc SATA_CLK_ID>;
		ceva,p0-cominit-params = /bits/ 8 <0x0F 0x25 0x18 0x29>;
		ceva,p0-comwake-params = /bits/ 8 <0x04 0x0B 0x08 0x0F>;
		ceva,p0-burst-params = /bits/ 8 <0x0A 0x08 0x4A 0x06>;
		ceva,p0-retry-params = /bits/ 16 <0x0216 0x7F06>;

		ceva,p1-cominit-params = /bits/ 8 <0x0F 0x25 0x18 0x29>;
		ceva,p1-comwake-params = /bits/ 8 <0x04 0x0B 0x08 0x0F>;
		ceva,p1-burst-params = /bits/ 8 <0x0A 0x08 0x4A 0x06>;
		ceva,p1-retry-params = /bits/ 16 <0x0216 0x7F06>;
		ceva,broken-gen2;
	};
```
