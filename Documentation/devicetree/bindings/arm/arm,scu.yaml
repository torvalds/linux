## Documentation/devicetree/bindings/arm/armada-370-xp-mpic.txt
```
Marvell Armada 370 and Armada XP Interrupt Controller
-----------------------------------------------------

Required properties:
- compatible: Should be "marvell,mpic"
- interrupt-controller: Identifies the node as an interrupt controller.
- #interrupt-cells: The number of cells to define the interrupts. Should be 1.
  The cell is the IRQ number

- reg: Should contain PMIC registers location and length. First pair
  for the main interrupt registers, second pair for the per-CPU
  interrupt registers. For this last pair, to be compliant with SMP
  support, the "virtual" must be use (For the record, these registers
  automatically map to the interrupt controller registers of the
  current CPU)



Example:

        mpic: interrupt-controller@d0020000 {
              compatible = "marvell,mpic";
              #interrupt-cells = <1>;
              #address-cells = <1>;
              #size-cells = <1>;
              interrupt-controller;
              reg = <0xd0020a00 0x1d0>,
                    <0xd0021070 0x58>;
        };
```

## Documentation/devicetree/bindings/arm/armada-370-xp-pmsu.txt
```
Power Management Service Unit(PMSU)
-----------------------------------
Available on Marvell SOCs: Armada 370 and Armada XP

Required properties:

- compatible: should be "marvell,armada-370-pmsu", whereas
  "marvell,armada-370-xp-pmsu" is deprecated and will be removed

- reg: Should contain PMSU registers location and length.

Example:

armada-370-xp-pmsu@22000 {
	compatible = "marvell,armada-370-pmsu";
	reg = <0x22000 0x1000>;
};
```

## Documentation/devicetree/bindings/arm/armada-370-xp-timer.txt
```
Marvell Armada 370 and Armada XP Global Timers
----------------------------------------------

Required properties:
- compatible: Should be "marvell,armada-370-xp-timer"
- interrupts: Should contain the list of Global Timer interrupts
- reg: Should contain the base address of the Global Timer registers

Optional properties:
- marvell,timer-25Mhz: Tells whether the Global timer supports the 25
  Mhz fixed mode (available on Armada XP and not on Armada 370)
```

## Documentation/devicetree/bindings/arm/armada-370-xp.txt
```
Marvell Armada 370 and Armada XP Platforms Device Tree Bindings
---------------------------------------------------------------

Boards with a SoC of the Marvell Armada 370 and Armada XP families
shall have the following property:

Required root node property:

compatible: must contain "marvell,armada-370-xp"

In addition, boards using the Marvell Armada 370 SoC shall have the
following property:

Required root node property:

compatible: must contain "marvell,armada370"

In addition, boards using the Marvell Armada XP SoC shall have the
following property:

Required root node property:

compatible: must contain "marvell,armadaxp"
```

## Documentation/devicetree/bindings/arm/armada-375.txt
```
Marvell Armada 375 Platforms Device Tree Bindings
-------------------------------------------------

Boards with a SoC of the Marvell Armada 375 family shall have the
following property:

Required root node property:

compatible: must contain "marvell,armada375"
```

## Documentation/devicetree/bindings/arm/armada-38x.txt
```
Marvell Armada 38x Platforms Device Tree Bindings
-------------------------------------------------

Boards with a SoC of the Marvell Armada 38x family shall have the
following property:

Required root node property:

 - compatible: must contain "marvell,armada380"

In addition, boards using the Marvell Armada 385 SoC shall have the
following property before the previous one:

Required root node property:

compatible: must contain "marvell,armada385"

Example:

compatible = "marvell,a385-rd", "marvell,armada385", "marvell,armada380";
```

## Documentation/devicetree/bindings/arm/armadeus.txt
```
Armadeus i.MX Platforms Device Tree Bindings
-----------------------------------------------

APF51: i.MX51 based module.
Required root node properties:
    - compatible = "armadeus,imx51-apf51", "fsl,imx51";
```

## Documentation/devicetree/bindings/arm/armv7m_systick.txt
```
* ARMv7M System Timer

ARMv7-M includes a system timer, known as SysTick. Current driver only
implements the clocksource feature.

Required properties:
- compatible	  : Should be "arm,armv7m-systick"
- reg		  : The address range of the timer

Required clocking property, have to be one of:
- clocks	  : The input clock of the timer
- clock-frequency : The rate in HZ in input of the ARM SysTick

Examples:

systick: timer@e000e010 {
	compatible = "arm,armv7m-systick";
	reg = <0xe000e010 0x10>;
	clocks = <&clk_systick>;
};

systick: timer@e000e010 {
	compatible = "arm,armv7m-systick";
	reg = <0xe000e010 0x10>;
	clock-frequency = <90000000>;
};
```

## Documentation/devicetree/bindings/arm/aspeed/aspeed,sbc.yaml
```yaml
# SPDX-License-Identifier: (GPL-2.0-or-later OR BSD-2-Clause)
# Copyright 2021 Joel Stanley, IBM Corp.
%YAML 1.2
---
$id: "http://devicetree.org/schemas/arm/aspeed/aspeed,sbc.yaml#"
$schema: "http://devicetree.org/meta-schemas/core.yaml#"

title: ASPEED Secure Boot Controller

maintainers:
  - Joel Stanley <joel@jms.id.au>
  - Andrew Jeffery <andrew@aj.id.au>

description: |
  The ASPEED SoCs have a register bank for interacting with the secure boot
  controller.

properties:
  compatible:
    items:
      - const: aspeed,ast2600-sbc

  reg:
    maxItems: 1

required:
  - compatible
  - reg

additionalProperties: false

examples:
  - |
    sbc: secure-boot-controller@1e6f2000 {
            compatible = "aspeed,ast2600-sbc";
            reg = <0x1e6f2000 0x1000>;
    };
```

## Documentation/devicetree/bindings/arm/aspeed/aspeed.yaml
```yaml
# SPDX-License-Identifier: GPL-2.0-only OR BSD-2-Clause
%YAML 1.2
---
$id: http://devicetree.org/schemas/arm/aspeed/aspeed.yaml#
$schema: http://devicetree.org/meta-schemas/core.yaml#

title: Aspeed SoC based boards

maintainers:
  - Joel Stanley <joel@jms.id.au>

properties:
  $nodename:
    const: '/'
  compatible:
    oneOf:
      - description: AST2400 based boards
        items:
          - enum:
              - delta,ahe50dc-bmc
              - facebook,galaxy100-bmc
              - facebook,wedge100-bmc
              - facebook,wedge40-bmc
              - microsoft,olympus-bmc
              - quanta,q71l-bmc
              - tyan,palmetto-bmc
              - yadro,vesnin-bmc
          - const: aspeed,ast2400

      - description: AST2500 based boards
        items:
          - enum:
              - amd,daytonax-bmc
              - amd,ethanolx-bmc
              - ampere,mtjade-bmc
              - aspeed,ast2500-evb
              - asrock,e3c246d4i-bmc
              - asrock,e3c256d4i-bmc
              - asrock,romed8hm3-bmc
              - asrock,spc621d8hm3-bmc
              - asrock,x570d4u-bmc
              - bytedance,g220a-bmc
              - facebook,cmm-bmc
              - facebook,minipack-bmc
              - facebook,tiogapass-bmc
              - facebook,yamp-bmc
              - facebook,yosemitev2-bmc
              - facebook,wedge400-bmc
              - hxt,stardragon4800-rep2-bmc
              - ibm,mihawk-bmc
              - ibm,mowgli-bmc
              - ibm,romulus-bmc
              - ibm,swift-bmc
              - ibm,witherspoon-bmc
              - ingrasys,zaius-bmc
              - inspur,fp5280g2-bmc
              - inspur,nf5280m6-bmc
              - inspur,on5263m5-bmc
              - intel,s2600wf-bmc
              - inventec,lanyang-bmc
              - lenovo,hr630-bmc
              - lenovo,hr855xg2-bmc
              - portwell,neptune-bmc
              - qcom,centriq2400-rep-bmc
              - supermicro,x11spi-bmc
              - tyan,s7106-bmc
              - tyan,s8036-bmc
              - yadro,nicole-bmc
              - yadro,vegman-n110-bmc
              - yadro,vegman-rx20-bmc
              - yadro,vegman-sx20-bmc
          - const: aspeed,ast2500

      - description: AST2600 based boards
        items:
          - enum:
              - ampere,mtmitchell-bmc
              - aspeed,ast2600-evb
              - aspeed,ast2600-evb-a1
              - asus,x4tf-bmc
              - facebook,bletchley-bmc
              - facebook,catalina-bmc
              - facebook,cloudripper-bmc
              - facebook,elbert-bmc
              - facebook,fuji-bmc
              - facebook,greatlakes-bmc
              - facebook,harma-bmc
              - facebook,minerva-cmc
              - facebook,yosemite4-bmc
              - ibm,blueridge-bmc
              - ibm,everest-bmc
              - ibm,fuji-bmc
              - ibm,rainier-bmc
              - ibm,system1-bmc
              - ibm,tacoma-bmc
              - inventec,starscream-bmc
              - inventec,transformer-bmc
              - jabil,rbp-bmc
              - qcom,dc-scm-v1-bmc
              - quanta,s6q-bmc
              - ufispace,ncplite-bmc
          - const: aspeed,ast2600

additionalProperties: true
```

## Documentation/devicetree/bindings/arm/atmel,at91rm9200-sdramc.yaml
```yaml
# SPDX-License-Identifier: (GPL-2.0-only OR BSD-2-Clause)
%YAML 1.2
---
$id: http://devicetree.org/schemas/arm/atmel,at91rm9200-sdramc.yaml#
$schema: http://devicetree.org/meta-schemas/core.yaml#

title: Microchip (Atmel) SDRAM / DDR Controller (RAMC / DDRAMC / UDDRC)

maintainers:
  - Nicolas Ferre <nicolas.ferre@microchip.com>
  - Claudiu Beznea <claudiu.beznea@tuxon.dev>

description:
  The SDRAM/DDR Controller (often called RAMC or DDRAMC) in various
  Atmel/Microchip ARM9 and Cortex-A5/A7 SoCs  manages external
  SDRAM / DDR memory. It is typically exposed as a syscon node for
  register access from other drivers (e.g. for initialization or mode
  configuration). No interrupts or clocks are usually required in the
  binding.

properties:
  compatible:
    oneOf:
      - items:
          - const: atmel,at91rm9200-sdramc
          - const: syscon
      - items:
          - const: microchip,sama7d65-uddrc
          - const: microchip,sama7g5-uddrc
      - enum:
          - atmel,at91sam9260-sdramc
          - atmel,at91sam9g45-ddramc
          - atmel,sama5d3-ddramc
          - microchip,sam9x60-ddramc
          - microchip,sam9x7-ddramc
          - microchip,sama7g5-uddrc

  reg:
    maxItems: 1

  clocks:
    minItems: 1
    maxItems: 2

  clock-names:
    minItems: 1
    items:
      - const: ddrck
      - const: mpddr

required:
  - compatible
  - reg

unevaluatedProperties: false

examples:
  - |
    #include <dt-bindings/clock/at91.h>
    ramc@ffffe400 {
        compatible = "atmel,at91sam9g45-ddramc";
        reg = <0xffffe400 0x200>;
        clocks = <&pmc PMC_TYPE_SYSTEM 2>;
        clock-names = "ddrck";
    };
...
```

## Documentation/devicetree/bindings/arm/atmel,at91rm9200-st.yaml
```yaml
# SPDX-License-Identifier: (GPL-2.0-only OR BSD-2-Clause)
%YAML 1.2
---
$id: http://devicetree.org/schemas/arm/atmel,at91rm9200-st.yaml#
$schema: http://devicetree.org/meta-schemas/core.yaml#

title: Atmel System Timer

maintainers:
  - Nicolas Ferre <nicolas.ferre@microchip.com>
  - Claudiu Beznea <claudiu.beznea@tuxon.dev>

description:
  The System Timer (ST) module in AT91RM9200 provides periodic tick and
  alarm capabilities. It is exposed as a simple multi-function device
  (simple-mfd + syscon) because it shares its register space and interrupt
  with other System Controller blocks.

properties:
  compatible:
    items:
      - const: atmel,at91rm9200-st
      - const: syscon
      - const: simple-mfd

  reg:
    maxItems: 1

  interrupts:
    maxItems: 1

  clocks:
    maxItems: 1

  "#address-cells":
    const: 1

  "#size-cells":
    const: 1

patternProperties:
  "^watchdog@[0-9a-f]+$":
    $ref: /schemas/watchdog/atmel,at91rm9200-wdt.yaml#

required:
  - compatible
  - reg
  - interrupts
  - clocks

unevaluatedProperties: false

examples:
  - |
    #include <dt-bindings/interrupt-controller/irq.h>
    timer@fffffd00 {
        compatible = "atmel,at91rm9200-st", "syscon", "simple-mfd";
        reg = <0xfffffd00 0x100>;
        interrupts = <1 IRQ_TYPE_LEVEL_HIGH 7>;
        clocks = <&slow_xtal>;
        #address-cells = <1>;
        #size-cells = <1>;

        watchdog@fffffd40 {
            compatible = "atmel,at91rm9200-wdt";
            reg = <0xfffffd40 0x40>;
        };
    };
...
```

## Documentation/devicetree/bindings/arm/atmel,at91sam9260-pit.yaml
```yaml
# SPDX-License-Identifier: (GPL-2.0-only OR BSD-2-Clause)
%YAML 1.2
---
$id: http://devicetree.org/schemas/arm/atmel,at91sam9260-pit.yaml#
$schema: http://devicetree.org/meta-schemas/core.yaml#

title: Atmel AT91SAM9260 Periodic Interval Timer (PIT)

maintainers:
  - Nicolas Ferre <nicolas.ferre@microchip.com>
  - Claudiu Beznea <claudiu.beznea@tuxon.dev>

description:
  The Periodic Interval Timer (PIT) is part of the System Controller of
  various Microchip 32-bit ARM-based SoCs (formerly Atmel AT91 series).
  It is a simple down-counter timer used mainly as the kernel tick source.
  The PIT is clocked from the slow clock and shares a single IRQ line with
  other System Controller peripherals.

properties:
  compatible:
    const: atmel,at91sam9260-pit

  reg:
    maxItems: 1

  interrupts:
    maxItems: 1

  clocks:
    maxItems: 1

required:
  - compatible
  - reg
  - interrupts

unevaluatedProperties: false

examples:
  - |
    #include <dt-bindings/interrupt-controller/irq.h>
    timer@fffffd30 {
        compatible = "atmel,at91sam9260-pit";
        reg = <0xfffffd30 0x10>;
        interrupts = <1 IRQ_TYPE_LEVEL_HIGH>;
        clocks = <&clk32k>;
    };
...
```

## Documentation/devicetree/bindings/arm/atmel,sama5d2-secumod.yaml
```yaml
# SPDX-License-Identifier: (GPL-2.0-only OR BSD-2-Clause)
%YAML 1.2
---
$id: http://devicetree.org/schemas/arm/atmel,sama5d2-secumod.yaml#
$schema: http://devicetree.org/meta-schemas/core.yaml#

title: Microchip AT91 Security Module (SECUMOD)

maintainers:
  - Nicolas Ferre <nicolas.ferre@microchip.com>

description:
  The Security Module also offers the PIOBU pins which can be used as GPIO pins.
  Note that they maintain their voltage during Backup/Self-refresh.

properties:
  compatible:
    oneOf:
      - items:
          - const: atmel,sama5d2-secumod
          - const: syscon
      - items:
          - enum:
              - microchip,sama7d65-secumod
              - microchip,sama7g5-secumod
          - const: atmel,sama5d2-secumod
          - const: syscon
  reg:
    maxItems: 1

  gpio-controller: true

  "#gpio-cells":
    const: 2

required:
  - compatible
  - reg

unevaluatedProperties: false

examples:
  - |
    security-module@fc040000 {
      compatible = "atmel,sama5d2-secumod", "syscon";
      reg = <0xfc040000 0x100>;
      gpio-controller;
      #gpio-cells = <2>;
    };
```
