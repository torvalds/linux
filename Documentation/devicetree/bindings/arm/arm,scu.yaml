## Documentation/devicetree/bindings/arm/arm,scu.yaml
```yaml
# SPDX-License-Identifier: (GPL-2.0-only OR BSD-2-Clause)
%YAML 1.2
---
$id: http://devicetree.org/schemas/arm/arm,scu.yaml#
$schema: http://devicetree.org/meta-schemas/core.yaml#

title: ARM Snoop Control Unit (SCU)

maintainers:
  - Linus Walleij <linus.walleij@linaro.org>

description: |
  As part of the MPCore complex, Cortex-A5 and Cortex-A9 are provided
  with a Snoop Control Unit. The register range is usually 256 (0x100)
  bytes.

  References:
    - Cortex-A9: see DDI0407E Cortex-A9 MPCore Technical Reference Manual
      Revision r2p0
    - Cortex-A5: see DDI0434B Cortex-A5 MPCore Technical Reference Manual
      Revision r0p1
    - ARM11 MPCore: see DDI0360F ARM 11 MPCore Processor Technical Reference
      Manial Revision r2p0

properties:
  compatible:
    enum:
      - arm,cortex-a9-scu
      - arm,cortex-a5-scu
      - arm,arm11mp-scu

  reg:
    maxItems: 1

required:
  - compatible
  - reg

additionalProperties: false

examples:
  - |
    scu@a0410000 {
            compatible = "arm,cortex-a9-scu";
            reg = <0xa0410000 0x100>;
    };
```

## Documentation/devicetree/bindings/arm/arm,versatile-sysreg.yaml
```yaml
# SPDX-License-Identifier: (GPL-2.0-only OR BSD-2-Clause)
%YAML 1.2
---
$id: http://devicetree.org/schemas/arm/arm,versatile-sysreg.yaml#
$schema: http://devicetree.org/meta-schemas/core.yaml#

title: Arm Versatile system registers

maintainers:
  - Linus Walleij <linus.walleij@linaro.org>

description:
  This is a system control registers block, providing multiple low level
  platform functions like board detection and identification, software
  interrupt generation, MMC and NOR Flash control, etc.

properties:
  compatible:
    items:
      - const: arm,versatile-sysreg
      - const: syscon
      - const: simple-mfd

  reg:
    maxItems: 1

  panel:
    type: object

required:
  - compatible
  - reg

additionalProperties: false
...
```

## Documentation/devicetree/bindings/arm/arm,versatile.yaml
```yaml
# SPDX-License-Identifier: (GPL-2.0-only OR BSD-2-Clause)
%YAML 1.2
---
$id: http://devicetree.org/schemas/arm/arm,versatile.yaml#
$schema: http://devicetree.org/meta-schemas/core.yaml#

title: ARM Versatile Boards

maintainers:
  - Linus Walleij <linus.walleij@linaro.org>

description: |+
  The ARM Versatile boards are two variants of ARM926EJ-S evaluation boards
  with various pluggable interface boards, in essence the Versatile PB version
  is a superset of the Versatile AB version.

  The root node in the Versatile platforms must contain a core module child
  node. They are always at physical address 0x10000000 in all the Versatile
  variants.

  When fitted with the IB2 Interface Board, the Versatile AB will present an
  optional system controller node which controls the extra peripherals on the
  interface board.

properties:
  $nodename:
    const: '/'
  compatible:
    oneOf:
      - description: The ARM Versatile Application Baseboard (HBI-0118) is an
          evaluation board specifically for the ARM926EJ-S. It can be connected
          to an IB1 interface board for a touchscreen-type use case or an IB2
          for a candybar phone-type use case. See ARM DUI 0225D.
        items:
          - const: arm,versatile-ab
      - description: The ARM Versatile Platform Baseboard (HBI-0117) is an
          extension of the Versatile Application Baseboard that includes a
          PCI host controller. Like the sibling board, it is done specifically
          for ARM926EJ-S. See ARM DUI 0224B.
        items:
          - const: arm,versatile-pb

required:
  - compatible
  - core-module@10000000

additionalProperties: true

...
```

## Documentation/devicetree/bindings/arm/arm,vexpress-juno.yaml
```yaml
# SPDX-License-Identifier: (GPL-2.0-only OR BSD-2-Clause)
%YAML 1.2
---
$id: http://devicetree.org/schemas/arm/arm,vexpress-juno.yaml#
$schema: http://devicetree.org/meta-schemas/core.yaml#

title: ARM Versatile Express and Juno Boards Device Tree Bindings

maintainers:
  - Sudeep Holla <sudeep.holla@arm.com>
  - Linus Walleij <linus.walleij@linaro.org>

description: |+
  ARM's Versatile Express platform were built as reference designs for exploring
  multicore Cortex-A class systems. The Versatile Express family contains both
  32 bit (Aarch32) and 64 bit (Aarch64) systems.

  The board consist of a motherboard and one or more daughterboards (tiles). The
  motherboard provides a set of peripherals. Processor and RAM "live" on the
  tiles.

  The motherboard and each core tile should be described by a separate Device
  Tree source file, with the tile's description including the motherboard file
  using an include directive. As the motherboard can be initialized in one of
  two different configurations ("memory maps"), care must be taken to include
  the correct one.

  When a new generation of boards were introduced under the name "Juno", these
  shared to many common characteristics with the Versatile Express that the
  "arm,vexpress" compatible was retained in the root node, and these are
  included in this binding schema as well.

  The root node indicates the CPU SoC on the core tile, and this
  is a daughterboard to the main motherboard. The name used in the compatible
  string shall match the name given in the core tile's technical reference
  manual, followed by "arm,vexpress" as an additional compatible value. If
  further subvariants are released of the core tile, even more fine-granular
  compatible strings with up to three compatible strings are used.

properties:
  $nodename:
    const: '/'
  compatible:
    oneOf:
      - description: CoreTile Express A9x4 (V2P-CA9) has 4 Cortex A9 CPU cores
          in MPCore configuration in a test chip on the core tile. See ARM
          DUI 0448I. This was the first Versatile Express platform.
        items:
          - const: arm,vexpress,v2p-ca9
          - const: arm,vexpress
      - description: CoreTile Express A5x2 (V2P-CA5s) has 2 Cortex A5 CPU cores
          in a test chip on the core tile. It is intended to evaluate NEON, FPU
          and Jazelle support in the Cortex A5 family. See ARM DUI 0541C.
        items:
          - const: arm,vexpress,v2p-ca5s
          - const: arm,vexpress
      - description: Coretile Express A15x2 (V2P-CA15) has 2 Cortex A15 CPU
          cores in a MPCore configuration in a test chip on the core tile. See
          ARM DUI 0604F.
        items:
          - const: arm,vexpress,v2p-ca15
          - const: arm,vexpress
      - description: CoreTile Express A15x4 (V2P-CA15, HBI-0237A) has 4 Cortex
          A15 CPU cores in a test chip on the core tile. This is the first test
          chip called "TC1".
        items:
          - const: arm,vexpress,v2p-ca15,tc1
          - const: arm,vexpress,v2p-ca15
          - const: arm,vexpress
      - description: Coretile Express A15x2 A7x3 (V2P-CA15_A7) has 2 Cortex A15
          CPU cores and 3 Cortex A7 cores in a big.LITTLE MPCore configuration
          in a test chip on the core tile. See ARM DDI 0503I.
        items:
          - const: arm,vexpress,v2p-ca15_a7
          - const: arm,vexpress
      - description: LogicTile Express 20MG (V2F-1XV7) has 2 Cortex A53 CPU
          cores in a test chip on the core tile. See ARM DDI 0498D.
        items:
          - const: arm,vexpress,v2f-1xv7,ca53x2
          - const: arm,vexpress,v2f-1xv7
          - const: arm,vexpress
      - description: Arm Versatile Express Juno "r0" (the first Juno board,
          V2M-Juno) was introduced as a vehicle for evaluating big.LITTLE on
          AArch64 CPU cores. It has 2 Cortex A57 CPU cores and 4 Cortex A53
          cores in a big.LITTLE configuration. It also features the MALI T624
          GPU. See ARM document 100113_0000_07_en.
        items:
          - const: arm,juno
          - const: arm,vexpress
      - description: Arm Versatile Express Juno r1 Development Platform
          (V2M-Juno r1) was introduced mainly aimed at development of PCIe
          based systems. Juno r1 also has support for AXI masters placed on
          the TLX connectors to join the coherency domain. Otherwise it is the
          same configuration as Juno r0. See ARM document 100122_0100_06_en.
        items:
          - const: arm,juno-r1
          - const: arm,juno
          - const: arm,vexpress
      - description: Arm Versatile Express Juno r2 Development Platform
          (V2M-Juno r2). It has the same feature set as Juno r0 and r1. See
          ARM document 100114_0200_04_en.
        items:
          - const: arm,juno-r2
          - const: arm,juno
          - const: arm,vexpress
      - description: Arm AEMv8a Versatile Express Real-Time System Model
          (VE RTSM) is a programmers view of the Versatile Express with Arm
          v8A hardware. See ARM DUI 0575D.
        items:
          - const: arm,rtsm_ve,aemv8a
          - const: arm,vexpress
      - description: Arm FVP (Fixed Virtual Platform) base model revision C
          See ARM Document 100964_1190_00_en.
        items:
          - const: arm,fvp-base-revc
          - const: arm,vexpress
      - description: Arm Foundation model for Aarch64
        items:
          - const: arm,foundation-aarch64
          - const: arm,vexpress

  arm,hbi:
    $ref: '/schemas/types.yaml#/definitions/uint32'
    description: This indicates the ARM HBI (Hardware Board ID), this is
      ARM's unique board model ID, visible on the PCB's silkscreen.

  arm,vexpress,site:
    description: As Versatile Express can be configured in number of physically
      different setups, the device tree should describe platform topology.
      For this reason the root node and main motherboard node must define this
      property, describing the physical location of the children nodes.
      0 means motherboard site, while 1 and 2 are daughterboard sites, and
      0xf means "sisterboard" which is the site containing the main CPU tile.
    $ref: '/schemas/types.yaml#/definitions/uint32'
    minimum: 0
    maximum: 15

  arm,vexpress,position:
    description: When daughterboards are stacked on one site, their position
      in the stack be be described this attribute.
    $ref: '/schemas/types.yaml#/definitions/uint32'
    minimum: 0
    maximum: 3

  arm,vexpress,dcc:
    description: When describing tiles consisting of more than one DCC, its
      number can be specified with this attribute.
    $ref: '/schemas/types.yaml#/definitions/uint32'
    minimum: 0
    maximum: 3

patternProperties:
  "^bus@[0-9a-f]+$":
    description: Static Memory Bus (SMB) node, if this exists it describes
      the connection between the motherboard and any tiles. Sometimes the
      compatible is placed directly under this node, sometimes it is placed
      in a subnode named "motherboard". Sometimes the compatible includes
      "arm,vexpress,v2?-p1" sometimes (on software models) is is just
      "simple-bus". If the compatible is placed in the "motherboard" node,
      it is stricter and always has two compatibles.
    type: object
    $ref: '/schemas/simple-bus.yaml'

    properties:
      compatible:
        oneOf:
          - items:
              - enum:
                  - arm,vexpress,v2m-p1
                  - arm,vexpress,v2p-p1
              - const: simple-bus
          - const: simple-bus
      motherboard:
        type: object
        description: The motherboard description provides a single "motherboard"
          node using 2 address cells corresponding to the Static Memory Bus
          used between the motherboard and the tile. The first cell defines the
          Chip Select (CS) line number, the second cell address offset within
          the CS. All interrupt lines between the motherboard and the tile
          are active high and are described using single cell.
        properties:
          "#address-cells":
            const: 2
          "#size-cells":
            const: 1
          compatible:
            items:
              - enum:
                  - arm,vexpress,v2m-p1
                  - arm,vexpress,v2p-p1
              - const: simple-bus
          arm,v2m-memory-map:
            description: This describes the memory map type.
            $ref: '/schemas/types.yaml#/definitions/string'
            enum:
              - rs1
              - rs2

        required:
          - compatible
    required:
      - compatible

allOf:
  - if:
      properties:
        compatible:
          contains:
            enum:
              - arm,vexpress,v2p-ca9
              - arm,vexpress,v2p-ca5s
              - arm,vexpress,v2p-ca15
              - arm,vexpress,v2p-ca15_a7
              - arm,vexpress,v2f-1xv7,ca53x2
    then:
      required:
        - arm,hbi

...
```

## Documentation/devicetree/bindings/arm/arm,vexpress-scc.yaml
```yaml
# SPDX-License-Identifier: (GPL-2.0-only OR BSD-2-Clause)
%YAML 1.2
---
$id: http://devicetree.org/schemas/arm/arm,vexpress-scc.yaml#
$schema: http://devicetree.org/meta-schemas/core.yaml#

title: ARM Versatile Express Serial Configuration Controller

maintainers:
  - Liviu Dudau <liviu.dudau@arm.com>
  - Sudeep Holla <sudeep.holla@arm.com>

description: |
  Test chips for ARM Versatile Express platform implement SCC (Serial
  Configuration Controller) interface, used to set initial conditions
  for the test chip.

  In some cases its registers are also mapped in normal address space
  and can be used to obtain runtime information about the chip internals
  (like silicon temperature sensors) and as interface to other subsystems
  like platform configuration control and power management.

properties:
  compatible:
    items:
      - enum:
          - arm,vexpress-scc,v2p-ca15_a7
      - const: arm,vexpress-scc

  reg:
    maxItems: 1

  interrupts:
    maxItems: 1

required:
  - compatible

additionalProperties: false

examples:
  - |
    bus {
        #address-cells = <2>;
        #size-cells = <2>;

        scc@7fff0000 {
            compatible = "arm,vexpress-scc,v2p-ca15_a7", "arm,vexpress-scc";
            reg = <0 0x7fff0000 0 0x1000>;
            interrupts = <0 95 4>;
        };
    };
...
```

## Documentation/devicetree/bindings/arm/arm-dsu-pmu.txt
```
* ARM DynamIQ Shared Unit (DSU) Performance Monitor Unit (PMU)

ARM DyanmIQ Shared Unit (DSU) integrates one or more CPU cores
with a shared L3 memory system, control logic and external interfaces to
form a multicore cluster. The PMU enables to gather various statistics on
the operations of the DSU. The PMU provides independent 32bit counters that
can count any of the supported events, along with a 64bit cycle counter.
The PMU is accessed via CPU system registers and has no MMIO component.

** DSU PMU required properties:

- compatible	: should be one of :

		"arm,dsu-pmu"

- interrupts	: Exactly 1 SPI must be listed.

- cpus		: List of phandles for the CPUs connected to this DSU instance.


** Example:

dsu-pmu-0 {
	compatible = "arm,dsu-pmu";
	interrupts = <GIC_SPI 02 IRQ_TYPE_LEVEL_HIGH>;
	cpus = <&cpu_0>, <&cpu_1>;
};
```
