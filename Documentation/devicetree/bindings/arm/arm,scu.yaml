## Documentation/devicetree/bindings/arm/atmel-adc.txt
```
* AT91's Analog to Digital Converter (ADC)

Required properties:
  - compatible: Should be "atmel,<chip>-adc"
    <chip> can be "at91sam9260", "at91sam9g45" or "at91sam9x5"
  - reg: Should contain ADC registers location and length
  - interrupts: Should contain the IRQ line for the ADC
  - atmel,adc-channels-used: Bitmask of the channels muxed and enable for this
    device
  - atmel,adc-startup-time: Startup Time of the ADC in microseconds as
    defined in the datasheet
  - atmel,adc-vref: Reference voltage in millivolts for the conversions
  - atmel,adc-res: List of resolution in bits supported by the ADC. List size
		   must be two at least.
  - atmel,adc-res-names: Contains one identifier string for each resolution
			 in atmel,adc-res property. "lowres" and "highres"
			 identifiers are required.

Optional properties:
  - atmel,adc-use-external: Boolean to enable of external triggers
  - atmel,adc-use-res: String corresponding to an identifier from
		       atmel,adc-res-names property. If not specified, the highest
		       resolution will be used.
  - atmel,adc-sleep-mode: Boolean to enable sleep mode when no conversion
  - atmel,adc-sample-hold-time: Sample and Hold Time in microseconds
 
Optional trigger Nodes:
  - Required properties:
    * trigger-name: Name of the trigger exposed to the user
    * trigger-value: Value to put in the Trigger register
      to activate this trigger
  - Optional properties:
    * trigger-external: Is the trigger an external trigger?

Examples:
adc0: adc@fffb0000 {
	compatible = "atmel,at91sam9260-adc";
	reg = <0xfffb0000 0x100>;
	interrupts = <20 4>;
	atmel,adc-channel-base = <0x30>;
	atmel,adc-channels-used = <0xff>;
	atmel,adc-drdy-mask = <0x10000>;
	atmel,adc-num-channels = <8>;
	atmel,adc-startup-time = <40>;
	atmel,adc-status-register = <0x1c>;
	atmel,adc-trigger-register = <0x08>;
	atmel,adc-use-external;
	atmel,adc-vref = <3300>;
	atmel,adc-res = <8 10>;
	atmel,adc-res-names = "lowres", "highres";
	atmel,adc-use-res = "lowres";

	trigger@0 {
		trigger-name = "external-rising";
		trigger-value = <0x1>;
		trigger-external;
	};
	trigger@1 {
		trigger-name = "external-falling";
		trigger-value = <0x2>;
		trigger-external;
	};

	trigger@2 {
		trigger-name = "external-any";
		trigger-value = <0x3>;
		trigger-external;
	};

	trigger@3 {
		trigger-name = "continuous";
		trigger-value = <0x6>;
	};
};
```

## Documentation/devicetree/bindings/arm/atmel-at91.txt
```
Atmel AT91 device tree bindings.
================================

Boards with a SoC of the Atmel AT91 or SMART family shall have the following
properties:

Required root node properties:
compatible: must be one of:
 * "atmel,at91rm9200"

 * "atmel,at91sam9" for SoCs using an ARM926EJ-S core, shall be extended with
   the specific SoC family or compatible:
    o "atmel,at91sam9260"
    o "atmel,at91sam9261"
    o "atmel,at91sam9263"
    o "atmel,at91sam9x5" for the 5 series, shall be extended with the specific
      SoC compatible:
       - "atmel,at91sam9g15"
       - "atmel,at91sam9g25"
       - "atmel,at91sam9g35"
       - "atmel,at91sam9x25"
       - "atmel,at91sam9x35"
    o "atmel,at91sam9g20"
    o "atmel,at91sam9g45"
    o "atmel,at91sam9n12"
    o "atmel,at91sam9rl"
    o "atmel,at91sam9xe"
    o "microchip,sam9x60"
 * "atmel,sama5" for SoCs using a Cortex-A5, shall be extended with the specific
   SoC family:
    o "atmel,sama5d2" shall be extended with the specific SoC compatible:
       - "atmel,sama5d27"
    o "atmel,sama5d3" shall be extended with the specific SoC compatible:
       - "atmel,sama5d31"
       - "atmel,sama5d33"
       - "atmel,sama5d34"
       - "atmel,sama5d35"
       - "atmel,sama5d36"
    o "atmel,sama5d4" shall be extended with the specific SoC compatible:
       - "atmel,sama5d41"
       - "atmel,sama5d42"
       - "atmel,sama5d43"
       - "atmel,sama5d44"

 * "atmel,samv7" for MCUs using a Cortex-M7, shall be extended with the specific
   SoC family:
    o "atmel,sams70" shall be extended with the specific MCU compatible:
       - "atmel,sams70j19"
       - "atmel,sams70j20"
       - "atmel,sams70j21"
       - "atmel,sams70n19"
       - "atmel,sams70n20"
       - "atmel,sams70n21"
       - "atmel,sams70q19"
       - "atmel,sams70q20"
       - "atmel,sams70q21"
    o "atmel,samv70" shall be extended with the specific MCU compatible:
       - "atmel,samv70j19"
       - "atmel,samv70j20"
       - "atmel,samv70n19"
       - "atmel,samv70n20"
       - "atmel,samv70q19"
       - "atmel,samv70q20"
    o "atmel,samv71" shall be extended with the specific MCU compatible:
       - "atmel,samv71j19"
       - "atmel,samv71j20"
       - "atmel,samv71j21"
       - "atmel,samv71n19"
       - "atmel,samv71n20"
       - "atmel,samv71n21"
       - "atmel,samv71q19"
       - "atmel,samv71q20"
       - "atmel,samv71q21"
```

## Documentation/devicetree/bindings/arm/atmel-at91.yaml
```yaml
# SPDX-License-Identifier: GPL-2.0
%YAML 1.2
---
$id: http://devicetree.org/schemas/arm/atmel-at91.yaml#
$schema: http://devicetree.org/meta-schemas/core.yaml#

title: Atmel AT91.

maintainers:
  - Alexandre Belloni <alexandre.belloni@bootlin.com>
  - Claudiu Beznea <claudiu.beznea@microchip.com>
  - Nicolas Ferre <nicolas.ferre@microchip.com>

description: |
  Boards with a SoC of the Atmel AT91 or SMART family shall have the following

properties:
  $nodename:
    const: '/'
  compatible:
    oneOf:
      - items:
          - const: atmel,at91rm9200
      - items:
          - enum:
              - atmel,at91sam9260
              - atmel,at91sam9261
              - atmel,at91sam9263
              - atmel,at91sam9g20
              - atmel,at91sam9g45
              - atmel,at91sam9n12
              - atmel,at91sam9rl
              - atmel,at91sam9xe
              - atmel,at91sam9x60
          - const: atmel,at91sam9

      - description: Olimex SAM9-L9260
        items:
          - const: olimex,sam9-l9260
          - const: atmel,at91sam9260
          - const: atmel,at91sam9

      - description: Calao USB A9260
        items:
          - const: calao,usb-a9260
          - const: atmel,at91sam9260
          - const: atmel,at91sam9

      - description: Calao USB A9263
        items:
          - const: calao,usb-a9263
          - const: atmel,at91sam9263
          - const: atmel,at91sam9

      - description: Calao USB A9G20
        items:
          - const: calao,usb-a9g20
          - const: atmel,at91sam9g20
          - const: atmel,at91sam9

      - description: Calao USB A9G20-LPW
        items:
          - const: calao,usb-a9g20-lpw
          - const: calao,usb-a9g20
          - const: atmel,at91sam9g20
          - const: atmel,at91sam9

      - items:
          - enum:
              - overkiz,kizboxmini-base # Overkiz kizbox Mini Base Board
              - overkiz,kizboxmini-mb   # Overkiz kizbox Mini Mother Board
              - overkiz,kizboxmini-rd   # Overkiz kizbox Mini RailDIN
              - overkiz,smartkiz        # Overkiz SmartKiz Board
              - gardena,smart-gateway-at91sam # GARDENA smart Gateway (Article No. 19000)
          - const: atmel,at91sam9g25
          - const: atmel,at91sam9x5
          - const: atmel,at91sam9

      - items:
          - enum:
              - atmel,at91sam9g15
              - atmel,at91sam9g25
              - atmel,at91sam9g35
              - atmel,at91sam9x25
              - atmel,at91sam9x35
          - const: atmel,at91sam9x5
          - const: atmel,at91sam9

      - description: Overkiz kizbox3 board
        items:
          - const: overkiz,kizbox3-hs
          - const: atmel,sama5d27
          - const: atmel,sama5d2
          - const: atmel,sama5

      - description: Microchip SAMA5D27 WLSOM1
        items:
          - const: microchip,sama5d27-wlsom1
          - const: atmel,sama5d27
          - const: atmel,sama5d2
          - const: atmel,sama5

      - description: Microchip SAMA5D27 WLSOM1 Evaluation Kit
        items:
          - const: microchip,sama5d27-wlsom1-ek
          - const: microchip,sama5d27-wlsom1
          - const: atmel,sama5d27
          - const: atmel,sama5d2
          - const: atmel,sama5

      - description: Microchip SAMA5D29 Curiosity
        items:
          - const: microchip,sama5d29-curiosity
          - const: atmel,sama5d29
          - const: atmel,sama5d2
          - const: atmel,sama5

      - items:
          - const: atmel,sama5d27
          - const: atmel,sama5d2
          - const: atmel,sama5

      - description: Microchip SAMA5D2 Industrial Connectivity Platform
        items:
          - const: microchip,sama5d2-icp
          - const: atmel,sama5d27
          - const: atmel,sama5d2
          - const: atmel,sama5

      - description: Microchip SAM9X60 Evaluation Boards
        items:
          - enum:
              - microchip,sam9x60ek
              - microchip,sam9x60-curiosity
          - const: microchip,sam9x60
          - const: atmel,at91sam9

      - description: Microchip SAM9X7 Evaluation Boards
        items:
          - const: microchip,sam9x75-curiosity
          - const: microchip,sam9x7
          - const: atmel,at91sam9

      - description: Nattis v2 board with Natte v2 power board
        items:
          - const: axentia,nattis-2
          - const: axentia,natte-2
          - const: axentia,linea
          - const: atmel,sama5d31
          - const: atmel,sama5d3
          - const: atmel,sama5

      - description: TSE-850 v3 board
        items:
          - const: axentia,tse850v3
          - const: axentia,linea
          - const: atmel,sama5d31
          - const: atmel,sama5d3
          - const: atmel,sama5

      - items:
          - const: axentia,linea
          - const: atmel,sama5d31
          - const: atmel,sama5d3
          - const: atmel,sama5

      - description: Overkiz kizbox2 board with two heads
        items:
          - const: overkiz,kizbox2-2
          - const: atmel,sama5d31
          - const: atmel,sama5d3
          - const: atmel,sama5

      - description: Microchip SAMA5D3 Ethernet Development System Board
        items:
          - const: microchip,sama5d3-eds
          - const: atmel,sama5d36
          - const: atmel,sama5d3
          - const: atmel,sama5

      - description: CalAmp LMU5000 board
        items:
          - const: calamp,lmu5000
          - const: atmel,at91sam9g20
          - const: atmel,at91sam9

      - description: Exegin Q5xR5 board
        items:
          - const: exegin,q5xr5
          - const: atmel,at91sam9g20
          - const: atmel,at91sam9

      - items:
          - enum:
              - atmel,sama5d31
              - atmel,sama5d33
              - atmel,sama5d34
              - atmel,sama5d35
              - atmel,sama5d36
          - const: atmel,sama5d3
          - const: atmel,sama5

      - items:
          - enum:
              - atmel,sama5d41
              - atmel,sama5d42
              - atmel,sama5d43
              - atmel,sama5d44
          - const: atmel,sama5d4
          - const: atmel,sama5

      - description: Microchip SAMA7D65 Curiosity Board
        items:
          - const: microchip,sama7d65-curiosity
          - const: microchip,sama7d65
          - const: microchip,sama7d6
          - const: microchip,sama7

      - items:
          - const: microchip,sama7g5ek # SAMA7G5 Evaluation Kit
          - const: microchip,sama7g5
          - const: microchip,sama7

      - description: Microchip SAMA7G54 Curiosity Board
        items:
          - const: microchip,sama7g54-curiosity
          - const: microchip,sama7g5
          - const: microchip,sama7

      - description: Microchip LAN9662 Evaluation Boards.
        items:
          - enum:
              - microchip,lan9662-pcb8291
              - microchip,lan9662-pcb8309
          - const: microchip,lan9662
          - const: microchip,lan966

      - description: Microchip LAN9668 PCB8290 Evaluation Board.
        items:
          - const: microchip,lan9668-pcb8290
          - const: microchip,lan9668
          - const: microchip,lan966

      - description: Kontron KSwitch D10 MMT series
        items:
          - enum:
              - kontron,kswitch-d10-mmt-8g
              - kontron,kswitch-d10-mmt-6g-2gs
          - const: kontron,s1921
          - const: microchip,lan9668
          - const: microchip,lan966

      - items:
          - enum:
              - atmel,sams70j19
              - atmel,sams70j20
              - atmel,sams70j21
              - atmel,sams70n19
              - atmel,sams70n20
              - atmel,sams70n21
              - atmel,sams70q19
              - atmel,sams70q20
              - atmel,sams70q21
          - const: atmel,sams70
          - const: atmel,samv7

      - items:
          - enum:
              - atmel,samv70j19
              - atmel,samv70j20
              - atmel,samv70n19
              - atmel,samv70n20
              - atmel,samv70q19
              - atmel,samv70q20
          - const: atmel,samv70
          - const: atmel,samv7

      - items:
          - enum:
              - atmel,samv71j19
              - atmel,samv71j20
              - atmel,samv71j21
              - atmel,samv71n19
              - atmel,samv71n20
              - atmel,samv71n21
              - atmel,samv71q19
              - atmel,samv71q20
              - atmel,samv71q21
          - const: atmel,samv71
          - const: atmel,samv7

additionalProperties: true

...
```

## Documentation/devicetree/bindings/arm/atmel-pmc.txt
```
* Power Management Controller (PMC)

Required properties:
- compatible: Should be "atmel,<chip>-pmc".
	<chip> can be: at91rm9200, at91sam9260, at91sam9g45, at91sam9n12,
	at91sam9x5, sama5d3

- reg: Should contain PMC registers location and length

Examples:
	pmc: pmc@fffffc00 {
		compatible = "atmel,at91rm9200-pmc";
		reg = <0xfffffc00 0x100>;
	};
```

## Documentation/devicetree/bindings/arm/atmel-sysregs.txt
```
Atmel system registers

System Timer (ST) required properties:
- compatible: Should be "atmel,at91rm9200-st", "syscon", "simple-mfd"
- reg: Should contain registers location and length
- interrupts: Should contain interrupt for the ST which is the IRQ line
  shared across all System Controller members.
- clocks: phandle to input clock.
Its subnodes can be:
- watchdog: compatible should be "atmel,at91rm9200-wdt"

RAMC SDRAM/DDR Controller required properties:
- compatible: Should be "atmel,at91rm9200-sdramc", "syscon" or
			"atmel,at91sam9260-sdramc" or
			"atmel,at91sam9g45-ddramc" or
			"atmel,sama5d3-ddramc" or
			"microchip,sam9x60-ddramc" or
			"microchip,sama7g5-uddrc" or
			"microchip,sama7d65-uddrc", "microchip,sama7g5-uddrc" or
			"microchip,sam9x7-ddramc", "atmel,sama5d3-ddramc".
- reg: Should contain registers location and length

Examples:

	ramc0: ramc@ffffe800 {
		compatible = "atmel,at91sam9g45-ddramc";
		reg = <0xffffe800 0x200>;
	};
```
