## Documentation/devicetree/bindings/arm/mediatek/mediatek,pericfg.txt
```
Mediatek pericfg controller
===========================

The Mediatek pericfg controller provides various clocks and reset
outputs to the system.

Required Properties:

- compatible: Should be one of:
	- "mediatek,mt2701-pericfg", "syscon"
	- "mediatek,mt2712-pericfg", "syscon"
	- "mediatek,mt7622-pericfg", "syscon"
	- "mediatek,mt7623-pericfg", "mediatek,mt2701-pericfg", "syscon"
	- "mediatek,mt7629-pericfg", "syscon"
	- "mediatek,mt8135-pericfg", "syscon"
	- "mediatek,mt8173-pericfg", "syscon"
	- "mediatek,mt8183-pericfg", "syscon"
- #clock-cells: Must be 1
- #reset-cells: Must be 1

The pericfg controller uses the common clk binding from
Documentation/devicetree/bindings/clock/clock-bindings.txt
The available clocks are defined in dt-bindings/clock/mt*-clk.h.
Also it uses the common reset controller binding from
Documentation/devicetree/bindings/reset/reset.txt.
The available reset outputs are defined in
dt-bindings/reset/mt*-resets.h

Example:

pericfg: power-controller@10003000 {
	compatible = "mediatek,mt8173-pericfg", "syscon";
	reg = <0 0x10003000 0 0x1000>;
	#clock-cells = <1>;
	#reset-cells = <1>;
};
```

## Documentation/devicetree/bindings/arm/mediatek/mediatek,pericfg.yaml
```yaml
# SPDX-License-Identifier: (GPL-2.0 OR BSD-2-Clause)
%YAML 1.2
---
$id: http://devicetree.org/schemas/arm/mediatek/mediatek,pericfg.yaml#
$schema: http://devicetree.org/meta-schemas/core.yaml#

title: MediaTek Peripheral Configuration Controller

maintainers:
  - Bartosz Golaszewski <bgolaszewski@baylibre.com>

description:
  The Mediatek pericfg controller provides various clocks and reset outputs
  to the system.

properties:
  compatible:
    oneOf:
      - items:
          - enum:
              - mediatek,mt2701-pericfg
              - mediatek,mt2712-pericfg
              - mediatek,mt6765-pericfg
              - mediatek,mt6795-pericfg
              - mediatek,mt7622-pericfg
              - mediatek,mt7629-pericfg
              - mediatek,mt8135-pericfg
              - mediatek,mt8173-pericfg
              - mediatek,mt8183-pericfg
              - mediatek,mt8186-pericfg
              - mediatek,mt8188-pericfg
              - mediatek,mt8195-pericfg
              - mediatek,mt8516-pericfg
          - const: syscon
      - items:
          # Special case for mt7623 for backward compatibility
          - const: mediatek,mt7623-pericfg
          - const: mediatek,mt2701-pericfg
          - const: syscon

  reg:
    maxItems: 1

  '#clock-cells':
    const: 1

  '#reset-cells':
    const: 1

required:
  - compatible
  - reg

additionalProperties: false

examples:
  - |
    pericfg@10003000 {
        compatible = "mediatek,mt8173-pericfg", "syscon";
        reg = <0x10003000 0x1000>;
        #clock-cells = <1>;
        #reset-cells = <1>;
    };

  - |
    pericfg@10003000 {
        compatible =  "mediatek,mt7623-pericfg", "mediatek,mt2701-pericfg", "syscon";
        reg = <0x10003000 0x1000>;
        #clock-cells = <1>;
        #reset-cells = <1>;
    };
```

## Documentation/devicetree/bindings/arm/mediatek/mediatek,sgmiisys.txt
```
MediaTek SGMIISYS controller
============================

The MediaTek SGMIISYS controller provides various clocks to the system.

Required Properties:

- compatible: Should be:
	- "mediatek,mt7622-sgmiisys", "syscon"
	- "mediatek,mt7629-sgmiisys", "syscon"
	- "mediatek,mt7986-sgmiisys_0", "syscon"
	- "mediatek,mt7986-sgmiisys_1", "syscon"
- #clock-cells: Must be 1

The SGMIISYS controller uses the common clk binding from
Documentation/devicetree/bindings/clock/clock-bindings.txt
The available clocks are defined in dt-bindings/clock/mt*-clk.h.

Example:

sgmiisys: sgmiisys@1b128000 {
	compatible = "mediatek,mt7622-sgmiisys", "syscon";
	reg = <0 0x1b128000 0 0x1000>;
	#clock-cells = <1>;
};
```

## Documentation/devicetree/bindings/arm/mediatek/mediatek,ssusbsys.txt
```
MediaTek SSUSBSYS controller
============================

The MediaTek SSUSBSYS controller provides various clocks to the system.

Required Properties:

- compatible: Should be:
	- "mediatek,mt7622-ssusbsys", "syscon"
- #clock-cells: Must be 1

The SSUSBSYS controller uses the common clk binding from
Documentation/devicetree/bindings/clock/clock-bindings.txt
The available clocks are defined in dt-bindings/clock/mt*-clk.h.

Example:

ssusbsys: ssusbsys@1a000000 {
	compatible = "mediatek,mt7622-ssusbsys", "syscon";
	reg = <0 0x1a000000 0 0x1000>;
	#clock-cells = <1>;
};
```

## Documentation/devicetree/bindings/arm/mediatek/mediatek,sysirq.txt
```
Mediatek 65xx/81xx sysirq

Mediatek SOCs sysirq support controllable irq inverter for each GIC SPI
interrupt.

Required properties:
- compatible: should be one of:
	"mediatek,mt8135-sysirq"
	"mediatek,mt8127-sysirq"
	"mediatek,mt6589-sysirq"
	"mediatek,mt6582-sysirq"
	"mediatek,mt6577-sysirq"
- interrupt-controller : Identifies the node as an interrupt controller
- #interrupt-cells : Use the same format as specified by GIC in
  Documentation/devicetree/bindings/arm/gic.txt
- interrupt-parent: phandle of irq parent for sysirq. The parent must
  use the same interrupt-cells format as GIC.
- reg: Physical base address of the intpol registers and length of memory
  mapped region.

Example:
	sysirq: interrupt-controller@10200100 {
		compatible = "mediatek,mt6589-sysirq", "mediatek,mt6577-sysirq";
		interrupt-controller;
		#interrupt-cells = <3>;
		interrupt-parent = <&gic>;
		reg = <0 0x10200100 0 0x1c>;
	};
```

## Documentation/devicetree/bindings/arm/mediatek/mediatek,topckgen.txt
```
Mediatek topckgen controller
============================

The Mediatek topckgen controller provides various clocks to the system.

Required Properties:

- compatible: Should be one of:
	- "mediatek,mt2701-topckgen"
	- "mediatek,mt2712-topckgen", "syscon"
	- "mediatek,mt6797-topckgen"
	- "mediatek,mt7622-topckgen"
	- "mediatek,mt7623-topckgen", "mediatek,mt2701-topckgen"
	- "mediatek,mt7629-topckgen"
	- "mediatek,mt8135-topckgen"
	- "mediatek,mt8173-topckgen"
	- "mediatek,mt8183-topckgen", "syscon"
	- "mediatek,mt8516-topckgen"
- #clock-cells: Must be 1

The topckgen controller uses the common clk binding from
Documentation/devicetree/bindings/clock/clock-bindings.txt
The available clocks are defined in dt-bindings/clock/mt*-clk.h.

Example:

topckgen: power-controller@10000000 {
	compatible = "mediatek,mt8173-topckgen";
	reg = <0 0x10000000 0 0x1000>;
	#clock-cells = <1>;
};
```

## Documentation/devicetree/bindings/arm/mediatek/mediatek,vcodecsys.txt
```
Mediatek vcodecsys controller
============================

The Mediatek vcodecsys controller provides various clocks to the system.

Required Properties:

- compatible: Should be one of:
	- "mediatek,mt6765-vcodecsys", "syscon"
- #clock-cells: Must be 1

The vcodecsys controller uses the common clk binding from
Documentation/devicetree/bindings/clock/clock-bindings.txt
The available clocks are defined in dt-bindings/clock/mt*-clk.h.

The vcodecsys controller also uses the common power domain from
Documentation/devicetree/bindings/soc/mediatek/scpsys.txt
The available power doamins are defined in dt-bindings/power/mt*-power.h.

Example:

venc_gcon: clock-controller@17000000 {
	compatible = "mediatek,mt6765-vcodecsys", "syscon";
	reg = <0 0x17000000 0 0x10000>;
	power-domains = <&scpsys MT6765_POWER_DOMAIN_VCODEC>;
	#clock-cells = <1>;
};
```

## Documentation/devicetree/bindings/arm/mediatek/mediatek,vdecsys.txt
```
Mediatek vdecsys controller
============================

The Mediatek vdecsys controller provides various clocks to the system.

Required Properties:

- compatible: Should be one of:
	- "mediatek,mt2701-vdecsys", "syscon"
	- "mediatek,mt2712-vdecsys", "syscon"
	- "mediatek,mt6797-vdecsys", "syscon"
	- "mediatek,mt8173-vdecsys", "syscon"
- #clock-cells: Must be 1

The vdecsys controller uses the common clk binding from
Documentation/devicetree/bindings/clock/clock-bindings.txt
The available clocks are defined in dt-bindings/clock/mt*-clk.h.

Example:

vdecsys: clock-controller@16000000 {
	compatible = "mediatek,mt8173-vdecsys", "syscon";
	reg = <0 0x16000000 0 0x1000>;
	#clock-cells = <1>;
};
```

## Documentation/devicetree/bindings/arm/mediatek/mediatek,vencltsys.txt
```
Mediatek vencltsys controller
============================

The Mediatek vencltsys controller provides various clocks to the system.

Required Properties:

- compatible: Should be:
	- "mediatek,mt8173-vencltsys", "syscon"
- #clock-cells: Must be 1

The vencltsys controller uses the common clk binding from
Documentation/devicetree/bindings/clock/clock-bindings.txt
The available clocks are defined in dt-bindings/clock/mt*-clk.h.

Example:

vencltsys: clock-controller@19000000 {
	compatible = "mediatek,mt8173-vencltsys", "syscon";
	reg = <0 0x19000000 0 0x1000>;
	#clock-cells = <1>;
};
```

## Documentation/devicetree/bindings/arm/mediatek/mediatek,vencsys.txt
```
Mediatek vencsys controller
============================

The Mediatek vencsys controller provides various clocks to the system.

Required Properties:

- compatible: Should be one of:
	- "mediatek,mt6797-vencsys", "syscon"
	- "mediatek,mt8173-vencsys", "syscon"
- #clock-cells: Must be 1

The vencsys controller uses the common clk binding from
Documentation/devicetree/bindings/clock/clock-bindings.txt
The available clocks are defined in dt-bindings/clock/mt*-clk.h.

Example:

vencsys: clock-controller@18000000 {
	compatible = "mediatek,mt8173-vencsys", "syscon";
	reg = <0 0x18000000 0 0x1000>;
	#clock-cells = <1>;
};
```

## Documentation/devicetree/bindings/arm/memory_group_manager.txt
```
#
# (C) COPYRIGHT 2019 ARM Limited. All rights reserved.
#
# This program is free software and is provided to you under the terms of the
# GNU General Public License version 2 as published by the Free Software
# Foundation, and any use by you of this program is subject to the terms
# of such GNU licence.
#
# This program is distributed in the hope that it will be useful,
# but WITHOUT ANY WARRANTY; without even the implied warranty of
# MERCHANTABILITY or FITNESS FOR A PARTICULAR PURPOSE. See the
# GNU General Public License for more details.
#
# You should have received a copy of the GNU General Public License
# along with this program; if not, you can access it online at
# http://www.gnu.org/licenses/gpl-2.0.html.
#
# SPDX-License-Identifier: GPL-2.0
#
#

* Arm memory group manager for Mali GPU device drivers

Required properties:

- compatible: Must be "arm,physical-memory-group-manager"

An example node:

        gpu_physical_memory_group_manager: physical-memory-group-manager {
                compatible = "arm,physical-memory-group-manager";
        };

It must be referenced by the GPU as well, see physical-memory-group-manager:

	gpu: gpu@0x6e000000 {
		compatible = "arm,mali-midgard";
		reg = <0x0 0x6e000000 0x0 0x200000>;
		interrupts = <0 168 4>, <0 168 4>, <0 168 4>;
		interrupt-names = "JOB", "MMU", "GPU";
		clocks = <&scpi_dvfs 2>;
		clock-names = "clk_mali";
		system-coherency = <31>;
		physical-memory-group-manager = <&gpu_physical_memory_group_manager>;
		operating-points = <
			/* KHz uV */
			50000 820000
		>;
	};
```

## Documentation/devicetree/bindings/arm/microchip,sam9x60-pit64b.yaml
```yaml
# SPDX-License-Identifier: (GPL-2.0-only OR BSD-2-Clause)
%YAML 1.2
---
$id: http://devicetree.org/schemas/arm/microchip,sam9x60-pit64b.yaml#
$schema: http://devicetree.org/meta-schemas/core.yaml#

title: Microchip PIT64B 64-bit Periodic Interval Timer

maintainers:
  - Nicolas Ferre <nicolas.ferre@microchip.com>
  - Claudiu Beznea <claudiu.beznea@tuxon.dev>

description:
  The Microchip PIT64B is a 64-bit periodic interval timer used in
  several modern Microchip ARM SoCs including SAM9X60, SAM9X7 and
  SAMA7D65 families. It provides extended timing range, flexible
  clock selection and supports both periodic and one-shot interrupt
  generation modes.

properties:
  compatible:
    oneOf:
      - const: microchip,sam9x60-pit64b
      - items:
          - enum:
              - microchip,sam9x7-pit64b
              - microchip,sama7d65-pit64b
              - microchip,sama7g5-pit64b
          - const: microchip,sam9x60-pit64b

  reg:
    maxItems: 1

  interrupts:
    maxItems: 1

  clocks:
    minItems: 1
    maxItems: 2

  clock-names:
    minItems: 1
    maxItems: 2
    items:
      enum:
        - pclk
        - gclk

required:
  - compatible
  - reg
  - interrupts
  - clocks

unevaluatedProperties: false

examples:
  - |
    #include <dt-bindings/interrupt-controller/irq.h>
    #include <dt-bindings/clock/at91.h>
    timer@f0028000 {
        compatible = "microchip,sama7g5-pit64b", "microchip,sam9x60-pit64b";
        reg = <0xf0028000 0x100>;
        interrupts = <37 IRQ_TYPE_LEVEL_HIGH 7>;
        clocks = <&pmc PMC_TYPE_PERIPHERAL 37>, <&pmc PMC_TYPE_GCK 37>;
        clock-names = "pclk", "gclk";
    };
...
```

## Documentation/devicetree/bindings/arm/microchip,sama7g5-chipid.yaml
```yaml
# SPDX-License-Identifier: (GPL-2.0-only OR BSD-2-Clause)
%YAML 1.2
---
$id: http://devicetree.org/schemas/arm/microchip,sama7g5-chipid.yaml#
$schema: http://devicetree.org/meta-schemas/core.yaml#

title: Atmel/Microchip RAMC SDRAM/DDR Controller

maintainers:
  - Nicolas Ferre <nicolas.ferre@microchip.com>
  - Claudiu Beznea <claudiu.beznea@tuxon.dev>

description:
  This binding describes the Atmel/Microchip Chip ID register block used
  for SoC identification and revision information. It requires compatible
  strings matching specific SoC families and a reg property defining the
  register address and size.

properties:
  compatible:
    enum:
      - atmel,sama5d2-chipid
      - microchip,sama7d65-chipid
      - microchip,sama7g5-chipid

  reg:
    maxItems: 1

required:
  - compatible
  - reg

unevaluatedProperties: false

examples:
  - |
    chipid@fc069000 {
        compatible = "atmel,sama5d2-chipid";
        reg = <0xfc069000 0x8>;
    };
...
```
