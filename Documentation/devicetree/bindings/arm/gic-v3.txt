## Documentation/devicetree/bindings/arm/hisilicon/controller/hisilicon,hi6220-mediactrl.txt
```
Hisilicon Hi6220 Media domain controller

Required properties:
- compatible : "hisilicon,hi6220-mediactrl"
- reg : Register address and size
- #clock-cells: should be set to 1, many clock registers are defined
  under this controller and this property must be present.

Hisilicon designs this system controller to control the multimedia
domain(e.g. codec, G3D ...) for mobile platform.

Example:
	/*for Hi6220*/
	media_ctrl: media_ctrl@f4410000 {
		compatible = "hisilicon,hi6220-mediactrl", "syscon";
		reg = <0x0 0xf4410000 0x0 0x1000>;
		#clock-cells = <1>;
	};
```

## Documentation/devicetree/bindings/arm/hisilicon/controller/hisilicon,hi6220-pmctrl.txt
```
Hisilicon Hi6220 Power Management domain controller

Required properties:
- compatible : "hisilicon,hi6220-pmctrl"
- reg : Register address and size
- #clock-cells: should be set to 1, some clock registers are define
  under this controller and this property must be present.

Hisilicon designs this system controller to control the power management
domain for mobile platform.

Example:
	/*for Hi6220*/
	pm_ctrl: pm_ctrl@f7032000 {
		compatible = "hisilicon,hi6220-pmctrl", "syscon";
		reg = <0x0 0xf7032000 0x0 0x1000>;
		#clock-cells = <1>;
	};
```

## Documentation/devicetree/bindings/arm/hisilicon/controller/hisilicon,hi6220-sysctrl.txt
```
Hisilicon Hi6220 system controller

Required properties:
- compatible : "hisilicon,hi6220-sysctrl"
- reg : Register address and size
- #clock-cells: should be set to 1, many clock registers are defined
  under this controller and this property must be present.

Hisilicon designs this controller as one of the system controllers,
its main functions are the same as Hisilicon system controller, but
the register offset of some core modules are different.

Example:
	/*for Hi6220*/
	sys_ctrl: sys_ctrl@f7030000 {
		compatible = "hisilicon,hi6220-sysctrl", "syscon";
		reg = <0x0 0xf7030000 0x0 0x2000>;
		#clock-cells = <1>;
	};
```

## Documentation/devicetree/bindings/arm/hisilicon/controller/hisilicon,hip01-sysctrl.txt
```
Hisilicon HiP01 system controller

Required properties:
- compatible : "hisilicon,hip01-sysctrl"
- reg : Register address and size

The HiP01 system controller is mostly compatible with hisilicon
system controller,but it has some specific control registers for
HIP01 SoC family, such as slave core boot, and also some same
registers located at different offset.

Example:

	/* for hip01-ca9x2 */
	sysctrl: system-controller@10000000 {
		compatible = "hisilicon,hip01-sysctrl", "hisilicon,sysctrl";
		reg = <0x10000000 0x1000>;
		reboot-offset = <0x4>;
	};
```

## Documentation/devicetree/bindings/arm/hisilicon/controller/hisilicon,hip04-bootwrapper.txt
```
Bootwrapper boot method (software protocol on SMP):

Required Properties:
- compatible: "hisilicon,hip04-bootwrapper";
- boot-method: Address and size of boot method.
  [0]: bootwrapper physical address
  [1]: bootwrapper size
  [2]: relocation physical address
  [3]: relocation size
```

## Documentation/devicetree/bindings/arm/hisilicon/controller/hisilicon,hip04-fabric.txt
```
Fabric:

Required Properties:
- compatible: "hisilicon,hip04-fabric";
- reg: Address and size of Fabric
```

## Documentation/devicetree/bindings/arm/hisilicon/controller/hisilicon,pctrl.txt
```
PCTRL: Peripheral misc control register

Required Properties:
- compatible: "hisilicon,pctrl"
- reg: Address and size of pctrl.

Example:

	/* for Hi3620 */
	pctrl: pctrl@fca09000 {
		compatible = "hisilicon,pctrl";
		reg = <0xfca09000 0x1000>;
	};
```

## Documentation/devicetree/bindings/arm/hisilicon/controller/pctrl.yaml
```yaml
# SPDX-License-Identifier: (GPL-2.0-only OR BSD-2-Clause)
%YAML 1.2
---
$id: http://devicetree.org/schemas/arm/hisilicon/controller/pctrl.yaml#
$schema: http://devicetree.org/meta-schemas/core.yaml#

title: Peripheral misc control register

maintainers:
  - Wei Xu <xuwei5@hisilicon.com>

description: Peripheral misc control register

properties:
  compatible:
    items:
      - const: hisilicon,pctrl

  reg:
    maxItems: 1

required:
  - compatible
  - reg

additionalProperties: false

examples:
  - |
    pctrl@fca09000 {
        compatible = "hisilicon,pctrl";
        reg = <0xfca09000 0x1000>;
    };
...
```

## Documentation/devicetree/bindings/arm/hisilicon/controller/sysctrl.yaml
```yaml
# SPDX-License-Identifier: (GPL-2.0-only OR BSD-2-Clause)
%YAML 1.2
---
$id: http://devicetree.org/schemas/arm/hisilicon/controller/sysctrl.yaml#
$schema: http://devicetree.org/meta-schemas/core.yaml#

title: Hisilicon system controller

maintainers:
  - Wei Xu <xuwei5@hisilicon.com>

description: |
  The Hisilicon system controller is used on many Hisilicon boards, it can be
  used to assist the slave core startup, reboot the system, etc.

  There are some variants of the Hisilicon system controller, such as HiP01,
  Hi3519, Hi6220 system controller, each of them is mostly compatible with the
  Hisilicon system controller, but some same registers located at different
  offset. In addition, the HiP01 system controller has some specific control
  registers for HIP01 SoC family, such as slave core boot.

  The compatible names of each system controller are as follows:
  Hisilicon system controller   --> hisilicon,sysctrl
  HiP01     system controller   --> hisilicon,hip01-sysctrl
  Hi6220    system controller   --> hisilicon,hi6220-sysctrl
  Hi3519    system controller   --> hisilicon,hi3519-sysctrl

allOf:
  - if:
      properties:
        compatible:
          contains:
            const: hisilicon,hi6220-sysctrl
    then:
      required:
        - '#clock-cells'

properties:
  compatible:
    oneOf:
      - items:
          - enum:
              - hisilicon,sysctrl
              - hisilicon,hi6220-sysctrl
              - hisilicon,hi3519-sysctrl
          - const: syscon
      - items:
          - const: hisilicon,hip01-sysctrl
          - const: hisilicon,sysctrl

  reg:
    maxItems: 1

  smp-offset:
    description: |
      offset in sysctrl for notifying slave cpu booting
      cpu 1, reg;
      cpu 2, reg + 0x4;
      cpu 3, reg + 0x8;
      If reg value is not zero, cpun exit wfi and go
    $ref: /schemas/types.yaml#/definitions/uint32

  resume-offset:
    description: offset in sysctrl for notifying cpu0 when resume
    $ref: /schemas/types.yaml#/definitions/uint32

  reboot-offset:
    description: offset in sysctrl for system reboot
    $ref: /schemas/types.yaml#/definitions/uint32

  '#clock-cells':
    const: 1

  '#reset-cells':
    const: 1

  '#address-cells':
    const: 1

  '#size-cells':
    const: 1

  ranges: true

patternProperties:
  '^clock@':
    type: object
    additionalProperties: false

    properties:
      compatible:
        enum:
          - hisilicon,hi3620-clock
          - hisilicon,hi3620-mmc-clock

      reg:
        maxItems: 1

      '#clock-cells':
        const: 1

required:
  - compatible
  - reg

additionalProperties:
  type: object

examples:
  - |
    /* Hisilicon system controller */
    system-controller@802000 {
        compatible = "hisilicon,sysctrl", "syscon";
        #address-cells = <1>;
        #size-cells = <1>;
        ranges = <0 0x802000 0x1000>;
        reg = <0x802000 0x1000>;

        smp-offset = <0x31c>;
        resume-offset = <0x308>;
        reboot-offset = <0x4>;

        clock: clock@0 {
            compatible = "hisilicon,hi3620-clock";
            reg = <0 0x10000>;
            #clock-cells = <1>;
        };
    };

    /* HiP01 system controller */
    system-controller@10000000 {
        compatible = "hisilicon,hip01-sysctrl", "hisilicon,sysctrl";
        reg = <0x10000000 0x1000>;
        reboot-offset = <0x4>;
    };

    /* Hi6220 system controller */
    system-controller@f7030000 {
        compatible = "hisilicon,hi6220-sysctrl", "syscon";
        reg = <0xf7030000 0x2000>;
        #clock-cells = <1>;
    };

    /* Hi3519 system controller */
    system-controller@12010000 {
        compatible = "hisilicon,hi3519-sysctrl", "syscon";
        reg = <0x12010000 0x1000>;
    };
...
```

## Documentation/devicetree/bindings/arm/hisilicon/hi3519-sysctrl.txt
```
* Hisilicon Hi3519 System Controller Block

This bindings use the following binding:
Documentation/devicetree/bindings/mfd/syscon.yaml

Required properties:
- compatible: "hisilicon,hi3519-sysctrl".
- reg: the register region of this block

Examples:
sysctrl: system-controller@12010000 {
	compatible = "hisilicon,hi3519-sysctrl", "syscon";
	reg = <0x12010000 0x1000>;
};
```

## Documentation/devicetree/bindings/arm/hisilicon/hisilicon-low-pin-count.txt
```
Hisilicon Hip06 Low Pin Count device
  Hisilicon Hip06 SoCs implement a Low Pin Count (LPC) controller, which
  provides I/O access to some legacy ISA devices.
  Hip06 is based on arm64 architecture where there is no I/O space. So, the
  I/O ports here are not CPU addresses, and there is no 'ranges' property in
  LPC device node.

Required properties:
- compatible:  value should be as follows:
	(a) "hisilicon,hip06-lpc"
	(b) "hisilicon,hip07-lpc"
- #address-cells: must be 2 which stick to the ISA/EISA binding doc.
- #size-cells: must be 1 which stick to the ISA/EISA binding doc.
- reg: base memory range where the LPC register set is mapped.

Note:
  The node name before '@' must be "isa" to represent the binding stick to the
  ISA/EISA binding specification.

Example:

isa@a01b0000 {
	compatible = "hisilicon,hip06-lpc";
	#address-cells = <2>;
	#size-cells = <1>;
	reg = <0x0 0xa01b0000 0x0 0x1000>;

	ipmi0: bt@e4 {
		compatible = "ipmi-bt";
		device_type = "ipmi";
		reg = <0x01 0xe4 0x04>;
	};
};
```

## Documentation/devicetree/bindings/arm/hisilicon/hisilicon.txt
```
Hisilicon Platforms Device Tree Bindings
----------------------------------------------------
Hi3660 SoC
Required root node properties:
	- compatible = "hisilicon,hi3660";

HiKey960 Board
Required root node properties:
	- compatible = "hisilicon,hi3660-hikey960", "hisilicon,hi3660";

Hi3670 SoC
Required root node properties:
	- compatible = "hisilicon,hi3670";

HiKey970 Board
Required root node properties:
	- compatible = "hisilicon,hi3670-hikey970", "hisilicon,hi3670";

Hi3798cv200 SoC
Required root node properties:
	- compatible = "hisilicon,hi3798cv200";

Hi3798cv200 Poplar Board
Required root node properties:
	- compatible = "hisilicon,hi3798cv200-poplar", "hisilicon,hi3798cv200";

Hi4511 Board
Required root node properties:
	- compatible = "hisilicon,hi3620-hi4511";

Hi6220 SoC
Required root node properties:
	- compatible = "hisilicon,hi6220";

HiKey Board
Required root node properties:
	- compatible = "hisilicon,hi6220-hikey", "hisilicon,hi6220";

HiP01 ca9x2 Board
Required root node properties:
	- compatible = "hisilicon,hip01-ca9x2";

HiP04 D01 Board
Required root node properties:
	- compatible = "hisilicon,hip04-d01";

HiP05 D02 Board
Required root node properties:
	- compatible = "hisilicon,hip05-d02";

HiP06 D03 Board
Required root node properties:
	- compatible = "hisilicon,hip06-d03";

HiP07 D05 Board
Required root node properties:
	- compatible = "hisilicon,hip07-d05";
```

## Documentation/devicetree/bindings/arm/hisilicon/hisilicon.yaml
```yaml
# SPDX-License-Identifier: (GPL-2.0-only OR BSD-2-Clause)
%YAML 1.2
---
$id: http://devicetree.org/schemas/arm/hisilicon/hisilicon.yaml#
$schema: http://devicetree.org/meta-schemas/core.yaml#

title: Hisilicon Platforms Device Tree Bindings

maintainers:
  - Wei Xu <xuwei5@hisilicon.com>

properties:
  $nodename:
    const: '/'

  compatible:
    oneOf:
      - description: Hi3660 based boards.
        items:
          - const: hisilicon,hi3660-hikey960
          - const: hisilicon,hi3660

      - description: Hi3670 based boards.
        items:
          - const: hisilicon,hi3670-hikey970
          - const: hisilicon,hi3670

      - description: Hi3798cv200 based boards.
        items:
          - const: hisilicon,hi3798cv200-poplar
          - const: hisilicon,hi3798cv200

      - description: Hi4511 Board
        items:
          - const: hisilicon,hi3620-hi4511

      - description: Hi6220 based boards.
        items:
          - const: hisilicon,hi6220-hikey
          - const: hisilicon,hi6220

      - description: HiP01 based boards.
        items:
          - const: hisilicon,hip01-ca9x2
          - const: hisilicon,hip01

      - description: HiP04 D01 Board
        items:
          - const: hisilicon,hip04-d01

      - description: HiP05 D02 Board
        items:
          - const: hisilicon,hip05-d02

      - description: HiP06 D03 Board
        items:
          - const: hisilicon,hip06-d03

      - description: HiP07 D05 Board
        items:
          - const: hisilicon,hip07-d05
...
```

## Documentation/devicetree/bindings/arm/hisilicon/low-pin-count.yaml
```yaml
# SPDX-License-Identifier: (GPL-2.0-only OR BSD-2-Clause)
%YAML 1.2
---
$id: http://devicetree.org/schemas/arm/hisilicon/low-pin-count.yaml#
$schema: http://devicetree.org/meta-schemas/core.yaml#

title: Hisilicon HiP06 Low Pin Count device

maintainers:
  - Wei Xu <xuwei5@hisilicon.com>

description: |
  Hisilicon HiP06 SoCs implement a Low Pin Count (LPC) controller, which
  provides I/O access to some legacy ISA devices.
  HiP06 is based on arm64 architecture where there is no I/O space. So, the
  I/O ports here are not CPU addresses, and there is no 'ranges' property in
  LPC device node.

properties:
  $nodename:
    pattern: '^isa@[0-9a-f]+$'
    description: |
      The node name before '@' must be "isa" to represent the binding stick
      to the ISA/EISA binding specification.

  compatible:
    enum:
      - hisilicon,hip06-lpc
      - hisilicon,hip07-lpc

  reg:
    maxItems: 1

  '#address-cells':
    const: 2

  '#size-cells':
    const: 1

required:
  - compatible
  - reg

additionalProperties:
  type: object

examples:
  - |
    isa@a01b0000 {
        compatible = "hisilicon,hip06-lpc";
        #address-cells = <2>;
        #size-cells = <1>;
        reg = <0xa01b0000 0x1000>;

        ipmi0: bt@e4 {
            compatible = "ipmi-bt";
            device_type = "ipmi";
            reg = <0x01 0xe4 0x04>;
        };
    };
...
```
