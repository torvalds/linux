## Documentation/devicetree/bindings/arm/gic-v3.txt
```
* ARM Generic Interrupt Controller, version 3

AArch64 SMP cores are often associated with a GICv3, providing Private
Peripheral Interrupts (PPI), Shared Peripheral Interrupts (SPI),
Software Generated Interrupts (SGI), and Locality-specific Peripheral
Interrupts (LPI).

Main node required properties:

- compatible : should at least contain  "arm,gic-v3".
- interrupt-controller : Identifies the node as an interrupt controller
- #interrupt-cells : Specifies the number of cells needed to encode an
  interrupt source. Must be a single cell with a value of at least 3.

  The 1st cell is the interrupt type; 0 for SPI interrupts, 1 for PPI
  interrupts. Other values are reserved for future use.

  The 2nd cell contains the interrupt number for the interrupt type.
  SPI interrupts are in the range [0-987]. PPI interrupts are in the
  range [0-15].

  The 3rd cell is the flags, encoded as follows:
	bits[3:0] trigger type and level flags.
		1 = edge triggered
		4 = level triggered

  Cells 4 and beyond are reserved for future use. When the 1st cell
  has a value of 0 or 1, cells 4 and beyond act as padding, and may be
  ignored. It is recommended that padding cells have a value of 0.

- reg : Specifies base physical address(s) and size of the GIC
  registers, in the following order:
  - GIC Distributor interface (GICD)
  - GIC Redistributors (GICR), one range per redistributor region
  - GIC CPU interface (GICC)
  - GIC Hypervisor interface (GICH)
  - GIC Virtual CPU interface (GICV)

  GICC, GICH and GICV are optional.

- interrupts : Interrupt source of the VGIC maintenance interrupt.

Optional

- redistributor-stride : If using padding pages, specifies the stride
  of consecutive redistributors. Must be a multiple of 64kB.

- #redistributor-regions: The number of independent contiguous regions
  occupied by the redistributors. Required if more than one such
  region is present.

Examples:

	gic: interrupt-controller@2cf00000 {
		compatible = "arm,gic-v3";
		#interrupt-cells = <3>;
		interrupt-controller;
		reg = <0x0 0x2f000000 0 0x10000>,	// GICD
		      <0x0 0x2f100000 0 0x200000>,	// GICR
		      <0x0 0x2c000000 0 0x2000>,	// GICC
		      <0x0 0x2c010000 0 0x2000>,	// GICH
		      <0x0 0x2c020000 0 0x2000>;	// GICV
		interrupts = <1 9 4>;
	};

	gic: interrupt-controller@2c010000 {
		compatible = "arm,gic-v3";
		#interrupt-cells = <3>;
		interrupt-controller;
		redistributor-stride = <0x0 0x40000>;	// 256kB stride
		#redistributor-regions = <2>;
		reg = <0x0 0x2c010000 0 0x10000>,	// GICD
		      <0x0 0x2d000000 0 0x800000>,	// GICR 1: CPUs 0-31
		      <0x0 0x2e000000 0 0x800000>;	// GICR 2: CPUs 32-63
		      <0x0 0x2c040000 0 0x2000>,	// GICC
		      <0x0 0x2c060000 0 0x2000>,	// GICH
		      <0x0 0x2c080000 0 0x2000>;	// GICV
		interrupts = <1 9 4>;
	};
```

## Documentation/devicetree/bindings/arm/gic.txt
```
* ARM Generic Interrupt Controller

ARM SMP cores are often associated with a GIC, providing per processor
interrupts (PPI), shared processor interrupts (SPI) and software
generated interrupts (SGI).

Primary GIC is attached directly to the CPU and typically has PPIs and SGIs.
Secondary GICs are cascaded into the upward interrupt controller and do not
have PPIs or SGIs.

Main node required properties:

- compatible : should be one of:
	"arm,gic-400"
	"arm,cortex-a15-gic"
	"arm,cortex-a9-gic"
	"arm,cortex-a7-gic"
	"arm,arm11mp-gic"
	"brcm,brahma-b15-gic"
	"arm,arm1176jzf-devchip-gic"
- interrupt-controller : Identifies the node as an interrupt controller
- #interrupt-cells : Specifies the number of cells needed to encode an
  interrupt source.  The type shall be a <u32> and the value shall be 3.

  The 1st cell is the interrupt type; 0 for SPI interrupts, 1 for PPI
  interrupts.

  The 2nd cell contains the interrupt number for the interrupt type.
  SPI interrupts are in the range [0-987].  PPI interrupts are in the
  range [0-15].

  The 3rd cell is the flags, encoded as follows:
	bits[3:0] trigger type and level flags.
		1 = low-to-high edge triggered
		2 = high-to-low edge triggered
		4 = active high level-sensitive
		8 = active low level-sensitive
	bits[15:8] PPI interrupt cpu mask.  Each bit corresponds to each of
	the 8 possible cpus attached to the GIC.  A bit set to '1' indicated
	the interrupt is wired to that CPU.  Only valid for PPI interrupts.

- reg : Specifies base physical address(s) and size of the GIC registers. The
  first region is the GIC distributor register base and size. The 2nd region is
  the GIC cpu interface register base and size.

Optional
- interrupts	: Interrupt source of the parent interrupt controller on
  secondary GICs, or VGIC maintenance interrupt on primary GIC (see
  below).

- cpu-offset	: per-cpu offset within the distributor and cpu interface
  regions, used when the GIC doesn't have banked registers. The offset is
  cpu-offset * cpu-nr.

- arm,routable-irqs : Total number of gic irq inputs which are not directly
		  connected from the peripherals, but are routed dynamically
		  by a crossbar/multiplexer preceding the GIC. The GIC irq
		  input line is assigned dynamically when the corresponding
		  peripheral's crossbar line is mapped.
Example:

	intc: interrupt-controller@fff11000 {
		compatible = "arm,cortex-a9-gic";
		#interrupt-cells = <3>;
		#address-cells = <1>;
		interrupt-controller;
		arm,routable-irqs = <160>;
		reg = <0xfff11000 0x1000>,
		      <0xfff10100 0x100>;
	};


* GIC virtualization extensions (VGIC)

For ARM cores that support the virtualization extensions, additional
properties must be described (they only exist if the GIC is the
primary interrupt controller).

Required properties:

- reg : Additional regions specifying the base physical address and
  size of the VGIC registers. The first additional region is the GIC
  virtual interface control register base and size. The 2nd additional
  region is the GIC virtual cpu interface register base and size.

- interrupts : VGIC maintenance interrupt.

Example:

	interrupt-controller@2c001000 {
		compatible = "arm,cortex-a15-gic";
		#interrupt-cells = <3>;
		interrupt-controller;
		reg = <0x2c001000 0x1000>,
		      <0x2c002000 0x1000>,
		      <0x2c004000 0x2000>,
		      <0x2c006000 0x2000>;
		interrupts = <1 9 0xf04>;
	};


* GICv2m extension for MSI/MSI-x support (Optional)

Certain revisions of GIC-400 supports MSI/MSI-x via V2M register frame(s).
This is enabled by specifying v2m sub-node(s).

Required properties:

- compatible	    : The value here should contain "arm,gic-v2m-frame".

- msi-controller    : Identifies the node as an MSI controller.

- reg		    : GICv2m MSI interface register base and size

Optional properties:

- arm,msi-base-spi  : When the MSI_TYPER register contains an incorrect
  		      value, this property should contain the SPI base of
		      the MSI frame, overriding the HW value.

- arm,msi-num-spis  : When the MSI_TYPER register contains an incorrect
  		      value, this property should contain the number of
		      SPIs assigned to the frame, overriding the HW value.

Example:

	interrupt-controller@e1101000 {
		compatible = "arm,gic-400";
		#interrupt-cells = <3>;
		#address-cells = <2>;
		#size-cells = <2>;
		interrupt-controller;
		interrupts = <1 8 0xf04>;
		ranges = <0 0 0 0xe1100000 0 0x100000>;
		reg = <0x0 0xe1110000 0 0x01000>,
		      <0x0 0xe112f000 0 0x02000>,
		      <0x0 0xe1140000 0 0x10000>,
		      <0x0 0xe1160000 0 0x10000>;
		v2m0: v2m@0x8000 {
			compatible = "arm,gic-v2m-frame";
			msi-controller;
			reg = <0x0 0x80000 0 0x1000>;
		};

		....

		v2mN: v2m@0x9000 {
			compatible = "arm,gic-v2m-frame";
			msi-controller;
			reg = <0x0 0x90000 0 0x1000>;
		};
	};
```

## Documentation/devicetree/bindings/arm/global_timer.txt
```
* ARM Global Timer
	Cortex-A9 are often associated with a per-core Global timer.

** Timer node required properties:

- compatible : Should be "arm,cortex-a9-global-timer"
		Driver supports versions r2p0 and above.

- interrupts : One interrupt to each core

- reg : Specify the base address and the size of the GT timer
	register window.

- clocks : Should be phandle to a clock.

Example:

	timer@2c000600 {
		compatible = "arm,cortex-a9-global-timer";
		reg = <0x2c000600 0x20>;
		interrupts = <1 13 0xf01>;
		clocks = <&arm_periph_clk>;
	};
```

## Documentation/devicetree/bindings/arm/hisilicon/controller/cpuctrl.yaml
```yaml
# SPDX-License-Identifier: (GPL-2.0-only OR BSD-2-Clause)
%YAML 1.2
---
$id: http://devicetree.org/schemas/arm/hisilicon/controller/cpuctrl.yaml#
$schema: http://devicetree.org/meta-schemas/core.yaml#

title: Hisilicon CPU controller

maintainers:
  - Wei Xu <xuwei5@hisilicon.com>

description: |
  The clock registers and power registers of secondary cores are defined
  in CPU controller, especially in HIX5HD2 SoC.

properties:
  compatible:
    items:
      - const: hisilicon,cpuctrl

  reg:
    maxItems: 1

  "#address-cells":
    const: 1

  "#size-cells":
    const: 1

  ranges: true

required:
  - compatible
  - reg

additionalProperties:
  type: object

examples:
  - |
    cpuctrl@a22000 {
        compatible = "hisilicon,cpuctrl";
        #address-cells = <1>;
        #size-cells = <1>;
        reg = <0x00a22000 0x2000>;
        ranges = <0 0x00a22000 0x2000>;

        clock: clock@0 {
            compatible = "hisilicon,hix5hd2-clock";
            reg = <0 0x2000>;
            #clock-cells = <1>;
        };
    };
...
```

## Documentation/devicetree/bindings/arm/hisilicon/controller/hi3798cv200-perictrl.yaml
```yaml
# SPDX-License-Identifier: (GPL-2.0-only OR BSD-2-Clause)
%YAML 1.2
---
$id: http://devicetree.org/schemas/arm/hisilicon/controller/hi3798cv200-perictrl.yaml#
$schema: http://devicetree.org/meta-schemas/core.yaml#

title: Hisilicon Hi3798CV200 Peripheral Controller

maintainers:
  - Wei Xu <xuwei5@hisilicon.com>

description: |
  The Hi3798CV200 Peripheral Controller controls peripherals, queries
  their status, and configures some functions of peripherals.

properties:
  compatible:
    items:
      - const: hisilicon,hi3798cv200-perictrl
      - const: syscon
      - const: simple-mfd

  reg:
    maxItems: 1

  "#address-cells":
    const: 1

  "#size-cells":
    const: 1

  ranges: true

required:
  - compatible
  - reg
  - "#address-cells"
  - "#size-cells"
  - ranges

additionalProperties:
  type: object

examples:
  - |
    peripheral-controller@8a20000 {
        compatible = "hisilicon,hi3798cv200-perictrl", "syscon", "simple-mfd";
        reg = <0x8a20000 0x1000>;
        #address-cells = <1>;
        #size-cells = <1>;
        ranges = <0x0 0x8a20000 0x1000>;

        phy@850 {
            compatible = "hisilicon,hi3798cv200-combphy";
            reg = <0x850 0x8>;
            #phy-cells = <1>;
            clocks = <&crg 42>;
            resets = <&crg 0x188 4>;
            assigned-clocks = <&crg 42>;
            assigned-clock-rates = <100000000>;
            hisilicon,fixed-mode = <4>;
        };
    };
...
```

## Documentation/devicetree/bindings/arm/hisilicon/controller/hi6220-domain-ctrl.yaml
```yaml
# SPDX-License-Identifier: (GPL-2.0-only OR BSD-2-Clause)
%YAML 1.2
---
$id: http://devicetree.org/schemas/arm/hisilicon/controller/hi6220-domain-ctrl.yaml#
$schema: http://devicetree.org/meta-schemas/core.yaml#

title: Hisilicon Hi6220 domain controller

maintainers:
  - Wei Xu <xuwei5@hisilicon.com>

description: |
  Hisilicon designs some special domain controllers for mobile platform,
  such as: the power Always On domain controller, the Media domain
  controller(e.g. codec, G3D ...) and the Power Management domain
  controller.

  The compatible names of each domain controller are as follows:
  Power Always ON domain controller  --> hisilicon,hi6220-aoctrl
  Media domain controller            --> hisilicon,hi6220-mediactrl
  Power Management domain controller --> hisilicon,hi6220-pmctrl

properties:
  compatible:
    items:
      - enum:
          - hisilicon,hi6220-aoctrl
          - hisilicon,hi6220-mediactrl
          - hisilicon,hi6220-pmctrl
      - const: syscon

  reg:
    maxItems: 1

  '#clock-cells':
    const: 1

  '#reset-cells':
    const: 1

required:
  - compatible
  - reg
  - '#clock-cells'

additionalProperties: false

examples:
  - |
    ao_ctrl@f7800000 {
        compatible = "hisilicon,hi6220-aoctrl", "syscon";
        reg = <0xf7800000 0x2000>;
        #clock-cells = <1>;
        #reset-cells = <1>;
    };

    media_ctrl@f4410000 {
        compatible = "hisilicon,hi6220-mediactrl", "syscon";
        reg = <0xf4410000 0x1000>;
        #clock-cells = <1>;
    };

    pm_ctrl@f7032000 {
        compatible = "hisilicon,hi6220-pmctrl", "syscon";
        reg = <0xf7032000 0x1000>;
        #clock-cells = <1>;
    };
...
```

## Documentation/devicetree/bindings/arm/hisilicon/controller/hip04-bootwrapper.yaml
```yaml
# SPDX-License-Identifier: (GPL-2.0-only OR BSD-2-Clause)
%YAML 1.2
---
$id: http://devicetree.org/schemas/arm/hisilicon/controller/hip04-bootwrapper.yaml#
$schema: http://devicetree.org/meta-schemas/core.yaml#

title: Bootwrapper boot method

maintainers:
  - Wei Xu <xuwei5@hisilicon.com>

description: Bootwrapper boot method (software protocol on SMP)

properties:
  compatible:
    items:
      - const: hisilicon,hip04-bootwrapper

  boot-method:
    description: |
      Address and size of boot method.
      [0]: bootwrapper physical address
      [1]: bootwrapper size
      [2]: relocation physical address
      [3]: relocation size
    minItems: 1
    maxItems: 2

required:
  - compatible
  - boot-method

additionalProperties: false
...
```

## Documentation/devicetree/bindings/arm/hisilicon/controller/hip04-fabric.yaml
```yaml
# SPDX-License-Identifier: (GPL-2.0-only OR BSD-2-Clause)
%YAML 1.2
---
$id: http://devicetree.org/schemas/arm/hisilicon/controller/hip04-fabric.yaml#
$schema: http://devicetree.org/meta-schemas/core.yaml#

title: Hisilicon Fabric controller

maintainers:
  - Wei Xu <xuwei5@hisilicon.com>

description: Hisilicon Fabric controller

properties:
  compatible:
    items:
      - const: hisilicon,hip04-fabric

  reg:
    maxItems: 1

required:
  - compatible
  - reg

additionalProperties: false
...
```

## Documentation/devicetree/bindings/arm/hisilicon/controller/hisilicon,cpuctrl.txt
```
Hisilicon CPU controller

Required properties:
- compatible : "hisilicon,cpuctrl"
- reg : Register address and size

The clock registers and power registers of secondary cores are defined
in CPU controller, especially in HIX5HD2 SoC.
```

## Documentation/devicetree/bindings/arm/hisilicon/controller/hisilicon,hi3798cv200-perictrl.txt
```
Hisilicon Hi3798CV200 Peripheral Controller

The Hi3798CV200 Peripheral Controller controls peripherals, queries
their status, and configures some functions of peripherals.

Required properties:
- compatible: Should contain "hisilicon,hi3798cv200-perictrl", "syscon"
  and "simple-mfd".
- reg: Register address and size of Peripheral Controller.
- #address-cells: Should be 1.
- #size-cells: Should be 1.

Examples:

	perictrl: peripheral-controller@8a20000 {
		compatible = "hisilicon,hi3798cv200-perictrl", "syscon",
			     "simple-mfd";
		reg = <0x8a20000 0x1000>;
		#address-cells = <1>;
		#size-cells = <1>;
	};
```

## Documentation/devicetree/bindings/arm/hisilicon/controller/hisilicon,hi6220-aoctrl.txt
```
Hisilicon Hi6220 Power Always ON domain controller

Required properties:
- compatible : "hisilicon,hi6220-aoctrl"
- reg : Register address and size
- #clock-cells: should be set to 1, many clock registers are defined
  under this controller and this property must be present.

Hisilicon designs this system controller to control the power always
on domain for mobile platform.

Example:
	/*for Hi6220*/
	ao_ctrl: ao_ctrl@f7800000 {
		compatible = "hisilicon,hi6220-aoctrl", "syscon";
		reg = <0x0 0xf7800000 0x0 0x2000>;
		#clock-cells = <1>;
	};
```
