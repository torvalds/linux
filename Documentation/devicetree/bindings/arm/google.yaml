## Documentation/devicetree/bindings/clock/amlogic,a9-aoclkc.yaml
```yaml
# SPDX-License-Identifier: (GPL-2.0-only OR BSD-2-Clause)
# Copyright (C) 2026 Amlogic, Inc. All rights reserved
%YAML 1.2
---
$id: http://devicetree.org/schemas/clock/amlogic,a9-aoclkc.yaml#
$schema: http://devicetree.org/meta-schemas/core.yaml#

title: Amlogic A9 Series Always-On Clock Controller

maintainers:
  - Neil Armstrong <neil.armstrong@linaro.org>
  - Jerome Brunet <jbrunet@baylibre.com>
  - Jian Hu <jian.hu@amlogic.com>
  - Xianwei Zhao <xianwei.zhao@amlogic.com>

properties:
  compatible:
    const: amlogic,a9-aoclkc

  reg:
    maxItems: 1

  '#clock-cells':
    const: 1

  clocks:
    minItems: 5
    items:
      - description: input oscillator
      - description: input fclk div 3
      - description: input fclk div 4
      - description: input fclk div 5
      - description: input sys clk
      - description: external fixed 32k (optional)

  clock-names:
    minItems: 5
    items:
      - const: xtal
      - const: fdiv3
      - const: fdiv4
      - const: fdiv5
      - const: sys
      - const: ext_32k

required:
  - compatible
  - reg
  - '#clock-cells'
  - clocks
  - clock-names

additionalProperties: false

examples:
  - |
    soc {
        #address-cells = <2>;
        #size-cells = <2>;

        clock-controller@0 {
            compatible = "amlogic,a9-aoclkc";
            reg = <0x0 0x0 0x0 0x58>;
            #clock-cells = <1>;
            clocks = <&xtal>,
                     <&scmi_clk 14>,
                     <&scmi_clk 16>,
                     <&scmi_clk 18>,
                     <&scmi_clk 21>;
            clock-names = "xtal",
                          "fdiv3",
                          "fdiv4",
                          "fdiv5",
                          "sys";
        };
    };
```

## Documentation/devicetree/bindings/clock/amlogic,a9-peripherals-clkc.yaml
```yaml
# SPDX-License-Identifier: (GPL-2.0-only OR BSD-2-Clause)
# Copyright (C) 2026 Amlogic, Inc. All rights reserved
%YAML 1.2
---
$id: http://devicetree.org/schemas/clock/amlogic,a9-peripherals-clkc.yaml#
$schema: http://devicetree.org/meta-schemas/core.yaml#

title: Amlogic A9 Series Peripherals Clock Controller

maintainers:
  - Neil Armstrong <neil.armstrong@linaro.org>
  - Jerome Brunet <jbrunet@baylibre.com>
  - Jian Hu <jian.hu@amlogic.com>
  - Xianwei Zhao <xianwei.zhao@amlogic.com>

properties:
  compatible:
    const: amlogic,a9-peripherals-clkc

  reg:
    maxItems: 1

  '#clock-cells':
    const: 1

  clocks:
    minItems: 27
    items:
      - description: input oscillator
      - description: input fclk div 2
      - description: input fclk div 3
      - description: input fclk div 4
      - description: input fclk div 5
      - description: input fclk div 7
      - description: input fclk div 2p5
      - description: input sys clk
      - description: input gp1 pll
      - description: input gp2 pll
      - description: input sys pll div 16
      - description: input cpu clk div 16
      - description: input a78 clk div 16
      - description: input dsu clk div 16
      - description: input rtc clk
      - description: input gp0 pll
      - description: input hifi0 pll
      - description: input hifi1 pll
      - description: input mclk0 pll
      - description: input mclk1 pll
      - description: input video1 pll
      - description: input video2 pll
      - description: input hdmi out2 clk
      - description: input hdmi pixel clk
      - description: input pixel0 pll
      - description: input pixel1 pll
      - description: input ddr pll test clk
      - description: external input rmii oscillator (optional)

  clock-names:
    minItems: 27
    items:
      - const: xtal
      - const: fdiv2
      - const: fdiv3
      - const: fdiv4
      - const: fdiv5
      - const: fdiv7
      - const: fdiv2p5
      - const: sys
      - const: gp1
      - const: gp2
      - const: sysplldiv16
      - const: cpudiv16
      - const: a78div16
      - const: dsudiv16
      - const: rtc
      - const: gp0
      - const: hifi0
      - const: hifi1
      - const: mclk0
      - const: mclk1
      - const: vid1
      - const: vid2
      - const: hdmiout2
      - const: hdmipix
      - const: pix0
      - const: pix1
      - const: ddr_test
      - const: ext_rmii

required:
  - compatible
  - reg
  - '#clock-cells'
  - clocks
  - clock-names

additionalProperties: false

examples:
  - |
    soc {
        #address-cells = <2>;
        #size-cells = <2>;

        clock-controller@200 {
            compatible = "amlogic,a9-peripherals-clkc";
            reg = <0x0 0x200 0x0 0x2f8>;
            #clock-cells = <1>;
            clocks = <&xtal>,
                     <&scmi_clk 10>,
                     <&scmi_clk 12>,
                     <&scmi_clk 14>,
                     <&scmi_clk 16>,
                     <&scmi_clk 18>,
                     <&scmi_clk 20>,
                     <&scmi_clk 21>,
                     <&scmi_clk 33>,
                     <&scmi_clk 34>,
                     <&scmi_clk 35>,
                     <&scmi_clk 36>,
                     <&scmi_clk 37>,
                     <&scmi_clk 38>,
                     <&scmi_clk 40>,
                     <&gp0 3>,
                     <&hifi0 3>,
                     <&hifi1 3>,
                     <&mclk0 3>,
                     <&mclk1 3>,
                     <&vid1>,
                     <&vid2>,
                     <&hdmitx 10>,
                     <&hdmitx 11>,
                     <&pix0>,
                     <&pix1>,
                     <&ddr 3>;
            clock-names = "xtal",
                          "fdiv2",
                          "fdiv3",
                          "fdiv4",
                          "fdiv5",
                          "fdiv7",
                          "fdiv2p5",
                          "sys",
                          "gp1",
                          "gp2",
                          "sysplldiv16",
                          "cpudiv16",
                          "a78div16",
                          "dsudiv16",
                          "rtc",
                          "gp0",
                          "hifi0",
                          "hifi1",
                          "mclk0",
                          "mclk1",
                          "vid1",
                          "vid2",
                          "hdmiout2",
                          "hdmipix",
                          "pix0",
                          "pix1",
                          "ddr_test";
        };
    };
```

## Documentation/devicetree/bindings/clock/anlogic,dr1v90-cru.yaml
```yaml
# SPDX-License-Identifier: GPL-2.0-only OR BSD-2-Clause
%YAML 1.2
---
$id: http://devicetree.org/schemas/clock/anlogic,dr1v90-cru.yaml#
$schema: http://devicetree.org/meta-schemas/core.yaml#

title: Anlogic DR1V90 Clock and Reset Unit (CRU)

maintainers:
  - Junhui Liu <junhui.liu@pigmoral.tech>

properties:
  compatible:
    const: anlogic,dr1v90-cru

  reg:
    maxItems: 1

  clocks:
    minItems: 1
    maxItems: 3
    description:
      The main oscillator is always required. Either or both of the external CAN
      and WDT clocks may also be provided if the board routes them to the SoC.

  clock-names:
    minItems: 1
    items:
      - const: osc
      - enum: [can_ext, wdt_ext]
      - const: wdt_ext

  "#clock-cells":
    const: 1
    description:
      Refer <dt-bindings/clock/anlogic,dr1v90-cru.h> for valid indices.

  "#reset-cells":
    const: 1
    description:
      Refer <dt-bindings/reset/anlogic,dr1v90-cru.h> for valid indices.

required:
  - compatible
  - reg
  - clocks
  - clock-names
  - "#clock-cells"
  - "#reset-cells"

additionalProperties: false

examples:
  - |
    clock-controller@f8801000 {
        compatible = "anlogic,dr1v90-cru";
        reg = <0xf8801000 0x400>;
        clocks = <&osc>, <&can_ext>, <&wdt_ext>;
        clock-names = "osc", "can_ext", "wdt_ext";
        #clock-cells = <1>;
        #reset-cells = <1>;
    };
```

## Documentation/devicetree/bindings/clock/clock-nexus-node.yaml
```yaml
# SPDX-License-Identifier: (GPL-2.0-only OR BSD-2-Clause)
%YAML 1.2
---
$id: http://devicetree.org/schemas/clock/clock-nexus-node.yaml#
$schema: http://devicetree.org/meta-schemas/core.yaml#

title: Clock Nexus

description: >
  A nexus node allows to remap a clock specifier list in a consumer node
  through a container or a connector node in a generic way. With this
  remapping, the consumer node needs to know only about the nexus
  node. Resources behind the nexus node are decoupled by the nexus node
  itself.

maintainers:
  - Miquel Raynal <miquel.raynal@bootlin.com>

select: true

properties:
  clock-map:
    $ref: /schemas/types.yaml#/definitions/uint32-matrix

dependentRequired:
  clock-map: ['#clock-cells']

additionalProperties: true

# See the original pwm-nexus-node.yaml description for examples
```

## Documentation/devicetree/bindings/clock/eswin,eic7700-hspcrg.yaml
```yaml
# SPDX-License-Identifier: (GPL-2.0-only OR BSD-2-Clause)
%YAML 1.2
---
$id: http://devicetree.org/schemas/clock/eswin,eic7700-hspcrg.yaml#
$schema: http://devicetree.org/meta-schemas/core.yaml#

title: ESWIN EIC7700 HSP Clock and Reset Generator

maintainers:
  - Xuyang Dong <dongxuyang@eswincomputing.com>

description:
  Clock and reset generator for the ESWIN EIC7700 HSP (high-speed peripherals).

properties:
  compatible:
    const: eswin,eic7700-hspcrg

  reg:
    maxItems: 1

  clocks:
    items:
      - description: HSP configuration top clock
      - description: MMC top clock
      - description: SATA top clock

  clock-names:
    items:
      - const: cfg
      - const: mmc
      - const: sata

  '#clock-cells':
    const: 1
    description:
      See <dt-bindings/clock/eswin,eic7700-hspcrg.h> for valid indices.

  '#reset-cells':
    const: 1
    description:
      See <dt-bindings/reset/eswin,eic7700-hspcrg.h> for valid indices.

required:
  - compatible
  - reg
  - clocks
  - clock-names
  - '#clock-cells'
  - '#reset-cells'

additionalProperties: false

examples:
  - |
    clock-controller@50440000 {
        compatible = "eswin,eic7700-hspcrg";
        reg = <0x50440000 0x2000>;
        clocks = <&clock 171>, <&clock 254>, <&clock 187>;
        clock-names = "cfg", "mmc", "sata";
        #clock-cells = <1>;
        #reset-cells = <1>;
    };
```

## Documentation/devicetree/bindings/clock/hisilicon,clocks.yaml
```yaml
# SPDX-License-Identifier: (GPL-2.0-only OR BSD-2-Clause)
%YAML 1.2
---
$id: http://devicetree.org/schemas/clock/hisilicon,clocks.yaml#
$schema: http://devicetree.org/meta-schemas/core.yaml#

title: Hisilicon Hi6220/Hi3660/Hi3670 Clock Controllers

maintainers:
  - Wei Xu <xuwei5@hisilicon.com>

description: >
  The Hi3670 clock controller generates and supplies clock to various
  controllers within the Hi3670 SoC.

  All these identifiers can be found in:
    dt-bindings/clock/hi3660-clock.h.
    dt-bindings/clock/hi3670-clock.h.
    dt-bindings/clock/hi6220-clock.h.

properties:
  compatible:
    items:
      - enum:
          - hisilicon,hi3660-crgctrl
          - hisilicon,hi3660-pctrl
          - hisilicon,hi3660-pmuctrl
          - hisilicon,hi3660-sctrl
          - hisilicon,hi3660-iomcu
          - hisilicon,hi3670-crgctrl
          - hisilicon,hi3670-pctrl
          - hisilicon,hi3670-pmuctrl
          - hisilicon,hi3670-sctrl
          - hisilicon,hi3670-iomcu
          - hisilicon,hi3670-media1-crg
          - hisilicon,hi3670-media2-crg
          - hisilicon,hi6220-acpu-sctrl
      - const: syscon

  reg:
    maxItems: 1

  '#clock-cells':
    const: 1

required:
  - compatible
  - reg
  - '#clock-cells'

additionalProperties: false
```

## Documentation/devicetree/bindings/clock/hisilicon,hi6220-stub-clk.yaml
```yaml
# SPDX-License-Identifier: (GPL-2.0-only OR BSD-2-Clause)
%YAML 1.2
---
$id: http://devicetree.org/schemas/clock/hisilicon,hi6220-stub-clk.yaml#
$schema: http://devicetree.org/meta-schemas/core.yaml#

title: Hisilicon Stub Clock Controller

maintainers:
  - Wei Xu <xuwei5@hisilicon.com>

description: >
  Each clock is assigned an identifier and client nodes use this identifier
  to specify the clock which they consume.

  All these identifiers can be found in:
    dt-bindings/clock/hi3660-clock.h.
    dt-bindings/clock/hi6220-clock.h.

properties:
  compatible:
    enum:
      - hisilicon,hi3660-stub-clk
      - hisilicon,hi6220-stub-clk

  reg:
    maxItems: 1

  '#clock-cells':
    const: 1

  hisilicon,hi6220-clk-sram:
    description:
      syscon managing the SoC internal SRAM; driver needs the SRAM to pass
      parameters for frequency change.
    $ref: /schemas/types.yaml#/definitions/phandle

  mboxes:
    maxItems: 1

  mbox-names:
    const: mbox-tx

required:
  - compatible
  - '#clock-cells'
  - mboxes

additionalProperties: false
```

## Documentation/devicetree/bindings/clock/mediatek,mt8173-mfgtop.yaml
```yaml
# SPDX-License-Identifier: (GPL-2.0 OR BSD-2-Clause)
%YAML 1.2
---

$id: http://devicetree.org/schemas/clock/mediatek,mt8173-mfgtop.yaml#
$schema: http://devicetree.org/meta-schemas/core.yaml#

title: MediaTek MT8173 MFG TOP controller

maintainers:
  - AngeloGioacchino Del Regno <angelogioacchino.delregno@collabora.com>

description:
  The MFG TOP glue layer controls various signals going to the MFG (GPU)
  block on the MT8173.

properties:
  compatible:
    const: mediatek,mt8173-mfgtop

  reg:
    maxItems: 1

  clocks:
    maxItems: 4

  clock-names:
    items:
      - const: sys
      - const: mem
      - const: core
      - const: clk26m

  power-domains:
    maxItems: 1

  '#clock-cells':
    const: 1

  '#power-domain-cells':
    const: 0

required:
  - compatible
  - reg
  - clocks
  - clock-names
  - power-domains
  - '#clock-cells'
  - '#power-domain-cells'

additionalProperties: false

examples:
  - |
        #include <dt-bindings/clock/mt8173-clk.h>
        #include <dt-bindings/power/mt8173-power.h>

        clock-controller@13fff000 {
            compatible = "mediatek,mt8173-mfgtop";
            reg = <0x13fff000 0x1000>;
            clocks = <&topckgen CLK_TOP_AXI_MFG_IN_SEL>,
                     <&topckgen CLK_TOP_MEM_MFG_IN_SEL>,
                     <&topckgen CLK_TOP_MFG_SEL>,
                     <&clk26m>;
            clock-names = "sys", "mem", "core", "clk26m";
            power-domains = <&spm MT8173_POWER_DOMAIN_MFG>;
            #clock-cells = <1>;
            #power-domain-cells = <0>;
        };
```
