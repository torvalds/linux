## Documentation/devicetree/bindings/clock/nxp,imx95-blk-ctl.yaml
```yaml
# SPDX-License-Identifier: (GPL-2.0-only OR BSD-2-Clause)
%YAML 1.2
---
$id: http://devicetree.org/schemas/clock/nxp,imx95-blk-ctl.yaml#
$schema: http://devicetree.org/meta-schemas/core.yaml#

title: NXP i.MX95 Block Control

maintainers:
  - Peng Fan <peng.fan@nxp.com>

properties:
  compatible:
    items:
      - enum:
          - nxp,imx94-display-csr
          - nxp,imx94-lvds-csr
          - nxp,imx95-camera-csr
          - nxp,imx95-display-csr
          - nxp,imx95-hsio-blk-ctl
          - nxp,imx95-lvds-csr
          - nxp,imx95-netcmix-blk-ctrl
          - nxp,imx95-vpu-csr
      - const: syscon

  reg:
    maxItems: 1

  power-domains:
    maxItems: 1

  clocks:
    maxItems: 1

  '#clock-cells':
    const: 1
    description:
      The clock consumer should specify the desired clock by having the clock
      ID in its "clocks" phandle cell. See
      include/dt-bindings/clock/nxp,imx95-clock.h

  '#address-cells':
    const: 1

  '#size-cells':
    const: 1

patternProperties:
  '^formatter@[0-9a-f]+$':
    type: object
    $ref: /schemas/media/fsl,imx95-csi-formatter.yaml#
    unevaluatedProperties: false

required:
  - compatible
  - reg
  - '#clock-cells'
  - power-domains
  - clocks

allOf:
  - if:
      properties:
        compatible:
          contains:
            const: nxp,imx95-camera-csr
    then:
      required:
        - '#address-cells'
        - '#size-cells'
    else:
      properties:
        '#address-cells': false
        '#size-cells': false
      patternProperties:
        '^formatter@[0-9a-f]+$': false

additionalProperties: false

examples:
  - |
    syscon@4c410000 {
      compatible = "nxp,imx95-vpu-csr", "syscon";
      reg = <0x4c410000 0x10000>;
      #clock-cells = <1>;
      clocks = <&scmi_clk 114>;
      power-domains = <&scmi_devpd 21>;
    };

  - |
    #include <dt-bindings/clock/nxp,imx95-clock.h>

    syscon@4ac10000 {
      compatible = "nxp,imx95-camera-csr", "syscon";
      reg = <0x4ac10000 0x10000>;
      #address-cells = <1>;
      #size-cells = <1>;
      #clock-cells = <1>;
      clocks = <&scmi_clk 62>;
      power-domains = <&scmi_devpd 3>;

      formatter@20 {
        compatible = "fsl,imx95-csi-formatter";
        reg = <0x20 0x100>;
        clocks = <&cameramix_csr IMX95_CLK_CAMBLK_CSI2_FOR0>;
        power-domains = <&scmi_devpd 3>;

        ports {
          #address-cells = <1>;
          #size-cells = <0>;

          port@0 {
            reg = <0>;

            endpoint {
              remote-endpoint = <&mipi_csi_0_out>;
            };

          };

          port@1 {
            reg = <1>;

            endpoint {
              remote-endpoint = <&isi_in_2>;
            };
          };
        };
      };
    };
...
```

## Documentation/devicetree/bindings/clock/qcom,gcc-msm8952.yaml
```yaml
# SPDX-License-Identifier: (GPL-2.0-only OR BSD-2-Clause)
%YAML 1.2
---
$id: http://devicetree.org/schemas/clock/qcom,gcc-msm8952.yaml#
$schema: http://devicetree.org/meta-schemas/core.yaml#

title: Qualcomm Global Clock & Reset Controller on MSM8952

maintainers:
  - Muzaffer Kadir <muzafferkadir@mainlining.org>

description: |
  Qualcomm global clock control module provides the clocks, resets and power
  domains on MSM8952.

  See also:
    include/dt-bindings/clock/qcom,gcc-msm8952.h

properties:
  compatible:
    enum:
      - qcom,gcc-msm8952

  clocks:
    items:
      - description: XO source
      - description: Always-on XO source
      - description: DSI phy instance 0 dsi clock
      - description: DSI phy instance 0 byte clock

  power-domains:
    items:
      - description: CX power domain

required:
  - compatible
  - clocks
  - power-domains
  - '#power-domain-cells'

allOf:
  - $ref: qcom,gcc.yaml#

unevaluatedProperties: false

examples:
  - |
    #include <dt-bindings/clock/qcom,dsi-phy-28nm.h>
    #include <dt-bindings/clock/qcom,gcc-msm8952.h>
    #include <dt-bindings/clock/qcom,rpmcc.h>
    #include <dt-bindings/power/qcom-rpmpd.h>

    clock-controller@1800000 {
        compatible = "qcom,gcc-msm8952";
        reg = <0x01800000 0x80000>;
        clocks = <&rpmcc RPM_SMD_XO_CLK_SRC>,
                 <&rpmcc RPM_SMD_XO_A_CLK_SRC>,
                 <&mdss_dsi0_phy DSI_PIXEL_PLL_CLK>,
                 <&mdss_dsi0_phy DSI_BYTE_PLL_CLK>;
        power-domains = <&rpmpd RPMPD_VDDCX>;
        #clock-cells = <1>;
        #reset-cells = <1>;
        #power-domain-cells = <1>;
    };
...
```

## Documentation/devicetree/bindings/clock/qcom,gcc-sm6350.yaml
```yaml
# SPDX-License-Identifier: (GPL-2.0-only OR BSD-2-Clause)
%YAML 1.2
---
$id: http://devicetree.org/schemas/clock/qcom,gcc-sm6350.yaml#
$schema: http://devicetree.org/meta-schemas/core.yaml#

title: Qualcomm Global Clock & Reset Controller on SM6350

maintainers:
  - Konrad Dybcio <konradybcio@kernel.org>

description: |
  Qualcomm global clock control module provides the clocks, resets and power
  domains on SM6350.

  See also: include/dt-bindings/clock/qcom,gcc-sm6350.h

properties:
  compatible:
    const: qcom,gcc-sm6350

  clocks:
    items:
      - description: Board XO source
      - description: Board active XO source
      - description: Sleep clock source

  clock-names:
    items:
      - const: bi_tcxo
      - const: bi_tcxo_ao
      - const: sleep_clk

  power-domains:
    items:
      - description: CX power domain

required:
  - compatible
  - clocks
  - clock-names
  - power-domains
  - '#power-domain-cells'

allOf:
  - $ref: qcom,gcc.yaml#

unevaluatedProperties: false

examples:
  - |
    #include <dt-bindings/clock/qcom,rpmh.h>
    #include <dt-bindings/power/qcom,rpmhpd.h>
    clock-controller@100000 {
      compatible = "qcom,gcc-sm6350";
      reg = <0x00100000 0x1f0000>;
      clocks = <&rpmhcc RPMH_CXO_CLK>,
               <&rpmhcc RPMH_CXO_CLK_A>,
               <&sleep_clk>;
      power-domains = <&rpmhpd RPMHPD_CX>;
      clock-names = "bi_tcxo", "bi_tcxo_ao", "sleep_clk";
      #clock-cells = <1>;
      #reset-cells = <1>;
      #power-domain-cells = <1>;
    };
...
```

## Documentation/devicetree/bindings/clock/qcom,hawi-gpucc.yaml
```yaml
# SPDX-License-Identifier: (GPL-2.0-only OR BSD-2-Clause)
%YAML 1.2
---
$id: http://devicetree.org/schemas/clock/qcom,hawi-gpucc.yaml#
$schema: http://devicetree.org/meta-schemas/core.yaml#

title: Qualcomm Graphics Clock & Reset Controller on Hawi

maintainers:
  - Dongfang Zhao <dongfang.zhao@oss.qualcomm.com>

description: |
  Qualcomm graphics clock control module provides the clocks, resets and power
  domains on Qualcomm SoCs.

  See also: include/dt-bindings/clock/qcom,hawi-gpucc.h

properties:
  compatible:
    enum:
      - qcom,hawi-gpucc
      - qcom,maili-gpucc

  clocks:
    items:
      - description: Board XO source
      - description: GPLL0 main branch source
      - description: GPLL0 div branch source

  power-domains:
    items:
      - description: A phandle to the MX power-domain
      - description: A phandle to the CX power-domain
      - description: A phandle to the GMXC power-domain

  required-opps:
    items:
      - description: MX performance points
      - description: CX performance points
      - description: GMXC performance points

required:
  - compatible
  - clocks
  - power-domains
  - required-opps
  - '#power-domain-cells'

allOf:
  - $ref: qcom,gcc.yaml#

unevaluatedProperties: false

examples:
  - |
    #include <dt-bindings/clock/qcom,hawi-gcc.h>
    #include <dt-bindings/power/qcom,rpmhpd.h>

    soc {
        #address-cells = <2>;
        #size-cells = <2>;

        clock-controller@3d90000 {
            compatible = "qcom,hawi-gpucc";
            reg = <0x0 0x03d90000 0x0 0x9800>;
            clocks = <&bi_tcxo_div2>,
                     <&gcc GCC_GPU_GPLL0_CLK_SRC>,
                     <&gcc GCC_GPU_GPLL0_DIV_CLK_SRC>;
            power-domains = <&rpmhpd RPMHPD_MX>,
                            <&rpmhpd RPMHPD_CX>,
                            <&rpmhpd RPMHPD_GMXC>;
            required-opps = <&rpmhpd_opp_low_svs>,
                            <&rpmhpd_opp_low_svs>,
                            <&rpmhpd_opp_low_svs_d3>;
            #clock-cells = <1>;
            #reset-cells = <1>;
            #power-domain-cells = <1>;
        };
    };
...
```

## Documentation/devicetree/bindings/clock/qcom,kaanapali-gxclkctl.yaml
```yaml
# SPDX-License-Identifier: (GPL-2.0-only OR BSD-2-Clause)
%YAML 1.2
---
$id: http://devicetree.org/schemas/clock/qcom,kaanapali-gxclkctl.yaml#
$schema: http://devicetree.org/meta-schemas/core.yaml#

title: Qualcomm Graphics GX Power Domain Controller

maintainers:
  - Taniya Das <taniya.das@oss.qualcomm.com>

description: |
  The Qualcomm graphics GX clock controller (GXCLKCTL) contains PLLs, clocks
  and power domains (GDSC). This module provides the power domain control of
  GXCLKCTL on Qualcomm SoCs, which helps the recovery of the graphics
  subsystem.

  See also:
    include/dt-bindings/clock/qcom,kaanapali-gxclkctl.h

properties:
  compatible:
    oneOf:
      - enum:
          - qcom,glymur-gxclkctl
          - qcom,kaanapali-gxclkctl
          - qcom,sm8750-gxclkctl
      - items:
          - enum:
              - qcom,hawi-gxclkctl
              - qcom,maili-gxclkctl
          - const: qcom,kaanapali-gxclkctl

  power-domains:
    description:
      Power domains required for the clock controller to operate
    items:
      - description: GFX power domain
      - description: GMXC power domain
      - description: GPUCC(CX) power domain

  '#power-domain-cells':
    const: 1

  reg:
    maxItems: 1

required:
  - compatible
  - reg
  - power-domains
  - '#power-domain-cells'

additionalProperties: false

examples:
  - |
    #include <dt-bindings/power/qcom,rpmhpd.h>
    soc {
        #address-cells = <2>;
        #size-cells = <2>;

        clock-controller@3d64000 {
            compatible = "qcom,kaanapali-gxclkctl";
            reg = <0x0 0x03d64000 0x0 0x6000>;
            power-domains = <&rpmhpd RPMHPD_GFX>,
                            <&rpmhpd RPMHPD_GMXC>,
                            <&gpucc 0>;
            #power-domain-cells = <1>;
        };
    };
...
```

## Documentation/devicetree/bindings/clock/qcom,kuno-gcc.yaml
```yaml
# SPDX-License-Identifier: (GPL-2.0-only OR BSD-2-Clause)
%YAML 1.2
---
$id: http://devicetree.org/schemas/clock/qcom,kuno-gcc.yaml#
$schema: http://devicetree.org/meta-schemas/core.yaml#

title: Qualcomm Global Clock & Reset Controller on Kuno

maintainers:
  - Hardeep Sharma <hardeep.sharma@oss.qualcomm.com>

description: |
  Qualcomm global clock control module provides the clocks and resets on Kuno.

  See also: include/dt-bindings/clock/qcom,kuno-gcc.h

properties:
  compatible:
    const: qcom,kuno-gcc

  clocks:
    items:
      - description: Board XO source
      - description: Board active-only XO source
      - description: Sleep clock source
      - description: PCIe pipe clock source

required:
  - compatible
  - clocks
  - '#power-domain-cells'

allOf:
  - $ref: qcom,gcc.yaml#

unevaluatedProperties: false

examples:
  - |
    #include <dt-bindings/clock/qcom,rpmh.h>
    clock-controller@80000 {
        compatible = "qcom,kuno-gcc";
        reg = <0x00080000 0x1f4200>;
        clocks = <&rpmhcc RPMH_CXO_CLK>,
                 <&rpmhcc RPMH_CXO_CLK_A>,
                 <&sleep_clk>,
                 <&pcie_pipe_clk>;
        #clock-cells = <1>;
        #reset-cells = <1>;
        #power-domain-cells = <1>;
    };
...
```

## Documentation/devicetree/bindings/clock/qcom,milos-camcc.yaml
```yaml
# SPDX-License-Identifier: (GPL-2.0-only OR BSD-2-Clause)
%YAML 1.2
---
$id: http://devicetree.org/schemas/clock/qcom,milos-camcc.yaml#
$schema: http://devicetree.org/meta-schemas/core.yaml#

title: Qualcomm Camera Clock & Reset Controller on Milos

maintainers:
  - Luca Weiss <luca.weiss@fairphone.com>
  - Taniya Das <taniya.das@oss.qualcomm.com>

description: |
  Qualcomm camera clock control module provides the clocks, resets and power
  domains on Milos.

  See also:
    include/dt-bindings/clock/qcom,eliza-cambistmclkcc.h
    include/dt-bindings/clock/qcom,eliza-camcc.h
    include/dt-bindings/clock/qcom,milos-camcc.h

properties:
  compatible:
    enum:
      - qcom,eliza-cambistmclkcc
      - qcom,eliza-camcc
      - qcom,milos-camcc

  clocks:
    items:
      - description: Board XO source
      - description: Sleep clock source
      - description: Camera AHB clock from GCC

  interconnects:
    items:
      - description: Interconnect path to enable the MultiMedia NoC

  power-domains:
    items:
      - description: CX power domain
      - description: MX power domain

  required-opps:
    items:
      - description: CX performance point
      - description: MX performance point

required:
  - compatible
  - clocks
  - power-domains
  - required-opps

allOf:
  - $ref: qcom,gcc.yaml#
  - if:
      not:
        properties:
          compatible:
            contains:
              const: qcom,eliza-cambistmclkcc
    then:
      required:
        - '#power-domain-cells'

unevaluatedProperties: false

examples:
  - |
    #include <dt-bindings/clock/qcom,milos-gcc.h>
    #include <dt-bindings/interconnect/qcom,icc.h>
    #include <dt-bindings/interconnect/qcom,milos-rpmh.h>
    #include <dt-bindings/power/qcom,rpmhpd.h>
    clock-controller@adb0000 {
        compatible = "qcom,milos-camcc";
        reg = <0x0adb0000 0x40000>;
        clocks = <&bi_tcxo_div2>,
                 <&sleep_clk>,
                 <&gcc GCC_CAMERA_AHB_CLK>;
        interconnects = <&mmss_noc MASTER_CAMNOC_HF QCOM_ICC_TAG_ALWAYS
                         &mmss_noc SLAVE_MNOC_HF_MEM_NOC QCOM_ICC_TAG_ALWAYS>;

        power-domains = <&rpmhpd RPMHPD_CX>,
                        <&rpmhpd RPMHPD_MX>;
        required-opps = <&rpmhpd_opp_low_svs>,
                        <&rpmhpd_opp_low_svs>;

        #clock-cells = <1>;
        #reset-cells = <1>;
        #power-domain-cells = <1>;
    };

...
```

## Documentation/devicetree/bindings/clock/qcom,milos-videocc.yaml
```yaml
# SPDX-License-Identifier: (GPL-2.0-only OR BSD-2-Clause)
%YAML 1.2
---
$id: http://devicetree.org/schemas/clock/qcom,milos-videocc.yaml#
$schema: http://devicetree.org/meta-schemas/core.yaml#

title: Qualcomm Video Clock & Reset Controller on Milos

maintainers:
  - Luca Weiss <luca.weiss@fairphone.com>
  - Taniya Das <taniya.das@oss.qualcomm.com>

description: |
  Qualcomm video clock control module provides the clocks, resets and power
  domains on Milos.

  See also:
    include/dt-bindings/clock/qcom,eliza-videocc.h
    include/dt-bindings/clock/qcom,milos-videocc.h

properties:
  compatible:
    enum:
      - qcom,eliza-videocc
      - qcom,milos-videocc

  clocks:
    items:
      - description: Board XO source
      - description: Board active XO source
      - description: Sleep clock source
      - description: Video AHB clock from GCC

  power-domains:
    items:
      - description: CX power domain
      - description: MX power domain

  required-opps:
    items:
      - description: CX performance point
      - description: MX performance point

required:
  - compatible
  - clocks
  - power-domains
  - required-opps
  - '#power-domain-cells'

allOf:
  - $ref: qcom,gcc.yaml#

unevaluatedProperties: false

examples:
  - |
    #include <dt-bindings/clock/qcom,milos-gcc.h>
    #include <dt-bindings/power/qcom,rpmhpd.h>
    clock-controller@aaf0000 {
        compatible = "qcom,milos-videocc";
        reg = <0x0aaf0000 0x10000>;
        clocks = <&bi_tcxo_div2>,
                 <&bi_tcxo_ao_div2>,
                 <&sleep_clk>,
                 <&gcc GCC_VIDEO_AHB_CLK>;

        power-domains = <&rpmhpd RPMHPD_CX>,
                        <&rpmhpd RPMHPD_MX>;
        required-opps = <&rpmhpd_opp_low_svs>,
                        <&rpmhpd_opp_low_svs>;

        #clock-cells = <1>;
        #reset-cells = <1>;
        #power-domain-cells = <1>;
    };

...
```
