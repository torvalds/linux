## Documentation/devicetree/bindings/arm/google.yaml
```yaml
# SPDX-License-Identifier: GPL-2.0-only OR BSD-2-Clause
%YAML 1.2
---
$id: http://devicetree.org/schemas/arm/google.yaml#
$schema: http://devicetree.org/meta-schemas/core.yaml#

title: Google Tensor platforms

maintainers:
  - Peter Griffin <peter.griffin@linaro.org>

description: |
  ARM platforms using SoCs designed by Google branded "Tensor" used in Pixel
  devices.

  Currently upstream this is devices using gs101 SoC which is found in Pixel
  6, Pixel 6 Pro and Pixel 6a and Laguna SoC canonically referred to as lga
  found in Pixel 10, Pixel 10 Pro and Pixel 10 Pro XL.

properties:
  $nodename:
    const: '/'
  compatible:
    oneOf:
      # Google Tensor G1 AKA gs101 AKA whitechapel AKA Die ID S5P9845 boards
      - description: Google Pixel 6 or 6 Pro (Oriole or Raven)
        items:
          - enum:
              - google,gs101-oriole
              - google,gs101-raven
          - const: google,gs101

      # Google Tensor G5 AKA lga (laguna) SoC and boards
      - description:
          Google Pixel 10, 10 Pro, 10 Pro XL (Frankel, Blazer,
          Mustang).
        items:
          - enum:
              - google,lga-blazer
              - google,lga-frankel
              - google,lga-mustang
          - const: google,lga

  ect:
    type: object
    additionalProperties: false

additionalProperties: true

allOf:
  # Bootloader requires empty ect node to be present
  - if:
      properties:
        compatible:
          contains:
            const: google,gs101
    then:
      required:
        - ect
    else:
      properties:
        ect: false

...
```

## Documentation/devicetree/bindings/arm/qcom-soc.yaml
```yaml
# SPDX-License-Identifier: GPL-2.0-only OR BSD-2-Clause
%YAML 1.2
---
$id: http://devicetree.org/schemas/arm/qcom-soc.yaml#
$schema: http://devicetree.org/meta-schemas/core.yaml#

title: Qualcomm SoC compatibles naming convention

maintainers:
  - Bjorn Andersson <andersson@kernel.org>

description: |
  Guidelines for new compatibles for SoC blocks/components.
  When adding new compatibles in new bindings, use the format:
    qcom,SoC-IP

  For example:
   qcom,sdm845-llcc-bwmon

  When adding new compatibles to existing bindings, use the format in the
  existing binding, even if it contradicts the above.

select:
  properties:
    # Select all nodes which have SoC-based compatibles, but not the root
    # "/" node, because its front compatibles do not follow any SoC patterns
    $nodename:
      pattern: "[^/]"
    compatible:
      contains:
        oneOf:
          - pattern: "^qcom,.*(apq|ipq|mdm|msm|qcm|qcs|q[dr]u|sa|sar|sc|sd[amx]|sm|x1[ep])[0-9]+.*$"
          - pattern: "^qcom,.*(eliza|kaanapali|glymur|hawi|mahua|maili|milos|nord|shikra).*$"
  required:
    - compatible

properties:
  compatible:
    contains:
      anyOf:
        # Preferred naming style for compatibles of SoC components:
        - pattern: "^qcom,(apq|ipq|mdm|msm|qcm|qcs|q[dr]u|sa|sc|sd[amx]|sm|x1[ep])[0-9]+(pro)?-.*$"
        - pattern: "^qcom,sar[0-9]+[a-z]?-.*$"
        - pattern: "^qcom,(sa|sc)8[0-9]+[a-z][a-z]?-.*$"
        - pattern: "^qcom,(eliza|kaanapali|glymur|hawi|mahua|maili|milos|nord|shikra)-.+$"

        # Legacy namings - variations of existing patterns/compatibles are OK,
        # but do not add completely new entries to these:
        - pattern: "^qcom,[ak]pss-wdt-(apq|ipq|mdm|msm|qcm|qcs|q[dr]u|sa|sc|sd[amx]|sm|x1[ep])[0-9]+.*$"
        - pattern: "^qcom,apss-wdt-[a-z]+$" # Codenames variant
        - pattern: "^qcom,kpss-gcc-(apq|ipq|mdm|msm)[0-9]+.*$"
        - pattern: "^qcom,gcc-(apq|ipq|mdm|msm|qcm|qcs|q[dr]u|sa|sc|sd[amx]|sm)[0-9]+.*$"
        - pattern: "^qcom,mmcc-(apq|ipq|mdm|msm|qcm|qcs|q[dr]u|sa|sc|sd[amx]|sm)[0-9]+.*$"
        - pattern: "^qcom,pcie-(apq|ipq|mdm|msm|qcm|qcs|q[dr]u|sa|sc|sd[amx]|sm|x1[ep])[0-9]+.*$"
        - pattern: "^qcom,rpm-(apq|ipq|mdm|msm|qcm|qcs|q[dr]u|sa|sc|sd[amx]|sm)[0-9]+.*$"
        - pattern: "^qcom,rpmcc-(apq|ipq|mdm|msm|qcm|qcs|q[dr]u|sa|sc|sd[amx]|sm)[0-9]+.*$"
        - pattern: "^qcom,rpm(cc)?-[a-z]+$" # Codenames variant
        - pattern: "^qcom,scm-(apq|ipq|mdm|msm|qcm|qcs|q[dr]u|sar?|sc|sd[amx]|sm|x1[ep])[0-9]+.*$"
        - pattern: "^qcom,scm-[a-z]+$" # Codenames variant
        - pattern: "^qcom,tcsr-(apq|ipq|mdm|msm)[0-9]+.*$"
        - pattern: "^qcom,usb-hs-phy-(apq|ipq|mdm|msm|qcm|qcs|q[dr]u|sa|sc|sd[amx]|sm|x1[ep])[0-9]+.*$"
        - enum:
            - qcom,dsi-ctrl-6g-qcm2290
            - qcom,gpucc-sdm630
            - qcom,gpucc-sdm660
            - qcom,lcc-apq8064
            - qcom,lcc-ipq8064
            - qcom,lcc-mdm9615
            - qcom,lcc-msm8960
            - qcom,lpass-cpu-apq8016
            - qcom,usb-hs-ipq4019-phy
            - qcom,usb-hsic-phy-mdm9615
            - qcom,usb-hsic-phy-msm8974
            - qcom,usb-ss-ipq4019-phy
            - qcom,vqmmc-ipq4019-regulator

        # Legacy compatibles with wild-cards - list cannot grow with new bindings:
        - enum:
            - qcom,ipq806x-ahci
            - qcom,ipq806x-gmac
            - qcom,ipq806x-nand
            - qcom,ipq806x-sata-phy
            - qcom,ipq806x-usb-phy-ss
            - qcom,ipq806x-usb-phy-hs

        # In general non-SoC Qualcomm devices do not need to be listed here,
        # however in a few cases they got selected by patterns in "select":
        - pattern: "^qcom,wsa[0-9]+$"

additionalProperties: true
```

## Documentation/devicetree/bindings/arm/stm32/st,stm32-syscon.yaml
```yaml
# SPDX-License-Identifier: (GPL-2.0 OR BSD-2-Clause)
%YAML 1.2
---
$id: http://devicetree.org/schemas/arm/stm32/st,stm32-syscon.yaml#
$schema: http://devicetree.org/meta-schemas/core.yaml#

title: STMicroelectronics STM32 Platforms System Controller

maintainers:
  - Alexandre Torgue <alexandre.torgue@foss.st.com>
  - Christophe Roullier <christophe.roullier@foss.st.com>

properties:
  compatible:
    oneOf:
      - items:
          - enum:
              - st,stm32-power-config
              - st,stm32-syscfg
              - st,stm32-tamp
              - st,stm32f4-gcan
              - st,stm32mp151-pwr-mcu
              - st,stm32mp157-syscfg
              - st,stm32mp21-syscfg
              - st,stm32mp23-syscfg
              - st,stm32mp25-syscfg
          - const: syscon
      - items:
          - const: st,stm32-tamp
          - const: syscon
          - const: simple-mfd

  reg:
    maxItems: 1

  clocks:
    maxItems: 1

  "#clock-cells":
    const: 0

  "#address-cells":
    const: 1

  "#size-cells":
    const: 1

patternProperties:
  "^phy@2[48]00$":
    type: object
    $ref: /schemas/phy/st,stm32-usb2phy.yaml

required:
  - compatible
  - reg

allOf:
  - if:
      properties:
        compatible:
          contains:
            enum:
              - st,stm32mp157-syscfg
              - st,stm32f4-gcan
    then:
      required:
        - clocks
    else:
      properties:
        clocks: false
  - if:
      properties:
        compatible:
          contains:
            enum:
              - st,stm32mp23-syscfg
              - st,stm32mp25-syscfg
    then:
      required:
        - "#address-cells"
        - "#clock-cells"
        - "#size-cells"
        - phy@2400
        - phy@2800
    else:
      properties:
        '#address-cells': false
        '#clock-cells': false
        '#size-cells': false
        phy@2400: false
        phy@2800: false

additionalProperties: false

examples:
  - |
    #include <dt-bindings/clock/stm32mp1-clks.h>
    syscfg: syscon@50020000 {
        compatible = "st,stm32mp157-syscfg", "syscon";
        reg = <0x50020000 0x400>;
        clocks = <&rcc SYSCFG>;
    };

...
```

## Documentation/devicetree/bindings/arm/ti/ti,omap-mpu.yaml
```yaml
# SPDX-License-Identifier: (GPL-2.0-only OR BSD-2-Clause)
%YAML 1.2
---
$id: http://devicetree.org/schemas/arm/ti/ti,omap-mpu.yaml#
$schema: http://devicetree.org/meta-schemas/core.yaml#

title: TI MPU (Main Processor Unit) subsystem

maintainers:
  - Benoit Cousson <b-cousson@ti.com>

description:
  The MPU subsystem contains one or several ARM cores depending on the version.
  The MPU contains CPUs, GIC, L2 cache and a local PRCM.

properties:
  compatible:
    enum:
      - ti,omap3-mpu
      - ti,omap4-mpu
      - ti,omap5-mpu

  ti,hwmods:
    $ref: /schemas/types.yaml#/definitions/string
    description: Name of the hwmod associated with the MPU
    const: mpu
    deprecated: true

  sram:
    description: ocmcram node

  pm-sram:
    $ref: /schemas/types.yaml#/definitions/phandle-array
    description: ocmcram nodes for power management. For am335x and am437x.
    items:
      - items:
          - description: ocmcram node of type protect-exec for PM functions
      - items:
          - description: ocmcram node of regular pool to be used for data region

required:
  - compatible

additionalProperties: false

examples:
  - |
    mpu {
        compatible = "ti,omap5-mpu";
        ti,hwmods = "mpu";
    };

  - |
    mpu {
        compatible = "ti,omap3-mpu";
        ti,hwmods = "mpu";
        pm-sram = <&pm_sram_code &pm_sram_data>;
    };
```

## Documentation/devicetree/bindings/bus/hisilicon,hisi-localbus.yaml
```yaml
# SPDX-License-Identifier: GPL-2.0-only OR BSD-2-Clause
%YAML 1.2
---
$id: http://devicetree.org/schemas/bus/hisilicon,hisi-localbus.yaml#
$schema: http://devicetree.org/meta-schemas/core.yaml#

title: HiSilicon local bus

maintainers:
  - Wei Xu <xuwei5@hisilicon.com>

allOf:
  - $ref: /schemas/simple-bus.yaml#

properties:
  compatible:
    items:
      - const: hisilicon,hisi-localbus
      - const: simple-bus

  reg:
    maxItems: 1

required:
  - compatible
  - reg

unevaluatedProperties: false

examples:
  - |
    soc {
        #address-cells = <2>;
        #size-cells = <2>;

        local-bus@80380000 {
            compatible = "hisilicon,hisi-localbus", "simple-bus";
            reg = <0x0 0x80380000 0x0 0x10000>;
            #address-cells = <2>;
            #size-cells = <1>;
            ranges = <0 0 0x0 0x90000000 0x08000000>,
                     <1 0 0x0 0x98000000 0x08000000>;
        };
    };
```

## Documentation/devicetree/bindings/bus/ti,omap-l4.yaml
```yaml
# SPDX-License-Identifier: (GPL-2.0-only OR BSD-2-Clause)
%YAML 1.2
---
$id: http://devicetree.org/schemas/bus/ti,omap-l4.yaml#
$schema: http://devicetree.org/meta-schemas/core.yaml#

title: TI OMAP SoCs L4 interconnect bus

maintainers:
  - Eduard Bostina <egbostina@gmail.com>

description:
  These bindings describe the OMAP SoCs L4 interconnect bus.

select:
  properties:
    compatible:
      contains:
        enum:
          - ti,omap2-l4
          - ti,omap2-l4-wkup
          - ti,omap3-l4-core
          - ti,omap4-l4-abe
          - ti,omap4-l4-cfg
          - ti,omap4-l4-per
          - ti,omap4-l4-wkup
          - ti,omap5-l4-abe
          - ti,omap5-l4-cfg
          - ti,omap5-l4-per
          - ti,omap5-l4-wkup
          - ti,dra7-l4-cfg
          - ti,dra7-l4-per1
          - ti,dra7-l4-per2
          - ti,dra7-l4-per3
          - ti,dra7-l4-wkup
          - ti,am33xx-l4-fast
          - ti,am33xx-l4-fw
          - ti,am33xx-l4-mpuss
          - ti,am33xx-l4-per
          - ti,am33xx-l4-wkup
          - ti,am4-l4-fast
          - ti,am4-l4-per
          - ti,am4-l4-wkup
          - ti,dm814-l4hs
          - ti,dm814-l4ls
  required:
    - compatible

properties:
  compatible:
    items:
      - enum:
          - ti,omap2-l4
          - ti,omap2-l4-wkup
          - ti,omap3-l4-core
          - ti,omap4-l4-abe
          - ti,omap4-l4-cfg
          - ti,omap4-l4-per
          - ti,omap4-l4-wkup
          - ti,omap5-l4-abe
          - ti,omap5-l4-cfg
          - ti,omap5-l4-per
          - ti,omap5-l4-wkup
          - ti,dra7-l4-cfg
          - ti,dra7-l4-per1
          - ti,dra7-l4-per2
          - ti,dra7-l4-per3
          - ti,dra7-l4-wkup
          - ti,am33xx-l4-fast
          - ti,am33xx-l4-fw
          - ti,am33xx-l4-mpuss
          - ti,am33xx-l4-per
          - ti,am33xx-l4-wkup
          - ti,am4-l4-fast
          - ti,am4-l4-per
          - ti,am4-l4-wkup
          - ti,dm814-l4hs
          - ti,dm814-l4ls
      - enum:
          - simple-bus
          - simple-pm-bus

  reg:
    minItems: 1
    maxItems: 6

  reg-names:
    minItems: 1
    maxItems: 6
    items:
      enum:
        - ap
        - la
        - ia0
        - ia1
        - ia2
        - ia3

  ranges: true

  dma-ranges: true

  clocks:
    maxItems: 1

  clock-names:
    items:
      - const: fck

  power-domains:
    maxItems: 1

  "#address-cells":
    const: 1

  "#size-cells":
    const: 1

required:
  - compatible
  - ranges

additionalProperties:
  type: object

examples:
  - |
    bus@48000000 {
        compatible = "ti,omap4-l4-per", "simple-bus";
        reg = <0x48000000 0x800>,
              <0x48000800 0x800>,
              <0x48001000 0x400>,
              <0x48001400 0x400>,
              <0x48001800 0x400>,
              <0x48001c00 0x400>;
        reg-names = "ap", "la", "ia0", "ia1", "ia2", "ia3";
        #address-cells = <1>;
        #size-cells = <1>;
        ranges = <0 0x48000000 0x100000>;
    };
```

## Documentation/devicetree/bindings/bus/ti,omap-ocp2scp.yaml
```yaml
# SPDX-License-Identifier: (GPL-2.0-only OR BSD-2-Clause)
%YAML 1.2
---
$id: http://devicetree.org/schemas/bus/ti,omap-ocp2scp.yaml#
$schema: http://devicetree.org/meta-schemas/core.yaml#

title: TI OMAP OCP to SCP bus bridge

maintainers:
  - Kishon Vijay Abraham I <kishon@ti.com>

properties:
  compatible:
    oneOf:
      - items:
          - const: ti,am437x-ocp2scp
          - const: ti,omap-ocp2scp
      - const: ti,omap-ocp2scp

  reg:
    maxItems: 1

  "#address-cells":
    const: 1

  "#size-cells":
    const: 1

  ranges: true

  ti,hwmods:
    $ref: /schemas/types.yaml#/definitions/string
    description: Name of the hwmod associated with the device.
    deprecated: true

required:
  - compatible
  - "#address-cells"
  - "#size-cells"

allOf:
  - if:
      properties:
        compatible:
          contains:
            const: ti,am437x-ocp2scp
    then:
      properties:
        reg: false
    else:
      required:
        - reg

additionalProperties:
  type: object

examples:
  - |
    ocp2scp@4a0ad000 {
        compatible = "ti,omap-ocp2scp";
        reg = <0x4a0ad000 0x1f>;
        #address-cells = <1>;
        #size-cells = <1>;
        ranges;

        phy@80 {
            compatible = "ti,omap-usb2";
            reg = <0x80 0x58>;
            ctrl-module = <&omap_control_usb2phy>;
            clocks = <&usb_phy_cm_clk32k>;
            clock-names = "wkupclk";
            #phy-cells = <0>;
        };
    };
```
