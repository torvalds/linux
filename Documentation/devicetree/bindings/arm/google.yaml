## Documentation/devicetree/bindings/clock/qcom,shikra-audiocorecc.yaml
```yaml
# SPDX-License-Identifier: (GPL-2.0-only OR BSD-2-Clause)
%YAML 1.2
---
$id: http://devicetree.org/schemas/clock/qcom,shikra-audiocorecc.yaml#
$schema: http://devicetree.org/meta-schemas/core.yaml#

title: Audio Core Clock Controller for Qualcomm Shikra SoC

maintainers:
  - Imran Shaik <imran.shaik@oss.qualcomm.com>

description: |
  Audio core clock control module provides the clocks on Qualcomm Shikra
  SoC platform.

  See also:
  - include/dt-bindings/clock/qcom,shikra-audiocorecc.h

properties:
  compatible:
    const: qcom,shikra-audiocorecc

  clocks:
    items:
      - description: Board XO source
      - description: Board sleep clock
      - description: Audio ref clock source

  reg:
    maxItems: 1

  '#clock-cells':
    const: 1

required:
  - compatible
  - reg
  - clocks
  - '#clock-cells'

additionalProperties: false

examples:
  - |
    #include <dt-bindings/clock/qcom,rpmcc.h>
    #include <dt-bindings/clock/qcom,shikra-gcc.h>
    clock-controller@a0a0000 {
      compatible = "qcom,shikra-audiocorecc";
      reg = <0x0a0a0000 0x10000>;
      clocks = <&rpmcc RPM_SMD_XO_CLK_SRC>,
               <&sleep_clk>,
               <&aud_ref_clk_src>;
      #clock-cells = <1>;
    };
...
```

## Documentation/devicetree/bindings/clock/qcom,sm6375-gcc.yaml
```yaml
# SPDX-License-Identifier: (GPL-2.0-only OR BSD-2-Clause)
%YAML 1.2
---
$id: http://devicetree.org/schemas/clock/qcom,sm6375-gcc.yaml#
$schema: http://devicetree.org/meta-schemas/core.yaml#

title: Qualcomm Global Clock & Reset Controller on SM6375 and SM7150

maintainers:
  - Konrad Dybcio <konradybcio@kernel.org>
  - Bjorn Andersson <andersson@kernel.org>
  - Danila Tikhonov <danila@jiaxyga.com>
  - David Wronek <davidwronek@gmail.com>

description: |
  Qualcomm global clock control module provides the clocks, resets and power
  domains on SM6375

  See also: include/dt-bindings/clock/qcom,sm6375-gcc.h

allOf:
  - $ref: qcom,gcc.yaml#

properties:
  compatible:
    enum:
      - qcom,sm6375-gcc
      - qcom,sm7150-gcc

  clocks:
    items:
      - description: Board XO source
      - description: Board XO Active-Only source
      - description: Sleep clock source

required:
  - compatible
  - clocks
  - '#power-domain-cells'

unevaluatedProperties: false

examples:
  - |
    #include <dt-bindings/clock/qcom,rpmcc.h>
    clock-controller@1400000 {
      compatible = "qcom,sm6375-gcc";
      reg = <0x01400000 0x1f0000>;
      clocks = <&rpmcc RPM_SMD_XO_CLK_SRC>,
               <&rpmcc RPM_SMD_XO_A_CLK_SRC>,
               <&sleep_clk>;
      #clock-cells = <1>;
      #reset-cells = <1>;
      #power-domain-cells = <1>;
    };

...
```
