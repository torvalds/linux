## Documentation/devicetree/bindings/arm/arm,integrator.yaml
```yaml
# SPDX-License-Identifier: (GPL-2.0-only OR BSD-2-Clause)
%YAML 1.2
---
$id: http://devicetree.org/schemas/arm/arm,integrator.yaml#
$schema: http://devicetree.org/meta-schemas/core.yaml#

title: ARM Integrator Boards

maintainers:
  - Linus Walleij <linus.walleij@linaro.org>

description: |+
  These were the first ARM platforms officially supported by ARM Ltd.
  They are ARMv4, ARMv5 and ARMv6-capable using different core tiles,
  so the system is modular and can host a variety of CPU tiles called
  "core tiles" and referred to in the device tree as "core modules".

properties:
  $nodename:
    const: '/'
  compatible:
    oneOf:
      - description: ARM Integrator Application Platform, this board has a PCI
          host and several PCI slots, as well as a number of slots for logical
          expansion modules, it is referred to as an "ASIC Development
          Motherboard" and is extended with custom FPGA and is intended for
          rapid prototyping. See ARM DUI 0098B. This board can physically come
          pre-packaged in a PC Tower form factor called Integrator/PP1 or a
          special metal fixture called Integrator/PP2, see ARM DUI 0169A.
        items:
          - const: arm,integrator-ap
      - description: ARM Integrator Compact Platform (HBI-0086), this board has
          a compact form factor and mainly consists of the bare minimum
          peripherals to make use of the core module. See ARM DUI 0159B.
        items:
          - const: arm,integrator-cp
      - description: ARM Integrator Standard Development Board (SDB) Platform,
          this board is a PCI-based board conforming to the Microsoft SDB
          (HARP) specification. See ARM DUI 0099A.
        items:
          - const: arm,integrator-sp

  core-module@10000000:
    type: object
    description: the root node in the Integrator platforms must contain
      a core module child node. They are always at physical address
      0x10000000 in all the Integrator variants.
    properties:
      compatible:
        items:
          - const: arm,core-module-integrator
          - const: syscon
          - const: simple-mfd
      reg:
        maxItems: 1

    required:
      - compatible
      - reg

patternProperties:
  "^syscon@[0-9a-f]+$":
    description: All Integrator boards must provide a system controller as a
      node in the root of the device tree.
    type: object
    properties:
      compatible:
        items:
          - enum:
              - arm,integrator-ap-syscon
              - arm,integrator-cp-syscon
              - arm,integrator-sp-syscon
          - const: syscon
      reg:
        maxItems: 1

    required:
      - compatible
      - reg


required:
  - compatible
  - core-module@10000000

additionalProperties: true

...
```

## Documentation/devicetree/bindings/arm/arm,juno-fpga-apb-regs.yaml
```yaml
# SPDX-License-Identifier: GPL-2.0-only OR BSD-2-Clause
%YAML 1.2
---
$id: http://devicetree.org/schemas/arm/arm,juno-fpga-apb-regs.yaml#
$schema: http://devicetree.org/meta-schemas/core.yaml#

title: ARM Juno FPGA APB Registers

maintainers:
  - Sudeep Holla <sudeep.holla@arm.com>

properties:
  compatible:
    items:
      - const: arm,juno-fpga-apb-regs
      - const: syscon
      - const: simple-mfd

  reg:
    maxItems: 1

  ranges: true

  "#address-cells":
    const: 1

  "#size-cells":
    const: 1

patternProperties:
  "^led@[0-9a-f]+,[0-9a-f]$":
    $ref: /schemas/leds/register-bit-led.yaml#

required:
  - compatible
  - reg
  - ranges
  - "#address-cells"
  - "#size-cells"

additionalProperties: false

examples:
  - |
    syscon@10000 {
        compatible = "arm,juno-fpga-apb-regs", "syscon", "simple-mfd";
        reg = <0x010000 0x1000>;
        ranges = <0x0 0x10000 0x1000>;
        #address-cells = <1>;
        #size-cells = <1>;

        led@8,0 {
            compatible = "register-bit-led";
            reg = <0x08 0x04>;
            offset = <0x08>;
            mask = <0x01>;
            label = "vexpress:0";
            linux,default-trigger = "heartbeat";
            default-state = "on";
        };
    };
```

## Documentation/devicetree/bindings/arm/arm,morello.yaml
```yaml
# SPDX-License-Identifier: (GPL-2.0-only OR BSD-2-Clause)
%YAML 1.2
---
$id: http://devicetree.org/schemas/arm/arm,morello.yaml#
$schema: http://devicetree.org/meta-schemas/core.yaml#

title: ARM Morello Platforms

maintainers:
  - Vincenzo Frascino <vincenzo.frascino@arm.com>

description: |+
  The Morello architecture is an experimental extension to Armv8.2-A,
  which extends the AArch64 state with the principles proposed in
  version 7 of the Capability Hardware Enhanced RISC Instructions
  (CHERI) ISA.

  ARM's Morello Platforms are built as a research project to explore
  capability architectures based on arm.

properties:
  $nodename:
    const: '/'
  compatible:
    oneOf:
      - description: Arm Morello System Platforms
        items:
          - enum:
              - arm,morello-sdp
              - arm,morello-fvp
          - const: arm,morello

additionalProperties: true

...
```

## Documentation/devicetree/bindings/arm/arm,realview.yaml
```yaml
# SPDX-License-Identifier: (GPL-2.0-only OR BSD-2-Clause)
%YAML 1.2
---
$id: http://devicetree.org/schemas/arm/arm,realview.yaml#
$schema: http://devicetree.org/meta-schemas/core.yaml#

title: ARM RealView Boards

maintainers:
  - Linus Walleij <linus.walleij@linaro.org>

description: |+
  The ARM RealView series of reference designs were built to explore the Arm11,
  Cortex-A8, and Cortex-A9 CPUs. This included new features compared to the
  earlier CPUs such as TrustZone and multicore (MPCore).

properties:
  $nodename:
    const: '/'
  compatible:
    oneOf:
      - description: ARM RealView Emulation Baseboard (HBI-0140) was created
          as a generic platform to test different FPGA designs, and has
          pluggable CPU modules, see ARM DUI 0303E.
        items:
          - const: arm,realview-eb
      - description: ARM RealView Platform Baseboard for ARM1176JZF-S
          (HBI-0147) was created as a development board to test ARM TrustZone,
          CoreSight and Intelligent Energy Management (IEM) see ARM DUI 0425F.
        items:
          - const: arm,realview-pb1176
      - description: ARM RealView Platform Baseboard for ARM 11 MPCore
          (HBI-0159, HBI-0175 and HBI-0176) was created to showcase
          multiprocessing with ARM11 using MPCore using symmetric
          multiprocessing (SMP). See ARM DUI 0351E.
        items:
          - const: arm,realview-pb11mp
      - description: ARM RealView Platform Baseboard for Cortex-A8 (HBI-0178,
          HBI-0176 and HBI-0175) was the first reference platform for the
          Cortex CPU family, including a Cortex-A8 test chip.
        items:
          - const: arm,realview-pba8
      - description: ARM RealView Platform Baseboard Explore for Cortex-A9
          (HBI-0182 and HBI-0183) was the reference platform for the Cortex-A9
          CPU.
        items:
          - const: arm,realview-pbx

  soc:
    description: All RealView boards must provide a soc node in the root of the
      device tree, representing the System-on-Chip since these test chips are
      rather complex.
    type: object
    properties:
      compatible:
        oneOf:
          - items:
              - const: arm,realview-eb-soc
              - const: simple-bus
          - items:
              - const: arm,realview-pb1176-soc
              - const: simple-bus
          - items:
              - const: arm,realview-pb11mp-soc
              - const: simple-bus
          - items:
              - const: arm,realview-pba8-soc
              - const: simple-bus
          - items:
              - const: arm,realview-pbx-soc
              - const: simple-bus

    patternProperties:
      "^.*syscon@[0-9a-f]+$":
        type: object
        description: All RealView boards must provide a syscon system controller
          node inside the soc node.

    required:
      - compatible

required:
  - compatible
  - soc

additionalProperties: true

...
```

## Documentation/devicetree/bindings/arm/arm,scmi.txt
```
System Control and Management Interface (SCMI) Message Protocol
----------------------------------------------------------

The SCMI is intended to allow agents such as OSPM to manage various functions
that are provided by the hardware platform it is running on, including power
and performance functions.

This binding is intended to define the interface the firmware implementing
the SCMI as described in ARM document number ARM DUI 0922B ("ARM System Control
and Management Interface Platform Design Document")[0] provide for OSPM in
the device tree.

Required properties:

The scmi node with the following properties shall be under the /firmware/ node.

- compatible : shall be "arm,scmi"
- mboxes: List of phandle and mailbox channel specifiers. It should contain
	  exactly one or two mailboxes, one for transmitting messages("tx")
	  and another optional for receiving the notifications("rx") if
	  supported.
- shmem : List of phandle pointing to the shared memory(SHM) area as per
	  generic mailbox client binding.
- #address-cells : should be '1' if the device has sub-nodes, maps to
	  protocol identifier for a given sub-node.
- #size-cells : should be '0' as 'reg' property doesn't have any size
	  associated with it.

Optional properties:

- mbox-names: shall be "tx" or "rx" depending on mboxes entries.

See Documentation/devicetree/bindings/mailbox/mailbox.txt for more details
about the generic mailbox controller and client driver bindings.

The mailbox is the only permitted method of calling the SCMI firmware.
Mailbox doorbell is used as a mechanism to alert the presence of a
messages and/or notification.

Each protocol supported shall have a sub-node with corresponding compatible
as described in the following sections. If the platform supports dedicated
communication channel for a particular protocol, the 3 properties namely:
mboxes, mbox-names and shmem shall be present in the sub-node corresponding
to that protocol.

Clock/Performance bindings for the clocks/OPPs based on SCMI Message Protocol
------------------------------------------------------------

This binding uses the common clock binding[1].

Required properties:
- #clock-cells : Should be 1. Contains the Clock ID value used by SCMI commands.

Power domain bindings for the power domains based on SCMI Message Protocol
------------------------------------------------------------

This binding for the SCMI power domain providers uses the generic power
domain binding[2].

Required properties:
 - #power-domain-cells : Should be 1. Contains the device or the power
			 domain ID value used by SCMI commands.

Sensor bindings for the sensors based on SCMI Message Protocol
--------------------------------------------------------------
SCMI provides an API to access the various sensors on the SoC.

Required properties:
- #thermal-sensor-cells: should be set to 1. This property follows the
			 thermal device tree bindings[3].

			 Valid cell values are raw identifiers (Sensor ID)
			 as used by the firmware. Refer to  platform details
			 for your implementation for the IDs to use.

SRAM and Shared Memory for SCMI
-------------------------------

A small area of SRAM is reserved for SCMI communication between application
processors and SCP.

The properties should follow the generic mmio-sram description found in [4]

Each sub-node represents the reserved area for SCMI.

Required sub-node properties:
- reg : The base offset and size of the reserved area with the SRAM
- compatible : should be "arm,scmi-shmem" for Non-secure SRAM based
	       shared memory

[0] http://infocenter.arm.com/help/topic/com.arm.doc.den0056a/index.html
[1] Documentation/devicetree/bindings/clock/clock-bindings.txt
[2] Documentation/devicetree/bindings/power/power_domain.txt
[3] Documentation/devicetree/bindings/thermal/thermal.txt
[4] Documentation/devicetree/bindings/sram/sram.txt

Example:

sram@50000000 {
	compatible = "mmio-sram";
	reg = <0x0 0x50000000 0x0 0x10000>;

	#address-cells = <1>;
	#size-cells = <1>;
	ranges = <0 0x0 0x50000000 0x10000>;

	cpu_scp_lpri: scp-shmem@0 {
		compatible = "arm,scmi-shmem";
		reg = <0x0 0x200>;
	};

	cpu_scp_hpri: scp-shmem@200 {
		compatible = "arm,scmi-shmem";
		reg = <0x200 0x200>;
	};
};

mailbox@40000000 {
	....
	#mbox-cells = <1>;
	reg = <0x0 0x40000000 0x0 0x10000>;
};

firmware {

	...

	scmi {
		compatible = "arm,scmi";
		mboxes = <&mailbox 0 &mailbox 1>;
		mbox-names = "tx", "rx";
		shmem = <&cpu_scp_lpri &cpu_scp_hpri>;
		#address-cells = <1>;
		#size-cells = <0>;

		scmi_devpd: protocol@11 {
			reg = <0x11>;
			#power-domain-cells = <1>;
		};

		scmi_dvfs: protocol@13 {
			reg = <0x13>;
			#clock-cells = <1>;
		};

		scmi_clk: protocol@14 {
			reg = <0x14>;
			#clock-cells = <1>;
		};

		scmi_sensors0: protocol@15 {
			reg = <0x15>;
			#thermal-sensor-cells = <1>;
		};
	};
};

cpu@0 {
	...
	reg = <0 0>;
	clocks = <&scmi_dvfs 0>;
};

hdlcd@7ff60000 {
	...
	reg = <0 0x7ff60000 0 0x1000>;
	clocks = <&scmi_clk 4>;
	power-domains = <&scmi_devpd 1>;
};

thermal-zones {
	soc_thermal {
		polling-delay-passive = <100>;
		polling-delay = <1000>;
					/* sensor ID */
		thermal-sensors = <&scmi_sensors0 3>;
		...
	};
};
```
