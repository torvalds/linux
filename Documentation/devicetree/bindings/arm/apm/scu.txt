## Documentation/devicetree/bindings/arm/arm,coresight-static-funnel.yaml
```yaml
# SPDX-License-Identifier: GPL-2.0-only OR BSD-2-Clause
%YAML 1.2
---
$id: http://devicetree.org/schemas/arm/arm,coresight-static-funnel.yaml#
$schema: http://devicetree.org/meta-schemas/core.yaml#

title: Arm CoreSight Static Trace Bus Funnel

maintainers:
  - Mathieu Poirier <mathieu.poirier@linaro.org>
  - Mike Leach <mike.leach@linaro.org>
  - Leo Yan <leo.yan@linaro.org>
  - Suzuki K Poulose <suzuki.poulose@arm.com>

description: |
  CoreSight components are compliant with the ARM CoreSight architecture
  specification and can be connected in various topologies to suit a particular
  SoCs tracing needs. These trace components can generally be classified as
  sinks, links and sources. Trace data produced by one or more sources flows
  through the intermediate links connecting the source to the currently selected
  sink.

  The Coresight static funnel merges 2-8 trace sources into a single trace
  stream.

properties:
  compatible:
    const: arm,coresight-static-funnel

  power-domains:
    maxItems: 1

  in-ports:
    $ref: /schemas/graph.yaml#/properties/ports

    patternProperties:
      '^port@[0-7]$':
        description: Input connections from CoreSight Trace bus
        $ref: /schemas/graph.yaml#/properties/port

  out-ports:
    $ref: /schemas/graph.yaml#/properties/ports
    additionalProperties: false

    properties:
      port:
        description: Output connection to CoreSight Trace bus
        $ref: /schemas/graph.yaml#/properties/port

required:
  - compatible
  - in-ports
  - out-ports

additionalProperties: false

examples:
  - |
    funnel {
        /*
         * non-configurable replicators don't show up on the
         * AMBA bus.  As such no need to add "arm,primecell".
         */
        compatible = "arm,coresight-static-funnel";

        out-ports {
            port {
                combo_funnel_out: endpoint {
                    remote-endpoint = <&top_funnel_in>;
                };
            };
        };

        in-ports {
            #address-cells = <1>;
            #size-cells = <0>;

            port@0 {
                reg = <0>;
                combo_funnel_in0: endpoint {
                    remote-endpoint = <&cluster0_etf_out>;
                };
            };

            port@1 {
                reg = <1>;
                combo_funnel_in1: endpoint {
                    remote-endpoint = <&cluster1_etf_out>;
                };
            };
        };
    };
...
```

## Documentation/devicetree/bindings/arm/arm,coresight-static-replicator.yaml
```yaml
# SPDX-License-Identifier: GPL-2.0-only OR BSD-2-Clause
%YAML 1.2
---
$id: http://devicetree.org/schemas/arm/arm,coresight-static-replicator.yaml#
$schema: http://devicetree.org/meta-schemas/core.yaml#

title: Arm CoreSight Static Trace Bus Replicator

maintainers:
  - Mathieu Poirier <mathieu.poirier@linaro.org>
  - Mike Leach <mike.leach@linaro.org>
  - Leo Yan <leo.yan@linaro.org>
  - Suzuki K Poulose <suzuki.poulose@arm.com>

description: |
  CoreSight components are compliant with the ARM CoreSight architecture
  specification and can be connected in various topologies to suit a particular
  SoCs tracing needs. These trace components can generally be classified as
  sinks, links and sources. Trace data produced by one or more sources flows
  through the intermediate links connecting the source to the currently selected
  sink.

  The Coresight replicator splits a single trace stream into two trace streams
  for systems that have more than one trace sink component.

properties:
  compatible:
    const: arm,coresight-static-replicator

  power-domains:
    maxItems: 1

  in-ports:
    $ref: /schemas/graph.yaml#/properties/ports
    additionalProperties: false

    properties:
      port:
        description: Input connection from CoreSight Trace bus
        $ref: /schemas/graph.yaml#/properties/port

  out-ports:
    $ref: /schemas/graph.yaml#/properties/ports

    patternProperties:
      '^port@[01]$':
        description: Output connections to CoreSight Trace bus
        $ref: /schemas/graph.yaml#/properties/port

required:
  - compatible
  - in-ports
  - out-ports

additionalProperties: false

examples:
  - |
    replicator {
        /*
         * non-configurable replicators don't show up on the
         * AMBA bus.  As such no need to add "arm,primecell".
         */
        compatible = "arm,coresight-static-replicator";

        out-ports {
            #address-cells = <1>;
            #size-cells = <0>;

            /* replicator output ports */
            port@0 {
                reg = <0>;
                replicator_out_port0: endpoint {
                    remote-endpoint = <&etb_in_port>;
                };
            };

            port@1 {
                reg = <1>;
                replicator_out_port1: endpoint {
                    remote-endpoint = <&tpiu_in_port>;
                };
            };
        };

        in-ports {
            port {
                replicator_in_port0: endpoint {
                    remote-endpoint = <&funnel_out_port0>;
                };
            };
        };
    };
...
```

## Documentation/devicetree/bindings/arm/arm,coresight-stm.yaml
```yaml
# SPDX-License-Identifier: GPL-2.0-only OR BSD-2-Clause
%YAML 1.2
---
$id: http://devicetree.org/schemas/arm/arm,coresight-stm.yaml#
$schema: http://devicetree.org/meta-schemas/core.yaml#

title: Arm CoreSight System Trace MacroCell

maintainers:
  - Mathieu Poirier <mathieu.poirier@linaro.org>
  - Mike Leach <mike.leach@linaro.org>
  - Leo Yan <leo.yan@linaro.org>
  - Suzuki K Poulose <suzuki.poulose@arm.com>

description: |
  CoreSight components are compliant with the ARM CoreSight architecture
  specification and can be connected in various topologies to suit a particular
  SoCs tracing needs. These trace components can generally be classified as
  sinks, links and sources. Trace data produced by one or more sources flows
  through the intermediate links connecting the source to the currently selected
  sink.

  The STM is a trace source that is integrated into a CoreSight system, designed
  primarily for high-bandwidth trace of instrumentation embedded into software.
  This instrumentation is made up of memory-mapped writes to the STM Advanced
  eXtensible Interface (AXI) slave, which carry information about the behavior
  of the software.

select:
  properties:
    compatible:
      contains:
        const: arm,coresight-stm
  required:
    - compatible

allOf:
  - $ref: /schemas/arm/primecell.yaml#

properties:
  compatible:
    items:
      - const: arm,coresight-stm
      - const: arm,primecell

  reg:
    maxItems: 2

  reg-names:
    items:
      - const: stm-base
      - const: stm-stimulus-base

  clocks:
    minItems: 1
    maxItems: 2

  clock-names:
    minItems: 1
    items:
      - const: apb_pclk
      - const: atclk

  power-domains:
    maxItems: 1

  out-ports:
    $ref: /schemas/graph.yaml#/properties/ports
    additionalProperties: false

    properties:
      port:
        description: Output connection to the CoreSight Trace bus.
        $ref: /schemas/graph.yaml#/properties/port

required:
  - compatible
  - reg
  - reg-names
  - clocks
  - clock-names
  - out-ports

unevaluatedProperties: false

examples:
  - |
    stm@20100000 {
        compatible = "arm,coresight-stm", "arm,primecell";
        reg = <0x20100000 0x1000>,
              <0x28000000 0x180000>;
        reg-names = "stm-base", "stm-stimulus-base";

        clocks = <&soc_smc50mhz>;
        clock-names = "apb_pclk";
        out-ports {
            port {
                stm_out_port: endpoint {
                    remote-endpoint = <&main_funnel_in_port2>;
                };
            };
        };
    };
...
```

## Documentation/devicetree/bindings/arm/arm,coresight-tmc.yaml
```yaml
# SPDX-License-Identifier: GPL-2.0-only OR BSD-2-Clause
%YAML 1.2
---
$id: http://devicetree.org/schemas/arm/arm,coresight-tmc.yaml#
$schema: http://devicetree.org/meta-schemas/core.yaml#

title: Arm CoreSight Trace Memory Controller

maintainers:
  - Mathieu Poirier <mathieu.poirier@linaro.org>
  - Mike Leach <mike.leach@linaro.org>
  - Leo Yan <leo.yan@linaro.org>
  - Suzuki K Poulose <suzuki.poulose@arm.com>

description: |
  CoreSight components are compliant with the ARM CoreSight architecture
  specification and can be connected in various topologies to suit a particular
  SoCs tracing needs. These trace components can generally be classified as
  sinks, links and sources. Trace data produced by one or more sources flows
  through the intermediate links connecting the source to the currently selected
  sink.

  Trace Memory Controller is used for Embedded Trace Buffer(ETB), Embedded Trace
  FIFO(ETF) and Embedded Trace Router(ETR) configurations. The configuration
  mode (ETB, ETF, ETR) is discovered at boot time when the device is probed.

# Need a custom select here or 'arm,primecell' will match on lots of nodes
select:
  properties:
    compatible:
      contains:
        const: arm,coresight-tmc
  required:
    - compatible

allOf:
  - $ref: /schemas/arm/primecell.yaml#

properties:
  compatible:
    items:
      - const: arm,coresight-tmc
      - const: arm,primecell

  reg:
    maxItems: 1

  clocks:
    minItems: 1
    maxItems: 2

  clock-names:
    minItems: 1
    items:
      - const: apb_pclk
      - const: atclk

  arm,buffer-size:
    $ref: /schemas/types.yaml#/definitions/uint32
    deprecated: true
    description:
      Size of contiguous buffer space for TMC ETR (embedded trace router). The
      buffer size can be configured dynamically via buffer_size property in
      sysfs instead.

  arm,scatter-gather:
    type: boolean
    description:
      Indicates that the TMC-ETR can safely use the SG mode on this system.

  arm,max-burst-size:
    description:
      The maximum burst size initiated by TMC on the AXI master interface. The
      burst size can be in the range [0..15], the setting supports one data
      transfer per burst up to a maximum of 16 data transfers per burst.
    $ref: /schemas/types.yaml#/definitions/uint32
    maximum: 15

  in-ports:
    $ref: /schemas/graph.yaml#/properties/ports
    additionalProperties: false

    properties:
      port:
        description: Input connection from the CoreSight Trace bus.
        $ref: /schemas/graph.yaml#/properties/port

  out-ports:
    $ref: /schemas/graph.yaml#/properties/ports
    additionalProperties: false

    properties:
      port:
        description: AXI or ATB Master output connection. Used for ETR
          and ETF configurations.
        $ref: /schemas/graph.yaml#/properties/port

required:
  - compatible
  - reg
  - clocks
  - clock-names
  - in-ports

unevaluatedProperties: false

examples:
  - |
    etr@20070000 {
        compatible = "arm,coresight-tmc", "arm,primecell";
        reg = <0x20070000 0x1000>;

        clocks = <&oscclk6a>;
        clock-names = "apb_pclk";
        in-ports {
            port {
                etr_in_port: endpoint {
                    remote-endpoint = <&replicator2_out_port0>;
                };
            };
        };

        out-ports {
            port {
                etr_out_port: endpoint {
                    remote-endpoint = <&catu_in_port>;
                };
            };
        };
    };
...
```

## Documentation/devicetree/bindings/arm/arm,coresight-tpiu.yaml
```yaml
# SPDX-License-Identifier: GPL-2.0-only OR BSD-2-Clause
%YAML 1.2
---
$id: http://devicetree.org/schemas/arm/arm,coresight-tpiu.yaml#
$schema: http://devicetree.org/meta-schemas/core.yaml#

title: Arm CoreSight Trace Port Interface Unit

maintainers:
  - Mathieu Poirier <mathieu.poirier@linaro.org>
  - Mike Leach <mike.leach@linaro.org>
  - Leo Yan <leo.yan@linaro.org>
  - Suzuki K Poulose <suzuki.poulose@arm.com>

description: |
  CoreSight components are compliant with the ARM CoreSight architecture
  specification and can be connected in various topologies to suit a particular
  SoCs tracing needs. These trace components can generally be classified as
  sinks, links and sources. Trace data produced by one or more sources flows
  through the intermediate links connecting the source to the currently selected
  sink.

  The CoreSight Trace Port Interface Unit captures trace data from the trace bus
  and outputs it to an external trace port.

# Need a custom select here or 'arm,primecell' will match on lots of nodes
select:
  properties:
    compatible:
      contains:
        const: arm,coresight-tpiu
  required:
    - compatible

allOf:
  - $ref: /schemas/arm/primecell.yaml#

properties:
  compatible:
    items:
      - const: arm,coresight-tpiu
      - const: arm,primecell

  reg:
    maxItems: 1

  clocks:
    minItems: 1
    maxItems: 2

  clock-names:
    minItems: 1
    items:
      - const: apb_pclk
      - const: atclk

  in-ports:
    $ref: /schemas/graph.yaml#/properties/ports
    additionalProperties: false

    properties:
      port:
        description: Input connection from the CoreSight Trace bus.
        $ref: /schemas/graph.yaml#/properties/port

required:
  - compatible
  - reg
  - clocks
  - clock-names
  - in-ports

unevaluatedProperties: false

examples:
  - |
    tpiu@e3c05000 {
        compatible = "arm,coresight-tpiu", "arm,primecell";
        reg = <0xe3c05000 0x1000>;

        clocks = <&clk_375m>;
        clock-names = "apb_pclk";
        in-ports {
            port {
                tpiu_in_port: endpoint {
                    remote-endpoint = <&funnel4_out_port0>;
                };
            };
        };
    };
...
```

## Documentation/devicetree/bindings/arm/arm,corstone1000.yaml
```yaml
# SPDX-License-Identifier: (GPL-2.0-only OR BSD-2-Clause)
%YAML 1.2
---
$id: http://devicetree.org/schemas/arm/arm,corstone1000.yaml#
$schema: http://devicetree.org/meta-schemas/core.yaml#

title: ARM Corstone1000

maintainers:
  - Abdellatif El Khlifi <abdellatif.elkhlifi@arm.com>
  - Hugues Kamba Mpiana <hugues.kambampiana@arm.com>

description: |+
  ARM's Corstone1000 includes pre-verified Corstone SSE-710 subsystem that
  provides a flexible compute architecture that combines Cortex‑A and Cortex‑M
  processors.

  Support for Cortex‑A32, Cortex‑A35, Cortex‑A53 and Cortex-A320 processors.
  Two expansion systems for M-Class (or other) processors for adding sensors,
  connectivity, video, audio and machine learning at the edge System and
  security IPs to build a secure SoC for a range of rich IoT applications, for
  example gateways, smart cameras and embedded systems.

  Integrated Secure Enclave providing hardware Root of Trust and supporting
  seamless integration of the optional CryptoCell™-312 cryptographic
  accelerator.

properties:
  $nodename:
    const: '/'
  compatible:
    oneOf:
      - description: Corstone1000 MPS3 it has 1 Cortex-A35 CPU core in a FPGA
          implementation of the Corstone1000 in the MPS3 prototyping board. See
          ARM document DAI0550.
        items:
          - const: arm,corstone1000-mps3
      - description: Corstone1000 FVP is the Fixed Virtual Platform
          implementation of this system. See ARM ecosystems FVP's.
        items:
          - const: arm,corstone1000-fvp
      - description: Corstone1000-A320 FVP is the Fixed Virtual Platform
          implementation of this system with Cortex-A320 cores and Ethos-U85
          NPU. See ARM ecosystems FVP's.
        items:
          - const: arm,corstone1000-a320-fvp

additionalProperties: true

...
```
