## Documentation/devicetree/bindings/arm/msm/ssbi.txt
```
* Qualcomm SSBI

Some Qualcomm MSM devices contain a point-to-point serial bus used to
communicate with a limited range of devices (mostly power management
chips).

These require the following properties:

- compatible: "qcom,ssbi"

- qcom,controller-type
  indicates the SSBI bus variant the controller should use to talk
  with the slave device.  This should be one of "ssbi", "ssbi2", or
  "pmic-arbiter".  The type chosen is determined by the attached
  slave.

The slave device should be the single child node of the ssbi device
with a compatible field.
```

## Documentation/devicetree/bindings/arm/msm/timer.txt
```
* MSM Timer

Properties:

- compatible : Should at least contain "qcom,msm-timer". More specific
               properties specify which subsystem the timers are paired with.

               "qcom,kpss-timer" - krait subsystem
               "qcom,scss-timer" - scorpion subsystem

- interrupts : Interrupts for the the debug timer, the first general purpose
               timer, and optionally a second general purpose timer in that
               order.

- reg : Specifies the base address of the timer registers.

- clock-frequency : The frequency of the debug timer and the general purpose
                    timer(s) in Hz in that order.

Optional:

- cpu-offset : per-cpu offset used when the timer is accessed without the
               CPU remapping facilities. The offset is
               cpu-offset + (0x10000 * cpu-nr).

Example:

       timer@200a000 {
               compatible = "qcom,scss-timer", "qcom,msm-timer";
               interrupts = <1 1 0x301>,
                            <1 2 0x301>,
                            <1 3 0x301>;
               reg = <0x0200a000 0x100>;
               clock-frequency = <19200000>,
                                 <32768>;
               cpu-offset = <0x40000>;
       };
```

## Documentation/devicetree/bindings/arm/mstar/mstar,pmsleep.yaml
```yaml
# SPDX-License-Identifier: (GPL-2.0 OR BSD-2-Clause)
# Copyright 2020 thingy.jp.
%YAML 1.2
---
$id: "http://devicetree.org/schemas/arm/mstar/mstar,pmsleep.yaml#"
$schema: "http://devicetree.org/meta-schemas/core.yaml#"

title: MStar/SigmaStar Armv7 SoC pmsleep register region

maintainers:
  - Daniel Palmer <daniel@thingy.jp>

description: |
  MStar/Sigmastar's Armv7 SoCs contain a region of registers that are
  in the always on domain that the vendor code calls the "pmsleep" area.

  This area contains registers and bits for a broad range of functionality
  ranging from registers that control going into deep sleep to bits that
  turn things like the internal temperature sensor on and off.

properties:
  compatible:
    oneOf:
      - items:
         - enum:
             - mstar,pmsleep
         - const: syscon

  reg:
    maxItems: 1

required:
  - compatible
  - reg

additionalProperties: false

examples:
  - |
    pmsleep: pmsleep@1c00 {
        compatible = "mstar,pmsleep", "syscon";
        reg = <0x0x1c00 0x100>;
    };
```

## Documentation/devicetree/bindings/arm/mstar/mstar,smpctrl.yaml
```yaml
# SPDX-License-Identifier: (GPL-2.0 OR BSD-2-Clause)
# Copyright 2020 thingy.jp.
%YAML 1.2
---
$id: "http://devicetree.org/schemas/arm/mstar/mstar,smpctrl.yaml#"
$schema: "http://devicetree.org/meta-schemas/core.yaml#"

title: MStar/SigmaStar Armv7 SoC SMP control registers

maintainers:
  - Daniel Palmer <daniel@thingy.jp>

description: |
  MStar/SigmaStar's Armv7 SoCs that have more than one processor
  have a region of registers that allow setting the boot address
  and a magic number that allows secondary processors to leave
  the loop they are parked in by the boot ROM.

properties:
  compatible:
    items:
      - enum:
          - sstar,ssd201-smpctrl # SSD201/SSD202D
      - const: mstar,smpctrl

  reg:
    maxItems: 1

required:
  - compatible
  - reg

additionalProperties: false

examples:
  - |
    smpctrl@204000 {
        compatible = "sstar,ssd201-smpctrl", "mstar,smpctrl";
        reg = <0x204000 0x200>;
    };
```

## Documentation/devicetree/bindings/arm/mstar/mstar.yaml
```yaml
# SPDX-License-Identifier: (GPL-2.0-only OR BSD-2-Clause)
%YAML 1.2
---
$id: http://devicetree.org/schemas/arm/mstar/mstar.yaml#
$schema: http://devicetree.org/meta-schemas/core.yaml#

title: MStar platforms device tree bindings

maintainers:
  - Daniel Palmer <daniel@thingy.jp>

properties:
  $nodename:
    const: '/'
  compatible:
    oneOf:
      - description: infinity boards
        items:
          - enum:
              - thingyjp,breadbee-crust # thingy.jp BreadBee Crust
          - const: mstar,infinity

      - description: infinity2m boards
        items:
          - enum:
              - honestar,ssd201htv2 # Honestar SSD201_HT_V2 devkit
              - m5stack,unitv2 # M5Stack UnitV2
              - miyoo,miyoo-mini # Miyoo Mini
              - wirelesstag,ido-som2d01 # Wireless Tag IDO-SOM2D01
              - wirelesstag,ido-sbc2d06-v1b-22w # Wireless Tag IDO-SBC2D06-1VB-22W
          - const: mstar,infinity2m

      - description: infinity3 boards
        items:
          - enum:
              - thingyjp,breadbee # thingy.jp BreadBee
          - const: mstar,infinity3

      - description: mercury5 boards
        items:
          - enum:
              - 70mai,midrived08 # 70mai midrive d08
          - const: mstar,mercury5

additionalProperties: true
```

## Documentation/devicetree/bindings/arm/mvebu-system-controller.txt
```
MVEBU System Controller
-----------------------
MVEBU (Marvell SOCs: Armada 370/375/XP, Dove, mv78xx0, Kirkwood, Orion5x)

Required properties:

- compatible: one of:
	- "marvell,orion-system-controller"
	- "marvell,armada-370-xp-system-controller"
	- "marvell,armada-375-system-controller"
- reg: Should contain system controller registers location and length.

Example:

	system-controller@d0018200 {
		compatible = "marvell,armada-370-xp-system-controller";
		reg = <0xd0018200 0x500>;
	};
```

## Documentation/devicetree/bindings/arm/npcm/npcm.txt
```
NPCM Platforms Device Tree Bindings
-----------------------------------
NPCM750 SoC
Required root yesde properties:
	- compatible = "nuvoton,npcm750";
```

## Documentation/devicetree/bindings/arm/npcm/npcm.yaml
```yaml
# SPDX-License-Identifier: GPL-2.0-only OR BSD-2-Clause
%YAML 1.2
---
$id: http://devicetree.org/schemas/arm/npcm/npcm.yaml#
$schema: http://devicetree.org/meta-schemas/core.yaml#

title: NPCM Platforms Device Tree Bindings

maintainers:
  - Jonathan Neuschäfer <j.neuschaefer@gmx.net>

properties:
  $nodename:
    const: '/'
  compatible:
    oneOf:
      - description: WPCM450 based boards
        items:
          - enum:
              - supermicro,x9sci-ln4f-bmc   # Supermicro X9SCI-LN4F server's BMC
          - const: nuvoton,wpcm450

      - description: NPCM750 based boards
        items:
          - enum:
              - nuvoton,npcm750-evb         # NPCM750 evaluation board
          - const: nuvoton,npcm750

additionalProperties: true
```

## Documentation/devicetree/bindings/arm/nspire.txt
```
TI-NSPIRE calculators

Required properties:
- compatible: Compatible property value should contain "ti,nspire".
	CX models should have "ti,nspire-cx"
	Touchpad models should have "ti,nspire-tp"
	Clickpad models should have "ti,nspire-clp"

Example:

/ {
	model = "TI-NSPIRE CX";
	compatible = "ti,nspire-cx";
	...
```

## Documentation/devicetree/bindings/arm/nuvoton/nuvoton,ma35d1.yaml
```yaml
# SPDX-License-Identifier: GPL-2.0-only OR BSD-2-Clause
%YAML 1.2
---
$id: http://devicetree.org/schemas/arm/nuvoton/nuvoton,ma35d1.yaml#
$schema: http://devicetree.org/meta-schemas/core.yaml#

title: Nuvoton MA35 series SoC based platforms

maintainers:
  - Jacky Huang <ychuang3@nuvoton.com>

description: |
  Boards with an ARMv8 based Nuvoton MA35 series SoC shall have
  the following properties.

properties:
  $nodename:
    const: '/'
  compatible:
    oneOf:

      - description: MA35D1 based boards
        items:
          - enum:
              - nuvoton,ma35d1-iot
              - nuvoton,ma35d1-som
          - const: nuvoton,ma35d1

additionalProperties: true
...
```

## Documentation/devicetree/bindings/arm/nvidia,tegra194-ccplex.yaml
```yaml
# SPDX-License-Identifier: (GPL-2.0-only OR BSD-2-Clause)
%YAML 1.2
---
$id: "http://devicetree.org/schemas/arm/nvidia,tegra194-ccplex.yaml#"
$schema: "http://devicetree.org/meta-schemas/core.yaml#"

title: NVIDIA Tegra194 CPU Complex

maintainers:
  - Thierry Reding <thierry.reding@gmail.com>
  - Jonathan Hunter <jonathanh@nvidia.com>
  - Sumit Gupta <sumitg@nvidia.com>

description: |+
  Tegra194 SOC has homogeneous architecture where each cluster has two
  symmetric cores. Compatible string in "cpus" node represents the CPU
  Complex having all clusters.

properties:
  $nodename:
    const: cpus

  compatible:
    enum:
      - nvidia,tegra194-ccplex

  nvidia,bpmp:
    $ref: '/schemas/types.yaml#/definitions/phandle'
    description: |
      Specifies the bpmp node that needs to be queried to get
      operating point data for all CPUs.

additionalProperties: true

examples:
  - |
    cpus {
      compatible = "nvidia,tegra194-ccplex";
      nvidia,bpmp = <&bpmp>;
      #address-cells = <1>;
      #size-cells = <0>;

      cpu0_0: cpu@0 {
        compatible = "nvidia,tegra194-carmel";
        device_type = "cpu";
        reg = <0x0>;
        enable-method = "psci";
      };

      cpu0_1: cpu@1 {
        compatible = "nvidia,tegra194-carmel";
        device_type = "cpu";
        reg = <0x001>;
        enable-method = "psci";
      };

      cpu1_0: cpu@100 {
        compatible = "nvidia,tegra194-carmel";
        device_type = "cpu";
        reg = <0x100>;
        enable-method = "psci";
      };

      cpu1_1: cpu@101 {
        compatible = "nvidia,tegra194-carmel";
        device_type = "cpu";
        reg = <0x101>;
        enable-method = "psci";
      };
    };
...
```

## Documentation/devicetree/bindings/arm/nxp/lpc32xx.txt
```
NXP LPC32xx Platforms Device Tree Bindings
------------------------------------------

Boards with the NXP LPC32xx SoC shall have the following properties:

Required root node property:

compatible: must be "nxp,lpc3220", "nxp,lpc3230", "nxp,lpc3240" or "nxp,lpc3250"
```

## Documentation/devicetree/bindings/arm/nxp/lpc32xx.yaml
```yaml
# SPDX-License-Identifier: GPL-2.0
%YAML 1.2
---
$id: http://devicetree.org/schemas/arm/nxp/lpc32xx.yaml#
$schema: http://devicetree.org/meta-schemas/core.yaml#

title: NXP LPC32xx Platforms

maintainers:
  - Vladimir Zapolskiy <vz@mleia.com>

properties:
  compatible:
    oneOf:
      - enum:
          - nxp,lpc3220
          - nxp,lpc3230
          - nxp,lpc3240
      - items:
          - enum:
              - ea,ea3250
              - phytec,phy3250
          - const: nxp,lpc3250

additionalProperties: true
...
```

## Documentation/devicetree/bindings/arm/olimex.txt
```
Olimex Device Tree Bindings
---------------------------

SAM9-L9260 Board
Required root node properties:
    - compatible = "olimex,sam9-l9260", "atmel,at91sam9260";

i.MX23 Olinuxino Low Cost Board
Required root node properties:
    - compatible = "olimex,imx23-olinuxino", "fsl,imx23";
```

## Documentation/devicetree/bindings/arm/omap/counter.txt
```
OMAP Counter-32K bindings

Required properties:
- compatible:	Must be "ti,omap-counter32k" for OMAP controllers
- reg:		Contains timer register address range (base address and length)
- ti,hwmods:	Name of the hwmod associated to the counter, which is typically
		"counter_32k"

Example:

counter32k: counter@4a304000 {
	compatible = "ti,omap-counter32k";
	reg = <0x4a304000 0x20>;
	ti,hwmods = "counter_32k";
};
```
