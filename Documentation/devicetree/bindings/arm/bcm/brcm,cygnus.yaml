## Documentation/devicetree/bindings/arm/brcm-brcmstb.txt
```
ARM Broadcom STB platforms Device Tree Bindings
-----------------------------------------------
Boards with Broadcom Brahma15 ARM-based BCMxxxx (generally BCM7xxx variants)
SoC shall have the following DT organization:

Required root node properties:
    - compatible: "brcm,bcm<chip_id>", "brcm,brcmstb"

example:
/ {
    #address-cells = <2>;
    #size-cells = <2>;
    model = "Broadcom STB (bcm7445)";
    compatible = "brcm,bcm7445", "brcm,brcmstb";

Further, syscon nodes that map platform-specific registers used for general
system control is required:

    - compatible: "brcm,bcm<chip_id>-sun-top-ctrl", "syscon"
    - compatible: "brcm,bcm<chip_id>-hif-cpubiuctrl", "syscon"
    - compatible: "brcm,bcm<chip_id>-hif-continuation", "syscon"

example:
    rdb {
        #address-cells = <1>;
        #size-cells = <1>;
        compatible = "simple-bus";
        ranges = <0 0x00 0xf0000000 0x1000000>;

        sun_top_ctrl: syscon@404000 {
            compatible = "brcm,bcm7445-sun-top-ctrl", "syscon";
            reg = <0x404000 0x51c>;
        };

        hif_cpubiuctrl: syscon@3e2400 {
            compatible = "brcm,bcm7445-hif-cpubiuctrl", "syscon";
            reg = <0x3e2400 0x5b4>;
        };

        hif_continuation: syscon@452000 {
            compatible = "brcm,bcm7445-hif-continuation", "syscon";
            reg = <0x452000 0x100>;
        };
    };

Lastly, nodes that allow for support of SMP initialization and reboot are
required:

smpboot
-------
Required properties:

    - compatible
        The string "brcm,brcmstb-smpboot".

    - syscon-cpu
        A phandle / integer array property which lets the BSP know the location
        of certain CPU power-on registers.

        The layout of the property is as follows:
            o a phandle to the "hif_cpubiuctrl" syscon node
            o offset to the base CPU power zone register
            o offset to the base CPU reset register

    - syscon-cont
        A phandle pointing to the syscon node which describes the CPU boot
        continuation registers.
            o a phandle to the "hif_continuation" syscon node

example:
    smpboot {
        compatible = "brcm,brcmstb-smpboot";
        syscon-cpu = <&hif_cpubiuctrl 0x88 0x178>;
        syscon-cont = <&hif_continuation>;
    };

reboot
-------
Required properties

    - compatible
        The string property "brcm,brcmstb-reboot".

    - syscon
        A phandle / integer array that points to the syscon node which describes
        the general system reset registers.
            o a phandle to "sun_top_ctrl"
            o offset to the "reset source enable" register
            o offset to the "software master reset" register

example:
    reboot {
        compatible = "brcm,brcmstb-reboot";
        syscon = <&sun_top_ctrl 0x304 0x308>;
    };
```

## Documentation/devicetree/bindings/arm/bst.yaml
```yaml
# SPDX-License-Identifier: GPL-2.0-only OR BSD-2-Clause
%YAML 1.2
---
$id: http://devicetree.org/schemas/arm/bst.yaml#
$schema: http://devicetree.org/meta-schemas/core.yaml#

title: BST platforms

description:
  Black Sesame Technologies (BST) is a semiconductor company that produces
  automotive-grade system-on-chips (SoCs) for intelligent driving, focusing
  on computer vision and AI capabilities. The BST C1200 family includes SoCs
  for ADAS (Advanced Driver Assistance Systems) and autonomous driving
  applications.

maintainers:
  - Ge Gordon <gordon.ge@bst.ai>

properties:
  $nodename:
    const: '/'
  compatible:
    oneOf:
      - description: BST C1200 CDCU1.0 ADAS 4C2G board
        items:
          - const: bst,c1200-cdcu1.0-adas-4c2g
          - const: bst,c1200

additionalProperties: true

...
```

## Documentation/devicetree/bindings/arm/calxeda.txt
```
Calxeda Platforms Device Tree Bindings
-----------------------------------------------

Boards with Calxeda Cortex-A9 based ECX-1000 (Highbank) SOC shall have the
following properties.

Required root node properties:
    - compatible = "calxeda,highbank";


Boards with Calxeda Cortex-A15 based ECX-2000 SOC shall have the following
properties.

Required root node properties:
    - compatible = "calxeda,ecx-2000";
```

## Documentation/devicetree/bindings/arm/calxeda.yaml
```yaml
# SPDX-License-Identifier: (GPL-2.0 OR BSD-2-Clause)
%YAML 1.2
---
$id: http://devicetree.org/schemas/arm/calxeda.yaml#
$schema: http://devicetree.org/meta-schemas/core.yaml#

title: Calxeda Platforms Device Tree Bindings

maintainers:
  - Rob Herring <robh@kernel.org>
description: |+
  Bindings for boards with Calxeda Cortex-A9 based ECX-1000 (Highbank) SOC
  or Cortex-A15 based ECX-2000 SOCs

properties:
  $nodename:
    const: '/'
  compatible:
    items:
      - enum:
          - calxeda,highbank
          - calxeda,ecx-2000
```
