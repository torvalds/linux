## Documentation/devicetree/bindings/arm/bcm/brcm,cygnus.yaml
```yaml
# SPDX-License-Identifier: GPL-2.0
%YAML 1.2
---
$id: http://devicetree.org/schemas/arm/bcm/brcm,cygnus.yaml#
$schema: http://devicetree.org/meta-schemas/core.yaml#

title: Broadcom Cygnus device tree bindings

maintainers:
  - Ray Jui <rjui@broadcom.com>
  - Scott Branden <sbranden@broadcom.com>

properties:
  $nodename:
    const: '/'
  compatible:
    items:
      - enum:
          - brcm,bcm11300
          - brcm,bcm11320
          - brcm,bcm11350
          - brcm,bcm11360
          - brcm,bcm58300
          - brcm,bcm58302
          - brcm,bcm58303
          - brcm,bcm58305
      - const: brcm,cygnus

...
```

## Documentation/devicetree/bindings/arm/bcm/brcm,hr2.txt
```
Broadcom Hurricane 2 device tree bindings
---------------------------------------

Broadcom Hurricane 2 family of SoCs are used for switching control. These SoCs
are based on Broadcom's iProc SoC architecture and feature a single core Cortex
A9 ARM CPUs, DDR2/DDR3 memory, PCIe GEN-2, USB 2.0 and USB 3.0, serial and NAND
flash and a PCIe attached integrated switching engine.

Boards with Hurricane SoCs shall have the following properties:

Required root node property:

BCM53342
compatible = "brcm,bcm53342", "brcm,hr2";
```

## Documentation/devicetree/bindings/arm/bcm/brcm,hr2.yaml
```yaml
# SPDX-License-Identifier: GPL-2.0
%YAML 1.2
---
$id: http://devicetree.org/schemas/arm/bcm/brcm,hr2.yaml#
$schema: http://devicetree.org/meta-schemas/core.yaml#

title: Broadcom Hurricane 2 device tree bindings

description:
  Broadcom Hurricane 2 family of SoCs are used for switching control. These SoCs
  are based on Broadcom's iProc SoC architecture and feature a single core Cortex
  A9 ARM CPUs, DDR2/DDR3 memory, PCIe GEN-2, USB 2.0 and USB 3.0, serial and NAND
  flash and a PCIe attached integrated switching engine.

maintainers:
  - Florian Fainelli <f.fainelli@gmail.com>

properties:
  $nodename:
    const: '/'
  compatible:
    items:
      - enum:
          - ubnt,unifi-switch8
      - const: brcm,bcm53342
      - const: brcm,hr2

additionalProperties: true

...
```

## Documentation/devicetree/bindings/arm/bcm/brcm,ns2.txt
```
Broadcom North Star 2 (NS2) device tree bindings
------------------------------------------------

Boards with NS2 shall have the following properties:

Required root node property:

NS2 SVK board
compatible = "brcm,ns2-svk", "brcm,ns2";
```

## Documentation/devicetree/bindings/arm/bcm/brcm,ns2.yaml
```yaml
# SPDX-License-Identifier: GPL-2.0
%YAML 1.2
---
$id: http://devicetree.org/schemas/arm/bcm/brcm,ns2.yaml#
$schema: http://devicetree.org/meta-schemas/core.yaml#

title: Broadcom North Star 2 (NS2) device tree bindings

maintainers:
  - Ray Jui <rjui@broadcom.com>
  - Scott Branden <sbranden@broadcom.com>

properties:
  $nodename:
    const: '/'
  compatible:
    items:
      - enum:
        - brcm,ns2-svk
        - brcm,ns2-xmc
      - const: brcm,ns2

...
```

## Documentation/devicetree/bindings/arm/bcm/brcm,nsp-cpu-method.txt
```
Broadcom Northstar Plus SoC CPU Enable Method
---------------------------------------------
This binding defines the enable method used for starting secondary
CPU in the following Broadcom SoCs:
  BCM58522, BCM58525, BCM58535, BCM58622, BCM58623, BCM58625, BCM88312

The enable method is specified by defining the following required
properties in the corresponding secondary "cpu" device tree node:
  - enable-method = "brcm,bcm-nsp-smp";
  - secondary-boot-reg = <...>;

The secondary-boot-reg property is a u32 value that specifies the
physical address of the register which should hold the common
entry point for a secondary CPU. This entry is cpu node specific
and should be added per cpu. E.g., in case of NSP (BCM58625) which
is a dual core CPU SoC, this entry should be added to cpu1 node.


Example:
	cpus {
		#address-cells = <1>;
		#size-cells = <0>;

		cpu0: cpu@0 {
			device_type = "cpu";
			compatible = "arm,cortex-a9";
			next-level-cache = <&L2>;
			reg = <0>;
		};

		cpu1: cpu@1 {
			device_type = "cpu";
			compatible = "arm,cortex-a9";
			next-level-cache = <&L2>;
			enable-method = "brcm,bcm-nsp-smp";
			secondary-boot-reg = <0xffff042c>;
			reg = <1>;
		};
	};
```

## Documentation/devicetree/bindings/arm/bcm/brcm,nsp.txt
```
Broadcom Northstar Plus device tree bindings
--------------------------------------------

Broadcom Northstar Plus family of SoCs are used for switching control
and management applications as well as residential router/gateway
applications. The SoC features dual core Cortex A9 ARM CPUs, integrating
several peripheral interfaces including multiple Gigabit Ethernet PHYs,
DDR3 memory, PCIE Gen-2, USB 2.0 and USB 3.0, serial and NAND flash,
SATA and several other IO controllers.

Boards with Northstar Plus SoCs shall have the following properties:

Required root node property:

BCM58522
compatible = "brcm,bcm58522", "brcm,nsp";

BCM58525
compatible = "brcm,bcm58525", "brcm,nsp";

BCM58535
compatible = "brcm,bcm58535", "brcm,nsp";

BCM58622
compatible = "brcm,bcm58622", "brcm,nsp";

BCM58623
compatible = "brcm,bcm58623", "brcm,nsp";

BCM58625
compatible = "brcm,bcm58625", "brcm,nsp";

BCM88312
compatible = "brcm,bcm88312", "brcm,nsp";
```

## Documentation/devicetree/bindings/arm/bcm/brcm,nsp.yaml
```yaml
# SPDX-License-Identifier: GPL-2.0
%YAML 1.2
---
$id: http://devicetree.org/schemas/arm/bcm/brcm,nsp.yaml#
$schema: http://devicetree.org/meta-schemas/core.yaml#

title: Broadcom Northstar Plus

description:
  Broadcom Northstar Plus family of SoCs are used for switching control
  and management applications as well as residential router/gateway
  applications. The SoC features dual core Cortex A9 ARM CPUs, integrating
  several peripheral interfaces including multiple Gigabit Ethernet PHYs,
  DDR3 memory, PCIE Gen-2, USB 2.0 and USB 3.0, serial and NAND flash,
  SATA and several other IO controllers.

maintainers:
  - Ray Jui <rjui@broadcom.com>
  - Scott Branden <sbranden@broadcom.com>

properties:
  $nodename:
    const: '/'
  compatible:
    oneOf:
      - description: BCM58522 based boards
        items:
          - enum:
              - brcm,bcm958522er
          - const: brcm,bcm58522
          - const: brcm,nsp

      - description: BCM58525 based boards
        items:
          - enum:
              - brcm,bcm958525er
              - brcm,bcm958525xmc
          - const: brcm,bcm58525
          - const: brcm,nsp

      - description: BCM58535 based boards
        items:
          - const: brcm,bcm58535
          - const: brcm,nsp

      - description: BCM58622 based boards
        items:
          - enum:
              - brcm,bcm958622hr
          - const: brcm,bcm58622
          - const: brcm,nsp

      - description: BCM58623 based boards
        items:
          - enum:
              - brcm,bcm958623hr
          - const: brcm,bcm58623
          - const: brcm,nsp

      - description: BCM58625 based boards
        items:
          - enum:
              - brcm,bcm958625hr
              - brcm,bcm958625k
              - meraki,mx64
              - meraki,mx64-a0
              - meraki,mx64w
              - meraki,mx64w-a0
              - meraki,mx65
              - meraki,mx65w
          - const: brcm,bcm58625
          - const: brcm,nsp

      - description: BCM88312 based boards
        items:
          - enum:
              - brcm,bcm988312hr
          - const: brcm,bcm88312
          - const: brcm,nsp

additionalProperties: true

...
```

## Documentation/devicetree/bindings/arm/bcm/brcm,stingray.txt
```
Broadcom Stingray device tree bindings
------------------------------------------------

Boards with Stingray shall have the following properties:

Required root node property:

Stingray Combo SVK board
compatible = "brcm,bcm958742k", "brcm,stingray";

Stingray SST100 board
compatible = "brcm,bcm958742t", "brcm,stingray";
```

## Documentation/devicetree/bindings/arm/bcm/brcm,stingray.yaml
```yaml
# SPDX-License-Identifier: GPL-2.0
%YAML 1.2
---
$id: http://devicetree.org/schemas/arm/bcm/brcm,stingray.yaml#
$schema: http://devicetree.org/meta-schemas/core.yaml#

title: Broadcom Stingray

maintainers:
  - Ray Jui <rjui@broadcom.com>
  - Scott Branden <sbranden@broadcom.com>

properties:
  $nodename:
    const: '/'
  compatible:
    items:
      - enum:
          - brcm,bcm958742k
          - brcm,bcm958742t
          - brcm,bcm958802a802x
      - const: brcm,stingray

additionalProperties: true

...
```

## Documentation/devicetree/bindings/arm/bcm/brcm,vulcan-soc.txt
```
Broadcom Vulcan device tree bindings
------------------------------------

Boards with Broadcom Vulcan shall have the following root property:

Broadcom Vulcan Evaluation Board:
  compatible = "brcm,vulcan-eval", "brcm,vulcan-soc";

Generic Vulcan board:
  compatible = "brcm,vulcan-soc";
```

## Documentation/devicetree/bindings/arm/bcm/brcm,vulcan-soc.yaml
```yaml
# SPDX-License-Identifier: GPL-2.0
%YAML 1.2
---
$id: http://devicetree.org/schemas/arm/bcm/brcm,vulcan-soc.yaml#
$schema: http://devicetree.org/meta-schemas/core.yaml#

title: Broadcom Vulcan device tree bindings

maintainers:
  - Robert Richter <rrichter@marvell.com>

properties:
  $nodename:
    const: '/'
  compatible:
    items:
      - enum:
        - brcm,vulcan-eval
        - cavium,thunderx2-cn9900
      - const: brcm,vulcan-soc

...
```

## Documentation/devicetree/bindings/arm/bcm/cygnus.txt
```
Broadcom Cygnus device tree bindings
------------------------------------


Boards with Cygnus SoCs shall have the following properties:

Required root node property:

BCM11300
compatible = "brcm,bcm11300", "brcm,cygnus";

BCM11320
compatible = "brcm,bcm11320", "brcm,cygnus";

BCM11350
compatible = "brcm,bcm11350", "brcm,cygnus";

BCM11360
compatible = "brcm,bcm11360", "brcm,cygnus";

BCM58300
compatible = "brcm,bcm58300", "brcm,cygnus";

BCM58302
compatible = "brcm,bcm58302", "brcm,cygnus";

BCM58303
compatible = "brcm,bcm58303", "brcm,cygnus";

BCM58305
compatible = "brcm,bcm58305", "brcm,cygnus";
```

## Documentation/devicetree/bindings/arm/bcm/kona-resetmgr.txt
```
Broadcom Kona Family Reset Manager
----------------------------------

The reset manager is used on the Broadcom BCM21664 SoC.

Required properties:
  - compatible: brcm,bcm21664-resetmgr
  - reg: memory address & range

Example:
	brcm,resetmgr@35001f00 {
		compatible = "brcm,bcm21664-resetmgr";
		reg = <0x35001f00 0x24>;
	};
```

## Documentation/devicetree/bindings/arm/bcm/raspberrypi,bcm2835-firmware.txt
```
Raspberry Pi VideoCore firmware driver

Required properties:

- compatible:		Should be "raspberrypi,bcm2835-firmware"
- mboxes:		Phandle to the firmware device's Mailbox.
			  (See: ../mailbox/mailbox.txt for more information)

Example:

firmware {
	compatible = "raspberrypi,bcm2835-firmware";
	mboxes = <&mailbox>;
};
```

## Documentation/devicetree/bindings/arm/bcm/raspberrypi,bcm2835-firmware.yaml
```yaml
# SPDX-License-Identifier: GPL-2.0
%YAML 1.2
---
$id: http://devicetree.org/schemas/arm/bcm/raspberrypi,bcm2835-firmware.yaml#
$schema: http://devicetree.org/meta-schemas/core.yaml#

title: Raspberry Pi VideoCore firmware driver

maintainers:
  - Eric Anholt <eric@anholt.net>
  - Stefan Wahren <wahrenst@gmx.net>

select:
  properties:
    compatible:
      contains:
        const: raspberrypi,bcm2835-firmware

  required:
    - compatible

properties:
  compatible:
    items:
      - const: raspberrypi,bcm2835-firmware
      - const: simple-mfd

  mboxes:
    maxItems: 1

  clocks:
    type: object

    properties:
      compatible:
        const: raspberrypi,firmware-clocks

      "#clock-cells":
        const: 1
        description: >
          The argument is the ID of the clocks contained by the
          firmware messages.

    required:
      - compatible
      - "#clock-cells"

  reset:
    type: object

    properties:
      compatible:
        const: raspberrypi,firmware-reset

      "#reset-cells":
        const: 1
        description: >
          The argument is the ID of the firmware reset line to affect.

    required:
      - compatible
      - "#reset-cells"

  pwm:
    type: object

    properties:
      compatible:
        const: raspberrypi,firmware-poe-pwm

      "#pwm-cells":
        # See pwm.yaml in this directory for a description of the cells format.
        const: 2

    required:
      - compatible
      - "#pwm-cells"

    additionalProperties: false

required:
  - compatible
  - mboxes

additionalProperties: false

examples:
  - |
    firmware {
        compatible = "raspberrypi,bcm2835-firmware", "simple-mfd";
        mboxes = <&mailbox>;

        firmware_clocks: clocks {
            compatible = "raspberrypi,firmware-clocks";
            #clock-cells = <1>;
        };

        reset: reset {
            compatible = "raspberrypi,firmware-reset";
            #reset-cells = <1>;
        };

        pwm: pwm {
            compatible = "raspberrypi,firmware-poe-pwm";
            #pwm-cells = <2>;
        };
    };
...
```

## Documentation/devicetree/bindings/arm/bcm2835.txt
```
Broadcom BCM2835 device tree bindings
-------------------------------------------

Boards with the BCM2835 SoC shall have the following properties:

Required root node property:

compatible = "brcm,bcm2835";
```

## Documentation/devicetree/bindings/arm/bcm4708.txt
```
Broadcom BCM4708 device tree bindings
-------------------------------------------

Boards with the BCM4708 SoC shall have the following properties:

Required root node property:

compatible = "brcm,bcm4708";
```

## Documentation/devicetree/bindings/arm/bhf.txt
```
Beckhoff Automation Platforms Device Tree Bindings
--------------------------------------------------

CX9020 Embedded PC
Required root node properties:
    - compatible = "bhf,cx9020", "fsl,imx53";
```

## Documentation/devicetree/bindings/arm/bitmain.yaml
```yaml
# SPDX-License-Identifier: GPL-2.0
%YAML 1.2
---
$id: http://devicetree.org/schemas/arm/bitmain.yaml#
$schema: http://devicetree.org/meta-schemas/core.yaml#

title: Bitmain platform device tree bindings

maintainers:
  - Manivannan Sadhasivam <manivannan.sadhasivam@linaro.org>

properties:
  $nodename:
    const: "/"
  compatible:
    items:
      - enum:
          - bitmain,sophon-edge
      - const: bitmain,bm1880

additionalProperties: true

...
```

## Documentation/devicetree/bindings/arm/blaize.yaml
```yaml
# SPDX-License-Identifier: (GPL-2.0 OR BSD-2-Clause)
%YAML 1.2
---
$id: http://devicetree.org/schemas/arm/blaize.yaml#
$schema: http://devicetree.org/meta-schemas/core.yaml#

title: Blaize Platforms

maintainers:
  - James Cowgill <james.cowgill@blaize.com>
  - Matt Redfearn <matt.redfearn@blaize.com>
  - Neil Jones <neil.jones@blaize.com>
  - Nikolaos Pasaloukos <nikolaos.pasaloukos@blaize.com>

description: |
  Blaize Platforms using SoCs designed by Blaize Inc.

  The products based on the BLZP1600 SoC:

  - BLZP1600-SoM: SoM (System on Module)
  - BLZP1600-CB2: Development board CB2 based on BLZP1600-SoM

  BLZP1600 SoC integrates a dual core ARM Cortex A53 cluster
  and a Blaize Graph Streaming Processor for AI and ML workloads,
  plus a suite of connectivity and other peripherals.

properties:
  $nodename:
    const: '/'
  compatible:
    oneOf:
      - description: Blaize BLZP1600 based boards
        items:
          - enum:
              - blaize,blzp1600-cb2
          - const: blaize,blzp1600

additionalProperties: true

...
```
