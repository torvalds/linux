## Documentation/devicetree/bindings/arm/tegra/nvidia,tegra194-axi2apb.yaml
```yaml
# SPDX-License-Identifier: (GPL-2.0-only OR BSD-2-Clause)
%YAML 1.2
---
$id: http://devicetree.org/schemas/arm/tegra/nvidia,tegra194-axi2apb.yaml#
$schema: http://devicetree.org/meta-schemas/core.yaml#

title: NVIDIA Tegra194 AXI2APB bridge

maintainers:
  - Sumit Gupta <sumitg@nvidia.com>

properties:
  $nodename:
    pattern: "^axi2apb@([0-9a-f]+)$"

  compatible:
    enum:
      - nvidia,tegra194-axi2apb

  reg:
    maxItems: 6
    description: Physical base address and length of registers for all bridges

additionalProperties: false

required:
  - compatible
  - reg

examples:
  - |
    axi2apb: axi2apb@2390000 {
      compatible = "nvidia,tegra194-axi2apb";
      reg = <0x02390000 0x1000>,
            <0x023a0000 0x1000>,
            <0x023b0000 0x1000>,
            <0x023c0000 0x1000>,
            <0x023d0000 0x1000>,
            <0x023e0000 0x1000>;
    };
```
