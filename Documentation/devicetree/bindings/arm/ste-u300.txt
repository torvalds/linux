## Documentation/devicetree/bindings/arm/sunxi/allwinner,sun4i-a10-mbus.yaml
```yaml
# SPDX-License-Identifier: GPL-2.0
%YAML 1.2
---
$id: http://devicetree.org/schemas/arm/sunxi/allwinner,sun4i-a10-mbus.yaml#
$schema: http://devicetree.org/meta-schemas/core.yaml#

title: Allwinner Memory Bus (MBUS) controller

maintainers:
  - Chen-Yu Tsai <wens@csie.org>
  - Maxime Ripard <mripard@kernel.org>

description: |
  The MBUS controller drives the MBUS that other devices in the SoC
  will use to perform DMA. It also has a register interface that
  allows to monitor and control the bandwidth and priorities for
  masters on that bus.

  Each device having to perform their DMA through the MBUS must have
  the interconnects and interconnect-names properties set to the MBUS
  controller and with "dma-mem" as the interconnect name.

properties:
  "#interconnect-cells":
    const: 1
    description:
      The content of the cell is the MBUS ID.

  compatible:
    enum:
      - allwinner,sun5i-a13-mbus
      - allwinner,sun8i-h3-mbus
      - allwinner,sun8i-r40-mbus
      - allwinner,sun50i-a64-mbus
      - allwinner,sun50i-h5-mbus

  reg:
    minItems: 1
    items:
      - description: MBUS interconnect/bandwidth limit/PMU registers
      - description: DRAM controller/PHY registers

  reg-names:
    minItems: 1
    items:
      - const: mbus
      - const: dram

  clocks:
    minItems: 1
    items:
      - description: MBUS interconnect module clock
      - description: DRAM controller/PHY module clock
      - description: Register bus clock, shared by MBUS and DRAM

  clock-names:
    minItems: 1
    items:
      - const: mbus
      - const: dram
      - const: bus

  interrupts:
    maxItems: 1
    description:
      MBUS PMU activity interrupt.

  dma-ranges:
    description:
      See section 2.3.9 of the DeviceTree Specification.

  '#address-cells': true

  '#size-cells': true

required:
  - "#interconnect-cells"
  - compatible
  - reg
  - clocks
  - dma-ranges

if:
  properties:
    compatible:
      contains:
        enum:
          - allwinner,sun8i-h3-mbus
          - allwinner,sun50i-a64-mbus
          - allwinner,sun50i-h5-mbus

then:
  properties:
    reg:
      minItems: 2

    reg-names:
      minItems: 2

    clocks:
      minItems: 3

    clock-names:
      minItems: 3

  required:
    - reg-names
    - clock-names

else:
  properties:
    reg:
      maxItems: 1

    reg-names:
      maxItems: 1

    clocks:
      maxItems: 1

    clock-names:
      maxItems: 1

additionalProperties: false

examples:
  - |
    #include <dt-bindings/clock/sun50i-a64-ccu.h>
    #include <dt-bindings/interrupt-controller/arm-gic.h>

    dram-controller@1c01000 {
        compatible = "allwinner,sun5i-a13-mbus";
        reg = <0x01c01000 0x1000>;
        clocks = <&ccu CLK_MBUS>;
        #address-cells = <1>;
        #size-cells = <1>;
        dma-ranges = <0x00000000 0x40000000 0x20000000>;
        #interconnect-cells = <1>;
    };

  - |
    dram-controller@1c62000 {
        compatible = "allwinner,sun50i-a64-mbus";
        reg = <0x01c62000 0x1000>,
              <0x01c63000 0x1000>;
        reg-names = "mbus", "dram";
        clocks = <&ccu CLK_MBUS>,
                 <&ccu CLK_DRAM>,
                 <&ccu CLK_BUS_DRAM>;
        clock-names = "mbus", "dram", "bus";
        interrupts = <GIC_SPI 69 IRQ_TYPE_LEVEL_HIGH>;
        #address-cells = <1>;
        #size-cells = <1>;
        dma-ranges = <0x00000000 0x40000000 0xc0000000>;
        #interconnect-cells = <1>;
    };

...
```

## Documentation/devicetree/bindings/arm/sunxi/allwinner,sun6i-a31-cpuconfig.yaml
```yaml
# SPDX-License-Identifier: (GPL-2.0 OR BSD-2-Clause)
%YAML 1.2
---
$id: http://devicetree.org/schemas/arm/sunxi/allwinner,sun6i-a31-cpuconfig.yaml#
$schema: http://devicetree.org/meta-schemas/core.yaml#

title: Allwinner CPU Configuration Controller Device Tree Bindings

maintainers:
  - Chen-Yu Tsai <wens@csie.org>
  - Maxime Ripard <mripard@kernel.org>

properties:
  compatible:
    enum:
      - allwinner,sun6i-a31-cpuconfig
      - allwinner,sun8i-a23-cpuconfig
      - allwinner,sun8i-a83t-cpucfg
      - allwinner,sun8i-a83t-r-cpucfg
      - allwinner,sun9i-a80-cpucfg

  reg:
    maxItems: 1

required:
  - compatible
  - reg

additionalProperties: false

examples:
  - |
      cpucfg@1f01c00 {
          compatible = "allwinner,sun6i-a31-cpuconfig";
          reg = <0x01f01c00 0x300>;
      };

...
```

## Documentation/devicetree/bindings/arm/sunxi/allwinner,sun9i-a80-prcm.yaml
```yaml
# SPDX-License-Identifier: (GPL-2.0 OR BSD-2-Clause)
%YAML 1.2
---
$id: http://devicetree.org/schemas/arm/sunxi/allwinner,sun9i-a80-prcm.yaml#
$schema: http://devicetree.org/meta-schemas/core.yaml#

title: Allwinner A80 PRCM Device Tree Bindings

maintainers:
  - Chen-Yu Tsai <wens@csie.org>
  - Maxime Ripard <mripard@kernel.org>

properties:
  compatible:
    const: allwinner,sun9i-a80-prcm

  reg:
    maxItems: 1

required:
  - compatible
  - reg

additionalProperties: false

examples:
  - |
      prcm@8001400 {
          compatible = "allwinner,sun9i-a80-prcm";
          reg = <0x08001400 0x200>;
      };

...
```

## Documentation/devicetree/bindings/arm/sunxi/smp-sram.txt
```
Allwinner SRAM for smp bringup:
------------------------------------------------

Allwinner's A80 SoC uses part of the secure sram for hotplugging of the
primary core (cpu0). Once the core gets powered up it checks if a magic
value is set at a specific location. If it is then the BROM will jump
to the software entry address, instead of executing a standard boot.

Therefore a reserved section sub-node has to be added to the mmio-sram
declaration.

Note that this is separate from the Allwinner SRAM controller found in
../../sram/sunxi-sram.txt. This SRAM is secure only and not mappable to
any device.

Also there are no "secure-only" properties. The implementation should
check if this SRAM is usable first.

Required sub-node properties:
- compatible : depending on the SoC this should be one of:
		"allwinner,sun9i-a80-smp-sram"

The rest of the properties should follow the generic mmio-sram discription
found in ../../misc/sram.txt

Example:

	sram_b: sram@20000 {
		/* 256 KiB secure SRAM at 0x20000 */
		compatible = "mmio-sram";
		reg = <0x00020000 0x40000>;
		#address-cells = <1>;
		#size-cells = <1>;
		ranges = <0 0x00020000 0x40000>;

		smp-sram@1000 {
			/*
			 * This is checked by BROM to determine if
			 * cpu0 should jump to SMP entry vector
			 */
			compatible = "allwinner,sun9i-a80-smp-sram";
			reg = <0x1000 0x8>;
		};
	};
```

## Documentation/devicetree/bindings/arm/sunxi/sunxi-mbus.txt
```
Allwinner Memory Bus (MBUS) controller

The MBUS controller drives the MBUS that other devices in the SoC will
use to perform DMA. It also has a register interface that allows to
monitor and control the bandwidth and priorities for masters on that
bus.

Required properties:
 - compatible: Must be one of:
	- allwinner,sun5i-a13-mbus
	- allwinner,sun8i-h3-mbus
 - reg: Offset and length of the register set for the controller
 - clocks: phandle to the clock driving the controller
 - dma-ranges: See section 2.3.9 of the DeviceTree Specification
 - #interconnect-cells: Must be one, with the argument being the MBUS
   port ID

Each device having to perform their DMA through the MBUS must have the
interconnects and interconnect-names properties set to the MBUS
controller and with "dma-mem" as the interconnect name.

Example:

mbus: dram-controller@1c01000 {
	compatible = "allwinner,sun5i-a13-mbus";
	reg = <0x01c01000 0x1000>;
	clocks = <&ccu CLK_MBUS>;
	dma-ranges = <0x00000000 0x40000000 0x20000000>;
	#interconnect-cells = <1>;
};

fe0: display-frontend@1e00000 {
	compatible = "allwinner,sun5i-a13-display-frontend";
	...
	interconnects = <&mbus 19>;
	interconnect-names = "dma-mem";
};
```

## Documentation/devicetree/bindings/arm/swir.txt
```
Sierra Wireless Modules device tree bindings
--------------------------------------------

Supported Modules :
 - WP8548 : Includes MDM9615 and PM8018 in a module

Sierra Wireless modules shall have the following properties :
  Required root node property
   - compatible: "swir,wp8548" for the WP8548 CF3 Module

Board compatible values:
  - "swir,mangoh-green-wp8548" for the mangOH green board with the WP8548 module
```

## Documentation/devicetree/bindings/arm/syna.txt
```
Synaptics SoC Device Tree Bindings

According to https://www.synaptics.com/company/news/conexant-marvell
Synaptics has acquired the Multimedia Solutions Business of Marvell, so
berlin SoCs are now Synaptics' SoCs now.

---------------------------------------------------------------

Boards with a SoC of the Marvell Berlin family, e.g. Armada 1500
shall have the following properties:

* Required root node properties:
compatible: must contain "marvell,berlin"

In addition, the above compatible shall be extended with the specific
SoC and board used. Currently known SoC compatibles are:
    "marvell,berlin2"      for Marvell Armada 1500 (BG2, 88DE3100),
    "marvell,berlin2cd"    for Marvell Armada 1500-mini (BG2CD, 88DE3005)
    "marvell,berlin2ct"    for Marvell Armada ? (BG2CT, 88DE????)
    "marvell,berlin2q"     for Marvell Armada 1500-pro (BG2Q, 88DE3114)
    "marvell,berlin3"      for Marvell Armada ? (BG3, 88DE????)

* Example:

/ {
	model = "Sony NSZ-GS7";
	compatible = "sony,nsz-gs7", "marvell,berlin2", "marvell,berlin";

	...
}

* Marvell Berlin CPU control bindings

CPU control register allows various operations on CPUs, like resetting them
independently.

Required properties:
- compatible: should be "marvell,berlin-cpu-ctrl"
- reg: address and length of the register set

Example:

cpu-ctrl@f7dd0000 {
	compatible = "marvell,berlin-cpu-ctrl";
	reg = <0xf7dd0000 0x10000>;
};

* Marvell Berlin2 chip control binding

Marvell Berlin SoCs have a chip control register set providing several
individual registers dealing with pinmux, padmux, clock, reset, and secondary
CPU boot address. Unfortunately, the individual registers are spread among the
chip control registers, so there should be a single DT node only providing the
different functions which are described below.

Required properties:
- compatible:
	* the first and second values must be:
		"simple-mfd", "syscon"
- reg: address and length of following register sets for
  BG2/BG2CD: chip control register set
  BG2Q: chip control register set and cpu pll registers

* Marvell Berlin2 system control binding

Marvell Berlin SoCs have a system control register set providing several
individual registers dealing with pinmux, padmux, and reset.

Required properties:
- compatible:
	* the first and second values must be:
		"simple-mfd", "syscon"
- reg: address and length of the system control register set

Example:

chip: chip-control@ea0000 {
	compatible = "simple-mfd", "syscon";
	reg = <0xea0000 0x400>;

	/* sub-device nodes */
};

sysctrl: system-controller@d000 {
	compatible = "simple-mfd", "syscon";
	reg = <0xd000 0x100>;

	/* sub-device nodes */
};
```

## Documentation/devicetree/bindings/arm/technologic.txt
```
Technologic Systems Platforms Device Tree Bindings
--------------------------------------------------

TS-4600 is a System-on-Module based on the Freescale i.MX28 System-on-Chip.
It can be mounted on a carrier board providing additional peripheral connectors.
Required root node properties:
	- compatible = "technologic,imx28-ts4600", "fsl,imx28"

TS-4800 board
Required root node properties:
	- compatible = "technologic,imx51-ts4800", "fsl,imx51";

TS-4900 is a System-on-Module based on the Freescale i.MX6 System-on-Chip.
It can be mounted on a carrier board providing additional peripheral connectors.
Required root node properties:
	- compatible = "technologic,imx6dl-ts4900", "fsl,imx6dl"
	- compatible = "technologic,imx6q-ts4900", "fsl,imx6q"

TS-7970 is a System-on-Module based on the Freescale i.MX6 System-on-Chip.
It can be mounted on a carrier board providing additional peripheral connectors.
Required root node properties:
	- compatible = "technologic,imx6dl-ts7970", "fsl,imx6dl"
	- compatible = "technologic,imx6q-ts7970", "fsl,imx6q"
```

## Documentation/devicetree/bindings/arm/tegra.txt
```
NVIDIA Tegra device tree bindings
-------------------------------------------

SoCs
-------------------------------------------

Each device tree must specify which Tegra SoC it uses, using one of the
following compatible values:

  nvidia,tegra20
  nvidia,tegra30
  nvidia,tegra114
  nvidia,tegra124
  nvidia,tegra132
  nvidia,tegra210
  nvidia,tegra186
  nvidia,tegra194

Boards
-------------------------------------------

Each device tree must specify which one or more of the following
board-specific compatible values:

  ad,medcom-wide
  ad,plutux
  ad,tamonten
  ad,tec
  compal,paz00
  compulab,trimslice
  nvidia,beaver
  nvidia,cardhu
  nvidia,cardhu-a02
  nvidia,cardhu-a04
  nvidia,dalmore
  nvidia,harmony
  nvidia,jetson-tk1
  nvidia,norrin
  nvidia,p2371-0000
  nvidia,p2371-2180
  nvidia,p2571
  nvidia,p2771-0000
  nvidia,p2972-0000
  nvidia,roth
  nvidia,seaboard
  nvidia,tn7
  nvidia,ventana
  toradex,apalis_t30
  toradex,apalis_t30-eval
  toradex,apalis_t30-v1.1
  toradex,apalis_t30-v1.1-eval
  toradex,apalis-tk1
  toradex,apalis-tk1-eval
  toradex,apalis-tk1-v1.2
  toradex,apalis-tk1-v1.2-eval
  toradex,colibri_t20
  toradex,colibri_t20-eval-v3
  toradex,colibri_t20-iris
  toradex,colibri_t30
  toradex,colibri_t30-eval-v3

Trusted Foundations
-------------------------------------------
Tegra supports the Trusted Foundation secure monitor. See the
"tlm,trusted-foundations" binding's documentation for more details.
```
