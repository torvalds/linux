## Documentation/devicetree/bindings/arm/ste-u300.txt
```
ST-Ericsson U300 Device Tree Bindings

For various board the "board" node may contain specific properties
that pertain to this particular board, such as board-specific GPIOs
or board power regulator supplies.

Required root node property:

compatible="stericsson,u300";

Required node: syscon
This contains the system controller.
- compatible: must be "stericsson,u300-syscon".
- reg: the base address and size of the system controller.

Boards with the U300 SoC include:

S365 "Small Board U365":

Required node: s365
This contains the board-specific information.
- compatible: must be "stericsson,s365".
- vana15-supply: the regulator supplying the 1.5V to drive the
  board.
- syscon: a pointer to the syscon node so we can acccess the
  syscon registers to set the board as self-powered.

Example:

/ {
	model = "ST-Ericsson U300";
	compatible = "stericsson,u300";
	#address-cells = <1>;
	#size-cells = <1>;

	s365 {
		compatible = "stericsson,s365";
		vana15-supply = <&ab3100_ldo_d_reg>;
		syscon = <&syscon>;
	};

	syscon: syscon@c0011000 {
		compatible = "stericsson,u300-syscon";
		reg = <0xc0011000 0x1000>;
	};
};
```

## Documentation/devicetree/bindings/arm/sti.txt
```
ST STi Platforms Device Tree Bindings
---------------------------------------

Boards with the ST STiH415 SoC shall have the following properties:
Required root node property:
compatible = "st,stih415";

Boards with the ST STiH416 SoC shall have the following properties:
Required root node property:
compatible = "st,stih416";

Boards with the ST STiH407 SoC shall have the following properties:
Required root node property:
compatible = "st,stih407";
```

## Documentation/devicetree/bindings/arm/sti.yaml
```yaml
# SPDX-License-Identifier: (GPL-2.0-only OR BSD-2-Clause)
%YAML 1.2
---
$id: http://devicetree.org/schemas/arm/sti.yaml#
$schema: http://devicetree.org/meta-schemas/core.yaml#

title: ST STi Platforms

maintainers:
  - Patrice Chotard <patrice.chotard@foss.st.com>

properties:
  $nodename:
    const: '/'
  compatible:
    oneOf:
      - items:
          - enum:
              - st,stih410-b2260
          - const: st,stih410
      - items:
          - enum:
              - st,stih418-b2199
              - st,stih418-b2264
          - const: st,stih418

additionalProperties: true

...
```

## Documentation/devicetree/bindings/arm/stm32.txt
```
STMicroelectronics STM32 Platforms Device Tree Bindings

Each device tree must specify which STM32 SoC it uses,
using one of the following compatible strings:

  st,stm32f429
  st,stm32f469
  st,stm32f746
  st,stm32h743
  st,stm32mp157
```

## Documentation/devicetree/bindings/arm/stm32/mlahb.txt
```
ML-AHB interconnect bindings

These bindings describe the STM32 SoCs ML-AHB interconnect bus which connects
a Cortex-M subsystem with dedicated memories.
The MCU SRAM and RETRAM memory parts can be accessed through different addresses
(see "RAM aliases" in [1]) using different buses (see [2]) : balancing the
Cortex-M firmware accesses among those ports allows to tune the system
performance.

[1]: https://www.st.com/resource/en/reference_manual/dm00327659.pdf
[2]: https://wiki.st.com/stm32mpu/wiki/STM32MP15_RAM_mapping

Required properties:
- compatible: should be "simple-bus"
- dma-ranges: describes memory addresses translation between the local CPU and
	   the remote Cortex-M processor. Each memory region, is declared with
	   3 parameters:
		 - param 1: device base address (Cortex-M processor address)
		 - param 2: physical base address (local CPU address)
		 - param 3: size of the memory region.

The Cortex-M remote processor accessed via the mlahb interconnect is described
by a child node.

Example:
mlahb {
	compatible = "simple-bus";
	#address-cells = <1>;
	#size-cells = <1>;
	dma-ranges = <0x00000000 0x38000000 0x10000>,
		     <0x10000000 0x10000000 0x60000>,
		     <0x30000000 0x30000000 0x60000>;

	m4_rproc: m4@10000000 {
		...
	};
};
```

## Documentation/devicetree/bindings/arm/stm32/st,mlahb.yaml
```yaml
# SPDX-License-Identifier: (GPL-2.0 OR BSD-2-Clause)
%YAML 1.2
---
$id: http://devicetree.org/schemas/arm/stm32/st,mlahb.yaml#
$schema: http://devicetree.org/meta-schemas/core.yaml#

title: STMicroelectronics STM32 ML-AHB interconnect

maintainers:
  - Fabien Dessenne <fabien.dessenne@foss.st.com>
  - Arnaud Pouliquen <arnaud.pouliquen@foss.st.com>

description: |
  These bindings describe the STM32 SoCs ML-AHB interconnect bus which connects
  a Cortex-M subsystem with dedicated memories. The MCU SRAM and RETRAM memory
  parts can be accessed through different addresses (see "RAM aliases" in [1])
  using different buses (see [2]): balancing the Cortex-M firmware accesses
  among those ports allows to tune the system performance.
  [1]: https://www.st.com/resource/en/reference_manual/dm00327659.pdf
  [2]: https://wiki.st.com/stm32mpu/wiki/STM32MP15_RAM_mapping

allOf:
  - $ref: /schemas/simple-bus.yaml#

properties:
  compatible:
    contains:
      enum:
        - st,mlahb

  dma-ranges:
    description: |
      Describe memory addresses translation between the local CPU and the
      remote Cortex-M processor. Each memory region, is declared with
      3 parameters:
      - param 1: device base address (Cortex-M processor address)
      - param 2: physical base address (local CPU address)
      - param 3: size of the memory region.
    maxItems: 3

  '#address-cells':
    const: 1

  '#size-cells':
    const: 1

required:
  - compatible
  - '#address-cells'
  - '#size-cells'
  - dma-ranges

unevaluatedProperties: false

examples:
  - |
    mlahb: ahb@38000000 {
      compatible = "st,mlahb", "simple-bus";
      #address-cells = <1>;
      #size-cells = <1>;
      reg = <0x10000000 0x40000>;
      ranges;
      dma-ranges = <0x00000000 0x38000000 0x10000>,
                   <0x10000000 0x10000000 0x60000>,
                   <0x30000000 0x30000000 0x60000>;

      m4_rproc: m4@10000000 {
       reg = <0x10000000 0x40000>;
      };
    };

...
```

## Documentation/devicetree/bindings/arm/stm32/stm32-syscon.txt
```
STMicroelectronics STM32 Platforms System Controller

Properties:
   - compatible : should contain two values. First value must be :
                 - " st,stm32mp157-syscfg " - for stm32mp157 based SoCs,
                 second value must be always "syscon".
   - reg : offset and length of the register set.

 Example:
         syscfg: syscon@50020000 {
                 compatible = "st,stm32mp157-syscfg", "syscon";
                 reg = <0x50020000 0x400>;
         };
```

## Documentation/devicetree/bindings/arm/stm32/stm32.yaml
```yaml
# SPDX-License-Identifier: GPL-2.0
%YAML 1.2
---
$id: http://devicetree.org/schemas/arm/stm32/stm32.yaml#
$schema: http://devicetree.org/meta-schemas/core.yaml#

title: STMicroelectronics STM32 Platforms

maintainers:
  - Alexandre Torgue <alexandre.torgue@foss.st.com>

properties:
  $nodename:
    const: "/"
  compatible:
    oneOf:
      - description: emtrion STM32MP1 Argon based Boards
        items:
          - const: emtrion,stm32mp157c-emsbc-argon
          - const: emtrion,stm32mp157c-emstamp-argon
          - const: st,stm32mp157
      - items:
          - enum:
              - st,stm32f429i-disco
              - st,stm32429i-eval
          - const: st,stm32f429
      - items:
          - enum:
              - st,stm32f469i-disco
          - const: st,stm32f469
      - items:
          - enum:
              - st,stm32f746-disco
              - st,stm32746g-eval
          - const: st,stm32f746
      - items:
          - enum:
              - st,stm32f769-disco
          - const: st,stm32f769
      - items:
          - enum:
              - st,stm32h743i-disco
              - st,stm32h743i-eval
          - const: st,stm32h743
      - items:
          - enum:
              - st,stm32h750i-art-pi
          - const: st,stm32h750
      - items:
          - enum:
              - st,stm32mp135f-dk
          - const: st,stm32mp135

      - description: ST STM32MP151 based Boards
        items:
          - enum:
              - prt,prtt1a   # Protonic PRTT1A
              - prt,prtt1c   # Protonic PRTT1C
              - prt,prtt1s   # Protonic PRTT1S
          - const: st,stm32mp151

      - description: DH STM32MP151 DHCOR SoM based Boards
        items:
          - const: dh,stm32mp151a-dhcor-testbench
          - const: dh,stm32mp151a-dhcor-som
          - const: st,stm32mp151

      - description: DH STM32MP153 DHCOM SoM based Boards
        items:
          - const: dh,stm32mp153c-dhcom-drc02
          - const: dh,stm32mp153c-dhcom-som
          - const: st,stm32mp153

      - description: DH STM32MP153 DHCOR SoM based Boards
        items:
          - const: dh,stm32mp153c-dhcor-drc-compact
          - const: dh,stm32mp153c-dhcor-som
          - const: st,stm32mp153

      - items:
          - enum:
              - shiratech,stm32mp157a-iot-box # IoT Box
              - shiratech,stm32mp157a-stinger96 # Stinger96
              - st,stm32mp157c-ed1
              - st,stm32mp157a-dk1
              - st,stm32mp157c-dk2
          - const: st,stm32mp157

      - items:
          - const: st,stm32mp157a-dk1-scmi
          - const: st,stm32mp157a-dk1
          - const: st,stm32mp157
      - items:
          - const: st,stm32mp157c-dk2-scmi
          - const: st,stm32mp157c-dk2
          - const: st,stm32mp157
      - items:
          - const: st,stm32mp157c-ed1-scmi
          - const: st,stm32mp157c-ed1
          - const: st,stm32mp157
      - items:
          - const: st,stm32mp157c-ev1
          - const: st,stm32mp157c-ed1
          - const: st,stm32mp157
      - items:
          - const: st,stm32mp157c-ev1-scmi
          - const: st,stm32mp157c-ev1
          - const: st,stm32mp157c-ed1
          - const: st,stm32mp157

      - description: DH STM32MP1 SoM based Boards
        items:
          - enum:
              - arrow,stm32mp157a-avenger96 # Avenger96
          - const: dh,stm32mp157a-dhcor-som
          - const: st,stm32mp157

      - description: DH STM32MP1 SoM based Boards
        items:
          - enum:
              - dh,stm32mp157c-dhcom-pdk2
              - dh,stm32mp157c-dhcom-picoitx
          - const: dh,stm32mp157c-dhcom-som
          - const: st,stm32mp157

      - description: Engicam i.Core STM32MP1 SoM based Boards
        items:
          - enum:
              - engicam,icore-stm32mp1-ctouch2       # STM32MP1 Engicam i.Core STM32MP1 C.TOUCH 2.0
              - engicam,icore-stm32mp1-ctouch2-of10  # STM32MP1 Engicam i.Core STM32MP1 C.TOUCH 2.0 10.1" OF
              - engicam,icore-stm32mp1-edimm2.2      # STM32MP1 Engicam i.Core STM32MP1 EDIMM2.2 Starter Kit
          - const: engicam,icore-stm32mp1            # STM32MP1 Engicam i.Core STM32MP1 SoM
          - const: st,stm32mp157

      - description: Engicam MicroGEA STM32MP1 SoM based Boards
        items:
          - enum:
              - engicam,microgea-stm32mp1-microdev2.0
              - engicam,microgea-stm32mp1-microdev2.0-of7
          - const: engicam,microgea-stm32mp1
          - const: st,stm32mp157

      - description: Octavo OSD32MP15x System-in-Package based boards
        items:
          - enum:
              - lxa,stm32mp157c-mc1      # Linux Automation MC-1
              - lxa,stm32mp157c-tac-gen1 # Linux Automation TAC (Generation 1)
              - lxa,stm32mp157c-tac-gen2 # Linux Automation TAC (Generation 2)
          - const: oct,stm32mp15xx-osd32
          - enum:
              - st,stm32mp157

      - description: Odyssey STM32MP1 SoM based Boards
        items:
          - enum:
              - seeed,stm32mp157c-odyssey
          - const: seeed,stm32mp157c-odyssey-som
          - const: st,stm32mp157

      - description: Phytec STM32MP1 SoM based Boards
        items:
          - const: phytec,phycore-stm32mp1-3
          - const: phytec,phycore-stm32mp157c-som
          - const: st,stm32mp157

      - description: ST STM32MP257 based Boards
        items:
          - enum:
              - st,stm32mp257f-ev1
          - const: st,stm32mp257

additionalProperties: true

...
```

## Documentation/devicetree/bindings/arm/sunplus,sp7021.yaml
```yaml
# SPDX-License-Identifier: (GPL-2.0-only OR BSD-2-Clause)
# Copyright (C) Sunplus Co., Ltd. 2021
%YAML 1.2
---
$id: http://devicetree.org/schemas/arm/sunplus,sp7021.yaml#
$schema: http://devicetree.org/meta-schemas/core.yaml#

title: Sunplus SP7021 Boards

maintainers:
  - qinjian <qinjian@cqplus1.com>

description: |
  ARM platforms using Sunplus SP7021, an ARM Cortex A7 (4-cores) based SoC.
  Wiki: https://sunplus-tibbo.atlassian.net/wiki/spaces/doc/overview

properties:
  $nodename:
    const: '/'
  compatible:
    items:
      - enum:
          - sunplus,sp7021-achip
          - sunplus,sp7021-demo-v3
      - const: sunplus,sp7021

additionalProperties: true

...
```

## Documentation/devicetree/bindings/arm/sunxi.txt
```
Allwinner sunXi Platforms Device Tree Bindings

Each device tree must specify which Allwinner SoC it uses,
using one of the following compatible strings:

  allwinner,sun4i-a10
  allwinner,sun5i-a10s
  allwinner,sun5i-a13
  allwinner,sun5i-r8
  allwinner,sun6i-a31
  allwinner,sun7i-a20
  allwinner,sun8i-a23
  allwinner,sun8i-a33
  allwinner,sun8i-a83t
  allwinner,sun8i-h2-plus
  allwinner,sun8i-h3
  allwinner,sun8i-r40
  allwinner,sun8i-t3
  allwinner,sun8i-v3s
  allwinner,sun9i-a80
  allwinner,sun50i-a64
  allwinner,suniv-f1c100s
  nextthing,gr8
```
