## Documentation/devicetree/bindings/arm/axentia.txt
```
Device tree bindings for Axentia ARM devices
============================================

Linea CPU module
----------------

Required root node properties:
compatible = "axentia,linea",
	     "atmel,sama5d31", "atmel,sama5d3", "atmel,sama5";
and following the rules from atmel-at91.txt for a sama5d31 SoC.


Nattis v2 board with Natte v2 power board
-----------------------------------------

Required root node properties:
compatible = "axentia,nattis-2", "axentia,natte-2", "axentia,linea",
	     "atmel,sama5d31", "atmel,sama5d3", "atmel,sama5";
and following the rules from above for the axentia,linea CPU module.


TSE-850 v3 board
----------------

Required root node properties:
compatible = "axentia,tse850v3", "axentia,linea",
	     "atmel,sama5d31", "atmel,sama5d3", "atmel,sama5";
and following the rules from above for the axentia,linea CPU module.
```

## Documentation/devicetree/bindings/arm/axiado.yaml
```yaml
# SPDX-License-Identifier: GPL-2.0-only OR BSD-2-Clause
%YAML 1.2
---
$id: http://devicetree.org/schemas/arm/axiado.yaml#
$schema: http://devicetree.org/meta-schemas/core.yaml#

title: Axiado Platforms

maintainers:
  - Harshit Shah <hshah@axiado.com>

properties:
  $nodename:
    const: '/'
  compatible:
    oneOf:
      - description: AX3000 based boards
        items:
          - enum:
              - axiado,ax3000-evk       # Axiado AX3000 Evaluation Board
          - const: axiado,ax3000       # Axiado AX3000 SoC

additionalProperties: true
```

## Documentation/devicetree/bindings/arm/axis.txt
```
Axis Communications AB
ARTPEC series SoC Device Tree Bindings

ARTPEC-6 ARM SoC
================

Required root node properties:
- compatible = "axis,artpec6";

ARTPEC-6 Development board:
---------------------------
Required root node properties:
- compatible = "axis,artpec6-dev-board", "axis,artpec6";
```

## Documentation/devicetree/bindings/arm/axis.yaml
```yaml
# SPDX-License-Identifier: GPL-2.0-only OR BSD-2-Clause
%YAML 1.2
---
$id: http://devicetree.org/schemas/arm/axis.yaml#
$schema: http://devicetree.org/meta-schemas/core.yaml#

title: Axis ARTPEC platforms

maintainers:
  - Jesper Nilsson <jesper.nilsson@axis.com>
  - Lars Persson <lars.persson@axis.com>
  - linux-arm-kernel@axis.com

description: |
  ARM platforms using SoCs designed by Axis branded as "ARTPEC".

properties:
  $nodename:
    const: '/'
  compatible:
    oneOf:
      - description: Axis ARTPEC-6 SoC board
        items:
          - enum:
              - axis,artpec6-dev-board
          - const: axis,artpec6

      - description: Axis ARTPEC-8 SoC board
        items:
          - enum:
              - axis,artpec8-grizzly
          - const: axis,artpec8

additionalProperties: true

...
```

## Documentation/devicetree/bindings/arm/axxia.txt
```
Axxia AXM55xx device tree bindings

Boards using the AXM55xx SoC need to have the following properties:

Required root node property:

  - compatible = "lsi,axm5516"

Boards:

  LSI AXM5516 Validation board (Amarillo)
	compatible = "lsi,axm5516-amarillo", "lsi,axm5516"
```

## Documentation/devicetree/bindings/arm/axxia.yaml
```yaml
# SPDX-License-Identifier: GPL-2.0
%YAML 1.2
---
$id: http://devicetree.org/schemas/arm/axxia.yaml#
$schema: http://devicetree.org/meta-schemas/core.yaml#

title: Axxia AXM55xx device tree bindings

maintainers:
  - Anders Berg <anders.berg@lsi.com>

properties:
  $nodename:
    const: "/"
  compatible:
    description: LSI AXM5516 Validation board (Amarillo)
    items:
      - const: lsi,axm5516-amarillo
      - const: lsi,axm5516

additionalProperties: true

...
```

## Documentation/devicetree/bindings/arm/bcm/bcm,kona-timer.txt
```
Broadcom Kona Family timer
-----------------------------------------------------
This timer is used in the following Broadcom SoCs:
 BCM11130, BCM11140, BCM11351, BCM28145, BCM28155

Required properties:
- compatible : "bcm,kona-timer"
- reg : Register range for the timer
- interrupts : interrupt for the timer
- clock-frequency: frequency that the clock operates

Example:
	timer@35006000 {
		compatible = "bcm,kona-timer";
		reg = <0x35006000 0x1000>;
		interrupts = <0x0 7 0x4>;
		clock-frequency = <32768>;
	};
```

## Documentation/devicetree/bindings/arm/bcm/bcm11351.txt
```
Broadcom BCM11351 device tree bindings
-------------------------------------------

Boards with the bcm281xx SoC family (which includes bcm11130, bcm11140,
bcm11351, bcm28145, bcm28155 SoCs) shall have the following properties:

Required root node property:

compatible = "brcm,bcm11351";
DEPRECATED: compatible = "bcm,bcm11351";
```

## Documentation/devicetree/bindings/arm/bcm/bcm2835.yaml
```yaml
# SPDX-License-Identifier: GPL-2.0
%YAML 1.2
---
$id: http://devicetree.org/schemas/arm/bcm/bcm2835.yaml#
$schema: http://devicetree.org/meta-schemas/core.yaml#

title: Broadcom BCM2711/BCM2835 Platforms Device Tree Bindings

maintainers:
  - Eric Anholt <eric@anholt.net>
  - Stefan Wahren <wahrenst@gmx.net>

properties:
  $nodename:
    const: '/'
  compatible:
    oneOf:
      - description: BCM2835 based Boards
        items:
          - enum:
              - raspberrypi,model-a
              - raspberrypi,model-a-plus
              - raspberrypi,model-b
              - raspberrypi,model-b-i2c0  # Raspberry Pi Model B (no P5)
              - raspberrypi,model-b-rev2
              - raspberrypi,model-b-plus
              - raspberrypi,compute-module
              - raspberrypi,model-zero
              - raspberrypi,model-zero-w
          - const: brcm,bcm2835

      - description: BCM2836 based Boards
        items:
          - enum:
              - raspberrypi,2-model-b
          - const: brcm,bcm2836

      - description: BCM2837 based Boards
        items:
          - enum:
              - raspberrypi,3-model-a-plus
              - raspberrypi,3-model-b
              - raspberrypi,3-model-b-plus
              - raspberrypi,3-compute-module
              - raspberrypi,3-compute-module-lite
          - const: brcm,bcm2837

...
```

## Documentation/devicetree/bindings/arm/bcm/bcm63138.txt
```
Broadcom BCM63138 DSL System-on-a-Chip device tree bindings
-----------------------------------------------------------

Boards compatible with the BCM63138 DSL System-on-a-Chip should have the
following properties:

Required root node property:

compatible: should be "brcm,bcm63138"
```

## Documentation/devicetree/bindings/arm/bcm/brcm,bcm11351-cpu-method.txt
```
Broadcom Kona Family CPU Enable Method
--------------------------------------
This binding defines the enable method used for starting secondary
CPUs in the following Broadcom SoCs:
  BCM11130, BCM11140, BCM11351, BCM28145, BCM28155, BCM21664

The enable method is specified by defining the following required
properties in the "cpus" device tree node:
  - enable-method = "brcm,bcm11351-cpu-method";
  - secondary-boot-reg = <...>;

The secondary-boot-reg property is a u32 value that specifies the
physical address of the register used to request the ROM holding pen
code release a secondary CPU.  The value written to the register is
formed by encoding the target CPU id into the low bits of the
physical start address it should jump to.

Example:
	cpus {
		#address-cells = <1>;
		#size-cells = <0>;
		enable-method = "brcm,bcm11351-cpu-method";
		secondary-boot-reg = <0x3500417c>;

		cpu0: cpu@0 {
			device_type = "cpu";
			compatible = "arm,cortex-a9";
			reg = <0>;
		};

		cpu1: cpu@1 {
			device_type = "cpu";
			compatible = "arm,cortex-a9";
			reg = <1>;
		};
	};
```

## Documentation/devicetree/bindings/arm/bcm/brcm,bcm11351.yaml
```yaml
# SPDX-License-Identifier: GPL-2.0
%YAML 1.2
---
$id: http://devicetree.org/schemas/arm/bcm/brcm,bcm11351.yaml#
$schema: http://devicetree.org/meta-schemas/core.yaml#

title: Broadcom BCM11351 device tree bindings

maintainers:
  - Florian Fainelli <f.fainelli@gmail.com>

properties:
  $nodename:
    const: '/'
  compatible:
    items:
      - enum:
          - brcm,bcm28155-ap
      - const: brcm,bcm11351

...
```

## Documentation/devicetree/bindings/arm/bcm/brcm,bcm21664.txt
```
Broadcom BCM21664 device tree bindings
--------------------------------------

This document describes the device tree bindings for boards with the BCM21664
SoC.

Required root node property:
  - compatible: brcm,bcm21664

Example:
	/ {
		model = "BCM21664 SoC";
		compatible = "brcm,bcm21664";
		[...]
	}
```

## Documentation/devicetree/bindings/arm/bcm/brcm,bcm21664.yaml
```yaml
# SPDX-License-Identifier: GPL-2.0
%YAML 1.2
---
$id: http://devicetree.org/schemas/arm/bcm/brcm,bcm21664.yaml#
$schema: http://devicetree.org/meta-schemas/core.yaml#

title: Broadcom BCM21664 device tree bindings

maintainers:
  - Florian Fainelli <f.fainelli@gmail.com>

properties:
  $nodename:
    const: '/'
  compatible:
    items:
      - enum:
          - brcm,bcm21664-garnet
      - const: brcm,bcm21664

...
```

## Documentation/devicetree/bindings/arm/bcm/brcm,bcm23550-cpu-method.txt
```
Broadcom Kona Family CPU Enable Method
--------------------------------------
This binding defines the enable method used for starting secondary
CPUs in the following Broadcom SoCs:
  BCM23550

The enable method is specified by defining the following required
properties in the "cpu" device tree node:
  - enable-method = "brcm,bcm23550";
  - secondary-boot-reg = <...>;

The secondary-boot-reg property is a u32 value that specifies the
physical address of the register used to request the ROM holding pen
code release a secondary CPU.  The value written to the register is
formed by encoding the target CPU id into the low bits of the
physical start address it should jump to.

Example:
	cpus {
		#address-cells = <1>;
		#size-cells = <0>;

		cpu0: cpu@0 {
			device_type = "cpu";
			compatible = "arm,cortex-a9";
			reg = <0>;
		};

		cpu1: cpu@1 {
			device_type = "cpu";
			compatible = "arm,cortex-a9";
			reg = <1>;
			enable-method = "brcm,bcm23550";
			secondary-boot-reg = <0x3500417c>;
		};
	};
```

## Documentation/devicetree/bindings/arm/bcm/brcm,bcm23550.txt
```
Broadcom BCM23550 device tree bindings
--------------------------------------

This document describes the device tree bindings for boards with the BCM23550
SoC.

Required root node property:
  - compatible: brcm,bcm23550

Example:
	/ {
		model = "BCM23550 SoC";
		compatible = "brcm,bcm23550";
		[...]
	}
```

## Documentation/devicetree/bindings/arm/bcm/brcm,bcm23550.yaml
```yaml
# SPDX-License-Identifier: GPL-2.0
%YAML 1.2
---
$id: http://devicetree.org/schemas/arm/bcm/brcm,bcm23550.yaml#
$schema: http://devicetree.org/meta-schemas/core.yaml#

title: Broadcom BCM23550

maintainers:
  - Florian Fainelli <f.fainelli@gmail.com>

properties:
  $nodename:
    const: '/'
  compatible:
    items:
      - enum:
          - brcm,bcm23550-sparrow
      - const: brcm,bcm23550

additionalProperties: true

...
```

## Documentation/devicetree/bindings/arm/bcm/brcm,bcm2835.txt
```
Broadcom BCM2835 device tree bindings
-------------------------------------------

Raspberry Pi Model A
Required root node properties:
compatible = "raspberrypi,model-a", "brcm,bcm2835";

Raspberry Pi Model A+
Required root node properties:
compatible = "raspberrypi,model-a-plus", "brcm,bcm2835";

Raspberry Pi Model B
Required root node properties:
compatible = "raspberrypi,model-b", "brcm,bcm2835";

Raspberry Pi Model B (no P5)
early model B with I2C0 rather than I2C1 routed to the expansion header
Required root node properties:
compatible = "raspberrypi,model-b-i2c0", "brcm,bcm2835";

Raspberry Pi Model B rev2
Required root node properties:
compatible = "raspberrypi,model-b-rev2", "brcm,bcm2835";

Raspberry Pi Model B+
Required root node properties:
compatible = "raspberrypi,model-b-plus", "brcm,bcm2835";

Raspberry Pi 2 Model B
Required root node properties:
compatible = "raspberrypi,2-model-b", "brcm,bcm2836";

Raspberry Pi 3 Model B
Required root node properties:
compatible = "raspberrypi,3-model-b", "brcm,bcm2837";

Raspberry Pi Compute Module
Required root node properties:
compatible = "raspberrypi,compute-module", "brcm,bcm2835";

Raspberry Pi Zero
Required root node properties:
compatible = "raspberrypi,model-zero", "brcm,bcm2835";

Generic BCM2835 board
Required root node properties:
compatible = "brcm,bcm2835";
```

## Documentation/devicetree/bindings/arm/bcm/brcm,bcm4708.txt
```
Broadcom BCM4708 device tree bindings
-------------------------------------------

Boards with the BCM4708 SoC shall have the following properties:

Required root node property:

bcm4708
compatible = "brcm,bcm4708";

bcm4709
compatible = "brcm,bcm4709";

bcm53012
compatible = "brcm,bcm53012";
```

## Documentation/devicetree/bindings/arm/bcm/brcm,bcm4708.yaml
```yaml
# SPDX-License-Identifier: GPL-2.0
%YAML 1.2
---
$id: http://devicetree.org/schemas/arm/bcm/brcm,bcm4708.yaml#
$schema: http://devicetree.org/meta-schemas/core.yaml#

title: Broadcom BCM4708

description:
  Broadcom BCM4708/47081/4709/47094/53012 Wi-Fi/network SoCs based
  on the iProc architecture (Northstar).

maintainers:
  - Florian Fainelli <f.fainelli@gmail.com>
  - Hauke Mehrtens <hauke@hauke-m.de>
  - Rafal Milecki <zajec5@gmail.com>

properties:
  $nodename:
    const: '/'
  compatible:
    oneOf:
      - description: BCM4708 based boards
        items:
          - enum:
              - asus,rt-ac56u
              - asus,rt-ac68u
              - buffalo,wzr-1166dhp
              - buffalo,wzr-1166dhp2
              - buffalo,wzr-1750dhp
              - linksys,ea6300-v1
              - linksys,ea6500-v2
              - luxul,xap-1510-v1
              - luxul,xwc-1000
              - netgear,r6250-v1
              - netgear,r6300-v2
              - smartrg,sr400ac
              - brcm,bcm94708
          - const: brcm,bcm4708

      - description: BCM47081 based boards
        items:
          - enum:
              - asus,rt-n18u
              - buffalo,wzr-600dhp2
              - buffalo,wzr-900dhp
              - luxul,xap-1410-v1
              - luxul,xwr-1200-v1
              - tplink,archer-c5-v2
          - const: brcm,bcm47081
          - const: brcm,bcm4708

      - description: BCM4709 based boards
        items:
          - enum:
              - asus,rt-ac87u
              - buffalo,wxr-1900dhp
              - linksys,ea9200
              - netgear,r7000
              - netgear,r8000
              - tplink,archer-c9-v1
              - brcm,bcm94709
          - const: brcm,bcm4709
          - const: brcm,bcm4708

      - description: BCM47094 based boards
        items:
          - enum:
              - asus,rt-ac3100
              - asus,rt-ac88u
              - dlink,dir-885l
              - dlink,dir-890l
              - linksys,panamera
              - luxul,abr-4500-v1
              - luxul,xap-1610-v1
              - luxul,xbr-4500-v1
              - luxul,xwc-2000-v1
              - luxul,xwr-3100-v1
              - luxul,xwr-3150-v1
              - netgear,r8500
              - phicomm,k3
          - const: brcm,bcm47094
          - const: brcm,bcm4708

      - description: BCM53012 based boards
        items:
          - enum:
              - brcm,bcm953012er
              - brcm,bcm953012hr
              - brcm,bcm953012k
          - const: brcm,bcm53012
          - const: brcm,bcm4708

      - description: BCM53015 based boards
        items:
          - enum:
              - meraki,mr26
          - const: brcm,bcm53015
          - const: brcm,bcm4708

      - description: BCM53016 based boards
        items:
          - enum:
              - dlink,dwl-8610ap
              - meraki,mr32
          - const: brcm,bcm53016
          - const: brcm,bcm4708

additionalProperties: true

...
```
